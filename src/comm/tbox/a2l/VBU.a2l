ASAP2_VERSION 1 31
/begin PROJECT ProjectName "Project Comment Goes Here"
/begin HEADER "Header Comments go here" /end HEADER
/begin MODULE ModuleName "Module Comment Goes Here"
/begin MOD_COMMON "Mod Common Comment Here" BYTE_ORDER MSB_LAST /end MOD_COMMON
/begin RECORD_LAYOUT Scalar_BOOLEAN FNC_VALUES 1 UBYTE COLUMN_DIR DIRECT /end RECORD_LAYOUT
/begin RECORD_LAYOUT Scalar_UBYTE FNC_VALUES 1 UBYTE COLUMN_DIR DIRECT /end RECORD_LAYOUT
/begin RECORD_LAYOUT Scalar_BYTE FNC_VALUES 1 SBYTE COLUMN_DIR DIRECT /end RECORD_LAYOUT
/begin RECORD_LAYOUT Scalar_UWORD FNC_VALUES 1 UWORD COLUMN_DIR DIRECT /end RECORD_LAYOUT
/begin RECORD_LAYOUT Scalar_FLOAT32_IEEE FNC_VALUES 1 FLOAT32_IEEE COLUMN_DIR DIRECT /end RECORD_LAYOUT
/begin RECORD_LAYOUT Lookup1D_FLOAT32_IEEE FNC_VALUES 1 FLOAT32_IEEE COLUMN_DIR DIRECT /end RECORD_LAYOUT
/begin RECORD_LAYOUT Lookup1D_X_FLOAT32_IEEE AXIS_PTS_X 1 FLOAT32_IEEE INDEX_INCR DIRECT /end RECORD_LAYOUT
/begin RECORD_LAYOUT Lookup1D_X_FLOAT64_IEEE AXIS_PTS_X 1 FLOAT64_IEEE INDEX_INCR DIRECT /end RECORD_LAYOUT
/begin RECORD_LAYOUT Lookup2D_X_UBYTE AXIS_PTS_X 1 UBYTE INDEX_INCR DIRECT /end RECORD_LAYOUT
/begin RECORD_LAYOUT Lookup2D_BYTE FNC_VALUES 1 SBYTE COLUMN_DIR DIRECT /end RECORD_LAYOUT
/begin RECORD_LAYOUT Lookup2D_X_BYTE AXIS_PTS_X 1 SBYTE INDEX_INCR DIRECT /end RECORD_LAYOUT
/begin RECORD_LAYOUT Lookup2D_FLOAT32_IEEE FNC_VALUES 1 FLOAT32_IEEE COLUMN_DIR DIRECT /end RECORD_LAYOUT
/begin RECORD_LAYOUT Lookup2D_X_FLOAT32_IEEE AXIS_PTS_X 1 FLOAT32_IEEE INDEX_INCR DIRECT /end RECORD_LAYOUT
/begin AXIS_PTS TQD_vSgndSpd_CUR_x "" 0x7001498a TQD_vVehSpd Lookup1D_X_FLOAT32_IEEE 0 VBU0513_CM_single_kph 21 -250.0 250.0 /end AXIS_PTS
/begin CHARACTERISTIC DSPL_numRngCalcAch_CUR_v "" CURVE 0x70011f8e Lookup1D_FLOAT32_IEEE 0 VBU0513_CM_single_cnt 0.0 1.0E+10
 /begin AXIS_DESCR COM_AXIS NO_INPUT_QUANTITY VBU0513_CM_single_A 5 -1000.0 1000.0 AXIS_PTS_REF DSPL_iBattAch_CUR_x /end AXIS_DESCR
/end CHARACTERISTIC
/begin AXIS_PTS DSPL_iBattAch_CUR_x "" 0x70011f66 NO_INPUT_QUANTITY Lookup1D_X_FLOAT32_IEEE 0 VBU0513_CM_single_A 5 -1000.0 1000.0 /end AXIS_PTS
/begin CHARACTERISTIC DSPL_numRngCalcDch_CUR_v "" CURVE 0x70011fa2 Lookup1D_FLOAT32_IEEE 0 VBU0513_CM_single_cnt 0.0 1.0E+10
 /begin AXIS_DESCR COM_AXIS NO_INPUT_QUANTITY VBU0513_CM_single_A 5 -1000.0 1000.0 AXIS_PTS_REF DSPL_iBattDch_CUR_x /end AXIS_DESCR
/end CHARACTERISTIC
/begin AXIS_PTS DSPL_iBattDch_CUR_x "" 0x70011f7a NO_INPUT_QUANTITY Lookup1D_X_FLOAT32_IEEE 0 VBU0513_CM_single_A 5 -1000.0 1000.0 /end AXIS_PTS
/begin CHARACTERISTIC EDIS_pwrChrgCurrntOverDelta_CUR_v "" CURVE 0x70011b02 Lookup1D_FLOAT32_IEEE 0 VBU0513_CM_single_cnt -3.4028234663852886E+38 3.4028234663852886E+38
 /begin AXIS_DESCR COM_AXIS NO_INPUT_QUANTITY VBU0513_CM_single_cnt 2 -3.4028234663852886E+38 3.4028234663852886E+38 AXIS_PTS_REF EDIS_iChrgCurrntOverDelta_CUR_x /end AXIS_DESCR
/end CHARACTERISTIC
/begin AXIS_PTS EDIS_iChrgCurrntOverDelta_CUR_x "" 0x70011af2 NO_INPUT_QUANTITY Lookup1D_X_FLOAT32_IEEE 0 VBU0513_CM_single_cnt 2 -3.4028234663852886E+38 3.4028234663852886E+38 /end AXIS_PTS
/begin CHARACTERISTIC EDIS_facChrgCurrLimBaseSoc_CUR_v "" CURVE 0x70011aea Lookup1D_FLOAT32_IEEE 0 VBU0513_CM_single_cnt -3.4028234663852886E+38 3.4028234663852886E+38
 /begin AXIS_DESCR COM_AXIS NO_INPUT_QUANTITY VBU0513_CM_single_cnt 2 -3.4028234663852886E+38 3.4028234663852886E+38 AXIS_PTS_REF EDIS_pctBattSocChrgCurrLim_CUR_x /end AXIS_DESCR
/end CHARACTERISTIC
/begin AXIS_PTS EDIS_pctBattSocChrgCurrLim_CUR_x "" 0x70011afa NO_INPUT_QUANTITY Lookup1D_X_FLOAT32_IEEE 0 VBU0513_CM_single_cnt 2 -3.4028234663852886E+38 3.4028234663852886E+38 /end AXIS_PTS
/begin CHARACTERISTIC EDIS_facUpGradPwr_MAP_v "" MAP 0x7001ae6a Lookup2D_FLOAT32_IEEE 0 VBU0513_CM_single_cnt -3.4028234663852886E+38 3.4028234663852886E+38
 /begin AXIS_DESCR COM_AXIS TQO_trqRMotr VBU0513_CM_single_cnt 13 -3.4028234663852886E+38 3.4028234663852886E+38 AXIS_PTS_REF EDIS_facUpGradPwr_MAP_y /end AXIS_DESCR
 /begin AXIS_DESCR COM_AXIS SPD_vVehSpd VBU0513_CM_single_cnt 17 -3.4028234663852886E+38 3.4028234663852886E+38 AXIS_PTS_REF EDIS_facUpGradPwr_MAP_x /end AXIS_DESCR
/end CHARACTERISTIC
/begin AXIS_PTS EDIS_facUpGradPwr_MAP_x "" 0x70013e62 SPD_vVehSpd Lookup2D_X_FLOAT32_IEEE 0 VBU0513_CM_single_cnt 17 -3.4028234663852886E+38 3.4028234663852886E+38 /end AXIS_PTS
/begin AXIS_PTS EDIS_facUpGradPwr_MAP_y "" 0x700137fa TQO_trqRMotr Lookup2D_X_FLOAT32_IEEE 0 VBU0513_CM_single_cnt 13 -3.4028234663852886E+38 3.4028234663852886E+38 /end AXIS_PTS
/begin CHARACTERISTIC EDIS_facChPwrKd_CUR_v "" CURVE 0x70012ad6 Lookup1D_FLOAT32_IEEE 0 VBU0513_CM_single_cnt -3.4028234663852886E+38 3.4028234663852886E+38
 /begin AXIS_DESCR COM_AXIS NO_INPUT_QUANTITY VBU0513_CM_single_cnt 10 -3.4028234663852886E+38 3.4028234663852886E+38 AXIS_PTS_REF EDIS_facChPwrKd_CUR_x /end AXIS_DESCR
/end CHARACTERISTIC
/begin AXIS_PTS EDIS_facChPwrKd_CUR_x "" 0x70012afe NO_INPUT_QUANTITY Lookup1D_X_FLOAT32_IEEE 0 VBU0513_CM_single_cnt 10 -3.4028234663852886E+38 3.4028234663852886E+38 /end AXIS_PTS
/begin CHARACTERISTIC EDIS_facChPwrBaseDiffKp_CUR_v "" CURVE 0x700145ee Lookup1D_FLOAT32_IEEE 0 VBU0513_CM_single_cnt -3.4028234663852886E+38 3.4028234663852886E+38
 /begin AXIS_DESCR COM_AXIS EDIS_pwrRgnDelta VBU0513_CM_single_cnt 21 -3.4028234663852886E+38 3.4028234663852886E+38 AXIS_PTS_REF EDIS_pwrChPwrBaseDiffKp_CUR_x /end AXIS_DESCR
/end CHARACTERISTIC
/begin AXIS_PTS EDIS_pwrChPwrBaseDiffKp_CUR_x "" 0x700146ea EDIS_pwrRgnDelta Lookup1D_X_FLOAT32_IEEE 0 VBU0513_CM_single_cnt 21 -3.4028234663852886E+38 3.4028234663852886E+38 /end AXIS_PTS
/begin CHARACTERISTIC EDIS_facChPwrKi_MAP_v "" MAP 0x700161fe Lookup2D_FLOAT32_IEEE 0 VBU0513_CM_single_cnt -3.4028234663852886E+38 3.4028234663852886E+38
 /begin AXIS_DESCR COM_AXIS EDIS_pwrChLimDynRaw VBU0513_CM_single_cnt 10 -3.4028234663852886E+38 3.4028234663852886E+38 AXIS_PTS_REF EDIS_facChPwrKi_MAP_y /end AXIS_DESCR
 /begin AXIS_DESCR COM_AXIS EDIS_pwrRgnDelta VBU0513_CM_single_cnt 11 -3.4028234663852886E+38 3.4028234663852886E+38 AXIS_PTS_REF EDIS_facChPwrKi_MAP_x /end AXIS_DESCR
/end CHARACTERISTIC
/begin AXIS_PTS EDIS_facChPwrKi_MAP_x "" 0x70012e66 EDIS_pwrRgnDelta Lookup2D_X_FLOAT32_IEEE 0 VBU0513_CM_single_cnt 11 -3.4028234663852886E+38 3.4028234663852886E+38 /end AXIS_PTS
/begin AXIS_PTS EDIS_facChPwrKi_MAP_y "" 0x70012b26 EDIS_pwrChLimDynRaw Lookup2D_X_FLOAT32_IEEE 0 VBU0513_CM_single_cnt 10 -3.4028234663852886E+38 3.4028234663852886E+38 /end AXIS_PTS
/begin CHARACTERISTIC EDIS_facDisChPwrBaseDiffKp_CUR_v "" CURVE 0x70014696 Lookup1D_FLOAT32_IEEE 0 VBU0513_CM_single_cnt -3.4028234663852886E+38 3.4028234663852886E+38
 /begin AXIS_DESCR COM_AXIS EDIS_pwrDchaDelta VBU0513_CM_single_cnt 21 -3.4028234663852886E+38 3.4028234663852886E+38 AXIS_PTS_REF EDIS_pwrDisChPwrBaseDiffKp_CUR_x /end AXIS_DESCR
/end CHARACTERISTIC
/begin AXIS_PTS EDIS_pwrDisChPwrBaseDiffKp_CUR_x "" 0x70014792 EDIS_pwrDchaDelta Lookup1D_X_FLOAT32_IEEE 0 VBU0513_CM_single_cnt 21 -3.4028234663852886E+38 3.4028234663852886E+38 /end AXIS_PTS
/begin CHARACTERISTIC EDIS_facDisChPwrKi_MAP_v "" MAP 0x700163b6 Lookup2D_FLOAT32_IEEE 0 VBU0513_CM_single_cnt -3.4028234663852886E+38 3.4028234663852886E+38
 /begin AXIS_DESCR COM_AXIS EDIS_pwrDisChLimDynST VBU0513_CM_single_cnt 10 -3.4028234663852886E+38 3.4028234663852886E+38 AXIS_PTS_REF EDIS_facDisChPwrKi_MAP_y /end AXIS_DESCR
 /begin AXIS_DESCR COM_AXIS EDIS_pwrDchaDelta VBU0513_CM_single_cnt 11 -3.4028234663852886E+38 3.4028234663852886E+38 AXIS_PTS_REF EDIS_facDisChPwrKi_MAP_x /end AXIS_DESCR
/end CHARACTERISTIC
/begin AXIS_PTS EDIS_facDisChPwrKi_MAP_x "" 0x70012e92 EDIS_pwrDchaDelta Lookup2D_X_FLOAT32_IEEE 0 VBU0513_CM_single_cnt 11 -3.4028234663852886E+38 3.4028234663852886E+38 /end AXIS_PTS
/begin AXIS_PTS EDIS_facDisChPwrKi_MAP_y "" 0x70012b4e EDIS_pwrDisChLimDynST Lookup2D_X_FLOAT32_IEEE 0 VBU0513_CM_single_cnt 10 -3.4028234663852886E+38 3.4028234663852886E+38 /end AXIS_PTS
/begin CHARACTERISTIC SPD_pctSlope_CUR_v "" CURVE 0x7001225a Lookup1D_FLOAT32_IEEE 0 VBU0513_CM_single_cnt -3.4028234663852886E+38 3.4028234663852886E+38
 /begin AXIS_DESCR COM_AXIS SPD_aXSlope VBU0513_CM_single_cnt 6 -3.4028234663852886E+38 3.4028234663852886E+38 AXIS_PTS_REF SPD_aXSlope_CUR_x /end AXIS_DESCR
/end CHARACTERISTIC
/begin AXIS_PTS SPD_aXSlope_CUR_x "" 0x70012242 SPD_aXSlope Lookup1D_X_FLOAT32_IEEE 0 VBU0513_CM_single_cnt 6 -3.4028234663852886E+38 3.4028234663852886E+38 /end AXIS_PTS
/begin CHARACTERISTIC TQD_pctCrpCtrlBrkPctS_CUR_v "" CURVE 0x70012736 Lookup1D_FLOAT32_IEEE 0 VBU0513_CM_single_fac 0.0 2.0
 /begin AXIS_DESCR COM_AXIS BPD_pctBrkPos VBU0513_CM_single_cnt 8 0.0 100.0 AXIS_PTS_REF TQD_rCrpCtrlBrkPct_CUR_x /end AXIS_DESCR
/end CHARACTERISTIC
/begin AXIS_PTS TQD_rCrpCtrlBrkPct_CUR_x "" 0x70012796 BPD_pctBrkPos Lookup1D_X_FLOAT32_IEEE 0 VBU0513_CM_single_cnt 8 0.0 100.0 /end AXIS_PTS
/begin CHARACTERISTIC TQD_pctCrpCtrlBrkPct_MAP_v "" MAP 0x70015472 Lookup2D_FLOAT32_IEEE 0 VBU0513_CM_single_pct 0.0 1.0
 /begin AXIS_DESCR COM_AXIS BPD_pctBrkPos VBU0513_CM_single_pct 8 0.0 25.0 AXIS_PTS_REF TQD_pctCrpCtrlBrkPct_MAP_y /end AXIS_DESCR
 /begin AXIS_DESCR COM_AXIS SPD_pctSlope VBU0513_CM_single_fac 6 -5.0 20.0 AXIS_PTS_REF TQD_rCrpCtrlBrkPct_MAP_x /end AXIS_DESCR
/end CHARACTERISTIC
/begin AXIS_PTS TQD_rCrpCtrlBrkPct_MAP_x "" 0x70012452 SPD_pctSlope Lookup2D_X_FLOAT32_IEEE 0 VBU0513_CM_single_fac 6 -5.0 20.0 /end AXIS_PTS
/begin AXIS_PTS TQD_pctCrpCtrlBrkPct_MAP_y "" 0x70012756 BPD_pctBrkPos Lookup2D_X_FLOAT32_IEEE 0 VBU0513_CM_single_pct 8 0.0 25.0 /end AXIS_PTS
/begin CHARACTERISTIC TQD_pctCrpCtrlBrkPresS_CUR_v "" CURVE 0x70012776 Lookup1D_FLOAT32_IEEE 0 VBU0513_CM_single_p 0.0 2.0
 /begin AXIS_DESCR COM_AXIS TQD_pBrkPressFlt VBU0513_CM_single_p 8 0.0 20.0 AXIS_PTS_REF TQD_pCrpCtrlBrkPres_CUR_x /end AXIS_DESCR
/end CHARACTERISTIC
/begin AXIS_PTS TQD_pCrpCtrlBrkPres_CUR_x "" 0x700126f6 TQD_pBrkPressFlt Lookup1D_X_FLOAT32_IEEE 0 VBU0513_CM_single_p 8 0.0 20.0 /end AXIS_PTS
/begin CHARACTERISTIC TQD_pctCrpCtrlBrkPres_MAP_v "" MAP 0x70015532 Lookup2D_FLOAT32_IEEE 0 VBU0513_CM_single_pct 0.0 1.0
 /begin AXIS_DESCR COM_AXIS TQD_pBrkPressFlt VBU0513_CM_single_pct 8 0.0 100.0 AXIS_PTS_REF TQD_pCrpCtrlBrkPres_MAP_y /end AXIS_DESCR
 /begin AXIS_DESCR COM_AXIS SPD_pctSlope VBU0513_CM_single_fac 6 -5.0 20.0 AXIS_PTS_REF TQD_rCrpCtrlBrkPct_MAP_x /end AXIS_DESCR
/end CHARACTERISTIC
/begin AXIS_PTS TQD_pCrpCtrlBrkPres_MAP_y "" 0x70012716 TQD_pBrkPressFlt Lookup2D_X_FLOAT32_IEEE 0 VBU0513_CM_single_pct 8 0.0 100.0 /end AXIS_PTS
/begin CHARACTERISTIC TQD_trqCrpCtrlSlp_MAP_v "" MAP 0x70015b62 Lookup2D_FLOAT32_IEEE 0 VBU0513_CM_single_Nm -10000.0 10000.0
 /begin AXIS_DESCR COM_AXIS TQD_vVehSpd VBU0513_CM_single_kph 9 -250.0 250.0 AXIS_PTS_REF TQD_vCrpCtrlSlp_MAP_y /end AXIS_DESCR
 /begin AXIS_DESCR COM_AXIS NO_INPUT_QUANTITY VBU0513_CM_single_phi 11 0.0 360.0 AXIS_PTS_REF TQD_phiCrpCtrlSlp_MAP_x /end AXIS_DESCR
/end CHARACTERISTIC
/begin AXIS_PTS TQD_phiCrpCtrlSlp_MAP_x "" 0x70012f6e NO_INPUT_QUANTITY Lookup2D_X_FLOAT32_IEEE 0 VBU0513_CM_single_phi 11 0.0 360.0 /end AXIS_PTS
/begin AXIS_PTS TQD_vCrpCtrlSlp_MAP_y "" 0x700129d2 TQD_vVehSpd Lookup2D_X_FLOAT32_IEEE 0 VBU0513_CM_single_kph 9 -250.0 250.0 /end AXIS_PTS
/begin CHARACTERISTIC TQD_trqCrpCstModeA_CUR_v "" CURVE 0x700147e6 Lookup1D_FLOAT32_IEEE 0 VBU0513_CM_single_Nm -10000.0 10000.0
 /begin AXIS_DESCR COM_AXIS TQD_vVehSpd VBU0513_CM_single_kph 21 -250.0 250.0 AXIS_PTS_REF TQD_vSgndSpd_CUR_x /end AXIS_DESCR
/end CHARACTERISTIC
/begin CHARACTERISTIC TQD_trqCrpCstModeB_CUR_v "" CURVE 0x7001483a Lookup1D_FLOAT32_IEEE 0 VBU0513_CM_single_Nm -10000.0 10000.0
 /begin AXIS_DESCR COM_AXIS TQD_vVehSpd VBU0513_CM_single_kph 21 -250.0 250.0 AXIS_PTS_REF TQD_vSgndSpd_CUR_x /end AXIS_DESCR
/end CHARACTERISTIC
/begin CHARACTERISTIC TQD_trqCrpCstModeC_CUR_v "" CURVE 0x7001488e Lookup1D_FLOAT32_IEEE 0 VBU0513_CM_single_Nm -10000.0 10000.0
 /begin AXIS_DESCR COM_AXIS TQD_vVehSpd VBU0513_CM_single_kph 21 -250.0 250.0 AXIS_PTS_REF TQD_vSgndSpd_CUR_x /end AXIS_DESCR
/end CHARACTERISTIC
/begin CHARACTERISTIC TQD_trqCrpCstModeD_CUR_v "" CURVE 0x700148e2 Lookup1D_FLOAT32_IEEE 0 VBU0513_CM_single_Nm -10000.0 10000.0
 /begin AXIS_DESCR COM_AXIS TQD_vVehSpd VBU0513_CM_single_kph 21 -250.0 250.0 AXIS_PTS_REF TQD_vSgndSpd_CUR_x /end AXIS_DESCR
/end CHARACTERISTIC
/begin CHARACTERISTIC MTQL_trqVehSpdLimNormRMot_MAP_v "" MAP 0x70015076 Lookup2D_FLOAT32_IEEE 0 VBU0513_CM_single_cnt -3.4028234663852886E+38 3.4028234663852886E+38
 /begin AXIS_DESCR COM_AXIS NO_INPUT_QUANTITY VBU0513_CM_single_cnt 9 -3.4028234663852886E+38 3.4028234663852886E+38 AXIS_PTS_REF MTQL_stVehSpdLim_MAP_y /end AXIS_DESCR
 /begin AXIS_DESCR FIX_AXIS NO_INPUT_QUANTITY VBU0513_CM_uint8 4 0 3 FIX_AXIS_PAR_DIST 0 1 4 /end AXIS_DESCR
/end CHARACTERISTIC
/begin AXIS_PTS MTQL_stVehSpdLim_MAP_y "" 0x7001291e NO_INPUT_QUANTITY Lookup2D_X_FLOAT32_IEEE 0 VBU0513_CM_single_cnt 9 -3.4028234663852886E+38 3.4028234663852886E+38 /end AXIS_PTS
/begin CHARACTERISTIC MTQL_trqWhlRLim_CUR_v "" CURVE 0x70012966 Lookup1D_FLOAT32_IEEE 0 VBU0513_CM_single_cnt -3.4028234663852886E+38 3.4028234663852886E+38
 /begin AXIS_DESCR COM_AXIS NO_INPUT_QUANTITY VBU0513_CM_single_cnt 9 -3.4028234663852886E+38 3.4028234663852886E+38 AXIS_PTS_REF MTQL_dnWhlRLim_CUR_x /end AXIS_DESCR
/end CHARACTERISTIC
/begin AXIS_PTS MTQL_dnWhlRLim_CUR_x "" 0x700128d6 NO_INPUT_QUANTITY Lookup1D_X_FLOAT32_IEEE 0 VBU0513_CM_single_cnt 9 -3.4028234663852886E+38 3.4028234663852886E+38 /end AXIS_PTS
/begin CHARACTERISTIC VTQA_facMtrDrvPwrUpLim_MAP_v "" MAP 0x70015cee Lookup2D_FLOAT32_IEEE 0 VBU0513_CM_single_cnt -3.4028234663852886E+38 3.4028234663852886E+38
 /begin AXIS_DESCR COM_AXIS NO_INPUT_QUANTITY VBU0513_CM_single_cnt 9 -3.4028234663852886E+38 3.4028234663852886E+38 AXIS_PTS_REF VTQA_nMtrDrvPwrUpLim_MAP_y /end AXIS_DESCR
 /begin AXIS_DESCR COM_AXIS NO_INPUT_QUANTITY VBU0513_CM_single_cnt 12 -3.4028234663852886E+38 3.4028234663852886E+38 AXIS_PTS_REF VTQA_pwrMtrDrvPwrUpLim_MAP_x /end AXIS_DESCR
/end CHARACTERISTIC
/begin AXIS_PTS VTQA_pwrMtrDrvPwrUpLim_MAP_x "" 0x7001338e NO_INPUT_QUANTITY Lookup2D_X_FLOAT32_IEEE 0 VBU0513_CM_single_cnt 12 -3.4028234663852886E+38 3.4028234663852886E+38 /end AXIS_PTS
/begin AXIS_PTS VTQA_nMtrDrvPwrUpLim_MAP_y "" 0x70012a1a NO_INPUT_QUANTITY Lookup2D_X_FLOAT32_IEEE 0 VBU0513_CM_single_cnt 9 -3.4028234663852886E+38 3.4028234663852886E+38 /end AXIS_PTS
/begin CHARACTERISTIC VTQA_pwrRMtrRgnPwrLoss_MAP_v "" MAP 0x7001604e Lookup2D_FLOAT32_IEEE 0 VBU0513_CM_single_cnt -3.4028234663852886E+38 3.4028234663852886E+38
 /begin AXIS_DESCR COM_AXIS NO_INPUT_QUANTITY VBU0513_CM_single_cnt 9 -3.4028234663852886E+38 3.4028234663852886E+38 AXIS_PTS_REF VTQA_nRMtrRgnPwrLoss_MAP_y /end AXIS_DESCR
 /begin AXIS_DESCR COM_AXIS VTQA_trqRMotrNeg VBU0513_CM_single_cnt 12 -3.4028234663852886E+38 3.4028234663852886E+38 AXIS_PTS_REF VTQA_trqRMtrRgnPwrLoss_MAP_x /end AXIS_DESCR
/end CHARACTERISTIC
/begin AXIS_PTS VTQA_trqRMtrRgnPwrLoss_MAP_x "" 0x700133ee VTQA_trqRMotrNeg Lookup2D_X_FLOAT32_IEEE 0 VBU0513_CM_single_cnt 12 -3.4028234663852886E+38 3.4028234663852886E+38 /end AXIS_PTS
/begin AXIS_PTS VTQA_nRMtrRgnPwrLoss_MAP_y "" 0x70012a62 NO_INPUT_QUANTITY Lookup2D_X_FLOAT32_IEEE 0 VBU0513_CM_single_cnt 9 -3.4028234663852886E+38 3.4028234663852886E+38 /end AXIS_PTS
/begin CHARACTERISTIC VTQA_pwrRMtrDrvPwrLoss_MAP_v "" MAP 0x70015e9e Lookup2D_FLOAT32_IEEE 0 VBU0513_CM_single_cnt -3.4028234663852886E+38 3.4028234663852886E+38
 /begin AXIS_DESCR COM_AXIS NO_INPUT_QUANTITY VBU0513_CM_single_cnt 9 -3.4028234663852886E+38 3.4028234663852886E+38 AXIS_PTS_REF VTQA_nRMtrDrvPwrLoss_MAP_y /end AXIS_DESCR
 /begin AXIS_DESCR COM_AXIS VTQA_trqRMotrPos VBU0513_CM_single_cnt 12 -3.4028234663852886E+38 3.4028234663852886E+38 AXIS_PTS_REF VTQA_trqRMtrDrvPwrLoss_MAP_x /end AXIS_DESCR
/end CHARACTERISTIC
/begin AXIS_PTS VTQA_trqRMtrDrvPwrLoss_MAP_x "" 0x700133be VTQA_trqRMotrPos Lookup2D_X_FLOAT32_IEEE 0 VBU0513_CM_single_cnt 12 -3.4028234663852886E+38 3.4028234663852886E+38 /end AXIS_PTS
/begin AXIS_PTS VTQA_nRMtrDrvPwrLoss_MAP_y "" 0x70012a3e NO_INPUT_QUANTITY Lookup2D_X_FLOAT32_IEEE 0 VBU0513_CM_single_cnt 9 -3.4028234663852886E+38 3.4028234663852886E+38 /end AXIS_PTS
/begin CHARACTERISTIC VTQA_trqAxleMax_CUR_v "" CURVE 0x70012ff2 Lookup1D_FLOAT32_IEEE 0 VBU0513_CM_single_cnt -3.4028234663852886E+38 3.4028234663852886E+38
 /begin AXIS_DESCR COM_AXIS SPD_vVehSpd VBU0513_CM_single_cnt 11 -3.4028234663852886E+38 3.4028234663852886E+38 AXIS_PTS_REF VTQA_vAxleMax_CUR_x /end AXIS_DESCR
/end CHARACTERISTIC
/begin AXIS_PTS VTQA_vAxleMax_CUR_x "" 0x70013076 SPD_vVehSpd Lookup1D_X_FLOAT32_IEEE 0 VBU0513_CM_single_cnt 11 -3.4028234663852886E+38 3.4028234663852886E+38 /end AXIS_PTS
/begin CHARACTERISTIC VTQA_trqLimpModeMax_CUR_v "" CURVE 0x7001304a Lookup1D_FLOAT32_IEEE 0 VBU0513_CM_single_cnt -3.4028234663852886E+38 3.4028234663852886E+38
 /begin AXIS_DESCR COM_AXIS SPD_vVehSpd VBU0513_CM_single_cnt 11 -3.4028234663852886E+38 3.4028234663852886E+38 AXIS_PTS_REF VTQA_vAxleMax_CUR_x /end AXIS_DESCR
/end CHARACTERISTIC
/begin CHARACTERISTIC VTQA_trqLimpModeByPmpMax_CUR_v "" CURVE 0x7001301e Lookup1D_FLOAT32_IEEE 0 VBU0513_CM_single_cnt -3.4028234663852886E+38 3.4028234663852886E+38
 /begin AXIS_DESCR COM_AXIS SPD_vVehSpd VBU0513_CM_single_cnt 11 -3.4028234663852886E+38 3.4028234663852886E+38 AXIS_PTS_REF VTQA_vLimpModeByPmpMax_CUR_x /end AXIS_DESCR
/end CHARACTERISTIC
/begin AXIS_PTS VTQA_vLimpModeByPmpMax_CUR_x "" 0x700130ce SPD_vVehSpd Lookup1D_X_FLOAT32_IEEE 0 VBU0513_CM_single_cnt 11 -3.4028234663852886E+38 3.4028234663852886E+38 /end AXIS_PTS
/begin CHARACTERISTIC VTQA_trqBrk_MAP_v "" MAP 0x70016742 Lookup2D_FLOAT32_IEEE 0 VBU0513_CM_single_cnt -3.4028234663852886E+38 3.4028234663852886E+38
 /begin AXIS_DESCR COM_AXIS SPD_vVehSpd VBU0513_CM_single_cnt 11 -3.4028234663852886E+38 3.4028234663852886E+38 AXIS_PTS_REF VTQA_vBrk_MAP_y /end AXIS_DESCR
 /begin AXIS_DESCR COM_AXIS BPD_pctBrkPos VBU0513_CM_single_cnt 11 -3.4028234663852886E+38 3.4028234663852886E+38 AXIS_PTS_REF VTQA_pctBrk_MAP_x /end AXIS_DESCR
/end CHARACTERISTIC
/begin AXIS_PTS VTQA_pctBrk_MAP_x "" 0x70012fc6 BPD_pctBrkPos Lookup2D_X_FLOAT32_IEEE 0 VBU0513_CM_single_cnt 11 -3.4028234663852886E+38 3.4028234663852886E+38 /end AXIS_PTS
/begin AXIS_PTS VTQA_vBrk_MAP_y "" 0x700130a2 SPD_vVehSpd Lookup2D_X_FLOAT32_IEEE 0 VBU0513_CM_single_cnt 11 -3.4028234663852886E+38 3.4028234663852886E+38 /end AXIS_PTS
/begin CHARACTERISTIC APD_uThdDiff12_CUR_v "" CURVE 0x70013d9e Lookup1D_FLOAT32_IEEE 0 VBU0513_CM_single_cnt -3.4028234663852886E+38 3.4028234663852886E+38
 /begin AXIS_DESCR COM_AXIS NO_INPUT_QUANTITY VBU0513_CM_single_cnt 16 -3.4028234663852886E+38 3.4028234663852886E+38 AXIS_PTS_REF APD_uThdDiff12_CUR_x /end AXIS_DESCR
/end CHARACTERISTIC
/begin AXIS_PTS APD_uThdDiff12_CUR_x "" 0x70013dde NO_INPUT_QUANTITY Lookup1D_X_FLOAT32_IEEE 0 VBU0513_CM_single_cnt 16 -3.4028234663852886E+38 3.4028234663852886E+38 /end AXIS_PTS
/begin CHARACTERISTIC Veh_tDCPortTempPlausibility_CUR_v "" CURVE 0x700130fa Lookup1D_FLOAT32_IEEE 0 VBU0513_CM_single_cnt -3.4028234663852886E+38 3.4028234663852886E+38
 /begin AXIS_DESCR COM_AXIS NO_INPUT_QUANTITY VBU0513_CM_single_cnt 11 -3.4028234663852886E+38 3.4028234663852886E+38 AXIS_PTS_REF Veh_tDCPortTempPlausibility_CUR_x /end AXIS_DESCR
/end CHARACTERISTIC
/begin AXIS_PTS Veh_tDCPortTempPlausibility_CUR_x "" 0x70013126 NO_INPUT_QUANTITY Lookup1D_X_FLOAT32_IEEE 0 VBU0513_CM_single_cnt 11 -3.4028234663852886E+38 3.4028234663852886E+38 /end AXIS_PTS
/begin CHARACTERISTIC BPD_pctBrkPress_CUR_v "" CURVE 0x700125d6 Lookup1D_FLOAT32_IEEE 0 VBU0513_CM_single_cnt -3.4028234663852886E+38 3.4028234663852886E+38
 /begin AXIS_DESCR COM_AXIS BPD_pBrkPress VBU0513_CM_double_cnt 8 -3.4028234663852886E+38 3.4028234663852886E+38 AXIS_PTS_REF BPD_pBrkPress_CUR_x /end AXIS_DESCR
/end CHARACTERISTIC
/begin AXIS_PTS BPD_pBrkPress_CUR_x "" 0x700125b6 BPD_pBrkPress Lookup1D_X_FLOAT64_IEEE 0 VBU0513_CM_double_cnt 8 -3.4028234663852886E+38 3.4028234663852886E+38 /end AXIS_PTS
/begin CHARACTERISTIC BCU_pBrkPres "" CURVE 0x70011d9a Lookup1D_FLOAT32_IEEE 0 VBU0513_CM_single_MPa 0.0 1000.0
 /begin AXIS_DESCR COM_AXIS NO_INPUT_QUANTITY VBU0513_CM_single_V 5 0.0 100.0 AXIS_PTS_REF INP_uBrkPresFlt /end AXIS_DESCR
/end CHARACTERISTIC
/begin AXIS_PTS INP_uBrkPresFlt "" 0x70011fca NO_INPUT_QUANTITY Lookup1D_X_FLOAT32_IEEE 0 VBU0513_CM_single_V 5 0.0 100.0 /end AXIS_PTS
/begin CHARACTERISTIC APD_numPlausibilityDec_C "" VALUE 0x70010150 Scalar_FLOAT32_IEEE 0 VBU0513_CM_single_cnt -3.4028234663852886E+38 3.4028234663852886E+38 /end CHARACTERISTIC
/begin CHARACTERISTIC APD_numPlausibilityInc_C "" VALUE 0x70010154 Scalar_FLOAT32_IEEE 0 VBU0513_CM_single_cnt -3.4028234663852886E+38 3.4028234663852886E+38 /end CHARACTERISTIC
/begin CHARACTERISTIC APD_numPlausibilityLim_C "" VALUE 0x70010158 Scalar_FLOAT32_IEEE 0 VBU0513_CM_single_cnt -3.4028234663852886E+38 3.4028234663852886E+38 /end CHARACTERISTIC
/begin CHARACTERISTIC APD_pctAccPedPosLimit_C "" VALUE 0x7001015c Scalar_FLOAT32_IEEE 0 VBU0513_CM_single_cnt -3.4028234663852886E+38 3.4028234663852886E+38 /end CHARACTERISTIC
/begin CHARACTERISTIC APD_pctAccPedPosOverrideVal_C "" VALUE 0x70010160 Scalar_FLOAT32_IEEE 0 VBU0513_CM_single_cnt -3.4028234663852886E+38 3.4028234663852886E+38 /end CHARACTERISTIC
/begin CHARACTERISTIC APD_pctAccPedPosOverride_C "" VALUE 0x70010164 Scalar_FLOAT32_IEEE 0 VBU0513_CM_single_cnt -3.4028234663852886E+38 3.4028234663852886E+38 /end CHARACTERISTIC
/begin CHARACTERISTIC APD_uJitterFil1_C "" VALUE 0x70010194 Scalar_FLOAT32_IEEE 0 VBU0513_CM_single_cnt -3.4028234663852886E+38 3.4028234663852886E+38 /end CHARACTERISTIC
/begin CHARACTERISTIC APD_uJitterFil2_C "" VALUE 0x70010198 Scalar_FLOAT32_IEEE 0 VBU0513_CM_single_cnt -3.4028234663852886E+38 3.4028234663852886E+38 /end CHARACTERISTIC
/begin CHARACTERISTIC APD_uSetPoint1Max_C "" VALUE 0x7001019c Scalar_FLOAT32_IEEE 0 VBU0513_CM_single_cnt -3.4028234663852886E+38 3.4028234663852886E+38 /end CHARACTERISTIC
/begin CHARACTERISTIC APD_uSetPoint1Min_C "" VALUE 0x700101a0 Scalar_FLOAT32_IEEE 0 VBU0513_CM_single_cnt -3.4028234663852886E+38 3.4028234663852886E+38 /end CHARACTERISTIC
/begin CHARACTERISTIC APD_uSetPoint2Max_C "" VALUE 0x700101a4 Scalar_FLOAT32_IEEE 0 VBU0513_CM_single_cnt -3.4028234663852886E+38 3.4028234663852886E+38 /end CHARACTERISTIC
/begin CHARACTERISTIC APD_uSetPoint2Min_C "" VALUE 0x700101a8 Scalar_FLOAT32_IEEE 0 VBU0513_CM_single_cnt -3.4028234663852886E+38 3.4028234663852886E+38 /end CHARACTERISTIC
/begin CHARACTERISTIC BPD_facBrkPresVoltFilt_C "" VALUE 0x700103dc Scalar_FLOAT32_IEEE 0 VBU0513_CM_single -3.4E+38 3.4E+38 /end CHARACTERISTIC
/begin CHARACTERISTIC BPD_pctBrkPedalDownStep_C "" VALUE 0x700103e0 Scalar_FLOAT32_IEEE 0 VBU0513_CM_single_cnt -3.4028234663852886E+38 3.4028234663852886E+38 /end CHARACTERISTIC
/begin CHARACTERISTIC BPD_pctBrkPedalPressedZero_C "" VALUE 0x700103e4 Scalar_FLOAT32_IEEE 0 VBU0513_CM_single_cnt -3.4028234663852886E+38 3.4028234663852886E+38 /end CHARACTERISTIC
/begin CHARACTERISTIC BPD_pctBrkPedalPressed_C "" VALUE 0x700103e8 Scalar_FLOAT32_IEEE 0 VBU0513_CM_single_cnt -3.4028234663852886E+38 3.4028234663852886E+38 /end CHARACTERISTIC
/begin CHARACTERISTIC BPD_pctBrkPressDiag_C "" VALUE 0x700103f0 Scalar_FLOAT32_IEEE 0 VBU0513_CM_single_cnt -3.4028234663852886E+38 3.4028234663852886E+38 /end CHARACTERISTIC
/begin CHARACTERISTIC BPD_pctBrkReleaseDiag_C "" VALUE 0x700103f4 Scalar_FLOAT32_IEEE 0 VBU0513_CM_single_cnt -3.4028234663852886E+38 3.4028234663852886E+38 /end CHARACTERISTIC
/begin CHARACTERISTIC BPD_tiDftBrkPosSwtPress_C "" VALUE 0x700103f8 Scalar_FLOAT32_IEEE 0 VBU0513_CM_single_cnt -3.4028234663852886E+38 3.4028234663852886E+38 /end CHARACTERISTIC
/begin CHARACTERISTIC BPD_tiDftBrkPosSwtRelease_C "" VALUE 0x700103fc Scalar_FLOAT32_IEEE 0 VBU0513_CM_single_cnt -3.4028234663852886E+38 3.4028234663852886E+38 /end CHARACTERISTIC
/begin CHARACTERISTIC BPD_tiSampleTime_C "" VALUE 0x70010400 Scalar_FLOAT32_IEEE 0 VBU0513_CM_single_cnt -3.4028234663852886E+38 3.4028234663852886E+38 /end CHARACTERISTIC
/begin CHARACTERISTIC CcBCV_BdmBatteryBusVoltageMismatchFaultDelta_V "" VALUE 0x700104dc Scalar_FLOAT32_IEEE 0 VBU0513_CM_single_cnt -3.4028234663852886E+38 3.4028234663852886E+38 /end CHARACTERISTIC
/begin CHARACTERISTIC CcBCV_BdmBatteryBusVoltageMismatchFault_V "" VALUE 0x700104e0 Scalar_FLOAT32_IEEE 0 VBU0513_CM_single_cnt -3.4028234663852886E+38 3.4028234663852886E+38 /end CHARACTERISTIC
/begin CHARACTERISTIC CcBCV_BdmBatteryCurrentOoR_A "" VALUE 0x700104e4 Scalar_FLOAT32_IEEE 0 VBU0513_CM_single_cnt -3.4028234663852886E+38 3.4028234663852886E+38 /end CHARACTERISTIC
/begin CHARACTERISTIC CcBCV_BdmBatteryOverCurrent_A "" VALUE 0x700104e8 Scalar_FLOAT32_IEEE 0 VBU0513_CM_single_cnt -3.4028234663852886E+38 3.4028234663852886E+38 /end CHARACTERISTIC
/begin CHARACTERISTIC CcBCV_BdmBatteryOverVoltage_V "" VALUE 0x700104ec Scalar_FLOAT32_IEEE 0 VBU0513_CM_single_cnt -3.4028234663852886E+38 3.4028234663852886E+38 /end CHARACTERISTIC
/begin CHARACTERISTIC CcBCV_BdmBatteryUnderVoltage1_V "" VALUE 0x700104f0 Scalar_FLOAT32_IEEE 0 VBU0513_CM_single_cnt -3.4028234663852886E+38 3.4028234663852886E+38 /end CHARACTERISTIC
/begin CHARACTERISTIC CcBCV_BdmBatteryUnderVoltage2_V "" VALUE 0x700104f4 Scalar_FLOAT32_IEEE 0 VBU0513_CM_single_cnt -3.4028234663852886E+38 3.4028234663852886E+38 /end CHARACTERISTIC
/begin CHARACTERISTIC CcBCV_BdmBatteryUnderVoltageTemp_C "" VALUE 0x700104f8 Scalar_FLOAT32_IEEE 0 VBU0513_CM_single_cnt -3.4028234663852886E+38 3.4028234663852886E+38 /end CHARACTERISTIC
/begin CHARACTERISTIC CcBCV_BdmBatteryVoltageOoRHigh_V "" VALUE 0x700104fc Scalar_FLOAT32_IEEE 0 VBU0513_CM_single_cnt -3.4028234663852886E+38 3.4028234663852886E+38 /end CHARACTERISTIC
/begin CHARACTERISTIC CcBCV_BdmBatteryVoltageOoRLow_V "" VALUE 0x70010500 Scalar_FLOAT32_IEEE 0 VBU0513_CM_single_cnt -3.4028234663852886E+38 3.4028234663852886E+38 /end CHARACTERISTIC
/begin CHARACTERISTIC CcCTD_MNCStuckOpenCurrentMax_A "" VALUE 0x700105c8 Scalar_FLOAT32_IEEE 0 VBU0513_CM_single_cnt -3.4028234663852886E+38 3.4028234663852886E+38 /end CHARACTERISTIC
/begin CHARACTERISTIC CcCTD_MaxJouleHeat_J "" VALUE 0x700105d4 Scalar_FLOAT32_IEEE 0 VBU0513_CM_single_cnt -3.4028234663852886E+38 3.4028234663852886E+38 /end CHARACTERISTIC
/begin CHARACTERISTIC CcCTD_MinHeatDissipation_J "" VALUE 0x700105dc Scalar_FLOAT32_IEEE 0 VBU0513_CM_single_cnt -3.4028234663852886E+38 3.4028234663852886E+38 /end CHARACTERISTIC
/begin CHARACTERISTIC CcCTD_MnNegContactorOpenDeltaVoltage_V "" VALUE 0x700105e4 Scalar_FLOAT32_IEEE 0 VBU0513_CM_single_cnt -3.4028234663852886E+38 3.4028234663852886E+38 /end CHARACTERISTIC
/begin CHARACTERISTIC CcCTD_MnPosContactorOpenDeltaVoltage_V "" VALUE 0x700105ec Scalar_FLOAT32_IEEE 0 VBU0513_CM_single_cnt -3.4028234663852886E+38 3.4028234663852886E+38 /end CHARACTERISTIC
/begin CHARACTERISTIC CcCTD_OnePrechargeHeat_J "" VALUE 0x700105f0 Scalar_FLOAT32_IEEE 0 VBU0513_CM_single_cnt -3.4028234663852886E+38 3.4028234663852886E+38 /end CHARACTERISTIC
/begin CHARACTERISTIC CcCTD_PrechargeOverEnergy_J "" VALUE 0x70010608 Scalar_FLOAT32_IEEE 0 VBU0513_CM_single_cnt -3.4028234663852886E+38 3.4028234663852886E+38 /end CHARACTERISTIC
/begin CHARACTERISTIC CcCTD_PrechargeResistance_ohm "" VALUE 0x70010614 Scalar_FLOAT32_IEEE 0 VBU0513_CM_single_cnt -3.4028234663852886E+38 3.4028234663852886E+38 /end CHARACTERISTIC
/begin CHARACTERISTIC CcCTD_RnMNCStuckOpenCurrentMax_A "" VALUE 0x70010620 Scalar_FLOAT32_IEEE 0 VBU0513_CM_single_cnt -3.4028234663852886E+38 3.4028234663852886E+38 /end CHARACTERISTIC
/begin CHARACTERISTIC CcCTD_RnMnNegContactorOpenDeltaVoltage_V "" VALUE 0x70010624 Scalar_FLOAT32_IEEE 0 VBU0513_CM_single_cnt -3.4028234663852886E+38 3.4028234663852886E+38 /end CHARACTERISTIC
/begin CHARACTERISTIC CcCTD_RnMnPosContactorOpenDeltaVoltage_V "" VALUE 0x70010628 Scalar_FLOAT32_IEEE 0 VBU0513_CM_single_cnt -3.4028234663852886E+38 3.4028234663852886E+38 /end CHARACTERISTIC
/begin CHARACTERISTIC CcCTM_CellThermalRunawayRatePerSecond_C "" VALUE 0x7001065c Scalar_FLOAT32_IEEE 0 VBU0513_CM_single_cnt -3.4028234663852886E+38 3.4028234663852886E+38 /end CHARACTERISTIC
/begin CHARACTERISTIC CcFCC_ChargeCurrentOvRValue_A "" VALUE 0x700106f4 Scalar_FLOAT32_IEEE 0 VBU0513_CM_single_cnt -3.4028234663852886E+38 3.4028234663852886E+38 /end CHARACTERISTIC
/begin CHARACTERISTIC CcFCC_ChargeCurrentOverDelay_s "" VALUE 0x700106f8 Scalar_FLOAT32_IEEE 0 VBU0513_CM_single_cnt -3.4028234663852886E+38 3.4028234663852886E+38 /end CHARACTERISTIC
/begin CHARACTERISTIC CcFCC_ChargeCurrentRequestDec_A "" VALUE 0x70010704 Scalar_FLOAT32_IEEE 0 VBU0513_CM_single_cnt -3.4028234663852886E+38 3.4028234663852886E+38 /end CHARACTERISTIC
/begin CHARACTERISTIC DCH_iDiaDCChOvrCrntDiff_C "" VALUE 0x70010cdc Scalar_FLOAT32_IEEE 0 VBU0513_CM_single_cnt -3.4028234663852886E+38 3.4028234663852886E+38 /end CHARACTERISTIC
/begin CHARACTERISTIC DCH_numPDUNonRlySticky_C "" VALUE 0x70010d4c Scalar_FLOAT32_IEEE 0 VBU0513_CM_single_cnt -3.4028234663852886E+38 3.4028234663852886E+38 /end CHARACTERISTIC
/begin CHARACTERISTIC DCH_numPDUPosRlySticky_C "" VALUE 0x70010d50 Scalar_FLOAT32_IEEE 0 VBU0513_CM_single_cnt -3.4028234663852886E+38 3.4028234663852886E+38 /end CHARACTERISTIC
/begin CHARACTERISTIC DCH_numPDUStickyTolerance_C "" VALUE 0x70010d54 Scalar_FLOAT32_IEEE 0 VBU0513_CM_single_cnt -3.4028234663852886E+38 3.4028234663852886E+38 /end CHARACTERISTIC
/begin CHARACTERISTIC DCH_tDCChPortTempLowLim_C "" VALUE 0x70010d84 Scalar_FLOAT32_IEEE 0 VBU0513_CM_single_cnt -3.4028234663852886E+38 3.4028234663852886E+38 /end CHARACTERISTIC
/begin CHARACTERISTIC DCH_tReStartDCChPortTemp_C "" VALUE 0x70010da0 Scalar_FLOAT32_IEEE 0 VBU0513_CM_single_cnt -3.4028234663852886E+38 3.4028234663852886E+38 /end CHARACTERISTIC
/begin CHARACTERISTIC DCH_tStopForDCChPortTemp_C "" VALUE 0x70010da4 Scalar_FLOAT32_IEEE 0 VBU0513_CM_single_cnt -3.4028234663852886E+38 3.4028234663852886E+38 /end CHARACTERISTIC
/begin CHARACTERISTIC DCH_tiDCChRlyOpClsdDly_C "" VALUE 0x70010dfc Scalar_FLOAT32_IEEE 0 VBU0513_CM_single_cnt -3.4028234663852886E+38 3.4028234663852886E+38 /end CHARACTERISTIC
/begin CHARACTERISTIC DCH_tiDiagRlyCmd_C "" VALUE 0x70010e0c Scalar_FLOAT32_IEEE 0 VBU0513_CM_single_cnt -3.4028234663852886E+38 3.4028234663852886E+38 /end CHARACTERISTIC
/begin CHARACTERISTIC DCH_uDiaDCChOvrVltgDiff_C "" VALUE 0x70010e5c Scalar_FLOAT32_IEEE 0 VBU0513_CM_single_cnt -3.4028234663852886E+38 3.4028234663852886E+38 /end CHARACTERISTIC
/begin CHARACTERISTIC DSPL_facChargeTemp1_C "" VALUE 0x70010e88 Scalar_FLOAT32_IEEE 0 VBU0513_CM_single_fac 0.0 1.0 /end CHARACTERISTIC
/begin CHARACTERISTIC DSPL_facChargeTemp2_C "" VALUE 0x70010e8c Scalar_FLOAT32_IEEE 0 VBU0513_CM_single_fac 0.0 1.0 /end CHARACTERISTIC
/begin CHARACTERISTIC DSPL_facChargeTemp3_C "" VALUE 0x70010e90 Scalar_FLOAT32_IEEE 0 VBU0513_CM_single_fac 0.0 1.0 /end CHARACTERISTIC
/begin CHARACTERISTIC DSPL_facChargeTemp4_C "" VALUE 0x70010e94 Scalar_FLOAT32_IEEE 0 VBU0513_CM_single_fac 0.0 1.0 /end CHARACTERISTIC
/begin CHARACTERISTIC DSPL_facChargeTemp5_C "" VALUE 0x70010e98 Scalar_FLOAT32_IEEE 0 VBU0513_CM_single_fac 0.0 1.0 /end CHARACTERISTIC
/begin CHARACTERISTIC DSPL_iRngCalcAch_C "" VALUE 0x70010fac Scalar_FLOAT32_IEEE 0 VBU0513_CM_single_A -1000.0 1000.0 /end CHARACTERISTIC
/begin CHARACTERISTIC DSPL_iRngCalcDch_C "" VALUE 0x70010fb0 Scalar_FLOAT32_IEEE 0 VBU0513_CM_single_A -1000.0 1000.0 /end CHARACTERISTIC
/begin CHARACTERISTIC DSPL_kmDriveTempSpeedEnThreshold_C "" VALUE 0x70010fbc Scalar_FLOAT32_IEEE 0 VBU0513_CM_single_km 0.0 1.0E+11 /end CHARACTERISTIC
/begin CHARACTERISTIC DSPL_tDriveTempDefault_C "" VALUE 0x70011058 Scalar_FLOAT32_IEEE 0 VBU0513_CM_single_cnt 0.0 1.0E+17 /end CHARACTERISTIC
/begin CHARACTERISTIC DSPL_tRangeTempDefault_C "" VALUE 0x7001105c Scalar_FLOAT32_IEEE 0 VBU0513_CM_single_cnt -40.0 120.0 /end CHARACTERISTIC
/begin CHARACTERISTIC DSPL_tiDelayTimeDriveCnt_C "" VALUE 0x70011074 Scalar_FLOAT32_IEEE 0 VBU0513_CM_single_s 0.0 1.0E+23 /end CHARACTERISTIC
/begin CHARACTERISTIC DSPL_tiDriveTempMoveTime_C "" VALUE 0x7001107c Scalar_FLOAT32_IEEE 0 VBU0513_CM_single_s 0.0 1.0E+23 /end CHARACTERISTIC
/begin CHARACTERISTIC DSPL_tiDriveTempSpeedEnThreshold_C "" VALUE 0x70011080 Scalar_FLOAT32_IEEE 0 VBU0513_CM_single_s 0.0 1.0E+23 /end CHARACTERISTIC
/begin CHARACTERISTIC DSPL_tiDriveTempSpeedReset_C "" VALUE 0x70011084 Scalar_FLOAT32_IEEE 0 VBU0513_CM_single_s 0.0 1.0E+23 /end CHARACTERISTIC
/begin CHARACTERISTIC DSPL_tiRemChrgLineDelay_C "" VALUE 0x7001109c Scalar_FLOAT32_IEEE 0 VBU0513_CM_single_s 0.0 1.0E+23 /end CHARACTERISTIC
/begin CHARACTERISTIC DSPL_vDriveTempResetThreshold_C "" VALUE 0x700110c0 Scalar_FLOAT32_IEEE 0 VBU0513_CM_single_cnt 0.0 1000.0 /end CHARACTERISTIC
/begin CHARACTERISTIC DSPL_vDriveTempSpeedEnLe_C "" VALUE 0x700110c4 Scalar_FLOAT32_IEEE 0 VBU0513_CM_single_cnt 0.0 1000.0 /end CHARACTERISTIC
/begin CHARACTERISTIC DSPL_vDriveTempSpeedEnRi_C "" VALUE 0x700110c8 Scalar_FLOAT32_IEEE 0 VBU0513_CM_single_cnt 0.0 10000.0 /end CHARACTERISTIC
/begin CHARACTERISTIC EDIS_facStermDisChgRaw_C "" VALUE 0x700110d8 Scalar_FLOAT32_IEEE 0 VBU0513_CM_single_cnt -3.4028234663852886E+38 3.4028234663852886E+38 /end CHARACTERISTIC
/begin CHARACTERISTIC EDIS_kmVehOdometer_C "" VALUE 0x700110e0 Scalar_FLOAT32_IEEE 0 VBU0513_CM_single_cnt -3.4028234663852886E+38 3.4028234663852886E+38 /end CHARACTERISTIC
/begin CHARACTERISTIC EDIS_pctBmsSocOverrideHi1_C "" VALUE 0x70011104 Scalar_FLOAT32_IEEE 0 VBU0513_CM_single_cnt -3.4028234663852886E+38 3.4028234663852886E+38 /end CHARACTERISTIC
/begin CHARACTERISTIC EDIS_pctBmsSocOverrideHi_C "" VALUE 0x70011108 Scalar_FLOAT32_IEEE 0 VBU0513_CM_single_cnt -3.4028234663852886E+38 3.4028234663852886E+38 /end CHARACTERISTIC
/begin CHARACTERISTIC EDIS_pctBmsSocOverrideLo1_C "" VALUE 0x7001110c Scalar_FLOAT32_IEEE 0 VBU0513_CM_single_cnt -3.4028234663852886E+38 3.4028234663852886E+38 /end CHARACTERISTIC
/begin CHARACTERISTIC EDIS_pctBmsSocOverrideLo_C "" VALUE 0x70011110 Scalar_FLOAT32_IEEE 0 VBU0513_CM_single_cnt -3.4028234663852886E+38 3.4028234663852886E+38 /end CHARACTERISTIC
/begin CHARACTERISTIC EDIS_pwrACPowOverride_C "" VALUE 0x7001111c Scalar_FLOAT32_IEEE 0 VBU0513_CM_single_cnt -3.4028234663852886E+38 3.4028234663852886E+38 /end CHARACTERISTIC
/begin CHARACTERISTIC EDIS_pwrACRated_C "" VALUE 0x70011120 Scalar_FLOAT32_IEEE 0 VBU0513_CM_single_kW 0.0 1000.0 /end CHARACTERISTIC
/begin CHARACTERISTIC EDIS_pwrBattMaxPwrForInvaild_C "" VALUE 0x70011124 Scalar_FLOAT32_IEEE 0 VBU0513_CM_single_cnt -3.4028234663852886E+38 3.4028234663852886E+38 /end CHARACTERISTIC
/begin CHARACTERISTIC EDIS_pwrBattMinPwrForInvaild_C "" VALUE 0x70011128 Scalar_FLOAT32_IEEE 0 VBU0513_CM_single_cnt -3.4028234663852886E+38 3.4028234663852886E+38 /end CHARACTERISTIC
/begin CHARACTERISTIC EDIS_pwrDCDCPowOverride_C "" VALUE 0x7001113c Scalar_FLOAT32_IEEE 0 VBU0513_CM_single_cnt -3.4028234663852886E+38 3.4028234663852886E+38 /end CHARACTERISTIC
/begin CHARACTERISTIC EDIS_pwrDcdcRated_C "" VALUE 0x70011144 Scalar_FLOAT32_IEEE 0 VBU0513_CM_single_cnt 0.0 1000.0 /end CHARACTERISTIC
/begin CHARACTERISTIC EDIS_pwrDchaDeltaMin_C "" VALUE 0x70011148 Scalar_FLOAT32_IEEE 0 VBU0513_CM_single_kW -1000.0 1000.0 /end CHARACTERISTIC
/begin CHARACTERISTIC EDIS_pwrDchaItermMin_C "" VALUE 0x7001114c Scalar_FLOAT32_IEEE 0 VBU0513_CM_single_cnt -3.4028234663852886E+38 3.4028234663852886E+38 /end CHARACTERISTIC
/begin CHARACTERISTIC EDIS_pwrDchaPIDPowrLim_C "" VALUE 0x70011150 Scalar_FLOAT32_IEEE 0 VBU0513_CM_single_cnt -3.4028234663852886E+38 3.4028234663852886E+38 /end CHARACTERISTIC
/begin CHARACTERISTIC EDIS_pwrDecGradBmsSocLo_C "" VALUE 0x70011154 Scalar_FLOAT32_IEEE 0 VBU0513_CM_single_cnt -3.4028234663852886E+38 3.4028234663852886E+38 /end CHARACTERISTIC
/begin CHARACTERISTIC EDIS_pwrDrvPowLackHi_C "" VALUE 0x7001116c Scalar_FLOAT32_IEEE 0 VBU0513_CM_single_cnt -3.4028234663852886E+38 3.4028234663852886E+38 /end CHARACTERISTIC
/begin CHARACTERISTIC EDIS_pwrDrvPowLackLo_C "" VALUE 0x70011170 Scalar_FLOAT32_IEEE 0 VBU0513_CM_single_cnt -3.4028234663852886E+38 3.4028234663852886E+38 /end CHARACTERISTIC
/begin CHARACTERISTIC EDIS_pwrHVHPowOverride_C "" VALUE 0x70011178 Scalar_FLOAT32_IEEE 0 VBU0513_CM_single_cnt -3.4028234663852886E+38 3.4028234663852886E+38 /end CHARACTERISTIC
/begin CHARACTERISTIC EDIS_pwrHVHRated_C "" VALUE 0x7001117c Scalar_FLOAT32_IEEE 0 VBU0513_CM_single_cnt 0.0 1000.0 /end CHARACTERISTIC
/begin CHARACTERISTIC EDIS_pwrPTCPowOverride_C "" VALUE 0x700111a4 Scalar_FLOAT32_IEEE 0 VBU0513_CM_single_cnt -3.4028234663852886E+38 3.4028234663852886E+38 /end CHARACTERISTIC
/begin CHARACTERISTIC EDIS_pwrPTCRated_C "" VALUE 0x700111a8 Scalar_FLOAT32_IEEE 0 VBU0513_CM_single_kW 0.0 1000.0 /end CHARACTERISTIC
/begin CHARACTERISTIC EDIS_tiBattPowLackDelay_C "" VALUE 0x700111c0 Scalar_FLOAT32_IEEE 0 VBU0513_CM_single_cnt -3.4028234663852886E+38 3.4028234663852886E+38 /end CHARACTERISTIC
/begin CHARACTERISTIC EDIS_tiDrvPwrFilter_C "" VALUE 0x700111c4 Scalar_FLOAT32_IEEE 0 VBU0513_CM_single_cnt -3.4028234663852886E+38 3.4028234663852886E+38 /end CHARACTERISTIC
/begin CHARACTERISTIC EDIS_tiRgnPwrFilter_C "" VALUE 0x700111cc Scalar_FLOAT32_IEEE 0 VBU0513_CM_single_cnt -3.4028234663852886E+38 3.4028234663852886E+38 /end CHARACTERISTIC
/begin CHARACTERISTIC EDIS_tiSmplT_SY "" VALUE 0x700111d0 Scalar_FLOAT32_IEEE 0 VBU0513_CM_single_s -3.4028234663852886E+38 3.4028234663852886E+38 /end CHARACTERISTIC
/begin CHARACTERISTIC Gear_pctBrkPosPressed_C "" VALUE 0x70011270 Scalar_FLOAT32_IEEE 0 VBU0513_CM_single_cnt -3.4028234663852886E+38 3.4028234663852886E+38 /end CHARACTERISTIC
/begin CHARACTERISTIC Gear_tiGearDebounceCnt_C "" VALUE 0x70011280 Scalar_FLOAT32_IEEE 0 VBU0513_CM_single_cnt -3.4028234663852886E+38 3.4028234663852886E+38 /end CHARACTERISTIC
/begin CHARACTERISTIC Gear_tiGearPSwitchDebounceCnt_C "" VALUE 0x70011294 Scalar_FLOAT32_IEEE 0 VBU0513_CM_single_cnt -3.4028234663852886E+38 3.4028234663852886E+38 /end CHARACTERISTIC
/begin CHARACTERISTIC Gear_tiSampleTime_C "" VALUE 0x700112b0 Scalar_FLOAT32_IEEE 0 VBU0513_CM_single_cnt -3.4028234663852886E+38 3.4028234663852886E+38 /end CHARACTERISTIC
/begin CHARACTERISTIC Gear_tiShiftEnableCnt_C "" VALUE 0x700112b4 Scalar_FLOAT32_IEEE 0 VBU0513_CM_single_cnt -3.4028234663852886E+38 3.4028234663852886E+38 /end CHARACTERISTIC
/begin CHARACTERISTIC Gear_trqShiftDriveEnableLe_C "" VALUE 0x700112bc Scalar_FLOAT32_IEEE 0 VBU0513_CM_single_cnt -3.4028234663852886E+38 3.4028234663852886E+38 /end CHARACTERISTIC
/begin CHARACTERISTIC Gear_trqShiftDriveEnableRi_C "" VALUE 0x700112c0 Scalar_FLOAT32_IEEE 0 VBU0513_CM_single_cnt -3.4028234663852886E+38 3.4028234663852886E+38 /end CHARACTERISTIC
/begin CHARACTERISTIC Gear_vForce2NThreshold_C "" VALUE 0x700112c4 Scalar_FLOAT32_IEEE 0 VBU0513_CM_single_cnt -3.4028234663852886E+38 3.4028234663852886E+38 /end CHARACTERISTIC
/begin CHARACTERISTIC Gear_vGearDLowThreshold_C "" VALUE 0x700112c8 Scalar_FLOAT32_IEEE 0 VBU0513_CM_single_cnt -3.4028234663852886E+38 3.4028234663852886E+38 /end CHARACTERISTIC
/begin CHARACTERISTIC Gear_vGearDMiThreshold_C "" VALUE 0x700112cc Scalar_FLOAT32_IEEE 0 VBU0513_CM_single_cnt -3.4028234663852886E+38 3.4028234663852886E+38 /end CHARACTERISTIC
/begin CHARACTERISTIC Gear_vGearPThreshold_C "" VALUE 0x700112d0 Scalar_FLOAT32_IEEE 0 VBU0513_CM_single_cnt -3.4028234663852886E+38 3.4028234663852886E+38 /end CHARACTERISTIC
/begin CHARACTERISTIC Gear_vTowThreshold_C "" VALUE 0x700112d4 Scalar_FLOAT32_IEEE 0 VBU0513_CM_single_cnt -3.4028234663852886E+38 3.4028234663852886E+38 /end CHARACTERISTIC
/begin CHARACTERISTIC LVC_uDCDCReq_C "" VALUE 0x700113dc Scalar_FLOAT32_IEEE 0 VBU0513_CM_single_cnt -3.4028234663852886E+38 3.4028234663852886E+38 /end CHARACTERISTIC
/begin CHARACTERISTIC LVC_uDcdcHvMax_C "" VALUE 0x700113e0 Scalar_FLOAT32_IEEE 0 VBU0513_CM_single_cnt -3.4028234663852886E+38 3.4028234663852886E+38 /end CHARACTERISTIC
/begin CHARACTERISTIC LVC_uDcdcHvMin_C "" VALUE 0x700113e4 Scalar_FLOAT32_IEEE 0 VBU0513_CM_single_cnt -3.4028234663852886E+38 3.4028234663852886E+38 /end CHARACTERISTIC
/begin CHARACTERISTIC MTQL_trqPEURFidByTempLim_C "" VALUE 0x0000 Scalar_FLOAT32_IEEE 0 VBU0513_CM_single_cnt -10000.0 10000.0 /end CHARACTERISTIC
/begin CHARACTERISTIC MTQL_trqPEURFidLim_C "" VALUE 0x0000 Scalar_FLOAT32_IEEE 0 VBU0513_CM_single_cnt -10000.0 10000.0 /end CHARACTERISTIC
/begin CHARACTERISTIC PMM_iCtlShtDwnOffLoad_C "" VALUE 0x70011534 Scalar_FLOAT32_IEEE 0 VBU0513_CM_single_cnt -400.0 400.0 /end CHARACTERISTIC
/begin CHARACTERISTIC PMM_iEmgShtDwnOffLoad_C "" VALUE 0x70011538 Scalar_FLOAT32_IEEE 0 VBU0513_CM_single_cnt -400.0 400.0 /end CHARACTERISTIC
/begin CHARACTERISTIC PMM_iNrmlShtDwnOffLoad_C "" VALUE 0x7001153c Scalar_FLOAT32_IEEE 0 VBU0513_CM_single_cnt -400.0 400.0 /end CHARACTERISTIC
/begin CHARACTERISTIC PMM_pctBrkPos4HV_C "" VALUE 0x70011540 Scalar_FLOAT32_IEEE 0 VBU0513_CM_single_cnt 0.0 100.0 /end CHARACTERISTIC
/begin CHARACTERISTIC PMM_tiCtlShtDwnOffLoad_C "" VALUE 0x7001154c Scalar_FLOAT32_IEEE 0 VBU0513_CM_single_cnt 0.0 100.0 /end CHARACTERISTIC
/begin CHARACTERISTIC PMM_tiDCHShtDwnOffLoad_C "" VALUE 0x70011554 Scalar_FLOAT32_IEEE 0 VBU0513_CM_single_cnt 0.0 100.0 /end CHARACTERISTIC
/begin CHARACTERISTIC PMM_tiDlyHVClReqSrcOff_C "" VALUE 0x70011574 Scalar_FLOAT32_IEEE 0 VBU0513_CM_single_cnt -3.4028234663852886E+38 3.4028234663852886E+38 /end CHARACTERISTIC
/begin CHARACTERISTIC PMM_tiDlyHVRlyReqCC2_C "" VALUE 0x70011578 Scalar_FLOAT32_IEEE 0 VBU0513_CM_single_cnt -3.4028234663852886E+38 3.4028234663852886E+38 /end CHARACTERISTIC
/begin CHARACTERISTIC PMM_tiDlyIgnOnHVReq_C "" VALUE 0x70011580 Scalar_FLOAT32_IEEE 0 VBU0513_CM_single_cnt 0.0 10.0 /end CHARACTERISTIC
/begin CHARACTERISTIC PMM_tiDlyOffLoadCnfrm_C "" VALUE 0x7001158c Scalar_FLOAT32_IEEE 0 VBU0513_CM_single_cnt -3.4028234663852886E+38 3.4028234663852886E+38 /end CHARACTERISTIC
/begin CHARACTERISTIC PMM_tiDlyPwrUpNokResp_C "" VALUE 0x7001159c Scalar_FLOAT32_IEEE 0 VBU0513_CM_single_cnt -3.4028234663852886E+38 3.4028234663852886E+38 /end CHARACTERISTIC
/begin CHARACTERISTIC PMM_tiDlyVCUSwtOff_C "" VALUE 0x700115b0 Scalar_FLOAT32_IEEE 0 VBU0513_CM_single_cnt -3.4028234663852886E+38 3.4028234663852886E+38 /end CHARACTERISTIC
/begin CHARACTERISTIC PMM_tiDlyWkup1Cmd_SY "" VALUE 0x700115b8 Scalar_FLOAT32_IEEE 0 VBU0513_CM_single -3.4E+38 3.4E+38 /end CHARACTERISTIC
/begin CHARACTERISTIC PMM_tiEmgShtDwnOffLoad_C "" VALUE 0x700115bc Scalar_FLOAT32_IEEE 0 VBU0513_CM_single_cnt 0.0 100.0 /end CHARACTERISTIC
/begin CHARACTERISTIC PMM_tiInitToHVRlyClReq_C "" VALUE 0x700115c8 Scalar_FLOAT32_IEEE 0 VBU0513_CM_single_cnt -3.4028234663852886E+38 3.4028234663852886E+38 /end CHARACTERISTIC
/begin CHARACTERISTIC PMM_tiNrmlShtDwnOffLoad_C "" VALUE 0x700115d0 Scalar_FLOAT32_IEEE 0 VBU0513_CM_single_cnt 0.0 100.0 /end CHARACTERISTIC
/begin CHARACTERISTIC PMM_uActvDisChVltg_C "" VALUE 0x700115dc Scalar_FLOAT32_IEEE 0 VBU0513_CM_single_cnt 0.0 1000.0 /end CHARACTERISTIC
/begin CHARACTERISTIC PMM_vMaxSpdShtDwn_C "" VALUE 0x700115e4 Scalar_FLOAT32_IEEE 0 VBU0513_CM_single_cnt 0.0 255.0 /end CHARACTERISTIC
/begin CHARACTERISTIC PMM_vMinSpdShtDwn_C "" VALUE 0x700115e8 Scalar_FLOAT32_IEEE 0 VBU0513_CM_single_cnt 0.0 255.0 /end CHARACTERISTIC
/begin CHARACTERISTIC SPD_aBenchReset_C "" VALUE 0x70011600 Scalar_FLOAT32_IEEE 0 VBU0513_CM_single_cnt -3.4028234663852886E+38 3.4028234663852886E+38 /end CHARACTERISTIC
/begin CHARACTERISTIC SPD_aBenchSetHi_C "" VALUE 0x70011604 Scalar_FLOAT32_IEEE 0 VBU0513_CM_single_cnt -3.4028234663852886E+38 3.4028234663852886E+38 /end CHARACTERISTIC
/begin CHARACTERISTIC SPD_aBenchSetLow_C "" VALUE 0x70011608 Scalar_FLOAT32_IEEE 0 VBU0513_CM_single_cnt -3.4028234663852886E+38 3.4028234663852886E+38 /end CHARACTERISTIC
/begin CHARACTERISTIC SPD_cntBenchThd_C "" VALUE 0x7001160c Scalar_FLOAT32_IEEE 0 VBU0513_CM_single_cnt -3.4028234663852886E+38 3.4028234663852886E+38 /end CHARACTERISTIC
/begin CHARACTERISTIC SPD_facAXFilter_C "" VALUE 0x70011610 Scalar_FLOAT32_IEEE 0 VBU0513_CM_single_cnt -3.4028234663852886E+38 3.4028234663852886E+38 /end CHARACTERISTIC
/begin CHARACTERISTIC SPD_facSpdFlt_C "" VALUE 0x70011614 Scalar_FLOAT32_IEEE 0 VBU0513_CM_single_cnt -3.4028234663852886E+38 3.4028234663852886E+38 /end CHARACTERISTIC
/begin CHARACTERISTIC SPD_nMotrDrvRvsThd_C "" VALUE 0x70011618 Scalar_FLOAT32_IEEE 0 VBU0513_CM_single_cnt -3.4028234663852886E+38 3.4028234663852886E+38 /end CHARACTERISTIC
/begin CHARACTERISTIC SPD_tiSample10ms_SY "" VALUE 0x70011624 Scalar_FLOAT32_IEEE 0 VBU0513_CM_single_cnt -3.4028234663852886E+38 3.4028234663852886E+38 /end CHARACTERISTIC
/begin CHARACTERISTIC SPD_tiSlopeFilter_C "" VALUE 0x70011628 Scalar_FLOAT32_IEEE 0 VBU0513_CM_single_cnt -3.4028234663852886E+38 3.4028234663852886E+38 /end CHARACTERISTIC
/begin CHARACTERISTIC SPD_tiSpdFil_C "" VALUE 0x7001162c Scalar_FLOAT32_IEEE 0 VBU0513_CM_single_cnt -3.4028234663852886E+38 3.4028234663852886E+38 /end CHARACTERISTIC
/begin CHARACTERISTIC SPD_trqRvsRst_C "" VALUE 0x70011630 Scalar_FLOAT32_IEEE 0 VBU0513_CM_single_cnt -3.4028234663852886E+38 3.4028234663852886E+38 /end CHARACTERISTIC
/begin CHARACTERISTIC SPD_vGoThd_C "" VALUE 0x70011634 Scalar_FLOAT32_IEEE 0 VBU0513_CM_single_cnt -3.4028234663852886E+38 3.4028234663852886E+38 /end CHARACTERISTIC
/begin CHARACTERISTIC SPD_vVehOvrdFlg_C "" VALUE 0x70011638 Scalar_FLOAT32_IEEE 0 VBU0513_CM_single_cnt -3.4028234663852886E+38 3.4028234663852886E+38 /end CHARACTERISTIC
/begin CHARACTERISTIC SPD_vVehOvrdVal_C "" VALUE 0x7001163c Scalar_FLOAT32_IEEE 0 VBU0513_CM_single_cnt -3.4028234663852886E+38 3.4028234663852886E+38 /end CHARACTERISTIC
/begin CHARACTERISTIC SPD_vVehRvsRst_C "" VALUE 0x70011640 Scalar_FLOAT32_IEEE 0 VBU0513_CM_single_cnt -3.4028234663852886E+38 3.4028234663852886E+38 /end CHARACTERISTIC
/begin CHARACTERISTIC SPD_vVehRvsThd_C "" VALUE 0x70011644 Scalar_FLOAT32_IEEE 0 VBU0513_CM_single_cnt -3.4028234663852886E+38 3.4028234663852886E+38 /end CHARACTERISTIC
/begin CHARACTERISTIC STC_trqABSDecLimit "" VALUE 0x7001164c Scalar_FLOAT32_IEEE 0 VBU0513_CM_single -3.4E+38 3.4E+38 /end CHARACTERISTIC
/begin CHARACTERISTIC SYS_facGearRatioR_SY "" VALUE 0x70011654 Scalar_FLOAT32_IEEE 0 VBU0513_CM_single_cnt -3.4028234663852886E+38 3.4028234663852886E+38 /end CHARACTERISTIC
/begin CHARACTERISTIC THM_tActvCoolEnaDeltaTemp_C "" VALUE 0x700116bc Scalar_FLOAT32_IEEE 0 VBU0513_CM_single_cnt -3.4028234663852886E+38 3.4028234663852886E+38 /end CHARACTERISTIC
/begin CHARACTERISTIC THM_tActvHeatEnaDeltaTemp_C "" VALUE 0x700116c0 Scalar_FLOAT32_IEEE 0 VBU0513_CM_single_cnt -3.4028234663852886E+38 3.4028234663852886E+38 /end CHARACTERISTIC
/begin CHARACTERISTIC THM_tPsvCoolEnaDeltaTemp_C "" VALUE 0x700116e8 Scalar_FLOAT32_IEEE 0 VBU0513_CM_single_cnt -3.4028234663852886E+38 3.4028234663852886E+38 /end CHARACTERISTIC
/begin CHARACTERISTIC THM_tPsvCoolLckDeltaTemp_C "" VALUE 0x700116ec Scalar_FLOAT32_IEEE 0 VBU0513_CM_single_cnt -3.4028234663852886E+38 3.4028234663852886E+38 /end CHARACTERISTIC
/begin CHARACTERISTIC THM_tPsvHeatEnaDeltaTemp_C "" VALUE 0x700116f0 Scalar_FLOAT32_IEEE 0 VBU0513_CM_single_cnt -3.4028234663852886E+38 3.4028234663852886E+38 /end CHARACTERISTIC
/begin CHARACTERISTIC THM_tPsvHeatLckDeltaTemp_C "" VALUE 0x700116f4 Scalar_FLOAT32_IEEE 0 VBU0513_CM_single_cnt -3.4028234663852886E+38 3.4028234663852886E+38 /end CHARACTERISTIC
/begin CHARACTERISTIC TQDMP_vVehEnaMax_C "" VALUE 0x700118ac Scalar_FLOAT32_IEEE 0 VBU0513_CM_single -3.4E+38 3.4E+38 /end CHARACTERISTIC
/begin CHARACTERISTIC TQDMP_vVehEnaMin_C "" VALUE 0x700118b0 Scalar_FLOAT32_IEEE 0 VBU0513_CM_single -3.4E+38 3.4E+38 /end CHARACTERISTIC
/begin CHARACTERISTIC TQD_trqModeChngDecGrad_C "" VALUE 0x700118cc Scalar_FLOAT32_IEEE 0 VBU0513_CM_single_cnt -3.4028234663852886E+38 3.4028234663852886E+38 /end CHARACTERISTIC
/begin CHARACTERISTIC TQD_trqModeChngIncGrad_C "" VALUE 0x700118d0 Scalar_FLOAT32_IEEE 0 VBU0513_CM_single_cnt -3.4028234663852886E+38 3.4028234663852886E+38 /end CHARACTERISTIC
/begin CHARACTERISTIC TQD_trqNrmDecGrad_C "" VALUE 0x700118d4 Scalar_FLOAT32_IEEE 0 VBU0513_CM_single_cnt -3.4028234663852886E+38 3.4028234663852886E+38 /end CHARACTERISTIC
/begin CHARACTERISTIC TQD_trqNrmIncGrad_C "" VALUE 0x700118d8 Scalar_FLOAT32_IEEE 0 VBU0513_CM_single_cnt -3.4028234663852886E+38 3.4028234663852886E+38 /end CHARACTERISTIC
/begin CHARACTERISTIC TQD_trqRateLimThres_C "" VALUE 0x700118dc Scalar_FLOAT32_IEEE 0 VBU0513_CM_single_cnt -3.4028234663852886E+38 3.4028234663852886E+38 /end CHARACTERISTIC
/begin CHARACTERISTIC TQO_pctSlopeShft_C "" VALUE 0x700118e8 Scalar_FLOAT32_IEEE 0 VBU0513_CM_single_cnt -3.4028234663852886E+38 3.4028234663852886E+38 /end CHARACTERISTIC
/begin CHARACTERISTIC TQO_tiShftDR_C "" VALUE 0x700118f0 Scalar_FLOAT32_IEEE 0 VBU0513_CM_single_cnt -3.4028234663852886E+38 3.4028234663852886E+38 /end CHARACTERISTIC
/begin CHARACTERISTIC TQO_tiShftOut_C "" VALUE 0x700118f4 Scalar_FLOAT32_IEEE 0 VBU0513_CM_single_cnt -3.4028234663852886E+38 3.4028234663852886E+38 /end CHARACTERISTIC
/begin CHARACTERISTIC VTQA_facActDrvPwrFltr_C "" VALUE 0x70011970 Scalar_FLOAT32_IEEE 0 VBU0513_CM_single_cnt 0.0 1.0 /end CHARACTERISTIC
/begin CHARACTERISTIC VTQA_facActRgnPwrFltr_C "" VALUE 0x70011974 Scalar_FLOAT32_IEEE 0 VBU0513_CM_single_cnt 0.0 1.0 /end CHARACTERISTIC
/begin CHARACTERISTIC VTQA_facMotorAvgFltr_C "" VALUE 0x70011978 Scalar_FLOAT32_IEEE 0 VBU0513_CM_single_cnt 0.0 1.0 /end CHARACTERISTIC
/begin CHARACTERISTIC VTQA_facVehSpd2MotSpd_C "" VALUE 0x7001197c Scalar_FLOAT32_IEEE 0 VBU0513_CM_single_cnt 0.0 1000.0 /end CHARACTERISTIC
/begin CHARACTERISTIC VTQA_trqABSFailMin_C "" VALUE 0x70011980 Scalar_FLOAT32_IEEE 0 VBU0513_CM_single_cnt -10000.0 10000.0 /end CHARACTERISTIC
/begin CHARACTERISTIC VTQA_trqActDrvLoLim_C "" VALUE 0x70011984 Scalar_FLOAT32_IEEE 0 VBU0513_CM_single_cnt -10000.0 10000.0 /end CHARACTERISTIC
/begin CHARACTERISTIC VTQA_trqActDrvTrqLimORV "" VALUE 0x70011988 Scalar_FLOAT32_IEEE 0 VBU0513_CM_single -3.4E+38 3.4E+38 /end CHARACTERISTIC
/begin CHARACTERISTIC VTQA_trqActDrvUpLim_C "" VALUE 0x7001198c Scalar_FLOAT32_IEEE 0 VBU0513_CM_single_cnt -10000.0 10000.0 /end CHARACTERISTIC
/begin CHARACTERISTIC VTQA_trqActRgnLoLim_C "" VALUE 0x70011990 Scalar_FLOAT32_IEEE 0 VBU0513_CM_single_cnt -10000.0 10000.0 /end CHARACTERISTIC
/begin CHARACTERISTIC VTQA_trqActRgnTrqLimORV "" VALUE 0x70011994 Scalar_FLOAT32_IEEE 0 VBU0513_CM_single -3.4E+38 3.4E+38 /end CHARACTERISTIC
/begin CHARACTERISTIC VTQA_trqActRgnUpLim_C "" VALUE 0x70011998 Scalar_FLOAT32_IEEE 0 VBU0513_CM_single_cnt -10000.0 10000.0 /end CHARACTERISTIC
/begin CHARACTERISTIC VTQA_trqAxleMaxLimit_C "" VALUE 0x7001199c Scalar_FLOAT32_IEEE 0 VBU0513_CM_single -3.4E+38 3.4E+38 /end CHARACTERISTIC
/begin CHARACTERISTIC VTQA_trqAxleMaxORV "" VALUE 0x700119a0 Scalar_FLOAT32_IEEE 0 VBU0513_CM_single -3.4E+38 3.4E+38 /end CHARACTERISTIC
/begin CHARACTERISTIC VTQA_trqAxleMinORV "" VALUE 0x700119a4 Scalar_FLOAT32_IEEE 0 VBU0513_CM_single -3.4E+38 3.4E+38 /end CHARACTERISTIC
/begin CHARACTERISTIC VTQA_trqAxleMin_C "" VALUE 0x700119a8 Scalar_FLOAT32_IEEE 0 VBU0513_CM_single_cnt -10000.0 10000.0 /end CHARACTERISTIC
/begin CHARACTERISTIC VTQA_trqBrkSwtTrqLim_C "" VALUE 0x700119ac Scalar_FLOAT32_IEEE 0 VBU0513_CM_single_cnt -10000.0 10000.0 /end CHARACTERISTIC
/begin CHARACTERISTIC VTQA_trqLimphomeMin_C "" VALUE 0x0000 Scalar_FLOAT32_IEEE 0 VBU0513_CM_single_cnt -10000.0 10000.0 /end CHARACTERISTIC
/begin CHARACTERISTIC Veh_tDCPortNegativeTempCheckEn_C "" VALUE 0x700119d8 Scalar_FLOAT32_IEEE 0 VBU0513_CM_single_cnt -3.4028234663852886E+38 3.4028234663852886E+38 /end CHARACTERISTIC
/begin CHARACTERISTIC Veh_tiDCPortPlausibilityConfirm_C "" VALUE 0x700119dc Scalar_FLOAT32_IEEE 0 VBU0513_CM_single_cnt -3.4028234663852886E+38 3.4028234663852886E+38 /end CHARACTERISTIC
/begin CHARACTERISTIC Veh_tiModeDebTime_C "" VALUE 0x700119e8 Scalar_FLOAT32_IEEE 0 VBU0513_CM_single_cnt -3.4028234663852886E+38 3.4028234663852886E+38 /end CHARACTERISTIC
/begin CHARACTERISTIC Veh_tiModeSampleTime_C "" VALUE 0x700119ec Scalar_FLOAT32_IEEE 0 VBU0513_CM_single_cnt -3.4028234663852886E+38 3.4028234663852886E+38 /end CHARACTERISTIC
/begin CHARACTERISTIC BPD_numHWBrkSwtDebounce_C "" VALUE 0x70010006 Scalar_UWORD 0 VBU0513_CM_uint16_cnt 0.0 65535.0 /end CHARACTERISTIC
/begin CHARACTERISTIC CcCBL_CellBalanceRespMismatchReqtTimeLmt_ms "" VALUE 0x70010054 Scalar_UWORD 0 VBU0513_CM_uint16_cnt 0.0 65535.0 /end CHARACTERISTIC
/begin CHARACTERISTIC DSPL_numRngCalcAch_C "" VALUE 0x7001012a Scalar_UWORD 0 VBU0513_CM_uint16_cnt 0.0 65535.0 /end CHARACTERISTIC
/begin CHARACTERISTIC APD_efAccPedPos_C "" VALUE 0x700209a2 Scalar_BOOLEAN 0 VBU0513_CM_boolean_cnt 0.0 1.0 /end CHARACTERISTIC
/begin CHARACTERISTIC APD_flgAccPedPosPctVld_C "" VALUE 0x700209a3 Scalar_BOOLEAN 0 VBU0513_CM_boolean_cnt 0.0 1.0 /end CHARACTERISTIC
/begin CHARACTERISTIC CGW_flgVehAccrModeCaliOvrd_C "" VALUE 0x70020a58 Scalar_BOOLEAN 0 VBU0513_CM_boolean_cnt 0.0 1.0 /end CHARACTERISTIC
/begin CHARACTERISTIC CGW_flgVehCreepModeCaliOvrd_C "" VALUE 0x70020a59 Scalar_BOOLEAN 0 VBU0513_CM_boolean_cnt 0.0 1.0 /end CHARACTERISTIC
/begin CHARACTERISTIC CGW_flgVehDrvModeCaliOvrd_C "" VALUE 0x70020a5a Scalar_BOOLEAN 0 VBU0513_CM_boolean_cnt 0.0 1.0 /end CHARACTERISTIC
/begin CHARACTERISTIC CGW_flgVehRgnModeCaliOvrd_C "" VALUE 0x70020a5c Scalar_BOOLEAN 0 VBU0513_CM_boolean_cnt 0.0 1.0 /end CHARACTERISTIC
/begin CHARACTERISTIC CbBCV_BdmBatteryBusVoltageMismatch_flg "" VALUE 0x70020ab4 Scalar_BOOLEAN 0 VBU0513_CM_boolean_cnt 0.0 1.0 /end CHARACTERISTIC
/begin CHARACTERISTIC CbBCV_BdmBatteryCurrentOoR_flg "" VALUE 0x70020ab5 Scalar_BOOLEAN 0 VBU0513_CM_boolean_cnt 0.0 1.0 /end CHARACTERISTIC
/begin CHARACTERISTIC CbBCV_BdmBatteryOverCurrent_flg "" VALUE 0x70020ab6 Scalar_BOOLEAN 0 VBU0513_CM_boolean_cnt 0.0 1.0 /end CHARACTERISTIC
/begin CHARACTERISTIC CbBCV_BdmBatteryOverVoltage_flg "" VALUE 0x70020ab7 Scalar_BOOLEAN 0 VBU0513_CM_boolean_cnt 0.0 1.0 /end CHARACTERISTIC
/begin CHARACTERISTIC CbBCV_BdmBatteryUnderVoltage_flg "" VALUE 0x70020ab8 Scalar_BOOLEAN 0 VBU0513_CM_boolean_cnt 0.0 1.0 /end CHARACTERISTIC
/begin CHARACTERISTIC CbBCV_BdmBatteryVoltageOoR_flg "" VALUE 0x70020ab9 Scalar_BOOLEAN 0 VBU0513_CM_boolean_cnt 0.0 1.0 /end CHARACTERISTIC
/begin CHARACTERISTIC CbCTD_MnNegContactorStuckOpenFaultEnable_flg "" VALUE 0x70020ad9 Scalar_BOOLEAN 0 VBU0513_CM_boolean_cnt 0.0 1.0 /end CHARACTERISTIC
/begin CHARACTERISTIC CbCTD_MnPosContactorStuckOpenFaultEnable_flg "" VALUE 0x70020adb Scalar_BOOLEAN 0 VBU0513_CM_boolean_cnt 0.0 1.0 /end CHARACTERISTIC
/begin CHARACTERISTIC CbCTD_PrechargeEnergyHighFaultEnable_flg "" VALUE 0x70020add Scalar_BOOLEAN 0 VBU0513_CM_boolean_cnt 0.0 1.0 /end CHARACTERISTIC
/begin CHARACTERISTIC CbCTD_PrechargeHeatProtectionEnable_flg "" VALUE 0x70020ade Scalar_BOOLEAN 0 VBU0513_CM_boolean_cnt 0.0 1.0 /end CHARACTERISTIC
/begin CHARACTERISTIC CbCTD_RnMnNegContactorStuckOpenFaultEnable_flg "" VALUE 0x70020ae3 Scalar_BOOLEAN 0 VBU0513_CM_boolean_cnt 0.0 1.0 /end CHARACTERISTIC
/begin CHARACTERISTIC CbCTD_RnMnPosContactorStuckOpenFaultEnable_flg "" VALUE 0x70020ae4 Scalar_BOOLEAN 0 VBU0513_CM_boolean_cnt 0.0 1.0 /end CHARACTERISTIC
/begin CHARACTERISTIC CbFCC_ChargeCurrentOvR_flg "" VALUE 0x70020b08 Scalar_BOOLEAN 0 VBU0513_CM_boolean_cnt 0.0 1.0 /end CHARACTERISTIC
/begin CHARACTERISTIC CcFCC_ChargeCurrentOverEnable_flg "" VALUE 0x70020c2e Scalar_BOOLEAN 0 VBU0513_CM_boolean_cnt 0.0 1.0 /end CHARACTERISTIC
/begin CHARACTERISTIC CcFCC_ChargeCurrentOverFuncEnable_flg "" VALUE 0x70020c31 Scalar_BOOLEAN 0 VBU0513_CM_boolean_cnt 0.0 1.0 /end CHARACTERISTIC
/begin CHARACTERISTIC DCH_flgDCChDiagCmdOvrdVal_C "" VALUE 0x70020d0a Scalar_BOOLEAN 0 VBU0513_CM_boolean_cnt 0.0 1.0 /end CHARACTERISTIC
/begin CHARACTERISTIC DCH_flgDCChDiagCmdOvrd_C "" VALUE 0x70020d0b Scalar_BOOLEAN 0 VBU0513_CM_boolean_cnt 0.0 1.0 /end CHARACTERISTIC
/begin CHARACTERISTIC DCH_flgPosDCRlyReqOvrdVal_C "" VALUE 0x70020d21 Scalar_BOOLEAN 0 VBU0513_CM_boolean_cnt 0.0 1.0 /end CHARACTERISTIC
/begin CHARACTERISTIC DCH_flgPosDCRlyReqOvrd_C "" VALUE 0x70020d22 Scalar_BOOLEAN 0 VBU0513_CM_boolean_cnt 0.0 1.0 /end CHARACTERISTIC
/begin CHARACTERISTIC DSPL_flgSwapModeEn_C "" VALUE 0x70020da2 Scalar_BOOLEAN 0 VBU0513_CM_boolean_flg 0.0 1.0 /end CHARACTERISTIC
/begin CHARACTERISTIC EDIS_flgACPowOverride_C "" VALUE 0x70020db0 Scalar_BOOLEAN 0 VBU0513_CM_boolean_cnt 0.0 1.0 /end CHARACTERISTIC
/begin CHARACTERISTIC EDIS_flgDCDCPowOverride_C "" VALUE 0x70020db2 Scalar_BOOLEAN 0 VBU0513_CM_boolean_cnt 0.0 1.0 /end CHARACTERISTIC
/begin CHARACTERISTIC EDIS_flgHVHPowOverride_C "" VALUE 0x70020db5 Scalar_BOOLEAN 0 VBU0513_CM_boolean_cnt 0.0 1.0 /end CHARACTERISTIC
/begin CHARACTERISTIC EDIS_flgNoUsePowLackUpGrad_C "" VALUE 0x70020db6 Scalar_BOOLEAN 0 VBU0513_CM_boolean_cnt 0.0 1.0 /end CHARACTERISTIC
/begin CHARACTERISTIC EDIS_flgPTCPowOverride_C "" VALUE 0x70020db8 Scalar_BOOLEAN 0 VBU0513_CM_boolean_cnt 0.0 1.0 /end CHARACTERISTIC
/begin CHARACTERISTIC EDIS_flgUseAcsPwrReq_C "" VALUE 0x70020db9 Scalar_BOOLEAN 0 VBU0513_CM_boolean_cnt 0.0 1.0 /end CHARACTERISTIC
/begin CHARACTERISTIC EDIS_flgUseDynChPwrComfort_C "" VALUE 0x70020dba Scalar_BOOLEAN 0 VBU0513_CM_boolean_cnt 0.0 1.0 /end CHARACTERISTIC
/begin CHARACTERISTIC Gear_flgBrkPressConfig_C "" VALUE 0x90004b4f Scalar_BOOLEAN 0 VBU0513_CM_boolean 0 1 /end CHARACTERISTIC
/begin CHARACTERISTIC Gear_flgDriveIntendGearVld_C "" VALUE 0x70020df2 Scalar_BOOLEAN 0 VBU0513_CM_boolean_cnt 0.0 1.0 /end CHARACTERISTIC
/begin CHARACTERISTIC Gear_flgEmotTqSelect_C "" VALUE 0x70020df4 Scalar_BOOLEAN 0 VBU0513_CM_boolean_cnt 0.0 1.0 /end CHARACTERISTIC
/begin CHARACTERISTIC Gear_flgTorqueProtectEn_C "" VALUE 0x70020df6 Scalar_BOOLEAN 0 VBU0513_CM_boolean_cnt 0.0 1.0 /end CHARACTERISTIC
/begin CHARACTERISTIC HIGH "" VALUE 0x70020e18 Scalar_BOOLEAN 0 VBU0513_CM_boolean_cnt 0.0 1.0 /end CHARACTERISTIC
/begin CHARACTERISTIC LOW "" VALUE 0x70020e46 Scalar_BOOLEAN 0 VBU0513_CM_boolean_cnt 0.0 1.0 /end CHARACTERISTIC
/begin CHARACTERISTIC LbCTS_AbortPrechargeOvrdVal_flg "" VALUE 0x70020e4b Scalar_BOOLEAN 0 VBU0513_CM_boolean 0 1 /end CHARACTERISTIC
/begin CHARACTERISTIC LbCTS_AbortPrechargeOvrd_flg "" VALUE 0x70020e4c Scalar_BOOLEAN 0 VBU0513_CM_boolean 0 1 /end CHARACTERISTIC
/begin CHARACTERISTIC LbCTS_InhibitPrechargeOvrdVal_flg "" VALUE 0x70020e4d Scalar_BOOLEAN 0 VBU0513_CM_boolean 0 1 /end CHARACTERISTIC
/begin CHARACTERISTIC LbCTS_InhibitPrechargeOvrd_flg "" VALUE 0x70020e4e Scalar_BOOLEAN 0 VBU0513_CM_boolean 0 1 /end CHARACTERISTIC
/begin CHARACTERISTIC PMM_flgOffLoadTOutToHVOpReqSwt_C "" VALUE 0x70020e83 Scalar_BOOLEAN 0 VBU0513_CM_boolean_cnt 0.0 1.0 /end CHARACTERISTIC
/begin CHARACTERISTIC PMM_flgVCUShtDwnOvrdSwt_C "" VALUE 0x70020e8e Scalar_BOOLEAN 0 VBU0513_CM_boolean_cnt 0.0 1.0 /end CHARACTERISTIC
/begin CHARACTERISTIC PMM_flgVCUShtDwnOvrdVal_C "" VALUE 0x70020e8f Scalar_BOOLEAN 0 VBU0513_CM_boolean_cnt 0.0 1.0 /end CHARACTERISTIC
/begin CHARACTERISTIC PMM_flgWkup1CmdOvrdSwt_C "" VALUE 0x70020e95 Scalar_BOOLEAN 0 VBU0513_CM_boolean_cnt 0.0 1.0 /end CHARACTERISTIC
/begin CHARACTERISTIC PMM_flgWkup1CmdOvrdVal_C "" VALUE 0x70020e96 Scalar_BOOLEAN 0 VBU0513_CM_boolean_cnt 0.0 1.0 /end CHARACTERISTIC
/begin CHARACTERISTIC SPD_flgUseMotorSpeed_C "" VALUE 0x70020ed4 Scalar_BOOLEAN 0 VBU0513_CM_boolean 0.0 1.0 /end CHARACTERISTIC
/begin CHARACTERISTIC STC_flgRgnTrqCnclRA_C "" VALUE 0x70020ed6 Scalar_BOOLEAN 0 VBU0513_CM_boolean_cnt 0.0 1.0 /end CHARACTERISTIC
/begin CHARACTERISTIC TQDMP_flgROTCDisblORF "" VALUE 0x70020efb Scalar_BOOLEAN 0 VBU0513_CM_boolean 0 1 /end CHARACTERISTIC
/begin CHARACTERISTIC TQDMP_flgROTCDisblORV "" VALUE 0x70020efc Scalar_BOOLEAN 0 VBU0513_CM_boolean 0 1 /end CHARACTERISTIC
/begin CHARACTERISTIC TQD_flgBrkPresUsed_C "" VALUE 0x70020f02 Scalar_BOOLEAN 0 VBU0513_CM_boolean_cnt 0.0 1.0 /end CHARACTERISTIC
/begin CHARACTERISTIC TQD_flgCreepFnctnEna_C "" VALUE 0x70020f03 Scalar_BOOLEAN 0 VBU0513_CM_boolean_cnt 0.0 1.0 /end CHARACTERISTIC
/begin CHARACTERISTIC TQD_flgSlpEna_C "" VALUE 0x0000 Scalar_BOOLEAN 0 VBU0513_CM_boolean_cnt 0.0 1.0 /end CHARACTERISTIC
/begin CHARACTERISTIC TQD_flgTrqMinEn_C "" VALUE 0x70020f04 Scalar_BOOLEAN 0 VBU0513_CM_boolean_cnt 0.0 1.0 /end CHARACTERISTIC
/begin CHARACTERISTIC VTQA_flgActDrvTrqLimORF "" VALUE 0x70020f1d Scalar_BOOLEAN 0 VBU0513_CM_boolean 0 1 /end CHARACTERISTIC
/begin CHARACTERISTIC VTQA_flgActRgnTrqLimORF "" VALUE 0x70020f1e Scalar_BOOLEAN 0 VBU0513_CM_boolean 0 1 /end CHARACTERISTIC
/begin CHARACTERISTIC VTQA_flgAxleMaxORF "" VALUE 0x70020f1f Scalar_BOOLEAN 0 VBU0513_CM_boolean 0 1 /end CHARACTERISTIC
/begin CHARACTERISTIC VTQA_flgAxleMinORF "" VALUE 0x70020f20 Scalar_BOOLEAN 0 VBU0513_CM_boolean 0 1 /end CHARACTERISTIC
/begin CHARACTERISTIC Veh_flgNetworkPartialEn_C "" VALUE 0x70020f26 Scalar_BOOLEAN 0 VBU0513_CM_boolean_cnt 0.0 1.0 /end CHARACTERISTIC
/begin CHARACTERISTIC CcBCV_BdmBatteryBusVoltageMismatchFaultFIC_n "" VALUE 0x70020bd7 Scalar_BYTE 0 VBU0513_CM_int8_cnt -128.0 127.0 /end CHARACTERISTIC
/begin CHARACTERISTIC CcBCV_BdmBatteryBusVoltageMismatchFaultPIC_n "" VALUE 0x70020bd8 Scalar_BYTE 0 VBU0513_CM_int8_cnt -128.0 127.0 /end CHARACTERISTIC
/begin CHARACTERISTIC CcBCV_BdmBatteryCurrentOoRFaultFIC_n "" VALUE 0x70020bd9 Scalar_BYTE 0 VBU0513_CM_int8_cnt -128.0 127.0 /end CHARACTERISTIC
/begin CHARACTERISTIC CcBCV_BdmBatteryCurrentOoRFaultPIC_n "" VALUE 0x70020bda Scalar_BYTE 0 VBU0513_CM_int8_cnt -128.0 127.0 /end CHARACTERISTIC
/begin CHARACTERISTIC CcBCV_BdmBatteryOverCurrentFaultFIC_n "" VALUE 0x70020bdb Scalar_BYTE 0 VBU0513_CM_int8_cnt -128.0 127.0 /end CHARACTERISTIC
/begin CHARACTERISTIC CcBCV_BdmBatteryOverCurrentFaultPIC_n "" VALUE 0x70020bdc Scalar_BYTE 0 VBU0513_CM_int8_cnt -128.0 127.0 /end CHARACTERISTIC
/begin CHARACTERISTIC CcBCV_BdmBatteryOverVoltageFaultFIC_n "" VALUE 0x70020bdd Scalar_BYTE 0 VBU0513_CM_int8_cnt -128.0 127.0 /end CHARACTERISTIC
/begin CHARACTERISTIC CcBCV_BdmBatteryOverVoltageFaultPIC_n "" VALUE 0x70020bde Scalar_BYTE 0 VBU0513_CM_int8_cnt -128.0 127.0 /end CHARACTERISTIC
/begin CHARACTERISTIC CcBCV_BdmBatteryUnderVoltageFaultFIC_n "" VALUE 0x70020bdf Scalar_BYTE 0 VBU0513_CM_int8_cnt -128.0 127.0 /end CHARACTERISTIC
/begin CHARACTERISTIC CcBCV_BdmBatteryUnderVoltageFaultPIC_n "" VALUE 0x70020be0 Scalar_BYTE 0 VBU0513_CM_int8_cnt -128.0 127.0 /end CHARACTERISTIC
/begin CHARACTERISTIC CcBCV_BdmBatteryVoltageOoRFaultFIC_n "" VALUE 0x70020be1 Scalar_BYTE 0 VBU0513_CM_int8_cnt -128.0 127.0 /end CHARACTERISTIC
/begin CHARACTERISTIC CcBCV_BdmBatteryVoltageOoRFaultPIC_n "" VALUE 0x70020be2 Scalar_BYTE 0 VBU0513_CM_int8_cnt -128.0 127.0 /end CHARACTERISTIC
/begin CHARACTERISTIC CcCTD_MnNegContactorStuckOpenFaultFIC_n "" VALUE 0x70020beb Scalar_BYTE 0 VBU0513_CM_int8_cnt -128.0 127.0 /end CHARACTERISTIC
/begin CHARACTERISTIC CcCTD_MnNegContactorStuckOpenFaultPIC_n "" VALUE 0x70020bec Scalar_BYTE 0 VBU0513_CM_int8_cnt -128.0 127.0 /end CHARACTERISTIC
/begin CHARACTERISTIC CcCTD_MnPosContactorStuckOpenFaultFIC_n "" VALUE 0x70020bef Scalar_BYTE 0 VBU0513_CM_int8_cnt -128.0 127.0 /end CHARACTERISTIC
/begin CHARACTERISTIC CcCTD_MnPosContactorStuckOpenFaultPIC_n "" VALUE 0x70020bf0 Scalar_BYTE 0 VBU0513_CM_int8_cnt -128.0 127.0 /end CHARACTERISTIC
/begin CHARACTERISTIC CcCTD_PrechargeEnergyHighFaultFIC_n "" VALUE 0x70020bf3 Scalar_BYTE 0 VBU0513_CM_int8_cnt -128.0 127.0 /end CHARACTERISTIC
/begin CHARACTERISTIC CcCTD_PrechargeEnergyHighFaultPIC_n "" VALUE 0x70020bf4 Scalar_BYTE 0 VBU0513_CM_int8_cnt -128.0 127.0 /end CHARACTERISTIC
/begin CHARACTERISTIC CcCTD_RnMnNegContactorStuckOpenFaultFIC_n "" VALUE 0x70020bfb Scalar_BYTE 0 VBU0513_CM_int8_cnt -128.0 127.0 /end CHARACTERISTIC
/begin CHARACTERISTIC CcCTD_RnMnNegContactorStuckOpenFaultPIC_n "" VALUE 0x70020bfc Scalar_BYTE 0 VBU0513_CM_int8_cnt -128.0 127.0 /end CHARACTERISTIC
/begin CHARACTERISTIC CcCTD_RnMnPosContactorStuckOpenFaultFIC_n "" VALUE 0x70020bfd Scalar_BYTE 0 VBU0513_CM_int8_cnt -128.0 127.0 /end CHARACTERISTIC
/begin CHARACTERISTIC CcCTD_RnMnPosContactorStuckOpenFaultPIC_n "" VALUE 0x70020bfe Scalar_BYTE 0 VBU0513_CM_int8_cnt -128.0 127.0 /end CHARACTERISTIC
/begin CHARACTERISTIC APD_stConfirmErr_C "" VALUE 0x700209a5 Scalar_UBYTE 0 VBU0513_CM_uint8_cnt 0.0 15.0 /end CHARACTERISTIC
/begin CHARACTERISTIC APD_stNoErr_C "" VALUE 0x700209a6 Scalar_UBYTE 0 VBU0513_CM_uint8_cnt 0.0 15.0 /end CHARACTERISTIC
/begin CHARACTERISTIC BPD_stBrkPedPrsActv_C "" VALUE 0x70020a40 Scalar_UBYTE 0 VBU0513_CM_uint8_cnt 0.0 15.0 /end CHARACTERISTIC
/begin CHARACTERISTIC BPD_stBrkPedPrsPsbl_C "" VALUE 0x70020a42 Scalar_UBYTE 0 VBU0513_CM_uint8_cnt 0.0 15.0 /end CHARACTERISTIC
/begin CHARACTERISTIC BPD_stBrkSwtConfig_C "" VALUE 0x70020a43 Scalar_UBYTE 0 VBU0513_CM_uint8_cnt 0.0 255.0 /end CHARACTERISTIC
/begin CHARACTERISTIC CDC_stVehAccr2Mod_C "" VALUE 0x70020a4b Scalar_UBYTE 0 VBU0513_CM_uint8_cnt 0.0 15.0 /end CHARACTERISTIC
/begin CHARACTERISTIC CDC_stVehAccrNormalMod_C "" VALUE 0x70020a4c Scalar_UBYTE 0 VBU0513_CM_uint8_cnt 0.0 15.0 /end CHARACTERISTIC
/begin CHARACTERISTIC CDC_stVehAccrSportMod_C "" VALUE 0x70020a4d Scalar_UBYTE 0 VBU0513_CM_uint8_cnt 0.0 15.0 /end CHARACTERISTIC
/begin CHARACTERISTIC CDC_stVehAutoMod_C "" VALUE 0x70020a4e Scalar_UBYTE 0 VBU0513_CM_uint8_cnt 0.0 15.0 /end CHARACTERISTIC
/begin CHARACTERISTIC CDC_stVehCreepON_C "" VALUE 0x70020a4f Scalar_UBYTE 0 VBU0513_CM_uint8_cnt 0.0 15.0 /end CHARACTERISTIC
/begin CHARACTERISTIC CDC_stVehCreepOffRgnOff_C "" VALUE 0x70020a50 Scalar_UBYTE 0 VBU0513_CM_uint8_cnt 0.0 15.0 /end CHARACTERISTIC
/begin CHARACTERISTIC CDC_stVehCreepOff_C "" VALUE 0x70020a51 Scalar_UBYTE 0 VBU0513_CM_uint8_cnt 0.0 15.0 /end CHARACTERISTIC
/begin CHARACTERISTIC CDC_stVehCreepOnRgnLow_C "" VALUE 0x70020a52 Scalar_UBYTE 0 VBU0513_CM_uint8_cnt 0.0 15.0 /end CHARACTERISTIC
/begin CHARACTERISTIC CDC_stVehCreepOnRgnNormal_C "" VALUE 0x70020a53 Scalar_UBYTE 0 VBU0513_CM_uint8_cnt 0.0 15.0 /end CHARACTERISTIC
/begin CHARACTERISTIC CDC_stVehCreepOnRgnZero_C "" VALUE 0x70020a54 Scalar_UBYTE 0 VBU0513_CM_uint8_cnt 0.0 15.0 /end CHARACTERISTIC
/begin CHARACTERISTIC CDC_stVehECOMod_C "" VALUE 0x70020a55 Scalar_UBYTE 0 VBU0513_CM_uint8_cnt 0.0 15.0 /end CHARACTERISTIC
/begin CHARACTERISTIC CGW_stVehAccr2Mod_C "" VALUE 0x70020a5d Scalar_UBYTE 0 VBU0513_CM_uint8_cnt 0.0 15.0 /end CHARACTERISTIC
/begin CHARACTERISTIC CGW_stVehAccrModeCaliOvrdVal_C "" VALUE 0x70020a5e Scalar_UBYTE 0 VBU0513_CM_uint8_cnt 0.0 15.0 /end CHARACTERISTIC
/begin CHARACTERISTIC CGW_stVehAccrNormalMod_C "" VALUE 0x70020a5f Scalar_UBYTE 0 VBU0513_CM_uint8_cnt 0.0 15.0 /end CHARACTERISTIC
/begin CHARACTERISTIC CGW_stVehAccrSportMod_C "" VALUE 0x70020a60 Scalar_UBYTE 0 VBU0513_CM_uint8_cnt 0.0 15.0 /end CHARACTERISTIC
/begin CHARACTERISTIC CGW_stVehCreepModeCaliOvrdVal_C "" VALUE 0x70020a61 Scalar_UBYTE 0 VBU0513_CM_uint8_cnt 0.0 15.0 /end CHARACTERISTIC
/begin CHARACTERISTIC CGW_stVehCreepOff_C "" VALUE 0x70020a62 Scalar_UBYTE 0 VBU0513_CM_uint8_cnt 0.0 15.0 /end CHARACTERISTIC
/begin CHARACTERISTIC CGW_stVehCreepOn_C "" VALUE 0x70020a63 Scalar_UBYTE 0 VBU0513_CM_uint8_cnt 0.0 15.0 /end CHARACTERISTIC
/begin CHARACTERISTIC CGW_stVehDrvModeCaliOvrdVal_C "" VALUE 0x70020a64 Scalar_UBYTE 0 VBU0513_CM_uint8_cnt 0.0 15.0 /end CHARACTERISTIC
/begin CHARACTERISTIC CGW_stVehECOMod_C "" VALUE 0x70020a66 Scalar_UBYTE 0 VBU0513_CM_uint8_cnt 0.0 15.0 /end CHARACTERISTIC
/begin CHARACTERISTIC CGW_stVehNormalMod_C "" VALUE 0x70020a67 Scalar_UBYTE 0 VBU0513_CM_uint8_cnt 0.0 15.0 /end CHARACTERISTIC
/begin CHARACTERISTIC CGW_stVehRgnLow_C "" VALUE 0x70020a68 Scalar_UBYTE 0 VBU0513_CM_uint8_cnt 0.0 15.0 /end CHARACTERISTIC
/begin CHARACTERISTIC CGW_stVehRgnModeCaliOvrdVal_C "" VALUE 0x70020a69 Scalar_UBYTE 0 VBU0513_CM_uint8_cnt 0.0 15.0 /end CHARACTERISTIC
/begin CHARACTERISTIC CGW_stVehRgnNormal_C "" VALUE 0x70020a6c Scalar_UBYTE 0 VBU0513_CM_uint8_cnt 0.0 15.0 /end CHARACTERISTIC
/begin CHARACTERISTIC CGW_stVehRgnOff_C "" VALUE 0x70020a6d Scalar_UBYTE 0 VBU0513_CM_uint8_cnt 0.0 15.0 /end CHARACTERISTIC
/begin CHARACTERISTIC CGW_stVehRgnZero_C "" VALUE 0x70020a6e Scalar_UBYTE 0 VBU0513_CM_uint8_cnt 0.0 15.0 /end CHARACTERISTIC
/begin CHARACTERISTIC CGW_stVehSportMod_C "" VALUE 0x70020a6f Scalar_UBYTE 0 VBU0513_CM_uint8_cnt 0.0 15.0 /end CHARACTERISTIC
/begin CHARACTERISTIC CTD_MAIN_NEGATIVE_CONTACTOR_STUCK_OPEN_FAULT "" VALUE 0x70020a89 Scalar_UBYTE 0 VBU0513_CM_uint8_cnt 0.0 255.0 /end CHARACTERISTIC
/begin CHARACTERISTIC CTD_MAIN_POSITIVE_CONTACTOR_STUCK_OPEN_FAULT "" VALUE 0x70020a8a Scalar_UBYTE 0 VBU0513_CM_uint8_cnt 0.0 255.0 /end CHARACTERISTIC
/begin CHARACTERISTIC CTD_PRECHARGE_STATUS_IDLE "" VALUE 0x70020a8d Scalar_UBYTE 0 VBU0513_CM_uint8_cnt 0.0 255.0 /end CHARACTERISTIC
/begin CHARACTERISTIC DCH_stBMSChrging_SY "" VALUE 0x70020d4a Scalar_UBYTE 0 VBU0513_CM_uint8_cnt 0.0 255.0 /end CHARACTERISTIC
/begin CHARACTERISTIC DCH_stHVCntctClosed_SY "" VALUE 0x70020d61 Scalar_UBYTE 0 VBU0513_CM_uint8_cnt 0.0 255.0 /end CHARACTERISTIC
/begin CHARACTERISTIC DIAGS_stPsvRespAlreadyOk_SY "" VALUE 0x70020d9b Scalar_UBYTE 0 VBU0513_CM_uint8_cnt 0.0 255.0 /end CHARACTERISTIC
/begin CHARACTERISTIC DSPL_cntDriveTempReset_C "" VALUE 0x70020d9f Scalar_UBYTE 0 VBU0513_CM_uint8_cnt 0.0 255.0 /end CHARACTERISTIC
/begin CHARACTERISTIC DSPL_stDCPortTempNoErr_C "" VALUE 0x70020da8 Scalar_UBYTE 0 VBU0513_CM_uint8_cnt 0.0 255.0 /end CHARACTERISTIC
/begin CHARACTERISTIC EPB_CompleteTight "" VALUE 0x70020dbe Scalar_UBYTE 0 VBU0513_CM_uint8 0 255 /end CHARACTERISTIC
/begin CHARACTERISTIC EPB_stApplying "" VALUE 0x70020dc1 Scalar_UBYTE 0 VBU0513_CM_uint8 0 255 /end CHARACTERISTIC
/begin CHARACTERISTIC EPB_stClosed "" VALUE 0x70020dc2 Scalar_UBYTE 0 VBU0513_CM_uint8_cnt 0.0 255.0 /end CHARACTERISTIC
/begin CHARACTERISTIC Gear_stBCUEPBSwtPressed_C "" VALUE 0x70020df7 Scalar_UBYTE 0 VBU0513_CM_uint8_cnt 0.0 15.0 /end CHARACTERISTIC
/begin CHARACTERISTIC Gear_stCurrentGearD_C "" VALUE 0x70020df8 Scalar_UBYTE 0 VBU0513_CM_uint8_cnt 0.0 15.0 /end CHARACTERISTIC
/begin CHARACTERISTIC Gear_stCurrentGearR_C "" VALUE 0x70020dfd Scalar_UBYTE 0 VBU0513_CM_uint8_cnt 0.0 15.0 /end CHARACTERISTIC
/begin CHARACTERISTIC Gear_stEPBApplied_C "" VALUE 0x70020e02 Scalar_UBYTE 0 VBU0513_CM_uint8_cnt 0.0 15.0 /end CHARACTERISTIC
/begin CHARACTERISTIC Gear_stEPBApplyReq_C "" VALUE 0x70020e03 Scalar_UBYTE 0 VBU0513_CM_uint8_cnt 0.0 15.0 /end CHARACTERISTIC
/begin CHARACTERISTIC Gear_stEPBFailNoErr_C "" VALUE 0x70020e04 Scalar_UBYTE 0 VBU0513_CM_uint8_cnt 0.0 15.0 /end CHARACTERISTIC
/begin CHARACTERISTIC Gear_stEPBNoApplyReq_C "" VALUE 0x70020e05 Scalar_UBYTE 0 VBU0513_CM_uint8_cnt 0.0 15.0 /end CHARACTERISTIC
/begin CHARACTERISTIC Gear_stEPBReleased_C "" VALUE 0x70020e06 Scalar_UBYTE 0 VBU0513_CM_uint8_cnt 0.0 15.0 /end CHARACTERISTIC
/begin CHARACTERISTIC Gear_stEPBUnknow_C "" VALUE 0x70020e08 Scalar_UBYTE 0 VBU0513_CM_uint8_cnt 0.0 15.0 /end CHARACTERISTIC
/begin CHARACTERISTIC Gear_stHVRelayClosed_C "" VALUE 0x70020e0c Scalar_UBYTE 0 VBU0513_CM_uint8_cnt 0.0 15.0 /end CHARACTERISTIC
/begin CHARACTERISTIC Gear_stIntendGearP_C "" VALUE 0x70020e0f Scalar_UBYTE 0 VBU0513_CM_uint8_cnt 0.0 15.0 /end CHARACTERISTIC
/begin CHARACTERISTIC Gear_stVehModeDCH_C "" VALUE 0x70020e11 Scalar_UBYTE 0 VBU0513_CM_uint8_cnt 0.0 15.0 /end CHARACTERISTIC
/begin CHARACTERISTIC PMM_stACChMode_SY "" VALUE 0x70020e98 Scalar_UBYTE 0 VBU0513_CM_uint8_cnt 0.0 255.0 /end CHARACTERISTIC
/begin CHARACTERISTIC PMM_stDCDCWrking_SY "" VALUE 0x70020e9e Scalar_UBYTE 0 VBU0513_CM_uint8_cnt 0.0 255.0 /end CHARACTERISTIC
/begin CHARACTERISTIC PMM_stDCHInitSts_SY "" VALUE 0x70020e9f Scalar_UBYTE 0 VBU0513_CM_uint8_cnt 0.0 255.0 /end CHARACTERISTIC
/begin CHARACTERISTIC PMM_stDCHShtDwnSts_SY "" VALUE 0x70020ea0 Scalar_UBYTE 0 VBU0513_CM_uint8_cnt 0.0 255.0 /end CHARACTERISTIC
/begin CHARACTERISTIC SYS_stMCUErr_SY "" VALUE 0x70020ed9 Scalar_UBYTE 0 VBU0513_CM_uint8_cnt 0.0 255.0 /end CHARACTERISTIC
/begin CHARACTERISTIC SYS_stShftPosNeutr_SY "" VALUE 0x70020eda Scalar_UBYTE 0 VBU0513_CM_uint8_cnt 0.0 255.0 /end CHARACTERISTIC
/begin CHARACTERISTIC SYS_stShftPosPark_SY "" VALUE 0x70020edb Scalar_UBYTE 0 VBU0513_CM_uint8_cnt 0.0 255.0 /end CHARACTERISTIC
/begin CHARACTERISTIC Veh_stCGWNetworkPartial_C "" VALUE 0x70020f27 Scalar_UBYTE 0 VBU0513_CM_uint8_cnt 0.0 15.0 /end CHARACTERISTIC
/begin CHARACTERISTIC Veh_stDCPortTempErr_C "" VALUE 0x70020f28 Scalar_UBYTE 0 VBU0513_CM_uint8_cnt 0.0 15.0 /end CHARACTERISTIC
/begin CHARACTERISTIC Veh_stDCPortTempNoErr_C "" VALUE 0x70020f29 Scalar_UBYTE 0 VBU0513_CM_uint8_cnt 0.0 15.0 /end CHARACTERISTIC
/begin MEASUREMENT LcCTD_tiPrechargeHeatProtectionTime "" ULONG VBU0513_CM_uint32 0 0 0 4294967295 ECU_ADDRESS 0x900022e6 /end MEASUREMENT
/begin MEASUREMENT BPD_pBrkPress "" FLOAT32_IEEE VBU0513_CM_single 0 0 -3.4E+38 3.4E+38 ECU_ADDRESS 0x900020fe /end MEASUREMENT
/begin MEASUREMENT BPD_pctBrkPress "" FLOAT32_IEEE VBU0513_CM_single 0 0 -3.4E+38 3.4E+38 ECU_ADDRESS 0x90002106 /end MEASUREMENT
/begin MEASUREMENT BPD_pctBrkPressPercent "" FLOAT32_IEEE VBU0513_CM_single 0 0 -3.4E+38 3.4E+38 ECU_ADDRESS 0x9000210a /end MEASUREMENT
/begin MEASUREMENT BPD_pctBrkPos "" FLOAT32_IEEE VBU0513_CM_single 0 0 -3.4E+38 3.4E+38 ECU_ADDRESS 0x90002102 /end MEASUREMENT
/begin MEASUREMENT SPD_vMotrSpd "" FLOAT32_IEEE VBU0513_CM_single 0 0 -3.4E+38 3.4E+38 ECU_ADDRESS 0x90001fee /end MEASUREMENT
/begin MEASUREMENT APD_pctAccPedPos "" FLOAT32_IEEE VBU0513_CM_single 0 0 -3.4E+38 3.4E+38 ECU_ADDRESS 0x900020ee /end MEASUREMENT
/begin MEASUREMENT SPD_pctSlope "" FLOAT32_IEEE VBU0513_CM_single 0 0 -3.4E+38 3.4E+38 ECU_ADDRESS 0x90001fe2 /end MEASUREMENT
/begin MEASUREMENT VTQA_trqBrkTrqMax "" FLOAT32_IEEE VBU0513_CM_single 0 0 -10000.0 10000.0 ECU_ADDRESS 0x9000220a /end MEASUREMENT
/begin MEASUREMENT VTQA_trqBcuTrqMax "" FLOAT32_IEEE VBU0513_CM_single 0 0 -10000.0 10000.0 ECU_ADDRESS 0x90002206 /end MEASUREMENT
/begin MEASUREMENT VTQA_trqBattTrqMax "" FLOAT32_IEEE VBU0513_CM_single 0 0 -10000.0 10000.0 ECU_ADDRESS 0x900021fe /end MEASUREMENT
/begin MEASUREMENT VTQA_trqMotTrqMax "" FLOAT32_IEEE VBU0513_CM_single 0 0 -10000.0 10000.0 ECU_ADDRESS 0x90002216 /end MEASUREMENT
/begin MEASUREMENT VTQA_trqLimpTrqMax "" FLOAT32_IEEE VBU0513_CM_single 0 0 -10000.0 10000.0 ECU_ADDRESS 0x90002212 /end MEASUREMENT
/begin MEASUREMENT VTQA_trqLimpByPmpTrqMax "" FLOAT32_IEEE VBU0513_CM_single 0 0 -10000.0 10000.0 ECU_ADDRESS 0x9000220e /end MEASUREMENT
/begin MEASUREMENT VTQA_trqAxleMax "" FLOAT32_IEEE VBU0513_CM_single 0 0 -10000.0 10000.0 ECU_ADDRESS 0x900021f6 /end MEASUREMENT
/begin MEASUREMENT VTQA_trqBattTrqMin "" FLOAT32_IEEE VBU0513_CM_single 0 0 -10000.0 10000.0 ECU_ADDRESS 0x90002202 /end MEASUREMENT
/begin MEASUREMENT VTQA_trqMotTrqMin "" FLOAT32_IEEE VBU0513_CM_single 0 0 -10000.0 10000.0 ECU_ADDRESS 0x9000221a /end MEASUREMENT
/begin MEASUREMENT VTQA_trqActvLimpLimit "" FLOAT32_IEEE VBU0513_CM_single 0 0 -3.4E+38 3.4E+38 ECU_ADDRESS 0x9000252e /end MEASUREMENT
/begin MEASUREMENT VTQA_trqInhibRegenLimit "" FLOAT32_IEEE VBU0513_CM_single 0 0 -3.4E+38 3.4E+38 ECU_ADDRESS 0x90002532 /end MEASUREMENT
/begin MEASUREMENT VTQA_trqABSFailLimit "" FLOAT32_IEEE VBU0513_CM_single 0 0 -3.4E+38 3.4E+38 ECU_ADDRESS 0x9000252a /end MEASUREMENT
/begin MEASUREMENT VTQA_trqAxleMin "" FLOAT32_IEEE VBU0513_CM_single 0 0 -10000.0 10000.0 ECU_ADDRESS 0x900021fa /end MEASUREMENT
/begin MEASUREMENT VTQA_trqDes "" FLOAT32_IEEE VBU0513_CM_single 0 0 -3.4E+38 3.4E+38 ECU_ADDRESS 0x900020ea /end MEASUREMENT
/begin MEASUREMENT VTQA_trqRMotrPos "" FLOAT32_IEEE VBU0513_CM_single 0 0 -10000.0 10000.0 ECU_ADDRESS 0x90002222 /end MEASUREMENT
/begin MEASUREMENT VTQA_trqRMotrNeg "" FLOAT32_IEEE VBU0513_CM_single 0 0 -10000.0 10000.0 ECU_ADDRESS 0x9000221e /end MEASUREMENT
/begin MEASUREMENT VTQA_pwrRMotActRgnLoss "" FLOAT32_IEEE VBU0513_CM_single 0 0 0.0 100.0 ECU_ADDRESS 0x900021f2 /end MEASUREMENT
/begin MEASUREMENT VTQA_pwrRMotActDrvLoss "" FLOAT32_IEEE VBU0513_CM_single 0 0 0.0 100.0 ECU_ADDRESS 0x900021ee /end MEASUREMENT
/begin MEASUREMENT VTQA_trqActRgnTrqLim "" FLOAT32_IEEE VBU0513_CM_single 0 0 -2000.0 2000.0 ECU_ADDRESS 0x900020e6 /end MEASUREMENT
/begin MEASUREMENT VTQA_trqActDrvTrqLim "" FLOAT32_IEEE VBU0513_CM_single 0 0 -2000.0 2000.0 ECU_ADDRESS 0x900020e2 /end MEASUREMENT
/begin MEASUREMENT MTQL_trqDnAbsLimR "" FLOAT32_IEEE VBU0513_CM_single 0 0 -3.4E+38 3.4E+38 ECU_ADDRESS 0x90001efe /end MEASUREMENT
/begin MEASUREMENT MTQL_trqRMotrFIDDrvLim "" FLOAT32_IEEE VBU0513_CM_single 0 0 -10000.0 10000.0 ECU_ADDRESS 0x9000218e /end MEASUREMENT
/begin MEASUREMENT TQDMP_trqCompRA "" FLOAT32_IEEE VBU0513_CM_single 0 0 -10000.0 10000.0 ECU_ADDRESS 0x90002096 /end MEASUREMENT
/begin MEASUREMENT TQO_facFilter "" FLOAT32_IEEE VBU0513_CM_single 0 0 -3.4E+38 3.4E+38 ECU_ADDRESS 0x900020c6 /end MEASUREMENT
/begin MEASUREMENT TQARB_TrqRgnRA "" FLOAT32_IEEE VBU0513_CM_single 0 0 -10000.0 10000.0 ECU_ADDRESS 0x9000201e /end MEASUREMENT
/begin MEASUREMENT TQARB_trqArbRA2 "" FLOAT32_IEEE VBU0513_CM_single 0 0 -3.4E+38 3.4E+38 ECU_ADDRESS 0x9000250e /end MEASUREMENT
/begin MEASUREMENT TQARB_trqBattRAMax "" FLOAT32_IEEE VBU0513_CM_single 0 0 -10000.0 10000.0 ECU_ADDRESS 0x90002026 /end MEASUREMENT
/begin MEASUREMENT TQARB_trqBattRAMin "" FLOAT32_IEEE VBU0513_CM_single 0 0 -10000.0 10000.0 ECU_ADDRESS 0x9000202a /end MEASUREMENT
/begin MEASUREMENT TQARB_trqArbRA "" FLOAT32_IEEE VBU0513_CM_single 0 0 -10000.0 10000.0 ECU_ADDRESS 0x90002022 /end MEASUREMENT
/begin MEASUREMENT STC_trqRgnLimit "" FLOAT32_IEEE VBU0513_CM_single 0 0 -3.4E+38 3.4E+38 ECU_ADDRESS 0x900024f6 /end MEASUREMENT
/begin MEASUREMENT TQDIS_trqRAPropLim "" FLOAT32_IEEE VBU0513_CM_single 0 0 -10000.0 10000.0 ECU_ADDRESS 0x9000207e /end MEASUREMENT
/begin MEASUREMENT TQDIS_trqRARgnLim "" FLOAT32_IEEE VBU0513_CM_single 0 0 -10000.0 10000.0 ECU_ADDRESS 0x90002082 /end MEASUREMENT
/begin MEASUREMENT TQDIS_trqRALim "" FLOAT32_IEEE VBU0513_CM_single 0 0 -10000.0 10000.0 ECU_ADDRESS 0x9000207a /end MEASUREMENT
/begin MEASUREMENT TQDIS_AxleArbK "" FLOAT32_IEEE VBU0513_CM_single 0 0 -3.4E+38 3.4E+38 ECU_ADDRESS 0x90002512 /end MEASUREMENT
/begin MEASUREMENT TQD_vVehSpd "" FLOAT32_IEEE VBU0513_CM_single 0 0 -3.4E+38 3.4E+38 ECU_ADDRESS 0x900020c2 /end MEASUREMENT
/begin MEASUREMENT TQD_pBrkPressFlt "" FLOAT32_IEEE VBU0513_CM_single 0 0 -3.4E+38 3.4E+38 ECU_ADDRESS 0x900021be /end MEASUREMENT
/begin MEASUREMENT TQD_facBrkPresCrpMod "" FLOAT32_IEEE VBU0513_CM_single 0 0 -3.4E+38 3.4E+38 ECU_ADDRESS 0x900021b6 /end MEASUREMENT
/begin MEASUREMENT TQD_facBrkPosCrpMod "" FLOAT32_IEEE VBU0513_CM_single 0 0 0.0 1.0 ECU_ADDRESS 0x900021b2 /end MEASUREMENT
/begin MEASUREMENT TQD_facBrkCrpPct "" FLOAT32_IEEE VBU0513_CM_single 0 0 -3.4E+38 3.4E+38 ECU_ADDRESS 0x900020ae /end MEASUREMENT
/begin MEASUREMENT TQD_trqCrpCst "" FLOAT32_IEEE VBU0513_CM_single 0 0 -10000.0 10000.0 ECU_ADDRESS 0x900021ca /end MEASUREMENT
/begin MEASUREMENT TQD_trqCrpMode "" FLOAT32_IEEE VBU0513_CM_single 0 0 -10000.0 10000.0 ECU_ADDRESS 0x900021ce /end MEASUREMENT
/begin MEASUREMENT TQD_trqCor "" FLOAT32_IEEE VBU0513_CM_single 0 0 -3.4E+38 3.4E+38 ECU_ADDRESS 0x900020b2 /end MEASUREMENT
/begin MEASUREMENT EDIS_pwrDisChBattPwr "" FLOAT32_IEEE VBU0513_CM_single 0 0 -3.4E+38 3.4E+38 ECU_ADDRESS 0x90002406 /end MEASUREMENT
/begin MEASUREMENT EDIS_pwrDchaDelta "" FLOAT32_IEEE VBU0513_CM_single 0 0 -1000.0 1000.0 ECU_ADDRESS 0x90002126 /end MEASUREMENT
/begin MEASUREMENT EDIS_pwrPIDDisChgFnl "" FLOAT32_IEEE VBU0513_CM_single 0 0 -3.4E+38 3.4E+38 ECU_ADDRESS 0x9000214e /end MEASUREMENT
/begin MEASUREMENT EDIS_pwrBattMaxPwr "" FLOAT32_IEEE VBU0513_CM_single 0 0 0.0 1000.0 ECU_ADDRESS 0x90002112 /end MEASUREMENT
/begin MEASUREMENT EDIS_pwrBattMaxPwrFnl "" FLOAT32_IEEE VBU0513_CM_single 0 0 0.0 1000.0 ECU_ADDRESS 0x90002116 /end MEASUREMENT
/begin MEASUREMENT EDIS_pwrAcsPwrReq "" FLOAT32_IEEE VBU0513_CM_single 0 0 -3.4E+38 3.4E+38 ECU_ADDRESS 0x90001eaa /end MEASUREMENT
/begin MEASUREMENT EDIS_pwrDrvPwrLim "" FLOAT32_IEEE VBU0513_CM_single 0 0 -3.4E+38 3.4E+38 ECU_ADDRESS 0x90001ec6 /end MEASUREMENT
/begin MEASUREMENT EDIS_pwrRgnLim "" FLOAT32_IEEE VBU0513_CM_single 0 0 -3.4E+38 3.4E+38 ECU_ADDRESS 0x90002162 /end MEASUREMENT
/begin MEASUREMENT EDIS_pwrRgnDelta "" FLOAT32_IEEE VBU0513_CM_single 0 0 -3.4E+38 3.4E+38 ECU_ADDRESS 0x90002156 /end MEASUREMENT
/begin MEASUREMENT EDIS_pwrRgnPterm "" FLOAT32_IEEE VBU0513_CM_single 0 0 -3.4E+38 3.4E+38 ECU_ADDRESS 0x90002166 /end MEASUREMENT
/begin MEASUREMENT EDIS_pwrRgnIterm "" FLOAT32_IEEE VBU0513_CM_single 0 0 -3.4E+38 3.4E+38 ECU_ADDRESS 0x9000215e /end MEASUREMENT
/begin MEASUREMENT EDIS_pwrRgnDterm "" FLOAT32_IEEE VBU0513_CM_single 0 0 -3.4E+38 3.4E+38 ECU_ADDRESS 0x9000215a /end MEASUREMENT
/begin MEASUREMENT EDIS_pwrRgn "" FLOAT32_IEEE VBU0513_CM_single 0 0 -3.4E+38 3.4E+38 ECU_ADDRESS 0x90002152 /end MEASUREMENT
/begin MEASUREMENT EDIS_pwrBattMinPwrFnl "" FLOAT32_IEEE VBU0513_CM_single 0 0 0.0 1000.0 ECU_ADDRESS 0x9000211a /end MEASUREMENT
/begin MEASUREMENT FCC_iADecreasedChargeCurrentRequest "" FLOAT32_IEEE VBU0513_CM_single 0 0 -3.4E+38 3.4E+38 ECU_ADDRESS 0x9000241e /end MEASUREMENT
/begin MEASUREMENT FCC_iAChargeCurrentReqDec "" FLOAT32_IEEE VBU0513_CM_single 0 0 -3.4E+38 3.4E+38 ECU_ADDRESS 0x90002412 /end MEASUREMENT
/begin MEASUREMENT FCC_iARawChargeCurrentRequestFnl "" FLOAT32_IEEE VBU0513_CM_single 0 0 -3.4E+38 3.4E+38 ECU_ADDRESS 0x90002422 /end MEASUREMENT
/begin MEASUREMENT FCC_pctMaxSetSocMappingRealSoc "" FLOAT32_IEEE VBU0513_CM_single 0 0 -3.4E+38 3.4E+38 ECU_ADDRESS 0x90002432 /end MEASUREMENT
/begin MEASUREMENT FCC_pctDisplaySocMappingRealSoc "" FLOAT32_IEEE VBU0513_CM_single 0 0 -3.4E+38 3.4E+38 ECU_ADDRESS 0x9000242a /end MEASUREMENT
/begin MEASUREMENT FCC_pctEightySOCMappingRealSoc "" FLOAT32_IEEE VBU0513_CM_single 0 0 -3.4E+38 3.4E+38 ECU_ADDRESS 0x9000242e /end MEASUREMENT
/begin MEASUREMENT LcCTD_PrechargeJouleHeat_J "" FLOAT32_IEEE VBU0513_CM_single 0 0 -3.4E+38 3.4E+38 ECU_ADDRESS 0x900022e2 /end MEASUREMENT
/begin MEASUREMENT BCV_AhOverallCoulombFCCChgCarry "" FLOAT32_IEEE VBU0513_CM_single 0 0 -3.4E+38 3.4E+38 ECU_ADDRESS 0x9000224a /end MEASUREMENT
/begin MEASUREMENT HV5_MP_Pcharge_Relay__AD "" UWORD VBU0513_CM_uint16 0 0 0 65535 ECU_ADDRESS 0x90003948 /end MEASUREMENT
/begin MEASUREMENT Hall1_AD "" UWORD VBU0513_CM_uint16 0 0 0 65535 ECU_ADDRESS 0x9000394a /end MEASUREMENT
/begin MEASUREMENT Hall2_AD "" UWORD VBU0513_CM_uint16 0 0 0 65535 ECU_ADDRESS 0x9000394c /end MEASUREMENT
/begin MEASUREMENT HV4_Heat_Fuse__AD "" UWORD VBU0513_CM_uint16 0 0 0 65535 ECU_ADDRESS 0x90003946 /end MEASUREMENT
/begin MEASUREMENT LINK_Relay_MN_AD "" UWORD VBU0513_CM_uint16 0 0 0 65535 ECU_ADDRESS 0x90003968 /end MEASUREMENT
/begin MEASUREMENT Total_Volt_B "" UWORD VBU0513_CM_uint16 0 0 0 65535 ECU_ADDRESS 0x9000399e /end MEASUREMENT
/begin MEASUREMENT CellVolt33 "" UWORD VBU0513_CM_uint16 0 0 0 65535 ECU_ADDRESS 0x900038a2 /end MEASUREMENT
/begin MEASUREMENT CellVolt34 "" UWORD VBU0513_CM_uint16 0 0 0 65535 ECU_ADDRESS 0x900038a4 /end MEASUREMENT
/begin MEASUREMENT CellVolt35 "" UWORD VBU0513_CM_uint16 0 0 0 65535 ECU_ADDRESS 0x900038a6 /end MEASUREMENT
/begin MEASUREMENT CellVolt36 "" UWORD VBU0513_CM_uint16 0 0 0 65535 ECU_ADDRESS 0x900038a8 /end MEASUREMENT
/begin MEASUREMENT CellVolt29 "" UWORD VBU0513_CM_uint16 0 0 0 65535 ECU_ADDRESS 0x90003898 /end MEASUREMENT
/begin MEASUREMENT CellVolt30 "" UWORD VBU0513_CM_uint16 0 0 0 65535 ECU_ADDRESS 0x9000389c /end MEASUREMENT
/begin MEASUREMENT CellVolt31 "" UWORD VBU0513_CM_uint16 0 0 0 65535 ECU_ADDRESS 0x9000389e /end MEASUREMENT
/begin MEASUREMENT CellVolt32 "" UWORD VBU0513_CM_uint16 0 0 0 65535 ECU_ADDRESS 0x900038a0 /end MEASUREMENT
/begin MEASUREMENT CellVolt25 "" UWORD VBU0513_CM_uint16 0 0 0 65535 ECU_ADDRESS 0x90003890 /end MEASUREMENT
/begin MEASUREMENT CellVolt26 "" UWORD VBU0513_CM_uint16 0 0 0 65535 ECU_ADDRESS 0x90003892 /end MEASUREMENT
/begin MEASUREMENT CellVolt27 "" UWORD VBU0513_CM_uint16 0 0 0 65535 ECU_ADDRESS 0x90003894 /end MEASUREMENT
/begin MEASUREMENT CellVolt28 "" UWORD VBU0513_CM_uint16 0 0 0 65535 ECU_ADDRESS 0x90003896 /end MEASUREMENT
/begin MEASUREMENT CellVolt21 "" UWORD VBU0513_CM_uint16 0 0 0 65535 ECU_ADDRESS 0x90003888 /end MEASUREMENT
/begin MEASUREMENT CellVolt22 "" UWORD VBU0513_CM_uint16 0 0 0 65535 ECU_ADDRESS 0x9000388a /end MEASUREMENT
/begin MEASUREMENT CellVolt23 "" UWORD VBU0513_CM_uint16 0 0 0 65535 ECU_ADDRESS 0x9000388c /end MEASUREMENT
/begin MEASUREMENT CellVolt24 "" UWORD VBU0513_CM_uint16 0 0 0 65535 ECU_ADDRESS 0x9000388e /end MEASUREMENT
/begin MEASUREMENT CellVolt197 "" UWORD VBU0513_CM_uint16 0 0 0 65535 ECU_ADDRESS 0x9000387c /end MEASUREMENT
/begin MEASUREMENT CellVolt198 "" UWORD VBU0513_CM_uint16 0 0 0 65535 ECU_ADDRESS 0x9000387e /end MEASUREMENT
/begin MEASUREMENT CellVolt199 "" UWORD VBU0513_CM_uint16 0 0 0 65535 ECU_ADDRESS 0x90003880 /end MEASUREMENT
/begin MEASUREMENT CellVolt200 "" UWORD VBU0513_CM_uint16 0 0 0 65535 ECU_ADDRESS 0x90003886 /end MEASUREMENT
/begin MEASUREMENT CellVolt17 "" UWORD VBU0513_CM_uint16 0 0 0 65535 ECU_ADDRESS 0x90003840 /end MEASUREMENT
/begin MEASUREMENT CellVolt18 "" UWORD VBU0513_CM_uint16 0 0 0 65535 ECU_ADDRESS 0x90003856 /end MEASUREMENT
/begin MEASUREMENT CellVolt19 "" UWORD VBU0513_CM_uint16 0 0 0 65535 ECU_ADDRESS 0x9000386c /end MEASUREMENT
/begin MEASUREMENT CellVolt20 "" UWORD VBU0513_CM_uint16 0 0 0 65535 ECU_ADDRESS 0x90003884 /end MEASUREMENT
/begin MEASUREMENT CellVolt193 "" UWORD VBU0513_CM_uint16 0 0 0 65535 ECU_ADDRESS 0x90003874 /end MEASUREMENT
/begin MEASUREMENT CellVolt194 "" UWORD VBU0513_CM_uint16 0 0 0 65535 ECU_ADDRESS 0x90003876 /end MEASUREMENT
/begin MEASUREMENT CellVolt195 "" UWORD VBU0513_CM_uint16 0 0 0 65535 ECU_ADDRESS 0x90003878 /end MEASUREMENT
/begin MEASUREMENT CellVolt196 "" UWORD VBU0513_CM_uint16 0 0 0 65535 ECU_ADDRESS 0x9000387a /end MEASUREMENT
/begin MEASUREMENT CellVolt189 "" UWORD VBU0513_CM_uint16 0 0 0 65535 ECU_ADDRESS 0x9000386a /end MEASUREMENT
/begin MEASUREMENT CellVolt190 "" UWORD VBU0513_CM_uint16 0 0 0 65535 ECU_ADDRESS 0x9000386e /end MEASUREMENT
/begin MEASUREMENT CellVolt191 "" UWORD VBU0513_CM_uint16 0 0 0 65535 ECU_ADDRESS 0x90003870 /end MEASUREMENT
/begin MEASUREMENT CellVolt192 "" UWORD VBU0513_CM_uint16 0 0 0 65535 ECU_ADDRESS 0x90003872 /end MEASUREMENT
/begin MEASUREMENT CellVolt185 "" UWORD VBU0513_CM_uint16 0 0 0 65535 ECU_ADDRESS 0x90003862 /end MEASUREMENT
/begin MEASUREMENT CellVolt186 "" UWORD VBU0513_CM_uint16 0 0 0 65535 ECU_ADDRESS 0x90003864 /end MEASUREMENT
/begin MEASUREMENT CellVolt187 "" UWORD VBU0513_CM_uint16 0 0 0 65535 ECU_ADDRESS 0x90003866 /end MEASUREMENT
/begin MEASUREMENT CellVolt188 "" UWORD VBU0513_CM_uint16 0 0 0 65535 ECU_ADDRESS 0x90003868 /end MEASUREMENT
/begin MEASUREMENT HV1_AD "" UWORD VBU0513_CM_uint16 0 0 0 65535 ECU_ADDRESS 0x90003940 /end MEASUREMENT
/begin MEASUREMENT HV2_Heating_Relay__AD "" UWORD VBU0513_CM_uint16 0 0 0 65535 ECU_ADDRESS 0x90003942 /end MEASUREMENT
/begin MEASUREMENT HV3_Main_Fuse__AD "" UWORD VBU0513_CM_uint16 0 0 0 65535 ECU_ADDRESS 0x90003944 /end MEASUREMENT
/begin MEASUREMENT CellVolt181 "" UWORD VBU0513_CM_uint16 0 0 0 65535 ECU_ADDRESS 0x9000385a /end MEASUREMENT
/begin MEASUREMENT CellVolt182 "" UWORD VBU0513_CM_uint16 0 0 0 65535 ECU_ADDRESS 0x9000385c /end MEASUREMENT
/begin MEASUREMENT CellVolt183 "" UWORD VBU0513_CM_uint16 0 0 0 65535 ECU_ADDRESS 0x9000385e /end MEASUREMENT
/begin MEASUREMENT CellVolt184 "" UWORD VBU0513_CM_uint16 0 0 0 65535 ECU_ADDRESS 0x90003860 /end MEASUREMENT
/begin MEASUREMENT CellVolt177 "" UWORD VBU0513_CM_uint16 0 0 0 65535 ECU_ADDRESS 0x90003850 /end MEASUREMENT
/begin MEASUREMENT CellVolt178 "" UWORD VBU0513_CM_uint16 0 0 0 65535 ECU_ADDRESS 0x90003852 /end MEASUREMENT
/begin MEASUREMENT CellVolt179 "" UWORD VBU0513_CM_uint16 0 0 0 65535 ECU_ADDRESS 0x90003854 /end MEASUREMENT
/begin MEASUREMENT CellVolt180 "" UWORD VBU0513_CM_uint16 0 0 0 65535 ECU_ADDRESS 0x90003858 /end MEASUREMENT
/begin MEASUREMENT CellVolt173 "" UWORD VBU0513_CM_uint16 0 0 0 65535 ECU_ADDRESS 0x90003848 /end MEASUREMENT
/begin MEASUREMENT CellVolt174 "" UWORD VBU0513_CM_uint16 0 0 0 65535 ECU_ADDRESS 0x9000384a /end MEASUREMENT
/begin MEASUREMENT CellVolt175 "" UWORD VBU0513_CM_uint16 0 0 0 65535 ECU_ADDRESS 0x9000384c /end MEASUREMENT
/begin MEASUREMENT CellVolt176 "" UWORD VBU0513_CM_uint16 0 0 0 65535 ECU_ADDRESS 0x9000384e /end MEASUREMENT
/begin MEASUREMENT CellVolt169 "" UWORD VBU0513_CM_uint16 0 0 0 65535 ECU_ADDRESS 0x9000383e /end MEASUREMENT
/begin MEASUREMENT CellVolt170 "" UWORD VBU0513_CM_uint16 0 0 0 65535 ECU_ADDRESS 0x90003842 /end MEASUREMENT
/begin MEASUREMENT CellVolt171 "" UWORD VBU0513_CM_uint16 0 0 0 65535 ECU_ADDRESS 0x90003844 /end MEASUREMENT
/begin MEASUREMENT CellVolt172 "" UWORD VBU0513_CM_uint16 0 0 0 65535 ECU_ADDRESS 0x90003846 /end MEASUREMENT
/begin MEASUREMENT CellVolt165 "" UWORD VBU0513_CM_uint16 0 0 0 65535 ECU_ADDRESS 0x90003836 /end MEASUREMENT
/begin MEASUREMENT CellVolt166 "" UWORD VBU0513_CM_uint16 0 0 0 65535 ECU_ADDRESS 0x90003838 /end MEASUREMENT
/begin MEASUREMENT CellVolt167 "" UWORD VBU0513_CM_uint16 0 0 0 65535 ECU_ADDRESS 0x9000383a /end MEASUREMENT
/begin MEASUREMENT CellVolt168 "" UWORD VBU0513_CM_uint16 0 0 0 65535 ECU_ADDRESS 0x9000383c /end MEASUREMENT
/begin MEASUREMENT CellVolt161 "" UWORD VBU0513_CM_uint16 0 0 0 65535 ECU_ADDRESS 0x9000382e /end MEASUREMENT
/begin MEASUREMENT CellVolt162 "" UWORD VBU0513_CM_uint16 0 0 0 65535 ECU_ADDRESS 0x90003830 /end MEASUREMENT
/begin MEASUREMENT CellVolt163 "" UWORD VBU0513_CM_uint16 0 0 0 65535 ECU_ADDRESS 0x90003832 /end MEASUREMENT
/begin MEASUREMENT CellVolt164 "" UWORD VBU0513_CM_uint16 0 0 0 65535 ECU_ADDRESS 0x90003834 /end MEASUREMENT
/begin MEASUREMENT CellVolt157 "" UWORD VBU0513_CM_uint16 0 0 0 65535 ECU_ADDRESS 0x90003824 /end MEASUREMENT
/begin MEASUREMENT CellVolt158 "" UWORD VBU0513_CM_uint16 0 0 0 65535 ECU_ADDRESS 0x90003826 /end MEASUREMENT
/begin MEASUREMENT CellVolt159 "" UWORD VBU0513_CM_uint16 0 0 0 65535 ECU_ADDRESS 0x90003828 /end MEASUREMENT
/begin MEASUREMENT CellVolt160 "" UWORD VBU0513_CM_uint16 0 0 0 65535 ECU_ADDRESS 0x9000382c /end MEASUREMENT
/begin MEASUREMENT CellVolt13 "" UWORD VBU0513_CM_uint16 0 0 0 65535 ECU_ADDRESS 0x900037e8 /end MEASUREMENT
/begin MEASUREMENT CellVolt14 "" UWORD VBU0513_CM_uint16 0 0 0 65535 ECU_ADDRESS 0x900037fe /end MEASUREMENT
/begin MEASUREMENT CellVolt15 "" UWORD VBU0513_CM_uint16 0 0 0 65535 ECU_ADDRESS 0x90003814 /end MEASUREMENT
/begin MEASUREMENT CellVolt16 "" UWORD VBU0513_CM_uint16 0 0 0 65535 ECU_ADDRESS 0x9000382a /end MEASUREMENT
/begin MEASUREMENT CellVolt153 "" UWORD VBU0513_CM_uint16 0 0 0 65535 ECU_ADDRESS 0x9000381c /end MEASUREMENT
/begin MEASUREMENT CellVolt154 "" UWORD VBU0513_CM_uint16 0 0 0 65535 ECU_ADDRESS 0x9000381e /end MEASUREMENT
/begin MEASUREMENT CellVolt155 "" UWORD VBU0513_CM_uint16 0 0 0 65535 ECU_ADDRESS 0x90003820 /end MEASUREMENT
/begin MEASUREMENT CellVolt156 "" UWORD VBU0513_CM_uint16 0 0 0 65535 ECU_ADDRESS 0x90003822 /end MEASUREMENT
/begin MEASUREMENT CellVolt149 "" UWORD VBU0513_CM_uint16 0 0 0 65535 ECU_ADDRESS 0x90003812 /end MEASUREMENT
/begin MEASUREMENT CellVolt150 "" UWORD VBU0513_CM_uint16 0 0 0 65535 ECU_ADDRESS 0x90003816 /end MEASUREMENT
/begin MEASUREMENT CellVolt151 "" UWORD VBU0513_CM_uint16 0 0 0 65535 ECU_ADDRESS 0x90003818 /end MEASUREMENT
/begin MEASUREMENT CellVolt152 "" UWORD VBU0513_CM_uint16 0 0 0 65535 ECU_ADDRESS 0x9000381a /end MEASUREMENT
/begin MEASUREMENT CellVolt145 "" UWORD VBU0513_CM_uint16 0 0 0 65535 ECU_ADDRESS 0x9000380a /end MEASUREMENT
/begin MEASUREMENT CellVolt146 "" UWORD VBU0513_CM_uint16 0 0 0 65535 ECU_ADDRESS 0x9000380c /end MEASUREMENT
/begin MEASUREMENT CellVolt147 "" UWORD VBU0513_CM_uint16 0 0 0 65535 ECU_ADDRESS 0x9000380e /end MEASUREMENT
/begin MEASUREMENT CellVolt148 "" UWORD VBU0513_CM_uint16 0 0 0 65535 ECU_ADDRESS 0x90003810 /end MEASUREMENT
/begin MEASUREMENT CellVolt141 "" UWORD VBU0513_CM_uint16 0 0 0 65535 ECU_ADDRESS 0x90003802 /end MEASUREMENT
/begin MEASUREMENT CellVolt142 "" UWORD VBU0513_CM_uint16 0 0 0 65535 ECU_ADDRESS 0x90003804 /end MEASUREMENT
/begin MEASUREMENT CellVolt143 "" UWORD VBU0513_CM_uint16 0 0 0 65535 ECU_ADDRESS 0x90003806 /end MEASUREMENT
/begin MEASUREMENT CellVolt144 "" UWORD VBU0513_CM_uint16 0 0 0 65535 ECU_ADDRESS 0x90003808 /end MEASUREMENT
/begin MEASUREMENT CellVolt137 "" UWORD VBU0513_CM_uint16 0 0 0 65535 ECU_ADDRESS 0x900037f8 /end MEASUREMENT
/begin MEASUREMENT CellVolt138 "" UWORD VBU0513_CM_uint16 0 0 0 65535 ECU_ADDRESS 0x900037fa /end MEASUREMENT
/begin MEASUREMENT CellVolt139 "" UWORD VBU0513_CM_uint16 0 0 0 65535 ECU_ADDRESS 0x900037fc /end MEASUREMENT
/begin MEASUREMENT CellVolt140 "" UWORD VBU0513_CM_uint16 0 0 0 65535 ECU_ADDRESS 0x90003800 /end MEASUREMENT
/begin MEASUREMENT CellVolt133 "" UWORD VBU0513_CM_uint16 0 0 0 65535 ECU_ADDRESS 0x900037f0 /end MEASUREMENT
/begin MEASUREMENT CellVolt134 "" UWORD VBU0513_CM_uint16 0 0 0 65535 ECU_ADDRESS 0x900037f2 /end MEASUREMENT
/begin MEASUREMENT CellVolt135 "" UWORD VBU0513_CM_uint16 0 0 0 65535 ECU_ADDRESS 0x900037f4 /end MEASUREMENT
/begin MEASUREMENT CellVolt136 "" UWORD VBU0513_CM_uint16 0 0 0 65535 ECU_ADDRESS 0x900037f6 /end MEASUREMENT
/begin MEASUREMENT CellVolt129 "" UWORD VBU0513_CM_uint16 0 0 0 65535 ECU_ADDRESS 0x900037e6 /end MEASUREMENT
/begin MEASUREMENT CellVolt130 "" UWORD VBU0513_CM_uint16 0 0 0 65535 ECU_ADDRESS 0x900037ea /end MEASUREMENT
/begin MEASUREMENT CellVolt131 "" UWORD VBU0513_CM_uint16 0 0 0 65535 ECU_ADDRESS 0x900037ec /end MEASUREMENT
/begin MEASUREMENT CellVolt132 "" UWORD VBU0513_CM_uint16 0 0 0 65535 ECU_ADDRESS 0x900037ee /end MEASUREMENT
/begin MEASUREMENT CellVolt125 "" UWORD VBU0513_CM_uint16 0 0 0 65535 ECU_ADDRESS 0x900037de /end MEASUREMENT
/begin MEASUREMENT CellVolt126 "" UWORD VBU0513_CM_uint16 0 0 0 65535 ECU_ADDRESS 0x900037e0 /end MEASUREMENT
/begin MEASUREMENT CellVolt127 "" UWORD VBU0513_CM_uint16 0 0 0 65535 ECU_ADDRESS 0x900037e2 /end MEASUREMENT
/begin MEASUREMENT CellVolt128 "" UWORD VBU0513_CM_uint16 0 0 0 65535 ECU_ADDRESS 0x900037e4 /end MEASUREMENT
/begin MEASUREMENT CellVolt121 "" UWORD VBU0513_CM_uint16 0 0 0 65535 ECU_ADDRESS 0x900037d6 /end MEASUREMENT
/begin MEASUREMENT CellVolt122 "" UWORD VBU0513_CM_uint16 0 0 0 65535 ECU_ADDRESS 0x900037d8 /end MEASUREMENT
/begin MEASUREMENT CellVolt123 "" UWORD VBU0513_CM_uint16 0 0 0 65535 ECU_ADDRESS 0x900037da /end MEASUREMENT
/begin MEASUREMENT CellVolt124 "" UWORD VBU0513_CM_uint16 0 0 0 65535 ECU_ADDRESS 0x900037dc /end MEASUREMENT
/begin MEASUREMENT CellVolt117 "" UWORD VBU0513_CM_uint16 0 0 0 65535 ECU_ADDRESS 0x900037cc /end MEASUREMENT
/begin MEASUREMENT CellVolt118 "" UWORD VBU0513_CM_uint16 0 0 0 65535 ECU_ADDRESS 0x900037ce /end MEASUREMENT
/begin MEASUREMENT CellVolt119 "" UWORD VBU0513_CM_uint16 0 0 0 65535 ECU_ADDRESS 0x900037d0 /end MEASUREMENT
/begin MEASUREMENT CellVolt120 "" UWORD VBU0513_CM_uint16 0 0 0 65535 ECU_ADDRESS 0x900037d4 /end MEASUREMENT
/begin MEASUREMENT CellVolt10 "" UWORD VBU0513_CM_uint16 0 0 0 65535 ECU_ADDRESS 0x900037a6 /end MEASUREMENT
/begin MEASUREMENT CellVolt11 "" UWORD VBU0513_CM_uint16 0 0 0 65535 ECU_ADDRESS 0x900037bc /end MEASUREMENT
/begin MEASUREMENT CellVolt12 "" UWORD VBU0513_CM_uint16 0 0 0 65535 ECU_ADDRESS 0x900037d2 /end MEASUREMENT
/begin MEASUREMENT CellVolt9 "" UWORD VBU0513_CM_uint16 0 0 0 65535 ECU_ADDRESS 0x9000391e /end MEASUREMENT
/begin MEASUREMENT CellVolt113 "" UWORD VBU0513_CM_uint16 0 0 0 65535 ECU_ADDRESS 0x900037c4 /end MEASUREMENT
/begin MEASUREMENT CellVolt114 "" UWORD VBU0513_CM_uint16 0 0 0 65535 ECU_ADDRESS 0x900037c6 /end MEASUREMENT
/begin MEASUREMENT CellVolt115 "" UWORD VBU0513_CM_uint16 0 0 0 65535 ECU_ADDRESS 0x900037c8 /end MEASUREMENT
/begin MEASUREMENT CellVolt116 "" UWORD VBU0513_CM_uint16 0 0 0 65535 ECU_ADDRESS 0x900037ca /end MEASUREMENT
/begin MEASUREMENT CellVolt109 "" UWORD VBU0513_CM_uint16 0 0 0 65535 ECU_ADDRESS 0x900037ba /end MEASUREMENT
/begin MEASUREMENT CellVolt110 "" UWORD VBU0513_CM_uint16 0 0 0 65535 ECU_ADDRESS 0x900037be /end MEASUREMENT
/begin MEASUREMENT CellVolt111 "" UWORD VBU0513_CM_uint16 0 0 0 65535 ECU_ADDRESS 0x900037c0 /end MEASUREMENT
/begin MEASUREMENT CellVolt112 "" UWORD VBU0513_CM_uint16 0 0 0 65535 ECU_ADDRESS 0x900037c2 /end MEASUREMENT
/begin MEASUREMENT CellVolt105 "" UWORD VBU0513_CM_uint16 0 0 0 65535 ECU_ADDRESS 0x900037b2 /end MEASUREMENT
/begin MEASUREMENT CellVolt106 "" UWORD VBU0513_CM_uint16 0 0 0 65535 ECU_ADDRESS 0x900037b4 /end MEASUREMENT
/begin MEASUREMENT CellVolt107 "" UWORD VBU0513_CM_uint16 0 0 0 65535 ECU_ADDRESS 0x900037b6 /end MEASUREMENT
/begin MEASUREMENT CellVolt108 "" UWORD VBU0513_CM_uint16 0 0 0 65535 ECU_ADDRESS 0x900037b8 /end MEASUREMENT
/begin MEASUREMENT CellVolt101 "" UWORD VBU0513_CM_uint16 0 0 0 65535 ECU_ADDRESS 0x900037aa /end MEASUREMENT
/begin MEASUREMENT CellVolt102 "" UWORD VBU0513_CM_uint16 0 0 0 65535 ECU_ADDRESS 0x900037ac /end MEASUREMENT
/begin MEASUREMENT CellVolt103 "" UWORD VBU0513_CM_uint16 0 0 0 65535 ECU_ADDRESS 0x900037ae /end MEASUREMENT
/begin MEASUREMENT CellVolt104 "" UWORD VBU0513_CM_uint16 0 0 0 65535 ECU_ADDRESS 0x900037b0 /end MEASUREMENT
/begin MEASUREMENT CellVolt100 "" UWORD VBU0513_CM_uint16 0 0 0 65535 ECU_ADDRESS 0x900037a8 /end MEASUREMENT
/begin MEASUREMENT CellVolt97 "" UWORD VBU0513_CM_uint16 0 0 0 65535 ECU_ADDRESS 0x9000392e /end MEASUREMENT
/begin MEASUREMENT CellVolt98 "" UWORD VBU0513_CM_uint16 0 0 0 65535 ECU_ADDRESS 0x90003930 /end MEASUREMENT
/begin MEASUREMENT CellVolt99 "" UWORD VBU0513_CM_uint16 0 0 0 65535 ECU_ADDRESS 0x90003932 /end MEASUREMENT
/begin MEASUREMENT CellVolt93 "" UWORD VBU0513_CM_uint16 0 0 0 65535 ECU_ADDRESS 0x90003926 /end MEASUREMENT
/begin MEASUREMENT CellVolt94 "" UWORD VBU0513_CM_uint16 0 0 0 65535 ECU_ADDRESS 0x90003928 /end MEASUREMENT
/begin MEASUREMENT CellVolt95 "" UWORD VBU0513_CM_uint16 0 0 0 65535 ECU_ADDRESS 0x9000392a /end MEASUREMENT
/begin MEASUREMENT CellVolt96 "" UWORD VBU0513_CM_uint16 0 0 0 65535 ECU_ADDRESS 0x9000392c /end MEASUREMENT
/begin MEASUREMENT CellVolt89 "" UWORD VBU0513_CM_uint16 0 0 0 65535 ECU_ADDRESS 0x9000391c /end MEASUREMENT
/begin MEASUREMENT CellVolt90 "" UWORD VBU0513_CM_uint16 0 0 0 65535 ECU_ADDRESS 0x90003920 /end MEASUREMENT
/begin MEASUREMENT CellVolt91 "" UWORD VBU0513_CM_uint16 0 0 0 65535 ECU_ADDRESS 0x90003922 /end MEASUREMENT
/begin MEASUREMENT CellVolt92 "" UWORD VBU0513_CM_uint16 0 0 0 65535 ECU_ADDRESS 0x90003924 /end MEASUREMENT
/begin MEASUREMENT CellVolt85 "" UWORD VBU0513_CM_uint16 0 0 0 65535 ECU_ADDRESS 0x90003914 /end MEASUREMENT
/begin MEASUREMENT CellVolt86 "" UWORD VBU0513_CM_uint16 0 0 0 65535 ECU_ADDRESS 0x90003916 /end MEASUREMENT
/begin MEASUREMENT CellVolt87 "" UWORD VBU0513_CM_uint16 0 0 0 65535 ECU_ADDRESS 0x90003918 /end MEASUREMENT
/begin MEASUREMENT CellVolt88 "" UWORD VBU0513_CM_uint16 0 0 0 65535 ECU_ADDRESS 0x9000391a /end MEASUREMENT
/begin MEASUREMENT CellVolt81 "" UWORD VBU0513_CM_uint16 0 0 0 65535 ECU_ADDRESS 0x9000390c /end MEASUREMENT
/begin MEASUREMENT CellVolt82 "" UWORD VBU0513_CM_uint16 0 0 0 65535 ECU_ADDRESS 0x9000390e /end MEASUREMENT
/begin MEASUREMENT CellVolt83 "" UWORD VBU0513_CM_uint16 0 0 0 65535 ECU_ADDRESS 0x90003910 /end MEASUREMENT
/begin MEASUREMENT CellVolt84 "" UWORD VBU0513_CM_uint16 0 0 0 65535 ECU_ADDRESS 0x90003912 /end MEASUREMENT
/begin MEASUREMENT CellVolt77 "" UWORD VBU0513_CM_uint16 0 0 0 65535 ECU_ADDRESS 0x90003902 /end MEASUREMENT
/begin MEASUREMENT CellVolt78 "" UWORD VBU0513_CM_uint16 0 0 0 65535 ECU_ADDRESS 0x90003904 /end MEASUREMENT
/begin MEASUREMENT CellVolt79 "" UWORD VBU0513_CM_uint16 0 0 0 65535 ECU_ADDRESS 0x90003906 /end MEASUREMENT
/begin MEASUREMENT CellVolt80 "" UWORD VBU0513_CM_uint16 0 0 0 65535 ECU_ADDRESS 0x9000390a /end MEASUREMENT
/begin MEASUREMENT CellVolt5 "" UWORD VBU0513_CM_uint16 0 0 0 65535 ECU_ADDRESS 0x900038c6 /end MEASUREMENT
/begin MEASUREMENT CellVolt6 "" UWORD VBU0513_CM_uint16 0 0 0 65535 ECU_ADDRESS 0x900038dc /end MEASUREMENT
/begin MEASUREMENT CellVolt7 "" UWORD VBU0513_CM_uint16 0 0 0 65535 ECU_ADDRESS 0x900038f2 /end MEASUREMENT
/begin MEASUREMENT CellVolt8 "" UWORD VBU0513_CM_uint16 0 0 0 65535 ECU_ADDRESS 0x90003908 /end MEASUREMENT
/begin MEASUREMENT CellVolt73 "" UWORD VBU0513_CM_uint16 0 0 0 65535 ECU_ADDRESS 0x900038fa /end MEASUREMENT
/begin MEASUREMENT CellVolt74 "" UWORD VBU0513_CM_uint16 0 0 0 65535 ECU_ADDRESS 0x900038fc /end MEASUREMENT
/begin MEASUREMENT CellVolt75 "" UWORD VBU0513_CM_uint16 0 0 0 65535 ECU_ADDRESS 0x900038fe /end MEASUREMENT
/begin MEASUREMENT CellVolt76 "" UWORD VBU0513_CM_uint16 0 0 0 65535 ECU_ADDRESS 0x90003900 /end MEASUREMENT
/begin MEASUREMENT CellVolt69 "" UWORD VBU0513_CM_uint16 0 0 0 65535 ECU_ADDRESS 0x900038f0 /end MEASUREMENT
/begin MEASUREMENT CellVolt70 "" UWORD VBU0513_CM_uint16 0 0 0 65535 ECU_ADDRESS 0x900038f4 /end MEASUREMENT
/begin MEASUREMENT CellVolt71 "" UWORD VBU0513_CM_uint16 0 0 0 65535 ECU_ADDRESS 0x900038f6 /end MEASUREMENT
/begin MEASUREMENT CellVolt72 "" UWORD VBU0513_CM_uint16 0 0 0 65535 ECU_ADDRESS 0x900038f8 /end MEASUREMENT
/begin MEASUREMENT CellVolt65 "" UWORD VBU0513_CM_uint16 0 0 0 65535 ECU_ADDRESS 0x900038e8 /end MEASUREMENT
/begin MEASUREMENT CellVolt66 "" UWORD VBU0513_CM_uint16 0 0 0 65535 ECU_ADDRESS 0x900038ea /end MEASUREMENT
/begin MEASUREMENT CellVolt67 "" UWORD VBU0513_CM_uint16 0 0 0 65535 ECU_ADDRESS 0x900038ec /end MEASUREMENT
/begin MEASUREMENT CellVolt68 "" UWORD VBU0513_CM_uint16 0 0 0 65535 ECU_ADDRESS 0x900038ee /end MEASUREMENT
/begin MEASUREMENT CellVolt61 "" UWORD VBU0513_CM_uint16 0 0 0 65535 ECU_ADDRESS 0x900038e0 /end MEASUREMENT
/begin MEASUREMENT CellVolt62 "" UWORD VBU0513_CM_uint16 0 0 0 65535 ECU_ADDRESS 0x900038e2 /end MEASUREMENT
/begin MEASUREMENT CellVolt63 "" UWORD VBU0513_CM_uint16 0 0 0 65535 ECU_ADDRESS 0x900038e4 /end MEASUREMENT
/begin MEASUREMENT CellVolt64 "" UWORD VBU0513_CM_uint16 0 0 0 65535 ECU_ADDRESS 0x900038e6 /end MEASUREMENT
/begin MEASUREMENT CellVolt57 "" UWORD VBU0513_CM_uint16 0 0 0 65535 ECU_ADDRESS 0x900038d6 /end MEASUREMENT
/begin MEASUREMENT CellVolt58 "" UWORD VBU0513_CM_uint16 0 0 0 65535 ECU_ADDRESS 0x900038d8 /end MEASUREMENT
/begin MEASUREMENT CellVolt59 "" UWORD VBU0513_CM_uint16 0 0 0 65535 ECU_ADDRESS 0x900038da /end MEASUREMENT
/begin MEASUREMENT CellVolt60 "" UWORD VBU0513_CM_uint16 0 0 0 65535 ECU_ADDRESS 0x900038de /end MEASUREMENT
/begin MEASUREMENT CellVolt53 "" UWORD VBU0513_CM_uint16 0 0 0 65535 ECU_ADDRESS 0x900038ce /end MEASUREMENT
/begin MEASUREMENT CellVolt54 "" UWORD VBU0513_CM_uint16 0 0 0 65535 ECU_ADDRESS 0x900038d0 /end MEASUREMENT
/begin MEASUREMENT CellVolt55 "" UWORD VBU0513_CM_uint16 0 0 0 65535 ECU_ADDRESS 0x900038d2 /end MEASUREMENT
/begin MEASUREMENT CellVolt56 "" UWORD VBU0513_CM_uint16 0 0 0 65535 ECU_ADDRESS 0x900038d4 /end MEASUREMENT
/begin MEASUREMENT CellVolt49 "" UWORD VBU0513_CM_uint16 0 0 0 65535 ECU_ADDRESS 0x900038c4 /end MEASUREMENT
/begin MEASUREMENT CellVolt50 "" UWORD VBU0513_CM_uint16 0 0 0 65535 ECU_ADDRESS 0x900038c8 /end MEASUREMENT
/begin MEASUREMENT CellVolt51 "" UWORD VBU0513_CM_uint16 0 0 0 65535 ECU_ADDRESS 0x900038ca /end MEASUREMENT
/begin MEASUREMENT CellVolt52 "" UWORD VBU0513_CM_uint16 0 0 0 65535 ECU_ADDRESS 0x900038cc /end MEASUREMENT
/begin MEASUREMENT CellVolt45 "" UWORD VBU0513_CM_uint16 0 0 0 65535 ECU_ADDRESS 0x900038bc /end MEASUREMENT
/begin MEASUREMENT CellVolt46 "" UWORD VBU0513_CM_uint16 0 0 0 65535 ECU_ADDRESS 0x900038be /end MEASUREMENT
/begin MEASUREMENT CellVolt47 "" UWORD VBU0513_CM_uint16 0 0 0 65535 ECU_ADDRESS 0x900038c0 /end MEASUREMENT
/begin MEASUREMENT CellVolt48 "" UWORD VBU0513_CM_uint16 0 0 0 65535 ECU_ADDRESS 0x900038c2 /end MEASUREMENT
/begin MEASUREMENT CellVolt41 "" UWORD VBU0513_CM_uint16 0 0 0 65535 ECU_ADDRESS 0x900038b4 /end MEASUREMENT
/begin MEASUREMENT CellVolt42 "" UWORD VBU0513_CM_uint16 0 0 0 65535 ECU_ADDRESS 0x900038b6 /end MEASUREMENT
/begin MEASUREMENT CellVolt43 "" UWORD VBU0513_CM_uint16 0 0 0 65535 ECU_ADDRESS 0x900038b8 /end MEASUREMENT
/begin MEASUREMENT CellVolt44 "" UWORD VBU0513_CM_uint16 0 0 0 65535 ECU_ADDRESS 0x900038ba /end MEASUREMENT
/begin MEASUREMENT CellVolt37 "" UWORD VBU0513_CM_uint16 0 0 0 65535 ECU_ADDRESS 0x900038aa /end MEASUREMENT
/begin MEASUREMENT CellVolt38 "" UWORD VBU0513_CM_uint16 0 0 0 65535 ECU_ADDRESS 0x900038ac /end MEASUREMENT
/begin MEASUREMENT CellVolt39 "" UWORD VBU0513_CM_uint16 0 0 0 65535 ECU_ADDRESS 0x900038ae /end MEASUREMENT
/begin MEASUREMENT CellVolt40 "" UWORD VBU0513_CM_uint16 0 0 0 65535 ECU_ADDRESS 0x900038b2 /end MEASUREMENT
/begin MEASUREMENT CTD_stRnMnPosContactorStuckOpenFault "" UWORD VBU0513_CM_uint16 0 0 0 65535 ECU_ADDRESS 0x900039ba /end MEASUREMENT
/begin MEASUREMENT CTD_stMnPosContactorStuckOpenFault "" UWORD VBU0513_CM_uint16 0 0 0 65535 ECU_ADDRESS 0x900039b0 /end MEASUREMENT
/begin MEASUREMENT CTD_stMnNegContactorStuckOpenFault "" UWORD VBU0513_CM_uint16 0 0 0 65535 ECU_ADDRESS 0x900039ae /end MEASUREMENT
/begin MEASUREMENT CTD_stRnMnNegContactorStuckOpenFault "" UWORD VBU0513_CM_uint16 0 0 0 65535 ECU_ADDRESS 0x900039b8 /end MEASUREMENT
/begin MEASUREMENT CTD_stPrechargeEnergyHighFault "" UWORD VBU0513_CM_uint16 0 0 0 65535 ECU_ADDRESS 0x900039b2 /end MEASUREMENT
/begin MEASUREMENT SPD_numWhlSpdInvld "" UBYTE VBU0513_CM_uint8 0 0 0 255 ECU_ADDRESS 0x90004079 /end MEASUREMENT
/begin MEASUREMENT BPD_stBrkPedSwtRaw "" UBYTE VBU0513_CM_uint8 0 0 0.0 15.0 ECU_ADDRESS 0x90003fe4 /end MEASUREMENT
/begin MEASUREMENT BPD_stBrkSwt "" UBYTE VBU0513_CM_uint8 0 0 0.0 15.0 ECU_ADDRESS 0x90004092 /end MEASUREMENT
/begin MEASUREMENT TQO_stShft "" UBYTE VBU0513_CM_uint8 0 0 0.0 15.0 ECU_ADDRESS 0x9000408e /end MEASUREMENT
/begin MEASUREMENT HCU_Message_3_AD3_Heart "" UBYTE VBU0513_CM_uint8 0 0 0 255 ECU_ADDRESS 0x9000414f /end MEASUREMENT
/begin MEASUREMENT HCU_Message_3_AD2_Heart "" UBYTE VBU0513_CM_uint8 0 0 0 255 ECU_ADDRESS 0x9000414e /end MEASUREMENT
/begin MEASUREMENT HCU_Message_2_AD1_Heart "" UBYTE VBU0513_CM_uint8 0 0 0 255 ECU_ADDRESS 0x9000414d /end MEASUREMENT
/begin MEASUREMENT HCU_Message_1_RelayStatus_Heart "" UBYTE VBU0513_CM_uint8 0 0 0 255 ECU_ADDRESS 0x9000414c /end MEASUREMENT
/begin MEASUREMENT HCU_State "" UBYTE VBU0513_CM_uint8 0 0 0 255 ECU_ADDRESS 0x90004152 /end MEASUREMENT
/begin MEASUREMENT CTD_stPrechargeRelayStuckOpenDiagnosticStatus "" UBYTE VBU0513_CM_uint8 0 0 0 255 ECU_ADDRESS 0x9000410e /end MEASUREMENT
/begin MEASUREMENT CTD_stMnPosContactorWeldDiagnosticStatus "" UBYTE VBU0513_CM_uint8 0 0 0 255 ECU_ADDRESS 0x9000429c /end MEASUREMENT
/begin MEASUREMENT CTD_stMnNegContactorWeldDiagnosticStatus "" UBYTE VBU0513_CM_uint8 0 0 0 255 ECU_ADDRESS 0x9000429b /end MEASUREMENT
/begin MEASUREMENT Temperature_33 "" UBYTE VBU0513_CM_ufix8_Bn40 0 0 -40.0 215.0 ECU_ADDRESS 0x900041fc /end MEASUREMENT
/begin MEASUREMENT Temperature_34 "" UBYTE VBU0513_CM_ufix8_Bn40 0 0 -40.0 215.0 ECU_ADDRESS 0x900041fd /end MEASUREMENT
/begin MEASUREMENT Temperature_35 "" UBYTE VBU0513_CM_ufix8_Bn40 0 0 -40.0 215.0 ECU_ADDRESS 0x900041fe /end MEASUREMENT
/begin MEASUREMENT Temperature_36 "" UBYTE VBU0513_CM_ufix8_Bn40 0 0 -40.0 215.0 ECU_ADDRESS 0x900041ff /end MEASUREMENT
/begin MEASUREMENT Temperature_37 "" UBYTE VBU0513_CM_ufix8_Bn40 0 0 -40.0 215.0 ECU_ADDRESS 0x90004200 /end MEASUREMENT
/begin MEASUREMENT Temperature_38 "" UBYTE VBU0513_CM_ufix8_Bn40 0 0 -40.0 215.0 ECU_ADDRESS 0x90004201 /end MEASUREMENT
/begin MEASUREMENT Temperature_39 "" UBYTE VBU0513_CM_ufix8_Bn40 0 0 -40.0 215.0 ECU_ADDRESS 0x90004202 /end MEASUREMENT
/begin MEASUREMENT Temperature_40 "" UBYTE VBU0513_CM_ufix8_Bn40 0 0 -40.0 215.0 ECU_ADDRESS 0x90004204 /end MEASUREMENT
/begin MEASUREMENT Temperature_25 "" UBYTE VBU0513_CM_ufix8_Bn40 0 0 -40.0 215.0 ECU_ADDRESS 0x900041f3 /end MEASUREMENT
/begin MEASUREMENT Temperature_26 "" UBYTE VBU0513_CM_ufix8_Bn40 0 0 -40.0 215.0 ECU_ADDRESS 0x900041f4 /end MEASUREMENT
/begin MEASUREMENT Temperature_27 "" UBYTE VBU0513_CM_ufix8_Bn40 0 0 -40.0 215.0 ECU_ADDRESS 0x900041f5 /end MEASUREMENT
/begin MEASUREMENT Temperature_28 "" UBYTE VBU0513_CM_ufix8_Bn40 0 0 -40.0 215.0 ECU_ADDRESS 0x900041f6 /end MEASUREMENT
/begin MEASUREMENT Temperature_29 "" UBYTE VBU0513_CM_ufix8_Bn40 0 0 -40.0 215.0 ECU_ADDRESS 0x900041f7 /end MEASUREMENT
/begin MEASUREMENT Temperature_30 "" UBYTE VBU0513_CM_ufix8_Bn40 0 0 -40.0 215.0 ECU_ADDRESS 0x900041f9 /end MEASUREMENT
/begin MEASUREMENT Temperature_31 "" UBYTE VBU0513_CM_ufix8_Bn40 0 0 -40.0 215.0 ECU_ADDRESS 0x900041fa /end MEASUREMENT
/begin MEASUREMENT Temperature_32 "" UBYTE VBU0513_CM_ufix8_Bn40 0 0 -40.0 215.0 ECU_ADDRESS 0x900041fb /end MEASUREMENT
/begin MEASUREMENT Relay5_Error_State "" UBYTE VBU0513_CM_ufix4 0 0 0 15.0 ECU_ADDRESS 0x900041c0 /end MEASUREMENT
/begin MEASUREMENT Relay6_Error_State "" UBYTE VBU0513_CM_ufix4 0 0 0 15.0 ECU_ADDRESS 0x900041c1 /end MEASUREMENT
/begin MEASUREMENT Relay_Heat_Error_State "" UBYTE VBU0513_CM_ufix4 0 0 0 15.0 ECU_ADDRESS 0x900041c5 /end MEASUREMENT
/begin MEASUREMENT Relay_MainNegative_Error_State "" UBYTE VBU0513_CM_ufix4 0 0 0 15.0 ECU_ADDRESS 0x900041c7 /end MEASUREMENT
/begin MEASUREMENT Relay_MainPositive_Error_State "" UBYTE VBU0513_CM_ufix4 0 0 0 15.0 ECU_ADDRESS 0x900041c9 /end MEASUREMENT
/begin MEASUREMENT Relay_Precharge_Error_State "" UBYTE VBU0513_CM_ufix4 0 0 0 15.0 ECU_ADDRESS 0x900041cb /end MEASUREMENT
/begin MEASUREMENT Relay_5 "" UBYTE VBU0513_CM_ufix1 0 0 0 1.0 ECU_ADDRESS 0x900041c2 /end MEASUREMENT
/begin MEASUREMENT Relay_6 "" UBYTE VBU0513_CM_ufix1 0 0 0 1.0 ECU_ADDRESS 0x900041c3 /end MEASUREMENT
/begin MEASUREMENT Relay_Heat "" UBYTE VBU0513_CM_ufix1 0 0 0 1.0 ECU_ADDRESS 0x900041c4 /end MEASUREMENT
/begin MEASUREMENT Relay_MainNegative "" UBYTE VBU0513_CM_ufix1 0 0 0 1.0 ECU_ADDRESS 0x900041c6 /end MEASUREMENT
/begin MEASUREMENT Relay_MainPositive "" UBYTE VBU0513_CM_ufix1 0 0 0 1.0 ECU_ADDRESS 0x900041c8 /end MEASUREMENT
/begin MEASUREMENT Relay_Precharge "" UBYTE VBU0513_CM_ufix1 0 0 0 1.0 ECU_ADDRESS 0x900041ca /end MEASUREMENT
/begin MEASUREMENT BPD_flgMainBrkSwt "" UBYTE VBU0513_CM_boolean 0 0 0.0 1.0 ECU_ADDRESS 0x90003fe3 /end MEASUREMENT
/begin MEASUREMENT APD_flgDftRatioPlausibility "" UBYTE VBU0513_CM_boolean 0 0 0.0 1.0 ECU_ADDRESS 0x9000408f /end MEASUREMENT
/begin MEASUREMENT SPD_flgVehSpdVld "" UBYTE VBU0513_CM_boolean 0 0 0.0 1.0 ECU_ADDRESS 0x90004078 /end MEASUREMENT
/begin MEASUREMENT DCH_flgStationCrrntLimd "" UBYTE VBU0513_CM_boolean 0 0 0.0 1.0 ECU_ADDRESS 0x90004017 /end MEASUREMENT
/begin MEASUREMENT DCH_flgChargingPortTempHigh "" UBYTE VBU0513_CM_boolean 0 0 0.0 1.0 ECU_ADDRESS 0x90003ffb /end MEASUREMENT
/begin MEASUREMENT Gear_flgBrkPrssed "" UBYTE VBU0513_CM_boolean 0 0 0.0 1.0 ECU_ADDRESS 0x9000403e /end MEASUREMENT
/begin MEASUREMENT Gear_flgGearShiftReady "" UBYTE VBU0513_CM_boolean 0 0 0.0 1.0 ECU_ADDRESS 0x90004098 /end MEASUREMENT
/begin MEASUREMENT MTQL_flgRMotrInhbt "" UBYTE VBU0513_CM_boolean 0 0 0.0 1.0 ECU_ADDRESS 0x900040a3 /end MEASUREMENT
/begin MEASUREMENT TQD_flgVehSlide "" UBYTE VBU0513_CM_boolean 0 0 0.0 1.0 ECU_ADDRESS 0x9000408c /end MEASUREMENT
/begin MEASUREMENT TQD_flgCrpEna "" UBYTE VBU0513_CM_boolean 0 0 0.0 1.0 ECU_ADDRESS 0x900040b5 /end MEASUREMENT
/begin MEASUREMENT TQD_flgHillHld "" UBYTE VBU0513_CM_boolean 0 0 0.0 1.0 ECU_ADDRESS 0x9000408a /end MEASUREMENT
/begin MEASUREMENT PMM_flgHVClReqSrcRising "" UBYTE VBU0513_CM_boolean 0 0 0 1 ECU_ADDRESS 0x900040a9 /end MEASUREMENT
/begin MEASUREMENT PMM_flgCtlSht "" UBYTE VBU0513_CM_boolean 0 0 0 1 ECU_ADDRESS 0x90004271 /end MEASUREMENT
/begin MEASUREMENT PMM_flgRutnOffReq "" UBYTE VBU0513_CM_boolean 0 0 0 1 ECU_ADDRESS 0x900040b3 /end MEASUREMENT
/begin MEASUREMENT PMM_flgVehAllwOp "" UBYTE VBU0513_CM_boolean 0 0 0 1 ECU_ADDRESS 0x900040b4 /end MEASUREMENT
/begin MEASUREMENT PMM_flgHVRly "" UBYTE VBU0513_CM_boolean 0 0 0 1 ECU_ADDRESS 0x900040aa /end MEASUREMENT
/begin MEASUREMENT PMM_flgInhinPwrUp "" UBYTE VBU0513_CM_boolean 0 0 0 1 ECU_ADDRESS 0x900040b0 /end MEASUREMENT
/begin MEASUREMENT PMM_flgHVRlyOpReqToHVRlyClReq "" UBYTE VBU0513_CM_boolean 0 0 0 1 ECU_ADDRESS 0x900040af /end MEASUREMENT
/begin MEASUREMENT PMM_flgHVClReqOn "" UBYTE VBU0513_CM_boolean 0 0 0 1 ECU_ADDRESS 0x900040a8 /end MEASUREMENT
/begin MEASUREMENT PMM_flgDCDCDisblToHVRlyOpReq "" UBYTE VBU0513_CM_boolean 0 0 0 1 ECU_ADDRESS 0x900040a7 /end MEASUREMENT
/begin MEASUREMENT PMM_flgOffLoadToHVRlyCld "" UBYTE VBU0513_CM_boolean 0 0 0 1 ECU_ADDRESS 0x9000427a /end MEASUREMENT
/begin MEASUREMENT PMM_flgHVRlyOpReqToActvDisCh "" UBYTE VBU0513_CM_boolean 0 0 0 1 ECU_ADDRESS 0x900040ae /end MEASUREMENT
/begin MEASUREMENT PMM_flgACTstToHVRlyOpReq "" UBYTE VBU0513_CM_boolean 0 0 0 1 ECU_ADDRESS 0x900040a4 /end MEASUREMENT
/begin MEASUREMENT PMM_flgHVRlyClReqToActvDisCh "" UBYTE VBU0513_CM_boolean 0 0 0 1 ECU_ADDRESS 0x900040ab /end MEASUREMENT
/begin MEASUREMENT PMM_flgHVRlyCldToOffLoad "" UBYTE VBU0513_CM_boolean 0 0 0 1 ECU_ADDRESS 0x900040ad /end MEASUREMENT
/begin MEASUREMENT PMM_flgHVRlyClReqToHVRlyCld "" UBYTE VBU0513_CM_boolean 0 0 0 1 ECU_ADDRESS 0x900040ac /end MEASUREMENT
/begin MEASUREMENT PMM_flgActvDisChToHVRlyClReq "" UBYTE VBU0513_CM_boolean 0 0 0 1 ECU_ADDRESS 0x900040a5 /end MEASUREMENT
/begin MEASUREMENT PMM_flgShtDwnToInit "" UBYTE VBU0513_CM_boolean 0 0 0 1 ECU_ADDRESS 0x90004281 /end MEASUREMENT
/begin MEASUREMENT PMM_flgACTstToHVRlyCld "" UBYTE VBU0513_CM_boolean 0 0 0 1 ECU_ADDRESS 0x9000426e /end MEASUREMENT
/begin MEASUREMENT PMM_flgActvDisChToShtDwn "" UBYTE VBU0513_CM_boolean 0 0 0 1 ECU_ADDRESS 0x900040a6 /end MEASUREMENT
/begin MEASUREMENT PMM_flgWkup1Cmd "" UBYTE VBU0513_CM_boolean 0 0 0 1 ECU_ADDRESS 0x90004284 /end MEASUREMENT
/begin MEASUREMENT PMM_flgVCUShtDwn "" UBYTE VBU0513_CM_boolean 0 0 0 1 ECU_ADDRESS 0x90004282 /end MEASUREMENT
/begin MEASUREMENT PMM_flgACTstReq "" UBYTE VBU0513_CM_boolean 0 0 0 1 ECU_ADDRESS 0x9000426c /end MEASUREMENT
/begin MEASUREMENT DCH_flgDCChDiagCmd "" UBYTE VBU0513_CM_boolean 0 0 0.0 1.0 ECU_ADDRESS 0x90003ffd /end MEASUREMENT
/begin MEASUREMENT DCH_flgMonDCChOvrCrnt "" UBYTE VBU0513_CM_boolean 0 0 0.0 1.0 ECU_ADDRESS 0x90004009 /end MEASUREMENT
/begin MEASUREMENT DCH_flgDftDCChOvrCrnt "" UBYTE VBU0513_CM_boolean 0 0 0.0 1.0 ECU_ADDRESS 0x90004003 /end MEASUREMENT
/begin MEASUREMENT DCH_flgDftDCChOvrVltg "" UBYTE VBU0513_CM_boolean 0 0 0.0 1.0 ECU_ADDRESS 0x90004004 /end MEASUREMENT
/begin MEASUREMENT DCH_flgDftDCPortOvrTemp "" UBYTE VBU0513_CM_boolean 0 0 0.0 1.0 ECU_ADDRESS 0x90004006 /end MEASUREMENT
/begin MEASUREMENT DCH_flgMonDCPortOvrTemp "" UBYTE VBU0513_CM_boolean 0 0 0.0 1.0 ECU_ADDRESS 0x9000400a /end MEASUREMENT
/begin MEASUREMENT DCH_flgDCChPortTempLimEna "" UBYTE VBU0513_CM_boolean 0 0 0.0 1.0 ECU_ADDRESS 0x90003ffe /end MEASUREMENT
/begin MEASUREMENT FCC_flgChargeCurrentDerate "" UBYTE VBU0513_CM_boolean 0 0 0.0 1.0 ECU_ADDRESS 0x9000402f /end MEASUREMENT
/begin MEASUREMENT CTS_flgInhibitPrecharge "" UBYTE VBU0513_CM_boolean 0 0 0 1 ECU_ADDRESS 0x90004116 /end MEASUREMENT
/begin MEASUREMENT CTS_flgAbortPrecharge "" UBYTE VBU0513_CM_boolean 0 0 0 1 ECU_ADDRESS 0x90004112 /end MEASUREMENT
/begin MEASUREMENT LbCTD_RnMnPosContactorStuckOpenTestEnable_flg "" UBYTE VBU0513_CM_boolean 0 0 0 1 ECU_ADDRESS 0x90004174 /end MEASUREMENT
/begin MEASUREMENT CTD_flgRnMnPosContactorStuckOpenTestFail "" UBYTE VBU0513_CM_boolean 0 0 0 1 ECU_ADDRESS 0x90004109 /end MEASUREMENT
/begin MEASUREMENT CTD_flgRnMnNegContactorStuckOpenTestEnable "" UBYTE VBU0513_CM_boolean 0 0 0 1 ECU_ADDRESS 0x90004107 /end MEASUREMENT
/begin MEASUREMENT CTD_flgRnMnNegContactorStuckOpenTestFail "" UBYTE VBU0513_CM_boolean 0 0 0 1 ECU_ADDRESS 0x90004108 /end MEASUREMENT
/begin MEASUREMENT LbCTD_PrechargeEnergyHighTestEnable_flg "" UBYTE VBU0513_CM_boolean 0 0 0 1 ECU_ADDRESS 0x90004172 /end MEASUREMENT
/begin MEASUREMENT LbCTD_PrechargeEnergyHighTestFail_flg "" UBYTE VBU0513_CM_boolean 0 0 0 1 ECU_ADDRESS 0x90004173 /end MEASUREMENT
/begin MEASUREMENT BCV_flgBatteryVoltageValid "" UBYTE VBU0513_CM_boolean 0 0 0.0 1.0 ECU_ADDRESS 0x90004258 /end MEASUREMENT
/begin MEASUREMENT BCV_flgBusNegativeVoltageValid "" UBYTE VBU0513_CM_boolean 0 0 0 1 ECU_ADDRESS 0x900040e8 /end MEASUREMENT
/begin MEASUREMENT BCV_flgBusVoltageValid "" UBYTE VBU0513_CM_boolean 0 0 0 1 ECU_ADDRESS 0x900040e9 /end MEASUREMENT
/begin MEASUREMENT BCV_flgFuseVoltageValid "" UBYTE VBU0513_CM_boolean 0 0 0 1 ECU_ADDRESS 0x900040ea /end MEASUREMENT
/begin MEASUREMENT BCV_flgPrechargeVoltageValid "" UBYTE VBU0513_CM_boolean 0 0 0 1 ECU_ADDRESS 0x900040eb /end MEASUREMENT
/begin MEASUREMENT BCV_flgVx1VoltageValid "" UBYTE VBU0513_CM_boolean 0 0 0 1 ECU_ADDRESS 0x9000425b /end MEASUREMENT
/begin MEASUREMENT BCV_flgVx2VoltageValid "" UBYTE VBU0513_CM_boolean 0 0 0 1 ECU_ADDRESS 0x900040ec /end MEASUREMENT
/begin MEASUREMENT BCV_flgBatteryCurrentValid "" UBYTE VBU0513_CM_boolean 0 0 0 1 ECU_ADDRESS 0x90003fdc /end MEASUREMENT
/begin COMPU_METHOD VBU0513_CM_single_cnt "Q = V" RAT_FUNC "%8.6" "cnt" COEFFS 0 1 0 0 0 1 /end COMPU_METHOD
/begin COMPU_METHOD VBU0513_CM_single_Nm "Q = V" RAT_FUNC "%8.6" "Nm" COEFFS 0 1 0 0 0 1 /end COMPU_METHOD
/begin COMPU_METHOD VBU0513_CM_single_kph "Q = V" RAT_FUNC "%8.6" "kph" COEFFS 0 1 0 0 0 1 /end COMPU_METHOD
/begin COMPU_METHOD VBU0513_CM_uint16_cnt "Q = V" RAT_FUNC "%5.0" "cnt" COEFFS 0 1 0 0 0 1 /end COMPU_METHOD
/begin COMPU_METHOD VBU0513_CM_single_pct "Q = V" RAT_FUNC "%8.6" "pct" COEFFS 0 1 0 0 0 1 /end COMPU_METHOD
/begin COMPU_METHOD VBU0513_CM_single_A "Q = V" RAT_FUNC "%8.6" "A" COEFFS 0 1 0 0 0 1 /end COMPU_METHOD
/begin COMPU_METHOD VBU0513_CM_single_fac "Q = V" RAT_FUNC "%8.6" "fac" COEFFS 0 1 0 0 0 1 /end COMPU_METHOD
/begin COMPU_METHOD VBU0513_CM_single_p "Q = V" RAT_FUNC "%8.6" "p" COEFFS 0 1 0 0 0 1 /end COMPU_METHOD
/begin COMPU_METHOD VBU0513_CM_single_phi "Q = V" RAT_FUNC "%8.6" "phi" COEFFS 0 1 0 0 0 1 /end COMPU_METHOD
/begin COMPU_METHOD VBU0513_CM_uint8 "Q = V" RAT_FUNC "%3.0" "" COEFFS 0 1 0 0 0 1 /end COMPU_METHOD
/begin COMPU_METHOD VBU0513_CM_double_cnt "Q = V" RAT_FUNC "%15.10" "cnt" COEFFS 0 1 0 0 0 1 /end COMPU_METHOD
/begin COMPU_METHOD VBU0513_CM_single_MPa "Q = V" RAT_FUNC "%8.6" "MPa" COEFFS 0 1 0 0 0 1 /end COMPU_METHOD
/begin COMPU_METHOD VBU0513_CM_single_V "Q = V" RAT_FUNC "%8.6" "V" COEFFS 0 1 0 0 0 1 /end COMPU_METHOD
/begin COMPU_METHOD VBU0513_CM_single_km "Q = V" RAT_FUNC "%8.6" "km" COEFFS 0 1 0 0 0 1 /end COMPU_METHOD
/begin COMPU_METHOD VBU0513_CM_uint16 "Q = V" RAT_FUNC "%5.0" "" COEFFS 0 1 0 0 0 1 /end COMPU_METHOD
/begin COMPU_METHOD VBU0513_CM_single "Q = V" RAT_FUNC "%8.6" "" COEFFS 0 1 0 0 0 1 /end COMPU_METHOD
/begin COMPU_METHOD VBU0513_CM_single_s "Q = V" RAT_FUNC "%8.6" "s" COEFFS 0 1 0 0 0 1 /end COMPU_METHOD
/begin COMPU_METHOD VBU0513_CM_single_kW "Q = V" RAT_FUNC "%8.6" "kW" COEFFS 0 1 0 0 0 1 /end COMPU_METHOD
/begin COMPU_METHOD VBU0513_CM_uint32 "Q = V" RAT_FUNC "%10.0" "" COEFFS 0 1 0 0 0 1 /end COMPU_METHOD
/begin COMPU_METHOD VBU0513_CM_boolean_flg "Q = V" RAT_FUNC "%1.0" "flg" COEFFS 0 1 0 0 0 1 /end COMPU_METHOD
/begin COMPU_METHOD VBU0513_CM_boolean_cnt "Q = V" RAT_FUNC "%1.0" "cnt" COEFFS 0 1 0 0 0 1 /end COMPU_METHOD
/begin COMPU_METHOD VBU0513_CM_boolean "Q = V" RAT_FUNC "%1.0" "" COEFFS 0 1 0 0 0 1 /end COMPU_METHOD
/begin COMPU_METHOD VBU0513_CM_int8_cnt "Q = V" RAT_FUNC "%3.0" "cnt" COEFFS 0 1 0 0 0 1 /end COMPU_METHOD
/begin COMPU_METHOD VBU0513_CM_uint8_cnt "Q = V" RAT_FUNC "%3.0" "cnt" COEFFS 0 1 0 0 0 1 /end COMPU_METHOD
/begin COMPU_METHOD VBU0513_CM_ufix8_Bn40 "Q = (V+40.000000)/1.000000" RAT_FUNC "%0.6" "" COEFFS 0 1.000000 40.000000 0 0 1.000000 /end COMPU_METHOD
/begin COMPU_METHOD VBU0513_CM_ufix4 "Q = V/1.000000" RAT_FUNC "%3.0" "" COEFFS 0 1.000000 0.000000 0 0 1.000000 /end COMPU_METHOD
/begin COMPU_METHOD VBU0513_CM_ufix1 "Q = V/1.000000" RAT_FUNC "%3.0" "" COEFFS 0 1.000000 0.000000 0 0 1.000000 /end COMPU_METHOD
/begin GROUP S2840_HCUCellVolt10 "VBU0513/VBUSystem/HALIn/PrivateCAN/CanMsgUnpack1/MsgRxData_Unpack30/CanRxData_Unpack/HCUCellVolt10" /begin REF_MEASUREMENT CellVolt37 CellVolt38 CellVolt39 CellVolt40 /end REF_MEASUREMENT /end GROUP
/begin GROUP S2842_HCUCellVolt11 "VBU0513/VBUSystem/HALIn/PrivateCAN/CanMsgUnpack1/MsgRxData_Unpack31/CanRxData_Unpack/HCUCellVolt11" /begin REF_MEASUREMENT CellVolt41 CellVolt42 CellVolt43 CellVolt44 /end REF_MEASUREMENT /end GROUP
/begin GROUP S2844_HCUCellVolt12 "VBU0513/VBUSystem/HALIn/PrivateCAN/CanMsgUnpack1/MsgRxData_Unpack32/CanRxData_Unpack/HCUCellVolt12" /begin REF_MEASUREMENT CellVolt45 CellVolt46 CellVolt47 CellVolt48 /end REF_MEASUREMENT /end GROUP
/begin GROUP S2846_HCUCellVolt13 "VBU0513/VBUSystem/HALIn/PrivateCAN/CanMsgUnpack1/MsgRxData_Unpack33/CanRxData_Unpack/HCUCellVolt13" /begin REF_MEASUREMENT CellVolt49 CellVolt50 CellVolt51 CellVolt52 /end REF_MEASUREMENT /end GROUP
/begin GROUP S2848_HCUCellVolt14 "VBU0513/VBUSystem/HALIn/PrivateCAN/CanMsgUnpack1/MsgRxData_Unpack34/CanRxData_Unpack/HCUCellVolt14" /begin REF_MEASUREMENT CellVolt53 CellVolt54 CellVolt55 CellVolt56 /end REF_MEASUREMENT /end GROUP
/begin GROUP S2850_HCUCellVolt15 "VBU0513/VBUSystem/HALIn/PrivateCAN/CanMsgUnpack1/MsgRxData_Unpack35/CanRxData_Unpack/HCUCellVolt15" /begin REF_MEASUREMENT CellVolt57 CellVolt58 CellVolt59 CellVolt60 /end REF_MEASUREMENT /end GROUP
/begin GROUP S2852_HCUCellVolt16 "VBU0513/VBUSystem/HALIn/PrivateCAN/CanMsgUnpack1/MsgRxData_Unpack36/CanRxData_Unpack/HCUCellVolt16" /begin REF_MEASUREMENT CellVolt61 CellVolt62 CellVolt63 CellVolt64 /end REF_MEASUREMENT /end GROUP
/begin GROUP S2854_HCUCellVolt17 "VBU0513/VBUSystem/HALIn/PrivateCAN/CanMsgUnpack1/MsgRxData_Unpack37/CanRxData_Unpack/HCUCellVolt17" /begin REF_MEASUREMENT CellVolt65 CellVolt66 CellVolt67 CellVolt68 /end REF_MEASUREMENT /end GROUP
/begin GROUP S2856_HCUCellVolt18 "VBU0513/VBUSystem/HALIn/PrivateCAN/CanMsgUnpack1/MsgRxData_Unpack38/CanRxData_Unpack/HCUCellVolt18" /begin REF_MEASUREMENT CellVolt69 CellVolt70 CellVolt71 CellVolt72 /end REF_MEASUREMENT /end GROUP
/begin GROUP S2858_HCUCellVolt19 "VBU0513/VBUSystem/HALIn/PrivateCAN/CanMsgUnpack1/MsgRxData_Unpack39/CanRxData_Unpack/HCUCellVolt19" /begin REF_MEASUREMENT CellVolt73 CellVolt74 CellVolt75 CellVolt76 /end REF_MEASUREMENT /end GROUP
/begin GROUP S2860_HCUCellTemp_4 "VBU0513/VBUSystem/HALIn/PrivateCAN/CanMsgUnpack1/MsgRxData_Unpack4/CanRxData_Unpack/HCUCellTemp_4"
 /begin REF_MEASUREMENT Temperature_25 Temperature_26 Temperature_27 Temperature_28 Temperature_29 Temperature_30 Temperature_31 Temperature_32 /end REF_MEASUREMENT
/end GROUP
/begin GROUP S2862_HCUCellVolt2 "VBU0513/VBUSystem/HALIn/PrivateCAN/CanMsgUnpack1/MsgRxData_Unpack40/CanRxData_Unpack/HCUCellVolt2" /begin REF_MEASUREMENT CellVolt5 CellVolt6 CellVolt7 CellVolt8 /end REF_MEASUREMENT /end GROUP
/begin GROUP S2864_HCUCellVolt20 "VBU0513/VBUSystem/HALIn/PrivateCAN/CanMsgUnpack1/MsgRxData_Unpack41/CanRxData_Unpack/HCUCellVolt20" /begin REF_MEASUREMENT CellVolt77 CellVolt78 CellVolt79 CellVolt80 /end REF_MEASUREMENT /end GROUP
/begin GROUP S2866_HCUCellVolt21 "VBU0513/VBUSystem/HALIn/PrivateCAN/CanMsgUnpack1/MsgRxData_Unpack42/CanRxData_Unpack/HCUCellVolt21" /begin REF_MEASUREMENT CellVolt81 CellVolt82 CellVolt83 CellVolt84 /end REF_MEASUREMENT /end GROUP
/begin GROUP S2868_HCUCellVolt22 "VBU0513/VBUSystem/HALIn/PrivateCAN/CanMsgUnpack1/MsgRxData_Unpack43/CanRxData_Unpack/HCUCellVolt22" /begin REF_MEASUREMENT CellVolt85 CellVolt86 CellVolt87 CellVolt88 /end REF_MEASUREMENT /end GROUP
/begin GROUP S2870_HCUCellVolt23 "VBU0513/VBUSystem/HALIn/PrivateCAN/CanMsgUnpack1/MsgRxData_Unpack44/CanRxData_Unpack/HCUCellVolt23" /begin REF_MEASUREMENT CellVolt89 CellVolt90 CellVolt91 CellVolt92 /end REF_MEASUREMENT /end GROUP
/begin GROUP S2872_HCUCellVolt24 "VBU0513/VBUSystem/HALIn/PrivateCAN/CanMsgUnpack1/MsgRxData_Unpack45/CanRxData_Unpack/HCUCellVolt24" /begin REF_MEASUREMENT CellVolt93 CellVolt94 CellVolt95 CellVolt96 /end REF_MEASUREMENT /end GROUP
/begin GROUP S2874_HCUCellVolt25 "VBU0513/VBUSystem/HALIn/PrivateCAN/CanMsgUnpack1/MsgRxData_Unpack46/CanRxData_Unpack/HCUCellVolt25" /begin REF_MEASUREMENT CellVolt100 CellVolt97 CellVolt98 CellVolt99 /end REF_MEASUREMENT /end GROUP
/begin GROUP S2876_HCUCellVolt26 "VBU0513/VBUSystem/HALIn/PrivateCAN/CanMsgUnpack1/MsgRxData_Unpack47/CanRxData_Unpack/HCUCellVolt26" /begin REF_MEASUREMENT CellVolt101 CellVolt102 CellVolt103 CellVolt104 /end REF_MEASUREMENT /end GROUP
/begin GROUP S2878_HCUCellVolt27 "VBU0513/VBUSystem/HALIn/PrivateCAN/CanMsgUnpack1/MsgRxData_Unpack48/CanRxData_Unpack/HCUCellVolt27" /begin REF_MEASUREMENT CellVolt105 CellVolt106 CellVolt107 CellVolt108 /end REF_MEASUREMENT /end GROUP
/begin GROUP S2880_HCUCellVolt28 "VBU0513/VBUSystem/HALIn/PrivateCAN/CanMsgUnpack1/MsgRxData_Unpack49/CanRxData_Unpack/HCUCellVolt28" /begin REF_MEASUREMENT CellVolt109 CellVolt110 CellVolt111 CellVolt112 /end REF_MEASUREMENT /end GROUP
/begin GROUP S2882_HCUCellTemp_5 "VBU0513/VBUSystem/HALIn/PrivateCAN/CanMsgUnpack1/MsgRxData_Unpack5/CanRxData_Unpack/HCUCellTemp_5"
 /begin REF_MEASUREMENT Temperature_33 Temperature_34 Temperature_35 Temperature_36 Temperature_37 Temperature_38 Temperature_39 Temperature_40 /end REF_MEASUREMENT
/end GROUP
/begin GROUP S2884_HCUCellVolt29 "VBU0513/VBUSystem/HALIn/PrivateCAN/CanMsgUnpack1/MsgRxData_Unpack50/CanRxData_Unpack/HCUCellVolt29" /begin REF_MEASUREMENT CellVolt113 CellVolt114 CellVolt115 CellVolt116 /end REF_MEASUREMENT /end GROUP
/begin GROUP S2886_HCUCellVolt3 "VBU0513/VBUSystem/HALIn/PrivateCAN/CanMsgUnpack1/MsgRxData_Unpack51/CanRxData_Unpack/HCUCellVolt3" /begin REF_MEASUREMENT CellVolt10 CellVolt11 CellVolt12 CellVolt9 /end REF_MEASUREMENT /end GROUP
/begin GROUP S2888_HCUCellVolt30 "VBU0513/VBUSystem/HALIn/PrivateCAN/CanMsgUnpack1/MsgRxData_Unpack52/CanRxData_Unpack/HCUCellVolt30" /begin REF_MEASUREMENT CellVolt117 CellVolt118 CellVolt119 CellVolt120 /end REF_MEASUREMENT /end GROUP
/begin GROUP S2890_HCUCellVolt31 "VBU0513/VBUSystem/HALIn/PrivateCAN/CanMsgUnpack1/MsgRxData_Unpack53/CanRxData_Unpack/HCUCellVolt31" /begin REF_MEASUREMENT CellVolt121 CellVolt122 CellVolt123 CellVolt124 /end REF_MEASUREMENT /end GROUP
/begin GROUP S2892_HCUCellVolt32 "VBU0513/VBUSystem/HALIn/PrivateCAN/CanMsgUnpack1/MsgRxData_Unpack54/CanRxData_Unpack/HCUCellVolt32" /begin REF_MEASUREMENT CellVolt125 CellVolt126 CellVolt127 CellVolt128 /end REF_MEASUREMENT /end GROUP
/begin GROUP S2894_HCUCellVolt33 "VBU0513/VBUSystem/HALIn/PrivateCAN/CanMsgUnpack1/MsgRxData_Unpack55/CanRxData_Unpack/HCUCellVolt33" /begin REF_MEASUREMENT CellVolt129 CellVolt130 CellVolt131 CellVolt132 /end REF_MEASUREMENT /end GROUP
/begin GROUP S2896_HCUCellVolt34 "VBU0513/VBUSystem/HALIn/PrivateCAN/CanMsgUnpack1/MsgRxData_Unpack56/CanRxData_Unpack/HCUCellVolt34" /begin REF_MEASUREMENT CellVolt133 CellVolt134 CellVolt135 CellVolt136 /end REF_MEASUREMENT /end GROUP
/begin GROUP S2898_HCUCellVolt35 "VBU0513/VBUSystem/HALIn/PrivateCAN/CanMsgUnpack1/MsgRxData_Unpack57/CanRxData_Unpack/HCUCellVolt35" /begin REF_MEASUREMENT CellVolt137 CellVolt138 CellVolt139 CellVolt140 /end REF_MEASUREMENT /end GROUP
/begin GROUP S2900_HCUCellVolt36 "VBU0513/VBUSystem/HALIn/PrivateCAN/CanMsgUnpack1/MsgRxData_Unpack58/CanRxData_Unpack/HCUCellVolt36" /begin REF_MEASUREMENT CellVolt141 CellVolt142 CellVolt143 CellVolt144 /end REF_MEASUREMENT /end GROUP
/begin GROUP S2902_HCUCellVolt37 "VBU0513/VBUSystem/HALIn/PrivateCAN/CanMsgUnpack1/MsgRxData_Unpack59/CanRxData_Unpack/HCUCellVolt37" /begin REF_MEASUREMENT CellVolt145 CellVolt146 CellVolt147 CellVolt148 /end REF_MEASUREMENT /end GROUP
/begin GROUP S2904_HCU_Message_1_RelayStatus "VBU0513/VBUSystem/HALIn/PrivateCAN/CanMsgUnpack1/MsgRxData_Unpack6/CanRxData_Unpack/HCU_Message_1_RelayStatus"
 /begin REF_MEASUREMENT HCU_Message_1_RelayStatus_Heart HCU_State Relay5_Error_State Relay6_Error_State Relay_5 Relay_6 Relay_Heat Relay_Heat_Error_State Relay_MainNegative Relay_MainNegative_Error_State Relay_MainPositive Relay_MainPositive_Error_State Relay_Precharge Relay_Precharge_Error_State /end REF_MEASUREMENT
/end GROUP
/begin GROUP S2906_HCUCellVolt38 "VBU0513/VBUSystem/HALIn/PrivateCAN/CanMsgUnpack1/MsgRxData_Unpack60/CanRxData_Unpack/HCUCellVolt38" /begin REF_MEASUREMENT CellVolt149 CellVolt150 CellVolt151 CellVolt152 /end REF_MEASUREMENT /end GROUP
/begin GROUP S2908_HCUCellVolt39 "VBU0513/VBUSystem/HALIn/PrivateCAN/CanMsgUnpack1/MsgRxData_Unpack61/CanRxData_Unpack/HCUCellVolt39" /begin REF_MEASUREMENT CellVolt153 CellVolt154 CellVolt155 CellVolt156 /end REF_MEASUREMENT /end GROUP
/begin GROUP S2910_HCUCellVolt4 "VBU0513/VBUSystem/HALIn/PrivateCAN/CanMsgUnpack1/MsgRxData_Unpack62/CanRxData_Unpack/HCUCellVolt4" /begin REF_MEASUREMENT CellVolt13 CellVolt14 CellVolt15 CellVolt16 /end REF_MEASUREMENT /end GROUP
/begin GROUP S2912_HCUCellVolt40 "VBU0513/VBUSystem/HALIn/PrivateCAN/CanMsgUnpack1/MsgRxData_Unpack63/CanRxData_Unpack/HCUCellVolt40" /begin REF_MEASUREMENT CellVolt157 CellVolt158 CellVolt159 CellVolt160 /end REF_MEASUREMENT /end GROUP
/begin GROUP S2914_HCUCellVolt41 "VBU0513/VBUSystem/HALIn/PrivateCAN/CanMsgUnpack1/MsgRxData_Unpack64/CanRxData_Unpack/HCUCellVolt41" /begin REF_MEASUREMENT CellVolt161 CellVolt162 CellVolt163 CellVolt164 /end REF_MEASUREMENT /end GROUP
/begin GROUP S2916_HCUCellVolt42 "VBU0513/VBUSystem/HALIn/PrivateCAN/CanMsgUnpack1/MsgRxData_Unpack65/CanRxData_Unpack/HCUCellVolt42" /begin REF_MEASUREMENT CellVolt165 CellVolt166 CellVolt167 CellVolt168 /end REF_MEASUREMENT /end GROUP
/begin GROUP S2918_HCUCellVolt43 "VBU0513/VBUSystem/HALIn/PrivateCAN/CanMsgUnpack1/MsgRxData_Unpack66/CanRxData_Unpack/HCUCellVolt43" /begin REF_MEASUREMENT CellVolt169 CellVolt170 CellVolt171 CellVolt172 /end REF_MEASUREMENT /end GROUP
/begin GROUP S2920_HCUCellVolt44 "VBU0513/VBUSystem/HALIn/PrivateCAN/CanMsgUnpack1/MsgRxData_Unpack67/CanRxData_Unpack/HCUCellVolt44" /begin REF_MEASUREMENT CellVolt173 CellVolt174 CellVolt175 CellVolt176 /end REF_MEASUREMENT /end GROUP
/begin GROUP S2922_HCUCellVolt45 "VBU0513/VBUSystem/HALIn/PrivateCAN/CanMsgUnpack1/MsgRxData_Unpack68/CanRxData_Unpack/HCUCellVolt45" /begin REF_MEASUREMENT CellVolt177 CellVolt178 CellVolt179 CellVolt180 /end REF_MEASUREMENT /end GROUP
/begin GROUP S2924_HCUCellVolt46 "VBU0513/VBUSystem/HALIn/PrivateCAN/CanMsgUnpack1/MsgRxData_Unpack69/CanRxData_Unpack/HCUCellVolt46" /begin REF_MEASUREMENT CellVolt181 CellVolt182 CellVolt183 CellVolt184 /end REF_MEASUREMENT /end GROUP
/begin GROUP S2926_HCU_Message_2_AD1 "VBU0513/VBUSystem/HALIn/PrivateCAN/CanMsgUnpack1/MsgRxData_Unpack7/CanRxData_Unpack/HCU_Message_2_AD1"
 /begin REF_MEASUREMENT HCU_Message_2_AD1_Heart HV1_AD HV2_Heating_Relay__AD HV3_Main_Fuse__AD /end REF_MEASUREMENT
/end GROUP
/begin GROUP S2928_HCUCellVolt47 "VBU0513/VBUSystem/HALIn/PrivateCAN/CanMsgUnpack1/MsgRxData_Unpack70/CanRxData_Unpack/HCUCellVolt47" /begin REF_MEASUREMENT CellVolt185 CellVolt186 CellVolt187 CellVolt188 /end REF_MEASUREMENT /end GROUP
/begin GROUP S2930_HCUCellVolt48 "VBU0513/VBUSystem/HALIn/PrivateCAN/CanMsgUnpack1/MsgRxData_Unpack71/CanRxData_Unpack/HCUCellVolt48" /begin REF_MEASUREMENT CellVolt189 CellVolt190 CellVolt191 CellVolt192 /end REF_MEASUREMENT /end GROUP
/begin GROUP S2932_HCUCellVolt49 "VBU0513/VBUSystem/HALIn/PrivateCAN/CanMsgUnpack1/MsgRxData_Unpack72/CanRxData_Unpack/HCUCellVolt49" /begin REF_MEASUREMENT CellVolt193 CellVolt194 CellVolt195 CellVolt196 /end REF_MEASUREMENT /end GROUP
/begin GROUP S2934_HCUCellVolt5 "VBU0513/VBUSystem/HALIn/PrivateCAN/CanMsgUnpack1/MsgRxData_Unpack73/CanRxData_Unpack/HCUCellVolt5" /begin REF_MEASUREMENT CellVolt17 CellVolt18 CellVolt19 CellVolt20 /end REF_MEASUREMENT /end GROUP
/begin GROUP S2936_HCUCellVolt50 "VBU0513/VBUSystem/HALIn/PrivateCAN/CanMsgUnpack1/MsgRxData_Unpack74/CanRxData_Unpack/HCUCellVolt50" /begin REF_MEASUREMENT CellVolt197 CellVolt198 CellVolt199 CellVolt200 /end REF_MEASUREMENT /end GROUP
/begin GROUP S2938_HCUCellVolt6 "VBU0513/VBUSystem/HALIn/PrivateCAN/CanMsgUnpack1/MsgRxData_Unpack75/CanRxData_Unpack/HCUCellVolt6" /begin REF_MEASUREMENT CellVolt21 CellVolt22 CellVolt23 CellVolt24 /end REF_MEASUREMENT /end GROUP
/begin GROUP S2940_HCUCellVolt7 "VBU0513/VBUSystem/HALIn/PrivateCAN/CanMsgUnpack1/MsgRxData_Unpack76/CanRxData_Unpack/HCUCellVolt7" /begin REF_MEASUREMENT CellVolt25 CellVolt26 CellVolt27 CellVolt28 /end REF_MEASUREMENT /end GROUP
/begin GROUP S2942_HCUCellVolt8 "VBU0513/VBUSystem/HALIn/PrivateCAN/CanMsgUnpack1/MsgRxData_Unpack77/CanRxData_Unpack/HCUCellVolt8" /begin REF_MEASUREMENT CellVolt29 CellVolt30 CellVolt31 CellVolt32 /end REF_MEASUREMENT /end GROUP
/begin GROUP S2944_HCUCellVolt9 "VBU0513/VBUSystem/HALIn/PrivateCAN/CanMsgUnpack1/MsgRxData_Unpack78/CanRxData_Unpack/HCUCellVolt9" /begin REF_MEASUREMENT CellVolt33 CellVolt34 CellVolt35 CellVolt36 /end REF_MEASUREMENT /end GROUP
/begin GROUP S2946_HCU_Message_3_AD2 "VBU0513/VBUSystem/HALIn/PrivateCAN/CanMsgUnpack1/MsgRxData_Unpack8/CanRxData_Unpack/HCU_Message_3_AD2"
 /begin REF_MEASUREMENT HCU_Message_3_AD2_Heart HV4_Heat_Fuse__AD LINK_Relay_MN_AD Total_Volt_B /end REF_MEASUREMENT
/end GROUP
/begin GROUP S2948_HCU_Message_4_AD3 "VBU0513/VBUSystem/HALIn/PrivateCAN/CanMsgUnpack1/MsgRxData_Unpack9/CanRxData_Unpack/HCU_Message_4_AD3"
 /begin REF_MEASUREMENT HCU_Message_3_AD3_Heart HV5_MP_Pcharge_Relay__AD Hall1_AD Hall2_AD /end REF_MEASUREMENT
/end GROUP
/begin GROUP S3240_Turn_On_Delay_Time "VBU0513/VBUSystem/VCU /DCH/DCH_Overall/DCH_DCChargeCtrlOverall/DCH_BMSChgrReq/Turn_On_Delay_Time" /begin REF_MEASUREMENT DCH_flgStationCrrntLimd /end REF_MEASUREMENT /end GROUP
/begin GROUP S3240_Turn_On_Delay_Time1 "VBU0513/VBUSystem/VCU /DCH/DCH_Overall/DCH_DCChargeCtrlOverall/DCH_BMSChgrReq/Turn_On_Delay_Time1" /begin REF_MEASUREMENT DCH_flgChargingPortTempHigh /end REF_MEASUREMENT /end GROUP
/begin GROUP S3241_DCH_CtrlStateflowPostProcess "VBU0513/VBUSystem/VCU /DCH/DCH_Overall/DCH_DCChargeCtrlOverall/DCH_DCChargeCtrlStateflow/DCH_CtrlStateflowPostProcess"
 /begin REF_CHARACTERISTIC DCH_flgPosDCRlyReqOvrdVal_C DCH_flgPosDCRlyReqOvrd_C DCH_tiDCChRlyOpClsdDly_C /end REF_CHARACTERISTIC
/end GROUP
/begin GROUP S3241_DCH_InputSignalPreProcess "VBU0513/VBUSystem/VCU /DCH/DCH_Overall/DCH_DCChargeCtrlOverall/DCH_DCChargeCtrlStateflow/DCH_InputSignalPreProcess"
 /begin SUB_GROUP S3256_DCH_BMSChAvlDebounce S3256_DCH_DCRelayCloseDiagnose S3256_DCH_VehStateAnalyze /end SUB_GROUP
/end GROUP
/begin GROUP S3241_DCH_SignalPreProcessForStateflow "VBU0513/VBUSystem/VCU /DCH/DCH_Overall/DCH_DCChargeCtrlOverall/DCH_DCChargeCtrlStateflow/DCH_SignalPreProcessForStateflow"
 /begin SUB_GROUP S3257_DCH_BMSErrorDetect S3257_DCH_ChargeStopCalc S3257_DCH_ChgerZeroCurrentDiagnose S3257_DCH_ChgrAvlDiagnose S3257_DCH_OpenPDURelayValid /end SUB_GROUP
/end GROUP
/begin GROUP S3242_DCH_BmsVoltagCurrentDiagnose "VBU0513/VBUSystem/VCU /DCH/DCH_Overall/DCH_DCChargeCtrlOverall/DCH_Diagnose/DCH_BmsVoltagCurrentDiagnose"
 /begin REF_CHARACTERISTIC DCH_iDiaDCChOvrCrntDiff_C DCH_stBMSChrging_SY DCH_uDiaDCChOvrVltgDiff_C /end REF_CHARACTERISTIC
 /begin REF_MEASUREMENT DCH_flgDftDCChOvrCrnt DCH_flgDftDCChOvrVltg /end REF_MEASUREMENT
/end GROUP
/begin GROUP S3242_DCH_ChargeErrDetect "VBU0513/VBUSystem/VCU /DCH/DCH_Overall/DCH_DCChargeCtrlOverall/DCH_Diagnose/DCH_ChargeErrDetect"
 /begin REF_CHARACTERISTIC DCH_flgDCChDiagCmdOvrdVal_C DCH_flgDCChDiagCmdOvrd_C DCH_stHVCntctClosed_SY DCH_tiDiagRlyCmd_C /end REF_CHARACTERISTIC
 /begin REF_MEASUREMENT DCH_flgDCChDiagCmd DCH_flgMonDCChOvrCrnt /end REF_MEASUREMENT
/end GROUP
/begin GROUP S3242_DCH_DCRelayDiag "VBU0513/VBUSystem/VCU /DCH/DCH_Overall/DCH_DCChargeCtrlOverall/DCH_Diagnose/DCH_DCRelayDiag"
 /begin REF_CHARACTERISTIC DCH_numPDUNonRlySticky_C DCH_numPDUPosRlySticky_C DCH_numPDUStickyTolerance_C /end REF_CHARACTERISTIC
/end GROUP
/begin GROUP S3242_DCH_VehErrDetect "VBU0513/VBUSystem/VCU /DCH/DCH_Overall/DCH_DCChargeCtrlOverall/DCH_Diagnose/DCH_VehErrDetect"
 /begin REF_CHARACTERISTIC DCH_tDCChPortTempLowLim_C DCH_tReStartDCChPortTemp_C DCH_tStopForDCChPortTemp_C /end REF_CHARACTERISTIC
 /begin REF_MEASUREMENT DCH_flgDCChPortTempLimEna DCH_flgDftDCPortOvrTemp DCH_flgMonDCPortOvrTemp /end REF_MEASUREMENT
/end GROUP
/begin GROUP S3243_DCH_ChargeStopErrDiagnose "VBU0513/VBUSystem/VCU /DCH/DCH_Overall/DCH_DCChargeCtrlOverall/DCH_EepromStore/DCH_ChargeStopErrDiagnose" /begin SUB_GROUP S3300_DCH_BSTOrCSTTrigger /end SUB_GROUP /end GROUP
/begin GROUP S3243_DCH_ChargeTimeOutDiagnose "VBU0513/VBUSystem/VCU /DCH/DCH_Overall/DCH_DCChargeCtrlOverall/DCH_EepromStore/DCH_ChargeTimeOutDiagnose" /begin SUB_GROUP S3301_BEM_EEPROM /end SUB_GROUP /end GROUP
/begin GROUP S3243_DataConvertandCSTEEPROM "VBU0513/VBUSystem/VCU /DCH/DCH_Overall/DCH_DCChargeCtrlOverall/DCH_EepromStore/DataConvertandCSTEEPROM" /begin SUB_GROUP S3302_CSTTrigDly S3302_CST_EEPROM /end SUB_GROUP /end GROUP
/begin GROUP S3364_DSPL_EnergySelfLearn "VBU0513/VBUSystem/VCU /DSPL /DSPL/DriveRange/DSPL_Consumption/DSPL_EnergySelfLearn"
 /begin SUB_GROUP S3366_DSPL_EnergyComsumptionCal S3366_DSPL_EnergyFactorCal S3366_DSPL_EnergyRemainingCal /end SUB_GROUP
/end GROUP
/begin GROUP S3364_Range10kmConsumption "VBU0513/VBUSystem/VCU /DSPL /DSPL/DriveRange/DSPL_Consumption/Range10kmConsumption" /begin SUB_GROUP S3367_Comsumption S3367_DSPLRange10kmCondition /end SUB_GROUP /end GROUP
/begin GROUP S3364_Range50kmConsumption "VBU0513/VBUSystem/VCU /DSPL /DSPL/DriveRange/DSPL_Consumption/Range50kmConsumption"
 /begin SUB_GROUP S3368_DSPLRange50kmComsumptionCal S3368_DSPLRange50kmCondition /end SUB_GROUP
/end GROUP
/begin GROUP S3365_ChargeConditon "VBU0513/VBUSystem/VCU /DSPL /DSPL/DriveRange/RemainingRange/ChargeConditon"
 /begin REF_CHARACTERISTIC DSPL_iRngCalcAch_C DSPL_iRngCalcDch_C DSPL_numRngCalcAch_C DSPL_numRngCalcAch_CUR_v DSPL_numRngCalcDch_CUR_v DSPL_tiRemChrgLineDelay_C PMM_stACChMode_SY /end REF_CHARACTERISTIC
/end GROUP
/begin GROUP S3365_ChargeTemp "VBU0513/VBUSystem/VCU /DSPL /DSPL/DriveRange/RemainingRange/ChargeTemp"
 /begin REF_CHARACTERISTIC DSPL_facChargeTemp1_C DSPL_facChargeTemp2_C DSPL_facChargeTemp3_C DSPL_facChargeTemp4_C DSPL_facChargeTemp5_C /end REF_CHARACTERISTIC
/end GROUP
/begin GROUP S3365_DriveTemp "VBU0513/VBUSystem/VCU /DSPL /DSPL/DriveRange/RemainingRange/DriveTemp"
 /begin REF_CHARACTERISTIC DSPL_cntDriveTempReset_C DSPL_flgSwapModeEn_C DSPL_kmDriveTempSpeedEnThreshold_C DSPL_tDriveTempDefault_C DSPL_tiDelayTimeDriveCnt_C DSPL_tiDriveTempMoveTime_C DSPL_tiDriveTempSpeedEnThreshold_C DSPL_tiDriveTempSpeedReset_C DSPL_vDriveTempResetThreshold_C DSPL_vDriveTempSpeedEnLe_C DSPL_vDriveTempSpeedEnRi_C /end REF_CHARACTERISTIC
/end GROUP
/begin GROUP S3365_FullRangeAndSocDeclineFactor "VBU0513/VBUSystem/VCU /DSPL /DSPL/DriveRange/RemainingRange/FullRangeAndSocDeclineFactor"
 /begin SUB_GROUP S3419_FullRangeCalculation S3419_SOCDecRate S3419_SOCDeclineFactorCalculation /end SUB_GROUP
/end GROUP
/begin GROUP S3365_RangeTempSelect "VBU0513/VBUSystem/VCU /DSPL /DSPL/DriveRange/RemainingRange/RangeTempSelect" /begin REF_CHARACTERISTIC DSPL_stDCPortTempNoErr_C DSPL_tRangeTempDefault_C /end REF_CHARACTERISTIC /end GROUP
/begin GROUP S3365_SelectDisplayRange "VBU0513/VBUSystem/VCU /DSPL /DSPL/DriveRange/RemainingRange/SelectDisplayRange" /begin SUB_GROUP S3421_Charge S3421_Drive S3421_storeRange /end SUB_GROUP /end GROUP
/begin GROUP S3508_accessory_power_limit_Calculate "VBU0513/VBUSystem/VCU /EDIS/EDIS_Ctrl/BatDis_Power_Lim_Calc/Power_Arbitration/accessory_power_limit_Calculate"
 /begin REF_CHARACTERISTIC EDIS_facChrgCurrLimBaseSoc_CUR_v EDIS_flgACPowOverride_C EDIS_flgDCDCPowOverride_C EDIS_flgHVHPowOverride_C EDIS_flgPTCPowOverride_C EDIS_flgUseAcsPwrReq_C EDIS_pwrACPowOverride_C EDIS_pwrACRated_C EDIS_pwrChrgCurrntOverDelta_CUR_v EDIS_pwrDCDCPowOverride_C EDIS_pwrDcdcRated_C EDIS_pwrHVHPowOverride_C EDIS_pwrHVHRated_C EDIS_pwrPTCPowOverride_C EDIS_pwrPTCRated_C /end REF_CHARACTERISTIC
 /begin REF_MEASUREMENT EDIS_pwrAcsPwrReq /end REF_MEASUREMENT
/end GROUP
/begin GROUP S3508_drive_power_limit_calculate "VBU0513/VBUSystem/VCU /EDIS/EDIS_Ctrl/BatDis_Power_Lim_Calc/Power_Arbitration/drive_power_limit_calculate" /begin SUB_GROUP S3511_LowpassT /end SUB_GROUP
 /begin REF_CHARACTERISTIC EDIS_facUpGradPwr_MAP_v EDIS_flgNoUsePowLackUpGrad_C EDIS_kmVehOdometer_C EDIS_pctBmsSocOverrideHi1_C EDIS_pctBmsSocOverrideHi_C EDIS_pctBmsSocOverrideLo1_C EDIS_pctBmsSocOverrideLo_C EDIS_pwrDecGradBmsSocLo_C EDIS_pwrDrvPowLackHi_C EDIS_pwrDrvPowLackLo_C EDIS_tiBattPowLackDelay_C EDIS_tiDrvPwrFilter_C EDIS_tiRgnPwrFilter_C EDIS_tiSmplT_SY SYS_stShftPosNeutr_SY SYS_stShftPosPark_SY /end REF_CHARACTERISTIC
 /begin REF_MEASUREMENT EDIS_pwrDrvPwrLim /end REF_MEASUREMENT
/end GROUP
/begin GROUP S3527_BatDis_Regen_Power_PI_Filter "VBU0513/VBUSystem/VCU /EDIS/EDIS_Ctrl/battery_power_calculate/charge_power_calculate/BatDis_Regen_Power_PI_Filter"
 /begin REF_CHARACTERISTIC EDIS_facChPwrBaseDiffKp_CUR_v EDIS_facChPwrKd_CUR_v EDIS_facChPwrKi_MAP_v EDIS_flgUseDynChPwrComfort_C EDIS_pwrBattMinPwrForInvaild_C EDIS_pwrDchaDeltaMin_C EDIS_pwrDchaPIDPowrLim_C /end REF_CHARACTERISTIC
 /begin REF_MEASUREMENT EDIS_pwrBattMinPwrFnl EDIS_pwrRgn EDIS_pwrRgnDelta EDIS_pwrRgnDterm EDIS_pwrRgnIterm EDIS_pwrRgnLim EDIS_pwrRgnPterm /end REF_MEASUREMENT
/end GROUP
/begin GROUP S3527_ChPowSetPoint "VBU0513/VBUSystem/VCU /EDIS/EDIS_Ctrl/battery_power_calculate/charge_power_calculate/ChPowSetPoint" /begin SUB_GROUP S3530_fid_action S3530_setpiont /end SUB_GROUP /end GROUP
/begin GROUP S3528_DchPowSetpiont "VBU0513/VBUSystem/VCU /EDIS/EDIS_Ctrl/battery_power_calculate/discharge_power_calculate/DchPowSetpiont"
 /begin SUB_GROUP S3545_fid_action S3545_setpoint S3545_temperature_correction /end SUB_GROUP
/end GROUP
/begin GROUP S3528_discharge_pid "VBU0513/VBUSystem/VCU /EDIS/EDIS_Ctrl/battery_power_calculate/discharge_power_calculate/discharge_pid"
 /begin REF_CHARACTERISTIC EDIS_facDisChPwrBaseDiffKp_CUR_v EDIS_facDisChPwrKi_MAP_v EDIS_facStermDisChgRaw_C EDIS_pwrBattMaxPwrForInvaild_C EDIS_pwrDchaDeltaMin_C EDIS_pwrDchaItermMin_C EDIS_pwrDchaPIDPowrLim_C /end REF_CHARACTERISTIC
 /begin REF_MEASUREMENT EDIS_pwrBattMaxPwr EDIS_pwrBattMaxPwrFnl EDIS_pwrDchaDelta EDIS_pwrDisChBattPwr EDIS_pwrPIDDisChgFnl /end REF_MEASUREMENT
/end GROUP
/begin GROUP S3610_DCDC_Enable "VBU0513/VBUSystem/VCU /LVC/LVC/LowVoltageBalanceControl/LVC_DcdcStCtl/DCDC_Enable" /begin REF_CHARACTERISTIC LVC_uDCDCReq_C LVC_uDcdcHvMax_C LVC_uDcdcHvMin_C /end REF_CHARACTERISTIC /end GROUP
/begin GROUP S3610_RoutineControl "VBU0513/VBUSystem/VCU /LVC/LVC/LowVoltageBalanceControl/LVC_DcdcStCtl/RoutineControl" /begin SUB_GROUP S3620_Disenable S3620_Enable /end SUB_GROUP /end GROUP
/begin GROUP S3636_Turn_On_Delay_Time2 "VBU0513/VBUSystem/VCU /PMM/PMM_Ctrl/DrvMod_Ctrl/DVM_PEUShtDwn/Turn_On_Delay_Time2" /begin REF_MEASUREMENT PMM_flgACTstReq /end REF_MEASUREMENT /end GROUP
/begin GROUP S3647_LVWSrc "VBU0513/VBUSystem/VCU /PMM/PMM_Ctrl/LvWakeUp_Ctrl/LvWakeUp_State_Calc/LVWSrc" /begin SUB_GROUP S3650_StopNM S3650_VCUActSrc S3650_VCUWakeUp /end SUB_GROUP /end GROUP
/begin GROUP S3647_Wakeup "VBU0513/VBUSystem/VCU /PMM/PMM_Ctrl/LvWakeUp_Ctrl/LvWakeUp_State_Calc/Wakeup"
 /begin REF_CHARACTERISTIC PMM_flgVCUShtDwnOvrdSwt_C PMM_flgVCUShtDwnOvrdVal_C PMM_flgWkup1CmdOvrdSwt_C PMM_flgWkup1CmdOvrdVal_C PMM_tiDlyVCUSwtOff_C PMM_tiDlyWkup1Cmd_SY /end REF_CHARACTERISTIC
 /begin REF_MEASUREMENT PMM_flgVCUShtDwn PMM_flgWkup1Cmd /end REF_MEASUREMENT
/end GROUP
/begin GROUP S3696_CtrlSht "VBU0513/VBUSystem/VCU /PMM/PMM_Ctrl/PwrMod_Ctrl/PwrMod_PowerUp/CtrlSht" /begin REF_MEASUREMENT PMM_flgCtlSht /end REF_MEASUREMENT /end GROUP
/begin GROUP S3696_HVClReqSrc "VBU0513/VBUSystem/VCU /PMM/PMM_Ctrl/PwrMod_Ctrl/PwrMod_PowerUp/HVClReqSrc"
 /begin REF_CHARACTERISTIC PMM_pctBrkPos4HV_C PMM_stDCHInitSts_SY PMM_stDCHShtDwnSts_SY PMM_tiDlyHVRlyReqCC2_C PMM_tiDlyIgnOnHVReq_C /end REF_CHARACTERISTIC
 /begin REF_MEASUREMENT PMM_flgHVClReqSrcRising /end REF_MEASUREMENT
/end GROUP
/begin GROUP S3696_OllLoad "VBU0513/VBUSystem/VCU /PMM/PMM_Ctrl/PwrMod_Ctrl/PwrMod_PowerUp/OllLoad"
 /begin REF_CHARACTERISTIC PMM_iCtlShtDwnOffLoad_C PMM_iEmgShtDwnOffLoad_C PMM_iNrmlShtDwnOffLoad_C PMM_tiCtlShtDwnOffLoad_C PMM_tiDCHShtDwnOffLoad_C PMM_tiEmgShtDwnOffLoad_C PMM_tiNrmlShtDwnOffLoad_C /end REF_CHARACTERISTIC
/end GROUP
/begin GROUP S3696_VehStsJudgement "VBU0513/VBUSystem/VCU /PMM/PMM_Ctrl/PwrMod_Ctrl/PwrMod_PowerUp/VehStsJudgement"
 /begin REF_CHARACTERISTIC PMM_vMaxSpdShtDwn_C PMM_vMinSpdShtDwn_C SYS_stShftPosNeutr_SY SYS_stShftPosPark_SY /end REF_CHARACTERISTIC
 /begin REF_MEASUREMENT PMM_flgHVRly PMM_flgInhinPwrUp PMM_flgRutnOffReq PMM_flgVehAllwOp /end REF_MEASUREMENT
/end GROUP
/begin GROUP S3696_stateflowcondition "VBU0513/VBUSystem/VCU /PMM/PMM_Ctrl/PwrMod_Ctrl/PwrMod_PowerUp/stateflowcondition" /begin SUB_GROUP S3708_Turn_On_Delay_Time S3708_Turn_On_Delay_Time1 /end SUB_GROUP
 /begin REF_CHARACTERISTIC PMM_flgOffLoadTOutToHVOpReqSwt_C PMM_stDCDCWrking_SY PMM_tiDlyHVClReqSrcOff_C PMM_tiDlyOffLoadCnfrm_C PMM_tiInitToHVRlyClReq_C PMM_uActvDisChVltg_C /end REF_CHARACTERISTIC
 /begin REF_MEASUREMENT PMM_flgACTstToHVRlyCld PMM_flgACTstToHVRlyOpReq PMM_flgActvDisChToHVRlyClReq PMM_flgActvDisChToShtDwn PMM_flgDCDCDisblToHVRlyOpReq PMM_flgHVClReqOn PMM_flgHVRlyClReqToActvDisCh PMM_flgHVRlyClReqToHVRlyCld PMM_flgHVRlyCldToOffLoad PMM_flgHVRlyOpReqToActvDisCh PMM_flgHVRlyOpReqToHVRlyClReq PMM_flgOffLoadToHVRlyCld PMM_flgShtDwnToInit /end REF_MEASUREMENT
/end GROUP
/begin GROUP S3698_PwrUpRoutine "VBU0513/VBUSystem/VCU /PMM/PMM_Ctrl/PwrMod_Ctrl/Routine/PwrUpRoutine" /begin REF_CHARACTERISTIC DIAGS_stPsvRespAlreadyOk_SY PMM_tiDlyPwrUpNokResp_C /end REF_CHARACTERISTIC /end GROUP
/begin GROUP S3698_Routine_PwrDwn "VBU0513/VBUSystem/VCU /PMM/PMM_Ctrl/PwrMod_Ctrl/Routine/Routine_PwrDwn" /begin REF_CHARACTERISTIC DIAGS_stPsvRespAlreadyOk_SY PMM_uActvDisChVltg_C /end REF_CHARACTERISTIC /end GROUP
/begin GROUP S3698_Rouutine_RActiveDis "VBU0513/VBUSystem/VCU /PMM/PMM_Ctrl/PwrMod_Ctrl/Routine/Rouutine_RActiveDis" /begin REF_CHARACTERISTIC PMM_uActvDisChVltg_C /end REF_CHARACTERISTIC /end GROUP
/begin GROUP S3748_BenchArb "VBU0513/VBUSystem/VCU /SPD/SPD/SignalProcessing_10ms/Bench/BenchArb"
 /begin REF_CHARACTERISTIC SPD_aBenchReset_C SPD_aBenchSetHi_C SPD_aBenchSetLow_C SPD_cntBenchThd_C SPD_facAXFilter_C /end REF_CHARACTERISTIC
/end GROUP
/begin GROUP S3749_SlopeCal "VBU0513/VBUSystem/VCU /SPD/SPD/SignalProcessing_10ms/SlopeCal1/SlopeCal" /begin REF_CHARACTERISTIC SPD_pctSlope_CUR_v /end REF_CHARACTERISTIC /begin REF_MEASUREMENT SPD_pctSlope /end REF_MEASUREMENT /end GROUP
/begin GROUP S3749_VehSt "VBU0513/VBUSystem/VCU /SPD/SPD/SignalProcessing_10ms/SlopeCal1/VehSt" /begin REF_CHARACTERISTIC SPD_tiSlopeFilter_C SPD_vGoThd_C /end REF_CHARACTERISTIC /end GROUP
/begin GROUP S3750_vWhlProcess "VBU0513/VBUSystem/VCU /SPD/SPD/SignalProcessing_10ms/Subsystem1/vWhlProcess" /begin REF_MEASUREMENT SPD_numWhlSpdInvld /end REF_MEASUREMENT /end GROUP
/begin GROUP S3750_v_Axle "VBU0513/VBUSystem/VCU /SPD/SPD/SignalProcessing_10ms/Subsystem1/v_Axle" /begin SUB_GROUP S3768_Front S3768_Rear /end SUB_GROUP /end GROUP
/begin GROUP S3751_RearWhl "VBU0513/VBUSystem/VCU /SPD/SPD/SignalProcessing_10ms/VehDir/RearWhl" /begin SUB_GROUP S3771_SR_Flip_Flop /end SUB_GROUP
 /begin REF_CHARACTERISTIC SPD_nMotrDrvRvsThd_C SPD_trqRvsRst_C SPD_vVehRvsRst_C SPD_vVehRvsThd_C /end REF_CHARACTERISTIC
/end GROUP
/begin GROUP S3752_Normal_VehSpdCal "VBU0513/VBUSystem/VCU /SPD/SPD/SignalProcessing_10ms/VehSpdNorm/Normal_VehSpdCal" /begin SUB_GROUP S3773_First_Order_Low_Pass_Filter /end SUB_GROUP
 /begin REF_CHARACTERISTIC SPD_facSpdFlt_C SPD_flgUseMotorSpeed_C SPD_vVehOvrdFlg_C SPD_vVehOvrdVal_C /end REF_CHARACTERISTIC
 /begin REF_MEASUREMENT SPD_flgVehSpdVld /end REF_MEASUREMENT
/end GROUP
/begin GROUP S3752_nMotr2vVeh "VBU0513/VBUSystem/VCU /SPD/SPD/SignalProcessing_10ms/VehSpdNorm/nMotr2vVeh" /begin REF_CHARACTERISTIC SPD_tiSample10ms_SY SPD_tiSpdFil_C /end REF_CHARACTERISTIC /begin REF_MEASUREMENT SPD_vMotrSpd /end REF_MEASUREMENT /end GROUP
/begin GROUP S3808_Cool "VBU0513/VBUSystem/VCU /THM/THM/ThermalMode/OperateCycle/Cool"
 /begin REF_CHARACTERISTIC THM_tActvCoolEnaDeltaTemp_C THM_tPsvCoolEnaDeltaTemp_C THM_tPsvCoolLckDeltaTemp_C /end REF_CHARACTERISTIC
/end GROUP
/begin GROUP S3808_Heat "VBU0513/VBUSystem/VCU /THM/THM/ThermalMode/OperateCycle/Heat"
 /begin REF_CHARACTERISTIC THM_tActvHeatEnaDeltaTemp_C THM_tPsvHeatEnaDeltaTemp_C THM_tPsvHeatLckDeltaTemp_C /end REF_CHARACTERISTIC
/end GROUP
/begin GROUP S3879_BrakeCrpModify "VBU0513/VBUSystem/VCU /TQD/TrqDem/TrqDem_DrvTrq_Cal/TrqDem_MinTrq_Cal/BrakeCrpModify"
 /begin REF_CHARACTERISTIC TQD_flgBrkPresUsed_C TQD_pctCrpCtrlBrkPctS_CUR_v TQD_pctCrpCtrlBrkPct_MAP_v TQD_pctCrpCtrlBrkPresS_CUR_v TQD_pctCrpCtrlBrkPres_MAP_v /end REF_CHARACTERISTIC
 /begin REF_MEASUREMENT TQD_facBrkCrpPct TQD_facBrkPosCrpMod TQD_facBrkPresCrpMod /end REF_MEASUREMENT
/end GROUP
/begin GROUP S3879_CrpEnaArb "VBU0513/VBUSystem/VCU /TQD/TrqDem/TrqDem_DrvTrq_Cal/TrqDem_MinTrq_Cal/CrpEnaArb" /begin REF_CHARACTERISTIC EPB_stClosed TQD_flgCreepFnctnEna_C /end REF_CHARACTERISTIC /begin REF_MEASUREMENT TQD_flgCrpEna /end REF_MEASUREMENT /end GROUP
/begin GROUP S3879_CrpRgnTrqArb "VBU0513/VBUSystem/VCU /TQD/TrqDem/TrqDem_DrvTrq_Cal/TrqDem_MinTrq_Cal/CrpRgnTrqArb" /begin REF_CHARACTERISTIC TQD_flgSlpEna_C TQD_trqCrpCtrlSlp_MAP_v /end REF_CHARACTERISTIC /begin REF_MEASUREMENT TQD_flgHillHld TQD_trqCor TQD_trqCrpMode /end REF_MEASUREMENT /end GROUP
/begin GROUP S3879_CrpRgnTrqCal "VBU0513/VBUSystem/VCU /TQD/TrqDem/TrqDem_DrvTrq_Cal/TrqDem_MinTrq_Cal/CrpRgnTrqCal"
 /begin REF_CHARACTERISTIC TQD_trqCrpCstModeA_CUR_v TQD_trqCrpCstModeB_CUR_v TQD_trqCrpCstModeC_CUR_v TQD_trqCrpCstModeD_CUR_v /end REF_CHARACTERISTIC
 /begin REF_MEASUREMENT TQD_trqCrpCst /end REF_MEASUREMENT
/end GROUP
/begin GROUP S3879_CrpRgnTrqLim "VBU0513/VBUSystem/VCU /TQD/TrqDem/TrqDem_DrvTrq_Cal/TrqDem_MinTrq_Cal/CrpRgnTrqLim"
 /begin REF_CHARACTERISTIC TQD_flgTrqMinEn_C TQD_trqModeChngDecGrad_C TQD_trqModeChngIncGrad_C TQD_trqNrmDecGrad_C TQD_trqNrmIncGrad_C TQD_trqRateLimThres_C /end REF_CHARACTERISTIC
/end GROUP
/begin GROUP S3891_First_Order_Low_Pass_Filter "VBU0513/VBUSystem/VCU /TQD/TrqDem/TrqDem_InputTransfer/BrakePressureFilter/First_Order_Low_Pass_Filter" /begin REF_MEASUREMENT TQD_pBrkPressFlt /end REF_MEASUREMENT /end GROUP
/begin GROUP S3894_DejitterFIL "VBU0513/VBUSystem/VCU /TQD/TrqDem/TrqDem_InputTransfer/TrqDem_VehSpeed_Filter/DejitterFIL" /begin REF_MEASUREMENT TQD_vVehSpd /end REF_MEASUREMENT /end GROUP
/begin GROUP S3894_SR_Flip_Flop "VBU0513/VBUSystem/VCU /TQD/TrqDem/TrqDem_InputTransfer/TrqDem_VehSpeed_Filter/SR_Flip_Flop" /begin REF_MEASUREMENT TQD_flgVehSlide /end REF_MEASUREMENT /end GROUP
/begin GROUP S3909_ABSRgnCancel "VBU0513/VBUSystem/VCU /TQO/TQOAll/STC/STC/ABSRgnCancel" /begin REF_CHARACTERISTIC STC_trqABSDecLimit /end REF_CHARACTERISTIC /end GROUP
/begin GROUP S3909_DisableRgnTorque "VBU0513/VBUSystem/VCU /TQO/TQOAll/STC/STC/DisableRgnTorque" /begin REF_CHARACTERISTIC STC_flgRgnTrqCnclRA_C /end REF_CHARACTERISTIC /begin REF_MEASUREMENT STC_trqRgnLimit /end REF_MEASUREMENT /end GROUP
/begin GROUP S3913_Limitation "VBU0513/VBUSystem/VCU /TQO/TQOAll/TQARB/TQARB/Limitation"
 /begin REF_MEASUREMENT TQARB_trqArbRA TQARB_trqArbRA2 TQARB_trqBattRAMax TQARB_trqBattRAMin /end REF_MEASUREMENT
/end GROUP
/begin GROUP S3913_TrqArb "VBU0513/VBUSystem/VCU /TQO/TQOAll/TQARB/TQARB/TrqArb" /begin SUB_GROUP S3915_SignalProcess /end SUB_GROUP /begin REF_MEASUREMENT TQARB_TrqRgnRA /end REF_MEASUREMENT /end GROUP
/begin GROUP S3919_TrqPulse "VBU0513/VBUSystem/VCU /TQO/TQOAll/TQCMP/TQCMP/TrqPulse" /begin SUB_GROUP S3920_PulseTime S3920_PulseTrig S3920_PulseTrq /end SUB_GROUP /end GROUP
/begin GROUP S3927_AxleArb "VBU0513/VBUSystem/VCU /TQO/TQOAll/TQDIS/TQDIS/AxleArb" /begin REF_MEASUREMENT TQDIS_AxleArbK /end REF_MEASUREMENT /end GROUP
/begin GROUP S3927_Dmp "VBU0513/VBUSystem/VCU /TQO/TQOAll/TQDIS/TQDIS/Dmp" /begin SUB_GROUP S3929_DmpFilter /end SUB_GROUP /end GROUP
/begin GROUP S3927_TrqFilter "VBU0513/VBUSystem/VCU /TQO/TQOAll/TQDIS/TQDIS/TrqFilter" /begin SUB_GROUP S3930_Arb S3930_DrvLim S3930_Subsystem /end SUB_GROUP /end GROUP
/begin GROUP S3927_TrqLim "VBU0513/VBUSystem/VCU /TQO/TQOAll/TQDIS/TQDIS/TrqLim" /begin REF_CHARACTERISTIC SYS_facGearRatioR_SY /end REF_CHARACTERISTIC /begin REF_MEASUREMENT TQDIS_trqRALim TQDIS_trqRAPropLim TQDIS_trqRARgnLim /end REF_MEASUREMENT /end GROUP
/begin GROUP S3963_CMB "VBU0513/VBUSystem/VCU /TQO/TQOAll/TQDMP/TQDMP/CMB" /begin REF_CHARACTERISTIC SYS_facGearRatioR_SY /end REF_CHARACTERISTIC /begin REF_MEASUREMENT TQDMP_trqCompRA /end REF_MEASUREMENT /end GROUP
/begin GROUP S3963_Dibl "VBU0513/VBUSystem/VCU /TQO/TQOAll/TQDMP/TQDMP/Dibl"
 /begin REF_CHARACTERISTIC TQDMP_flgROTCDisblORF TQDMP_flgROTCDisblORV TQDMP_vVehEnaMax_C TQDMP_vVehEnaMin_C /end REF_CHARACTERISTIC
/end GROUP
/begin GROUP S3963_RAROTC "VBU0513/VBUSystem/VCU /TQO/TQOAll/TQDMP/TQDMP/RAROTC"
 /begin SUB_GROUP S3966_CalcSpdHiFre S3966_Foreback S3966_ROTCArbRA S3966_ROTCConidtion S3966_TorqueCal /end SUB_GROUP
/end GROUP
/begin GROUP S4006_MotorTorque "VBU0513/VBUSystem/VCU /TQO/TQOAll/TQO/TQO/MotorTorque" /begin SUB_GROUP S4007_ShftChange S4007_Subsystem /end SUB_GROUP /begin REF_CHARACTERISTIC TQO_pctSlopeShft_C TQO_tiShftDR_C TQO_tiShftOut_C /end REF_CHARACTERISTIC /begin REF_MEASUREMENT TQO_facFilter TQO_stShft /end REF_MEASUREMENT /end GROUP
/begin GROUP S4006_Subsystem "VBU0513/VBUSystem/VCU /TQO/TQOAll/TQO/TQO/Subsystem" /begin SUB_GROUP S4008_VirtualAPD /end SUB_GROUP /end GROUP
/begin GROUP S4006_Trq "VBU0513/VBUSystem/VCU /TQO/TQOAll/TQO/TQO/Trq" /begin SUB_GROUP S4009_TrqProtect /end SUB_GROUP /end GROUP
/begin GROUP S4024_FIDTrqLim "VBU0513/VBUSystem/VCU /VTQA/Subsystem/MTrqLim/TrqCapacityLim/FIDTrqLim" /begin REF_CHARACTERISTIC MTQL_trqPEURFidByTempLim_C MTQL_trqPEURFidLim_C /end REF_CHARACTERISTIC /begin REF_MEASUREMENT MTQL_trqRMotrFIDDrvLim /end REF_MEASUREMENT /end GROUP
/begin GROUP S4024_Motor_Inhibit "VBU0513/VBUSystem/VCU /VTQA/Subsystem/MTrqLim/TrqCapacityLim/Motor_Inhibit" /begin REF_CHARACTERISTIC SYS_stMCUErr_SY /end REF_CHARACTERISTIC /begin REF_MEASUREMENT MTQL_flgRMotrInhbt /end REF_MEASUREMENT /end GROUP
/begin GROUP S4024_VehicleSpeedLim "VBU0513/VBUSystem/VCU /VTQA/Subsystem/MTrqLim/TrqCapacityLim/VehicleSpeedLim" /begin SUB_GROUP S4032_IF_Then_Else1 /end SUB_GROUP /begin REF_CHARACTERISTIC MTQL_trqVehSpdLimNormRMot_MAP_v /end REF_CHARACTERISTIC /end GROUP
/begin GROUP S4024_dnLim "VBU0513/VBUSystem/VCU /VTQA/Subsystem/MTrqLim/TrqCapacityLim/dnLim" /begin REF_CHARACTERISTIC MTQL_trqWhlRLim_CUR_v /end REF_CHARACTERISTIC /begin REF_MEASUREMENT MTQL_trqDnAbsLimR /end REF_MEASUREMENT /end GROUP
/begin GROUP S4035_AxleTrq_Limit_Calc "VBU0513/VBUSystem/VCU /VTQA/Subsystem/VehTrqArb/BattLim_Transfer/AxleTrq_Limit_Calc"
 /begin REF_CHARACTERISTIC VTQA_facActDrvPwrFltr_C VTQA_facActRgnPwrFltr_C VTQA_facMotorAvgFltr_C VTQA_facMtrDrvPwrUpLim_MAP_v VTQA_flgActDrvTrqLimORF VTQA_flgActRgnTrqLimORF VTQA_trqActDrvLoLim_C VTQA_trqActDrvTrqLimORV VTQA_trqActDrvUpLim_C VTQA_trqActRgnLoLim_C VTQA_trqActRgnTrqLimORV VTQA_trqActRgnUpLim_C /end REF_CHARACTERISTIC
 /begin REF_MEASUREMENT VTQA_trqActDrvTrqLim VTQA_trqActRgnTrqLim /end REF_MEASUREMENT
/end GROUP
/begin GROUP S4035_Motor_PwrLoss_Calc "VBU0513/VBUSystem/VCU /VTQA/Subsystem/VehTrqArb/BattLim_Transfer/Motor_PwrLoss_Calc"
 /begin REF_CHARACTERISTIC VTQA_facVehSpd2MotSpd_C VTQA_pwrRMtrDrvPwrLoss_MAP_v VTQA_pwrRMtrRgnPwrLoss_MAP_v /end REF_CHARACTERISTIC
 /begin REF_MEASUREMENT VTQA_pwrRMotActDrvLoss VTQA_pwrRMotActRgnLoss VTQA_trqRMotrNeg VTQA_trqRMotrPos /end REF_MEASUREMENT
/end GROUP
/begin GROUP S4036_AlxeMax "VBU0513/VBUSystem/VCU /VTQA/Subsystem/VehTrqArb/Trq_Arb/AlxeMax"
 /begin REF_CHARACTERISTIC EPB_CompleteTight EPB_stApplying SYS_facGearRatioR_SY VTQA_flgAxleMaxORF VTQA_trqAxleMaxLimit_C VTQA_trqAxleMaxORV VTQA_trqAxleMax_CUR_v VTQA_trqBrkSwtTrqLim_C VTQA_trqBrk_MAP_v VTQA_trqLimpModeByPmpMax_CUR_v VTQA_trqLimpModeMax_CUR_v /end REF_CHARACTERISTIC
 /begin REF_MEASUREMENT VTQA_trqAxleMax VTQA_trqBattTrqMax VTQA_trqBcuTrqMax VTQA_trqBrkTrqMax VTQA_trqLimpByPmpTrqMax VTQA_trqLimpTrqMax VTQA_trqMotTrqMax /end REF_MEASUREMENT
/end GROUP
/begin GROUP S4036_AlxeMin "VBU0513/VBUSystem/VCU /VTQA/Subsystem/VehTrqArb/Trq_Arb/AlxeMin"
 /begin REF_CHARACTERISTIC SYS_facGearRatioR_SY VTQA_flgAxleMinORF VTQA_trqABSFailMin_C VTQA_trqAxleMinORV VTQA_trqAxleMin_C VTQA_trqLimphomeMin_C /end REF_CHARACTERISTIC
 /begin REF_MEASUREMENT VTQA_trqABSFailLimit VTQA_trqActvLimpLimit VTQA_trqAxleMin VTQA_trqBattTrqMin VTQA_trqInhibRegenLimit VTQA_trqMotTrqMin /end REF_MEASUREMENT
/end GROUP
/begin GROUP S4036_Arb "VBU0513/VBUSystem/VCU /VTQA/Subsystem/VehTrqArb/Trq_Arb/Arb" /begin REF_MEASUREMENT VTQA_trqDes /end REF_MEASUREMENT /end GROUP
/begin GROUP S4064_APD1_Norm "VBU0513/VBUSystem/VCU /VehINP/VehINP_Logic/APD/APD/APD1_Norm" /begin REF_CHARACTERISTIC APD_uSetPoint1Max_C APD_uSetPoint1Min_C /end REF_CHARACTERISTIC /end GROUP
/begin GROUP S4064_APD2_Norm "VBU0513/VBUSystem/VCU /VehINP/VehINP_Logic/APD/APD/APD2_Norm" /begin REF_CHARACTERISTIC APD_uSetPoint2Max_C APD_uSetPoint2Min_C /end REF_CHARACTERISTIC /end GROUP
/begin GROUP S4064_APD_Dejitter1 "VBU0513/VBUSystem/VCU /VehINP/VehINP_Logic/APD/APD/APD_Dejitter1" /begin REF_CHARACTERISTIC APD_uJitterFil1_C APD_uSetPoint1Min_C /end REF_CHARACTERISTIC /end GROUP
/begin GROUP S4064_APD_Dejitter2 "VBU0513/VBUSystem/VCU /VehINP/VehINP_Logic/APD/APD/APD_Dejitter2" /begin REF_CHARACTERISTIC APD_uJitterFil2_C APD_uSetPoint2Min_C /end REF_CHARACTERISTIC /end GROUP
/begin GROUP S4064_APD_Override "VBU0513/VBUSystem/VCU /VehINP/VehINP_Logic/APD/APD/APD_Override"
 /begin REF_CHARACTERISTIC APD_efAccPedPos_C APD_flgAccPedPosPctVld_C APD_pctAccPedPosLimit_C APD_pctAccPedPosOverrideVal_C APD_pctAccPedPosOverride_C /end REF_CHARACTERISTIC
 /begin REF_MEASUREMENT APD_pctAccPedPos /end REF_MEASUREMENT
/end GROUP
/begin GROUP S4064_Diag_Ratio "VBU0513/VBUSystem/VCU /VehINP/VehINP_Logic/APD/APD/Diag_Ratio"
 /begin REF_CHARACTERISTIC APD_numPlausibilityDec_C APD_numPlausibilityInc_C APD_numPlausibilityLim_C APD_stNoErr_C APD_uThdDiff12_CUR_v /end REF_CHARACTERISTIC
 /begin REF_MEASUREMENT APD_flgDftRatioPlausibility /end REF_MEASUREMENT
/end GROUP
/begin GROUP S4064_Diag_Status "VBU0513/VBUSystem/VCU /VehINP/VehINP_Logic/APD/APD/Diag_Status" /begin REF_CHARACTERISTIC APD_stConfirmErr_C /end REF_CHARACTERISTIC /end GROUP
/begin GROUP S4064_Value_Selection "VBU0513/VBUSystem/VCU /VehINP/VehINP_Logic/APD/APD/Value_Selection"
 /begin SUB_GROUP S4072_BrakeStickyCheck S4072_FullPedal S4072_PedalPercentSelection S4072_PedalSelection /end SUB_GROUP
/end GROUP
/begin GROUP S4096_Veh_DCPortTempPlausibility "VBU0513/VBUSystem/VCU /VehINP/VehINP_Logic/DCPortTemp/Charge_Port_Temp/Veh_DCPortTempPlausibility"
 /begin REF_CHARACTERISTIC Veh_stDCPortTempNoErr_C Veh_tDCPortTempPlausibility_CUR_v Veh_tiDCPortPlausibilityConfirm_C /end REF_CHARACTERISTIC
/end GROUP
/begin GROUP S4096_Veh_DCPortTempStatus "VBU0513/VBUSystem/VCU /VehINP/VehINP_Logic/DCPortTemp/Charge_Port_Temp/Veh_DCPortTempStatus"
 /begin REF_CHARACTERISTIC Veh_stDCPortTempErr_C Veh_stDCPortTempNoErr_C Veh_tDCPortNegativeTempCheckEn_C /end REF_CHARACTERISTIC
/end GROUP
/begin GROUP S4105_Digital_Gear_D_R "VBU0513/VBUSystem/VCU /VehINP/VehINP_Logic/GearShift/Gear1/Digital_Gear_D_R"
 /begin SUB_GROUP S4106_Gear4DriveIntend S4106_Gear_Bit S4106_Gear_DR_Req S4106_Gear_DR_Warning S4106_Gear_RawReq S4106_Gear_Warning /end SUB_GROUP
/end GROUP
/begin GROUP S4105_Gear4DriveIntend "VBU0513/VBUSystem/VCU /VehINP/VehINP_Logic/GearShift/Gear1/Gear4DriveIntend" /begin REF_CHARACTERISTIC Gear_flgDriveIntendGearVld_C /end REF_CHARACTERISTIC /end GROUP
/begin GROUP S4105_Gear_BrakeCondition "VBU0513/VBUSystem/VCU /VehINP/VehINP_Logic/GearShift/Gear1/Gear_BrakeCondition" /begin REF_CHARACTERISTIC Gear_flgBrkPressConfig_C Gear_pctBrkPosPressed_C /end REF_CHARACTERISTIC /begin REF_MEASUREMENT Gear_flgBrkPrssed /end REF_MEASUREMENT /end GROUP
/begin GROUP S4105_Gear_DriverShiftPReq "VBU0513/VBUSystem/VCU /VehINP/VehINP_Logic/GearShift/Gear1/Gear_DriverShiftPReq"
 /begin REF_CHARACTERISTIC Gear_stEPBApplyReq_C Gear_stEPBNoApplyReq_C Gear_stIntendGearP_C /end REF_CHARACTERISTIC
/end GROUP
/begin GROUP S4105_Gear_EPBStatus "VBU0513/VBUSystem/VCU /VehINP/VehINP_Logic/GearShift/Gear1/Gear_EPBStatus"
 /begin REF_CHARACTERISTIC Gear_stEPBApplied_C Gear_stEPBFailNoErr_C Gear_stEPBReleased_C Gear_stEPBUnknow_C Veh_flgNetworkPartialEn_C Veh_stCGWNetworkPartial_C /end REF_CHARACTERISTIC
/end GROUP
/begin GROUP S4105_Gear_ExternalReq "VBU0513/VBUSystem/VCU /VehINP/VehINP_Logic/GearShift/Gear1/Gear_ExternalReq" /begin REF_CHARACTERISTIC Gear_tiGearDebounceCnt_C Gear_tiSampleTime_C /end REF_CHARACTERISTIC /end GROUP
/begin GROUP S4105_Gear_P "VBU0513/VBUSystem/VCU /VehINP/VehINP_Logic/GearShift/Gear1/Gear_P"
 /begin REF_CHARACTERISTIC Gear_stBCUEPBSwtPressed_C Gear_tiGearPSwitchDebounceCnt_C Gear_tiSampleTime_C /end REF_CHARACTERISTIC
/end GROUP
/begin GROUP S4105_Gear_ProtectCondition "VBU0513/VBUSystem/VCU /VehINP/VehINP_Logic/GearShift/Gear1/Gear_ProtectCondition"
 /begin REF_CHARACTERISTIC Gear_flgEmotTqSelect_C Gear_flgTorqueProtectEn_C Gear_stCurrentGearD_C Gear_stCurrentGearR_C Gear_tiSampleTime_C Gear_tiShiftEnableCnt_C Gear_trqShiftDriveEnableLe_C Gear_trqShiftDriveEnableRi_C /end REF_CHARACTERISTIC
/end GROUP
/begin GROUP S4105_Gear_Status "VBU0513/VBUSystem/VCU /VehINP/VehINP_Logic/GearShift/Gear1/Gear_Status"
 /begin SUB_GROUP S4114_Gear4Reset S4114_Gear_CurrentValid S4114_Gear_DGear S4114_Gear_DefaultGear S4114_Gear_DriverShiftDReq S4114_Gear_DriverShiftRReq S4114_Gear_DriverShiftTowReq S4114_Gear_GearReq S4114_Gear_InitGear S4114_Gear_PGear S4114_Gear_PGear1 S4114_Gear_Powertrain S4114_Gear_RGear S4114_Warning /end SUB_GROUP
/end GROUP
/begin GROUP S4105_Gear_VehSpeed "VBU0513/VBUSystem/VCU /VehINP/VehINP_Logic/GearShift/Gear1/Gear_VehSpeed"
 /begin REF_CHARACTERISTIC Gear_vForce2NThreshold_C Gear_vGearDLowThreshold_C Gear_vGearDMiThreshold_C Gear_vGearPThreshold_C Gear_vTowThreshold_C /end REF_CHARACTERISTIC
/end GROUP
/begin GROUP S4105_Gear_VehicleStatus "VBU0513/VBUSystem/VCU /VehINP/VehINP_Logic/GearShift/Gear1/Gear_VehicleStatus" /begin REF_CHARACTERISTIC Gear_stHVRelayClosed_C Gear_stVehModeDCH_C /end REF_CHARACTERISTIC /begin REF_MEASUREMENT Gear_flgGearShiftReady /end REF_MEASUREMENT /end GROUP
/begin GROUP S4222_Veh_AccrMode "VBU0513/VBUSystem/VCU /VehINP/VehINP_Logic/Mode/VehMode/Veh_AccrMode"
 /begin REF_CHARACTERISTIC CDC_stVehAccr2Mod_C CDC_stVehAccrNormalMod_C CDC_stVehAccrSportMod_C CGW_flgVehAccrModeCaliOvrd_C CGW_stVehAccr2Mod_C CGW_stVehAccrModeCaliOvrdVal_C CGW_stVehAccrNormalMod_C CGW_stVehAccrSportMod_C Veh_tiModeDebTime_C Veh_tiModeSampleTime_C /end REF_CHARACTERISTIC
/end GROUP
/begin GROUP S4222_Veh_CreepMode "VBU0513/VBUSystem/VCU /VehINP/VehINP_Logic/Mode/VehMode/Veh_CreepMode" /begin SUB_GROUP S4224_override_signal1 /end SUB_GROUP
 /begin REF_CHARACTERISTIC CDC_stVehCreepON_C CDC_stVehCreepOff_C CGW_flgVehCreepModeCaliOvrd_C CGW_stVehCreepModeCaliOvrdVal_C CGW_stVehCreepOff_C CGW_stVehCreepOn_C Veh_tiModeDebTime_C Veh_tiModeSampleTime_C /end REF_CHARACTERISTIC
/end GROUP
/begin GROUP S4222_Veh_DrvMode "VBU0513/VBUSystem/VCU /VehINP/VehINP_Logic/Mode/VehMode/Veh_DrvMode"
 /begin REF_CHARACTERISTIC CDC_stVehAccrNormalMod_C CDC_stVehAccrSportMod_C CDC_stVehAutoMod_C CDC_stVehECOMod_C CGW_flgVehDrvModeCaliOvrd_C CGW_stVehDrvModeCaliOvrdVal_C CGW_stVehECOMod_C CGW_stVehNormalMod_C CGW_stVehSportMod_C Veh_tiModeDebTime_C Veh_tiModeSampleTime_C /end REF_CHARACTERISTIC
/end GROUP
/begin GROUP S4222_Veh_RgnMode "VBU0513/VBUSystem/VCU /VehINP/VehINP_Logic/Mode/VehMode/Veh_RgnMode"
 /begin REF_CHARACTERISTIC CDC_stVehCreepOffRgnOff_C CDC_stVehCreepOnRgnLow_C CDC_stVehCreepOnRgnNormal_C CDC_stVehCreepOnRgnZero_C CGW_flgVehRgnModeCaliOvrd_C CGW_stVehRgnLow_C CGW_stVehRgnModeCaliOvrdVal_C CGW_stVehRgnNormal_C CGW_stVehRgnOff_C CGW_stVehRgnZero_C Veh_tiModeDebTime_C Veh_tiModeSampleTime_C /end REF_CHARACTERISTIC
/end GROUP
/begin GROUP S4265_BPD_BrakePercentStatus "VBU0513/VBUSystem/VCU /VehINP/VehINP_Logic/VehINP_BPD/BPD_BrakePercent/BPD_BrakePercentStatus"
 /begin REF_CHARACTERISTIC BPD_pctBrkPedalDownStep_C BPD_pctBrkPedalPressedZero_C BPD_pctBrkPedalPressed_C /end REF_CHARACTERISTIC
 /begin REF_MEASUREMENT BPD_pctBrkPressPercent /end REF_MEASUREMENT
/end GROUP
/begin GROUP S4265_BPD_PressBrake "VBU0513/VBUSystem/VCU /VehINP/VehINP_Logic/VehINP_BPD/BPD_BrakePercent/BPD_PressBrake" /begin SUB_GROUP S4270_First_Order_Low_Pass_Filter /end SUB_GROUP
 /begin REF_CHARACTERISTIC BCU_pBrkPres BPD_facBrkPresVoltFilt_C BPD_pctBrkPress_CUR_v /end REF_CHARACTERISTIC
 /begin REF_MEASUREMENT BPD_pBrkPress BPD_pctBrkPress /end REF_MEASUREMENT
/end GROUP
/begin GROUP S4266_BPD_BrakeSwitchHW "VBU0513/VBUSystem/VCU /VehINP/VehINP_Logic/VehINP_BPD/BPD_BrakeSwitch/BPD_BrakeSwitchHW" /begin REF_CHARACTERISTIC BPD_numHWBrkSwtDebounce_C /end REF_CHARACTERISTIC /end GROUP
/begin GROUP S4266_BPD_BrakeSwitchSelect "VBU0513/VBUSystem/VCU /VehINP/VehINP_Logic/VehINP_BPD/BPD_BrakeSwitch/BPD_BrakeSwitchSelect"
 /begin REF_CHARACTERISTIC BPD_stBrkPedPrsActv_C BPD_stBrkPedPrsPsbl_C BPD_stBrkSwtConfig_C /end REF_CHARACTERISTIC
 /begin REF_MEASUREMENT BPD_flgMainBrkSwt BPD_stBrkPedSwtRaw /end REF_MEASUREMENT
/end GROUP
/begin GROUP S4267_DiagBrkPosDft "VBU0513/VBUSystem/VCU /VehINP/VehINP_Logic/VehINP_BPD/BPD_BrkSwtPosPlausibilityCheck/DiagBrkPosDft"
 /begin REF_CHARACTERISTIC BPD_pctBrkPressDiag_C BPD_pctBrkReleaseDiag_C BPD_stBrkPedPrsActv_C BPD_tiDftBrkPosSwtPress_C BPD_tiDftBrkPosSwtRelease_C BPD_tiSampleTime_C /end REF_CHARACTERISTIC
/end GROUP
/begin GROUP S4268_override_signal1 "VBU0513/VBUSystem/VCU /VehINP/VehINP_Logic/VehINP_BPD/VehINP_BrkPedOverride/override_signal1" /begin REF_MEASUREMENT BPD_pctBrkPos /end REF_MEASUREMENT /end GROUP
/begin GROUP S4268_override_signal4 "VBU0513/VBUSystem/VCU /VehINP/VehINP_Logic/VehINP_BPD/VehINP_BrkPedOverride/override_signal4" /begin REF_MEASUREMENT BPD_stBrkSwt /end REF_MEASUREMENT /end GROUP
/begin GROUP S4285_HVIL "VBU0513/VBUSystem/VCU /VehINP/VehINP_Logic/Veh_Status/VehHVIL/HVIL" /begin SUB_GROUP S4286_Veh_HVILCheck S4286_Veh_VCUHVIL /end SUB_GROUP /end GROUP
/begin GROUP S54_Calculate_BatteryCurrent_ZeroDrift "VBU0513/VBUSystem/BMS/BCV/BCV/Subsystem/Calculate_BatteryCurrent/Correct_BatteryCurrent/Calculate_BatteryCurrent_ZeroDrift" /begin SUB_GROUP S56_Calculate_Current_ZeroDruft S56_Calculate_ExtremeData /end SUB_GROUP /end GROUP
/begin GROUP S54_Delay_RisingEdge "VBU0513/VBUSystem/BMS/BCV/BCV/Subsystem/Calculate_BatteryCurrent/Correct_BatteryCurrent/Delay_RisingEdge" /begin REF_MEASUREMENT BCV_flgBatteryCurrentValid /end REF_MEASUREMENT /end GROUP
/begin GROUP S68_Delay_FallingEdge "VBU0513/VBUSystem/BMS/BCV/BCV/Subsystem/Calculate_BatteryVoltage/Check_BatteryVoltage_Valid/Delay_FallingEdge" /begin REF_MEASUREMENT BCV_flgBatteryVoltageValid /end REF_MEASUREMENT /end GROUP
/begin GROUP S69_Delay_FallingEdge "VBU0513/VBUSystem/BMS/BCV/BCV/Subsystem/Calculate_BatteryVoltage/Check_BusNegativeVoltage_Valid/Delay_FallingEdge" /begin REF_MEASUREMENT BCV_flgBusNegativeVoltageValid /end REF_MEASUREMENT /end GROUP
/begin GROUP S70_Delay_FallingEdge "VBU0513/VBUSystem/BMS/BCV/BCV/Subsystem/Calculate_BatteryVoltage/Check_BusVoltage_Valid/Delay_FallingEdge" /begin REF_MEASUREMENT BCV_flgBusVoltageValid /end REF_MEASUREMENT /end GROUP
/begin GROUP S71_Delay_FallingEdge "VBU0513/VBUSystem/BMS/BCV/BCV/Subsystem/Calculate_BatteryVoltage/Check_FuseVoltage_Valid/Delay_FallingEdge" /begin REF_MEASUREMENT BCV_flgFuseVoltageValid /end REF_MEASUREMENT /end GROUP
/begin GROUP S72_Delay_FallingEdge "VBU0513/VBUSystem/BMS/BCV/BCV/Subsystem/Calculate_BatteryVoltage/Check_PrechargeVoltage_Valid/Delay_FallingEdge" /begin REF_MEASUREMENT BCV_flgPrechargeVoltageValid /end REF_MEASUREMENT /end GROUP
/begin GROUP S73_Delay_FallingEdge "VBU0513/VBUSystem/BMS/BCV/BCV/Subsystem/Calculate_BatteryVoltage/Check_Vx1Voltage_Valid/Delay_FallingEdge" /begin REF_MEASUREMENT BCV_flgVx1VoltageValid /end REF_MEASUREMENT /end GROUP
/begin GROUP S74_Delay_FallingEdge "VBU0513/VBUSystem/BMS/BCV/BCV/Subsystem/Calculate_BatteryVoltage/Check_Vx2Voltage_Valid/Delay_FallingEdge" /begin REF_MEASUREMENT BCV_flgVx2VoltageValid /end REF_MEASUREMENT /end GROUP
/begin GROUP S107_Accumulate_Carry "VBU0513/VBUSystem/BMS/BCV/BCV/Subsystem/Calculate_Lifetime_Data/Calculate_LifeTimeFastcharge/Accumulate_Carry" /begin REF_MEASUREMENT BCV_AhOverallCoulombFCCChgCarry /end REF_MEASUREMENT /end GROUP
/begin GROUP S136_EVM_FDC_Handler "VBU0513/VBUSystem/BMS/BCV/BCV/Subsystem/Diagnose_BCV_Data_Fault/Diagnose_VoltageCurrent_Fault/EVM_FDC_Handler" /begin SUB_GROUP S143_DetermineFault S143_DetermineFaultCounter /end SUB_GROUP /end GROUP
/begin GROUP S136_EVM_FDC_Handler1 "VBU0513/VBUSystem/BMS/BCV/BCV/Subsystem/Diagnose_BCV_Data_Fault/Diagnose_VoltageCurrent_Fault/EVM_FDC_Handler1" /begin SUB_GROUP S144_DetermineFault S144_DetermineFaultCounter /end SUB_GROUP /end GROUP
/begin GROUP S136_EVM_FDC_Handler2 "VBU0513/VBUSystem/BMS/BCV/BCV/Subsystem/Diagnose_BCV_Data_Fault/Diagnose_VoltageCurrent_Fault/EVM_FDC_Handler2" /begin SUB_GROUP S145_DetermineFault S145_DetermineFaultCounter /end SUB_GROUP /end GROUP
/begin GROUP S186_Diagnose_BdmOutOfRange_Fault "VBU0513/VBUSystem/BMS/BCV/BCV/Subsystem/Monitor_BCV_Performance/Diagnose_BDM_BCV_Communication_Fault/Diagnose_BdmOutOfRange_Fault" /begin SUB_GROUP S192_BigDataMonitor_Handler S192_BigDataMonitor_Handler1 /end SUB_GROUP
 /begin REF_CHARACTERISTIC CbBCV_BdmBatteryCurrentOoR_flg CbBCV_BdmBatteryVoltageOoR_flg CcBCV_BdmBatteryCurrentOoRFaultFIC_n CcBCV_BdmBatteryCurrentOoRFaultPIC_n CcBCV_BdmBatteryCurrentOoR_A CcBCV_BdmBatteryVoltageOoRFaultFIC_n CcBCV_BdmBatteryVoltageOoRFaultPIC_n CcBCV_BdmBatteryVoltageOoRHigh_V CcBCV_BdmBatteryVoltageOoRLow_V /end REF_CHARACTERISTIC
/end GROUP
/begin GROUP S187_Diagnose_BdmBatteryBusVoltageMismatch_Fault "VBU0513/VBUSystem/BMS/BCV/BCV/Subsystem/Monitor_BCV_Performance/Diagnose_BDM_BCV_Data_Fault/Diagnose_BdmBatteryBusVoltageMismatch_Fault" /begin SUB_GROUP S203_BigDataMonitor_Handler1 /end SUB_GROUP
 /begin REF_CHARACTERISTIC CbBCV_BdmBatteryBusVoltageMismatch_flg CcBCV_BdmBatteryBusVoltageMismatchFaultDelta_V CcBCV_BdmBatteryBusVoltageMismatchFaultFIC_n CcBCV_BdmBatteryBusVoltageMismatchFaultPIC_n CcBCV_BdmBatteryBusVoltageMismatchFault_V /end REF_CHARACTERISTIC
/end GROUP
/begin GROUP S187_Diagnose_BdmVoltageCurrent_Fault "VBU0513/VBUSystem/BMS/BCV/BCV/Subsystem/Monitor_BCV_Performance/Diagnose_BDM_BCV_Data_Fault/Diagnose_BdmVoltageCurrent_Fault"
 /begin SUB_GROUP S204_BigDataMonitor_Handler S204_BigDataMonitor_Handler1 S204_BigDataMonitor_Handler2 /end SUB_GROUP
 /begin REF_CHARACTERISTIC CbBCV_BdmBatteryOverCurrent_flg CbBCV_BdmBatteryOverVoltage_flg CbBCV_BdmBatteryUnderVoltage_flg CcBCV_BdmBatteryOverCurrentFaultFIC_n CcBCV_BdmBatteryOverCurrentFaultPIC_n CcBCV_BdmBatteryOverCurrent_A CcBCV_BdmBatteryOverVoltageFaultFIC_n CcBCV_BdmBatteryOverVoltageFaultPIC_n CcBCV_BdmBatteryOverVoltage_V CcBCV_BdmBatteryUnderVoltage1_V CcBCV_BdmBatteryUnderVoltage2_V CcBCV_BdmBatteryUnderVoltageFaultFIC_n CcBCV_BdmBatteryUnderVoltageFaultPIC_n CcBCV_BdmBatteryUnderVoltageTemp_C /end REF_CHARACTERISTIC
/end GROUP
/begin GROUP S317_Cell0 "VBU0513/VBUSystem/BMS/CBL/Subsystem8/Subsystem/Determine_CSCCellBalanceRequest/Determine_CellBalanceRequest/Cell0"
 /begin SUB_GROUP S324_Determine_CellBlanceTime S324_Determine_SocBalanceReq S324_Determine_VoltageBalanceReq /end SUB_GROUP
/end GROUP
/begin GROUP S322_Balance_Fault_Diagnostic1 "VBU0513/VBUSystem/BMS/CBL/Subsystem8/Subsystem/Determine_CSCCellBalanceRequest/Subsystem/Balance_Fault_Diagnostic1" /begin REF_CHARACTERISTIC CcCBL_CellBalanceRespMismatchReqtTimeLmt_ms /end REF_CHARACTERISTIC /end GROUP
/begin GROUP S387_Determine_Diagnostic_Status "VBU0513/VBUSystem/BMS/CTD/Subsystem/Subsystem4/DiagnoseRelayWeld/MNC_Weld_Check/Determine_Diagnostic_Status" /begin REF_MEASUREMENT CTD_stMnNegContactorWeldDiagnosticStatus /end REF_MEASUREMENT /end GROUP
/begin GROUP S387_Equal_to_LOW1 "VBU0513/VBUSystem/BMS/CTD/Subsystem/Subsystem4/DiagnoseRelayWeld/MNC_Weld_Check/Equal_to_LOW1" /begin REF_CHARACTERISTIC LOW /end REF_CHARACTERISTIC /end GROUP
/begin GROUP S388_Determine_Diagnostic_Status "VBU0513/VBUSystem/BMS/CTD/Subsystem/Subsystem4/DiagnoseRelayWeld/MPC_Weld_Check/Determine_Diagnostic_Status" /begin REF_MEASUREMENT CTD_stMnPosContactorWeldDiagnosticStatus /end REF_MEASUREMENT /end GROUP
/begin GROUP S388_Equal_to_LOW1 "VBU0513/VBUSystem/BMS/CTD/Subsystem/Subsystem4/DiagnoseRelayWeld/MPC_Weld_Check/Equal_to_LOW1" /begin REF_CHARACTERISTIC LOW /end REF_CHARACTERISTIC /end GROUP
/begin GROUP S388_Equal_to_LOW2 "VBU0513/VBUSystem/BMS/CTD/Subsystem/Subsystem4/DiagnoseRelayWeld/MPC_Weld_Check/Equal_to_LOW2" /begin REF_CHARACTERISTIC LOW /end REF_CHARACTERISTIC /end GROUP
/begin GROUP S428_Determine_Heat_LockTime "VBU0513/VBUSystem/BMS/CTD/Subsystem/Subsystem4/Lockout_Precharge_Process/HeatProtection_Lockout/Determine_Heat_LockTime"
 /begin REF_CHARACTERISTIC CbCTD_PrechargeHeatProtectionEnable_flg CcCTD_MinHeatDissipation_J CcCTD_OnePrechargeHeat_J /end REF_CHARACTERISTIC
 /begin REF_MEASUREMENT LcCTD_tiPrechargeHeatProtectionTime /end REF_MEASUREMENT
/end GROUP
/begin GROUP S428_Determine_LockPoint_AvaliableHeat "VBU0513/VBUSystem/BMS/CTD/Subsystem/Subsystem4/Lockout_Precharge_Process/HeatProtection_Lockout/Determine_LockPoint_AvaliableHeat" /begin REF_CHARACTERISTIC CcCTD_OnePrechargeHeat_J /end REF_CHARACTERISTIC /end GROUP
/begin GROUP S454_Determine_Precharge_JouleHeat "VBU0513/VBUSystem/BMS/CTD/Subsystem/Subsystem4/PrechrgProcessMonitoring/Precharge_Thermal_Management/Determine_Precharge_JouleHeat" /begin SUB_GROUP S458_Determine_Accumulated_RemainingHeat /end SUB_GROUP /begin REF_CHARACTERISTIC CcCTD_MaxJouleHeat_J CcCTD_PrechargeResistance_ohm /end REF_CHARACTERISTIC /begin REF_MEASUREMENT LcCTD_PrechargeJouleHeat_J /end REF_MEASUREMENT /end GROUP
/begin GROUP S454_Perform_OverEnergy_Diagnostic "VBU0513/VBUSystem/BMS/CTD/Subsystem/Subsystem4/PrechrgProcessMonitoring/Precharge_Thermal_Management/Perform_OverEnergy_Diagnostic"
 /begin REF_CHARACTERISTIC CbCTD_PrechargeEnergyHighFaultEnable_flg CcCTD_PrechargeEnergyHighFaultFIC_n CcCTD_PrechargeEnergyHighFaultPIC_n CcCTD_PrechargeOverEnergy_J /end REF_CHARACTERISTIC
 /begin REF_MEASUREMENT CTD_stPrechargeEnergyHighFault LbCTD_PrechargeEnergyHighTestEnable_flg LbCTD_PrechargeEnergyHighTestFail_flg /end REF_MEASUREMENT
/end GROUP
/begin GROUP S456_Status_Idle "VBU0513/VBUSystem/BMS/CTD/Subsystem/Subsystem4/PrechrgProcessMonitoring/Precharging_Process_Monitoring/Status_Idle" /begin REF_CHARACTERISTIC CTD_PRECHARGE_STATUS_IDLE /end REF_CHARACTERISTIC /end GROUP
/begin GROUP S476_MNC_Stuck_Open_With_VehicleSpeed "VBU0513/VBUSystem/BMS/CTD/Subsystem/Subsystem4/Stuck_Open_Diagnostic/MNC_Stuck_Open/MNC_Stuck_Open_With_VehicleSpeed"
 /begin SUB_GROUP S480_CONTACTOR_STATUS_CLOSED1 S480_Determine_Diagnostic_Status S480_Equal_to_HIGH1 /end SUB_GROUP
 /begin REF_CHARACTERISTIC CTD_MAIN_NEGATIVE_CONTACTOR_STUCK_OPEN_FAULT CbCTD_MnNegContactorStuckOpenFaultEnable_flg CcCTD_MNCStuckOpenCurrentMax_A CcCTD_MnNegContactorOpenDeltaVoltage_V CcCTD_MnNegContactorStuckOpenFaultFIC_n CcCTD_MnNegContactorStuckOpenFaultPIC_n /end REF_CHARACTERISTIC
 /begin REF_MEASUREMENT CTD_stMnNegContactorStuckOpenFault /end REF_MEASUREMENT
/end GROUP
/begin GROUP S476_MNC_Stuck_Open_Without_VehicleSpeed "VBU0513/VBUSystem/BMS/CTD/Subsystem/Subsystem4/Stuck_Open_Diagnostic/MNC_Stuck_Open/MNC_Stuck_Open_Without_VehicleSpeed" /begin SUB_GROUP S481_CONTACTOR_STATUS_CLOSED1 S481_Equal_to_HIGH1 /end SUB_GROUP
 /begin REF_CHARACTERISTIC CbCTD_RnMnNegContactorStuckOpenFaultEnable_flg CcCTD_RnMNCStuckOpenCurrentMax_A CcCTD_RnMnNegContactorOpenDeltaVoltage_V CcCTD_RnMnNegContactorStuckOpenFaultFIC_n CcCTD_RnMnNegContactorStuckOpenFaultPIC_n /end REF_CHARACTERISTIC
 /begin REF_MEASUREMENT CTD_flgRnMnNegContactorStuckOpenTestEnable CTD_flgRnMnNegContactorStuckOpenTestFail CTD_stRnMnNegContactorStuckOpenFault /end REF_MEASUREMENT
/end GROUP
/begin GROUP S477_MPC_Stuck_Open_Within_VehicleSpeed "VBU0513/VBUSystem/BMS/CTD/Subsystem/Subsystem4/Stuck_Open_Diagnostic/MPC_Stuck_Open/MPC_Stuck_Open_Within_VehicleSpeed" /begin SUB_GROUP S503_CONTACTOR_STATUS_CLOSED1 /end SUB_GROUP
 /begin REF_CHARACTERISTIC CbCTD_RnMnPosContactorStuckOpenFaultEnable_flg CcCTD_RnMnPosContactorOpenDeltaVoltage_V CcCTD_RnMnPosContactorStuckOpenFaultFIC_n CcCTD_RnMnPosContactorStuckOpenFaultPIC_n /end REF_CHARACTERISTIC
 /begin REF_MEASUREMENT CTD_flgRnMnPosContactorStuckOpenTestFail CTD_stRnMnPosContactorStuckOpenFault LbCTD_RnMnPosContactorStuckOpenTestEnable_flg /end REF_MEASUREMENT
/end GROUP
/begin GROUP S477_MPC_Stuck_Open_Without_VehicleSpeed "VBU0513/VBUSystem/BMS/CTD/Subsystem/Subsystem4/Stuck_Open_Diagnostic/MPC_Stuck_Open/MPC_Stuck_Open_Without_VehicleSpeed"
 /begin SUB_GROUP S504_CONTACTOR_STATUS_CLOSED1 S504_Determine_Diagnostic_Status S504_Equal_to_HIGH1 /end SUB_GROUP
 /begin REF_CHARACTERISTIC CTD_MAIN_POSITIVE_CONTACTOR_STUCK_OPEN_FAULT CbCTD_MnPosContactorStuckOpenFaultEnable_flg CcCTD_MnPosContactorOpenDeltaVoltage_V CcCTD_MnPosContactorStuckOpenFaultFIC_n CcCTD_MnPosContactorStuckOpenFaultPIC_n /end REF_CHARACTERISTIC
 /begin REF_MEASUREMENT CTD_stMnPosContactorStuckOpenFault /end REF_MEASUREMENT
/end GROUP
/begin GROUP S478_Determine_Diagnostic_Status "VBU0513/VBUSystem/BMS/CTD/Subsystem/Subsystem4/Stuck_Open_Diagnostic/MPR_Stuck_Open/Determine_Diagnostic_Status" /begin REF_MEASUREMENT CTD_stPrechargeRelayStuckOpenDiagnosticStatus /end REF_MEASUREMENT /end GROUP
/begin GROUP S478_Equal_to_HIGH "VBU0513/VBUSystem/BMS/CTD/Subsystem/Subsystem4/Stuck_Open_Diagnostic/MPR_Stuck_Open/Equal_to_HIGH" /begin REF_CHARACTERISTIC HIGH /end REF_CHARACTERISTIC /end GROUP
/begin GROUP S593_CellTemp_ChangeRate_Calculate "VBU0513/VBUSystem/BMS/CTM/CTM/Subsystem/Determine_Thermal_Runaway/DetermineTempRiseRate/CellTemp_ChangeRate_Calculate" /begin REF_CHARACTERISTIC CcCTM_CellThermalRunawayRatePerSecond_C /end REF_CHARACTERISTIC /end GROUP
/begin GROUP S631_Combine_Precharge_Conditions "VBU0513/VBUSystem/BMS/CTS/CTS/Subsystem/DeterminePrechargeConditions/Precharge_Inhibit_Abort/Combine_Precharge_Conditions"
 /begin REF_CHARACTERISTIC LbCTS_AbortPrechargeOvrdVal_flg LbCTS_AbortPrechargeOvrd_flg LbCTS_InhibitPrechargeOvrdVal_flg LbCTS_InhibitPrechargeOvrd_flg /end REF_CHARACTERISTIC
 /begin REF_MEASUREMENT CTS_flgAbortPrecharge CTS_flgInhibitPrecharge /end REF_MEASUREMENT
/end GROUP
/begin GROUP S690_BigDataMonitor_Handler1 "VBU0513/VBUSystem/BMS/CVT/CVT/Subsystem/Monitor_CVT_Performance/Determine_CellVoltage_OverDeviationBDM/BigDataMonitor_Handler1" /begin SUB_GROUP S693_DetermineFault S693_DetermineFaultCounter /end SUB_GROUP /end GROUP
/begin GROUP S691_BigDataMonitor_Handler "VBU0513/VBUSystem/BMS/CVT/CVT/Subsystem/Monitor_CVT_Performance/Determine_CellVoltage_OverUnderBDM/BigDataMonitor_Handler" /begin SUB_GROUP S698_DetermineFault S698_DetermineFaultCounter /end SUB_GROUP /end GROUP
/begin GROUP S691_BigDataMonitor_Handler2 "VBU0513/VBUSystem/BMS/CVT/CVT/Subsystem/Monitor_CVT_Performance/Determine_CellVoltage_OverUnderBDM/BigDataMonitor_Handler2" /begin SUB_GROUP S699_DetermineFault S699_DetermineFaultCounter /end SUB_GROUP /end GROUP
/begin GROUP S754_EqualPorportionMapping3 "VBU0513/VBUSystem/BMS/FCC /FCC/Subsystem/Calculate_Fastcharge_Time/SOC_Mapping/EqualPorportionMapping3" /begin REF_MEASUREMENT FCC_pctEightySOCMappingRealSoc /end REF_MEASUREMENT /end GROUP
/begin GROUP S754_EqualPorportionMapping4 "VBU0513/VBUSystem/BMS/FCC /FCC/Subsystem/Calculate_Fastcharge_Time/SOC_Mapping/EqualPorportionMapping4" /begin REF_MEASUREMENT FCC_pctDisplaySocMappingRealSoc /end REF_MEASUREMENT /end GROUP
/begin GROUP S754_EqualPorportionMapping5 "VBU0513/VBUSystem/BMS/FCC /FCC/Subsystem/Calculate_Fastcharge_Time/SOC_Mapping/EqualPorportionMapping5" /begin REF_MEASUREMENT FCC_pctMaxSetSocMappingRealSoc /end REF_MEASUREMENT /end GROUP
/begin GROUP S798_Decrease_ChargeCurrentRequest "VBU0513/VBUSystem/BMS/FCC /FCC/Subsystem/Determine_Fastcharge_Request/Charge_Request_Protection/Decrease_ChargeCurrentRequest"
 /begin REF_CHARACTERISTIC CcFCC_ChargeCurrentOverDelay_s CcFCC_ChargeCurrentOverEnable_flg CcFCC_ChargeCurrentOverFuncEnable_flg CcFCC_ChargeCurrentRequestDec_A /end REF_CHARACTERISTIC
 /begin REF_MEASUREMENT FCC_flgChargeCurrentDerate FCC_iAChargeCurrentReqDec FCC_iADecreasedChargeCurrentRequest /end REF_MEASUREMENT
/end GROUP
/begin GROUP S798_Override_Block1 "VBU0513/VBUSystem/BMS/FCC /FCC/Subsystem/Determine_Fastcharge_Request/Charge_Request_Protection/Override_Block1" /begin REF_CHARACTERISTIC CbFCC_ChargeCurrentOvR_flg CcFCC_ChargeCurrentOvRValue_A /end REF_CHARACTERISTIC /begin REF_MEASUREMENT FCC_iARawChargeCurrentRequestFnl /end REF_MEASUREMENT /end GROUP
/begin GROUP S3256_DCH_VehStateAnalyze "VBU0513/VBUSystem/VCU /DCH/DCH_Overall/DCH_DCChargeCtrlOverall/DCH_DCChargeCtrlStateflow/DCH_InputSignalPreProcess/DCH_VehStateAnalyze" /begin REF_CHARACTERISTIC DCH_stHVCntctClosed_SY /end REF_CHARACTERISTIC /end GROUP
/begin GROUP S3530_setpiont "VBU0513/VBUSystem/VCU /EDIS/EDIS_Ctrl/battery_power_calculate/charge_power_calculate/ChPowSetPoint/setpiont" /begin REF_CHARACTERISTIC EDIS_tiSmplT_SY SYS_facGearRatioR_SY /end REF_CHARACTERISTIC /end GROUP
/begin GROUP S3620_Disenable "VBU0513/VBUSystem/VCU /LVC/LVC/LowVoltageBalanceControl/LVC_DcdcStCtl/RoutineControl/Disenable" /begin REF_CHARACTERISTIC DIAGS_stPsvRespAlreadyOk_SY /end REF_CHARACTERISTIC /end GROUP
/begin GROUP S3620_Enable "VBU0513/VBUSystem/VCU /LVC/LVC/LowVoltageBalanceControl/LVC_DcdcStCtl/RoutineControl/Enable" /begin REF_CHARACTERISTIC DIAGS_stPsvRespAlreadyOk_SY /end REF_CHARACTERISTIC /end GROUP
/begin GROUP S3650_VCUActSrc "VBU0513/VBUSystem/VCU /PMM/PMM_Ctrl/LvWakeUp_Ctrl/LvWakeUp_State_Calc/LVWSrc/VCUActSrc"
 /begin REF_CHARACTERISTIC PMM_stDCHInitSts_SY PMM_stDCHShtDwnSts_SY PMM_tiDlyHVRlyReqCC2_C PMM_uActvDisChVltg_C /end REF_CHARACTERISTIC
/end GROUP
/begin GROUP S3930_Subsystem "VBU0513/VBUSystem/VCU /TQO/TQOAll/TQDIS/TQDIS/TrqFilter/Subsystem" /begin REF_CHARACTERISTIC SYS_facGearRatioR_SY /end REF_CHARACTERISTIC /end GROUP
/begin GROUP S4007_ShftChange "VBU0513/VBUSystem/VCU /TQO/TQOAll/TQO/TQO/MotorTorque/ShftChange" /begin REF_CHARACTERISTIC SYS_stShftPosNeutr_SY SYS_stShftPosPark_SY /end REF_CHARACTERISTIC /end GROUP
/begin GROUP S4007_Subsystem "VBU0513/VBUSystem/VCU /TQO/TQOAll/TQO/TQO/MotorTorque/Subsystem" /begin REF_CHARACTERISTIC SYS_facGearRatioR_SY /end REF_CHARACTERISTIC /end GROUP
/begin GROUP S4072_BrakeStickyCheck "VBU0513/VBUSystem/VCU /VehINP/VehINP_Logic/APD/APD/Value_Selection/BrakeStickyCheck" /begin REF_CHARACTERISTIC BPD_stBrkPedPrsActv_C /end REF_CHARACTERISTIC /end GROUP
/begin GROUP S4106_Gear_DR_Req "VBU0513/VBUSystem/VCU /VehINP/VehINP_Logic/GearShift/Gear1/Digital_Gear_D_R/Gear_DR_Req" /begin REF_CHARACTERISTIC Gear_tiSampleTime_C /end REF_CHARACTERISTIC /end GROUP
/begin GROUP S4106_Gear_DR_Warning "VBU0513/VBUSystem/VCU /VehINP/VehINP_Logic/GearShift/Gear1/Digital_Gear_D_R/Gear_DR_Warning" /begin REF_CHARACTERISTIC Gear_tiSampleTime_C /end REF_CHARACTERISTIC /end GROUP
/begin GROUP S4114_Gear4Reset "VBU0513/VBUSystem/VCU /VehINP/VehINP_Logic/GearShift/Gear1/Gear_Status/Gear4Reset"
 /begin REF_CHARACTERISTIC Gear_stCurrentGearD_C Gear_stCurrentGearR_C Gear_tiSampleTime_C /end REF_CHARACTERISTIC
/end GROUP
/begin GROUP S4114_Gear_DGear "VBU0513/VBUSystem/VCU /VehINP/VehINP_Logic/GearShift/Gear1/Gear_Status/Gear_DGear" /begin REF_CHARACTERISTIC Gear_stCurrentGearD_C /end REF_CHARACTERISTIC /end GROUP
/begin GROUP S4114_Gear_DefaultGear "VBU0513/VBUSystem/VCU /VehINP/VehINP_Logic/GearShift/Gear1/Gear_Status/Gear_DefaultGear" /begin REF_CHARACTERISTIC Gear_tiSampleTime_C /end REF_CHARACTERISTIC /end GROUP
/begin GROUP S4114_Gear_DriverShiftDReq "VBU0513/VBUSystem/VCU /VehINP/VehINP_Logic/GearShift/Gear1/Gear_Status/Gear_DriverShiftDReq" /begin REF_CHARACTERISTIC Gear_stCurrentGearD_C Gear_stCurrentGearR_C /end REF_CHARACTERISTIC /end GROUP
/begin GROUP S4114_Gear_DriverShiftRReq "VBU0513/VBUSystem/VCU /VehINP/VehINP_Logic/GearShift/Gear1/Gear_Status/Gear_DriverShiftRReq" /begin REF_CHARACTERISTIC Gear_stCurrentGearD_C Gear_stCurrentGearR_C /end REF_CHARACTERISTIC /end GROUP
/begin GROUP S4114_Gear_DriverShiftTowReq "VBU0513/VBUSystem/VCU /VehINP/VehINP_Logic/GearShift/Gear1/Gear_Status/Gear_DriverShiftTowReq" /begin REF_CHARACTERISTIC Gear_stCurrentGearD_C Gear_stCurrentGearR_C /end REF_CHARACTERISTIC /end GROUP
/begin GROUP S4114_Gear_GearReq "VBU0513/VBUSystem/VCU /VehINP/VehINP_Logic/GearShift/Gear1/Gear_Status/Gear_GearReq" /begin REF_CHARACTERISTIC Gear_tiSampleTime_C /end REF_CHARACTERISTIC /end GROUP
/begin GROUP S4114_Gear_InitGear "VBU0513/VBUSystem/VCU /VehINP/VehINP_Logic/GearShift/Gear1/Gear_Status/Gear_InitGear" /begin REF_CHARACTERISTIC Gear_tiSampleTime_C /end REF_CHARACTERISTIC /end GROUP
/begin GROUP S4114_Gear_PGear "VBU0513/VBUSystem/VCU /VehINP/VehINP_Logic/GearShift/Gear1/Gear_Status/Gear_PGear" /begin REF_CHARACTERISTIC Gear_stIntendGearP_C Gear_tiSampleTime_C /end REF_CHARACTERISTIC /end GROUP
/begin GROUP S4114_Gear_RGear "VBU0513/VBUSystem/VCU /VehINP/VehINP_Logic/GearShift/Gear1/Gear_Status/Gear_RGear" /begin REF_CHARACTERISTIC Gear_stCurrentGearR_C /end REF_CHARACTERISTIC /end GROUP
/begin GROUP S4114_Warning "VBU0513/VBUSystem/VCU /VehINP/VehINP_Logic/GearShift/Gear1/Gear_Status/Warning" /begin REF_CHARACTERISTIC Gear_tiSampleTime_C /end REF_CHARACTERISTIC /end GROUP
/begin GROUP S480_Equal_to_HIGH1 "VBU0513/VBUSystem/BMS/CTD/Subsystem/Subsystem4/Stuck_Open_Diagnostic/MNC_Stuck_Open/MNC_Stuck_Open_With_VehicleSpeed/Equal_to_HIGH1" /begin REF_CHARACTERISTIC HIGH /end REF_CHARACTERISTIC /end GROUP
/begin GROUP S481_Equal_to_HIGH1 "VBU0513/VBUSystem/BMS/CTD/Subsystem/Subsystem4/Stuck_Open_Diagnostic/MNC_Stuck_Open/MNC_Stuck_Open_Without_VehicleSpeed/Equal_to_HIGH1" /begin REF_CHARACTERISTIC HIGH /end REF_CHARACTERISTIC /end GROUP
/begin GROUP S504_Equal_to_HIGH1 "VBU0513/VBUSystem/BMS/CTD/Subsystem/Subsystem4/Stuck_Open_Diagnostic/MPC_Stuck_Open/MPC_Stuck_Open_Without_VehicleSpeed/Equal_to_HIGH1" /begin REF_CHARACTERISTIC HIGH /end REF_CHARACTERISTIC /end GROUP
/begin GROUP S3548_batt_stpower_overrite "VBU0513/VBUSystem/VCU /EDIS/EDIS_Ctrl/battery_power_calculate/discharge_power_calculate/DchPowSetpiont/setpoint/batt_stpower_overrite" /begin REF_CHARACTERISTIC EDIS_tiSmplT_SY /end REF_CHARACTERISTIC /end GROUP
/begin GROUP S3548_discharge_setpoint "VBU0513/VBUSystem/VCU /EDIS/EDIS_Ctrl/battery_power_calculate/discharge_power_calculate/DchPowSetpiont/setpoint/discharge_setpoint" /begin REF_CHARACTERISTIC EDIS_tiSmplT_SY /end REF_CHARACTERISTIC /end GROUP
/begin GROUP S3943_AccPdlIdl "VBU0513/VBUSystem/VCU /TQO/TQOAll/TQDIS/TQDIS/TrqFilter/DrvLim/AccPdlIdl" /begin REF_CHARACTERISTIC SYS_stShftPosNeutr_SY SYS_stShftPosPark_SY /end REF_CHARACTERISTIC /end GROUP
/begin GROUP S3943_Creep "VBU0513/VBUSystem/VCU /TQO/TQOAll/TQDIS/TQDIS/TrqFilter/DrvLim/Creep" /begin REF_CHARACTERISTIC SYS_stShftPosNeutr_SY SYS_stShftPosPark_SY /end REF_CHARACTERISTIC /end GROUP
/begin GROUP S460_Determine_Accumulated_Cooling "VBU0513/VBUSystem/BMS/CTD/Subsystem/Subsystem4/PrechrgProcessMonitoring/Precharge_Thermal_Management/Determine_Precharge_JouleHeat/Determine_Accumulated_RemainingHeat/Determine_Accumulated_Cooling" /begin REF_CHARACTERISTIC CcCTD_MinHeatDissipation_J /end REF_CHARACTERISTIC /end GROUP
/end MODULE
/end PROJECT
