/******************************************************************************
* ASAP2 file: VBU0513.a2l
* Code generation for model "VBU0513".
* Model version : 7.287
* Simulink Coder version : 9.4 (R2020b) 29-Jul-2020
* C source code generated on : Thu Mar 4 01:11:34 2021
* Target selection: ert.tlc
* Embedded hardware selection: Infineon->TriCore
* Code generation objectives: Unspecified
* Validation result: Not run
* (add additional file header information here)
******************************************************************************/
/* Version 1.31 */
ASAP2_VERSION 1 31
/begin PROJECT ProjectName "Project Comment Goes Here"
/begin HEADER "Header Comments go here" /end HEADER
/begin MODULE ModuleName "Module Comment Goes Here"
/begin MOD_PAR "MOD PAR Comment Goes Here" /end MOD_PAR
/begin MOD_COMMON "Mod Common Comment Here" BYTE_ORDER MSB_LAST /end MOD_COMMON
/begin RECORD_LAYOUT Scalar_BOOLEAN FNC_VALUES 1 UBYTE COLUMN_DIR DIRECT /end RECORD_LAYOUT
/begin RECORD_LAYOUT Scalar_UBYTE FNC_VALUES 1 UBYTE COLUMN_DIR DIRECT /end RECORD_LAYOUT
/begin RECORD_LAYOUT Scalar_BYTE FNC_VALUES 1 SBYTE COLUMN_DIR DIRECT /end RECORD_LAYOUT
/begin RECORD_LAYOUT Scalar_UWORD FNC_VALUES 1 UWORD COLUMN_DIR DIRECT /end RECORD_LAYOUT
/begin RECORD_LAYOUT Scalar_ULONG FNC_VALUES 1 ULONG COLUMN_DIR DIRECT /end RECORD_LAYOUT
/begin RECORD_LAYOUT Scalar_LONG FNC_VALUES 1 SLONG COLUMN_DIR DIRECT /end RECORD_LAYOUT
/begin RECORD_LAYOUT Scalar_FLOAT32_IEEE FNC_VALUES 1 FLOAT32_IEEE COLUMN_DIR DIRECT /end RECORD_LAYOUT
/begin RECORD_LAYOUT Lookup1D_BOOLEAN FNC_VALUES 1 UBYTE COLUMN_DIR DIRECT /end RECORD_LAYOUT
/begin RECORD_LAYOUT Lookup1D_X_BOOLEAN AXIS_PTS_X 1 UBYTE INDEX_INCR DIRECT /end RECORD_LAYOUT
/begin RECORD_LAYOUT Lookup1D_BYTE FNC_VALUES 1 SBYTE COLUMN_DIR DIRECT /end RECORD_LAYOUT
/begin RECORD_LAYOUT Lookup1D_FLOAT32_IEEE FNC_VALUES 1 FLOAT32_IEEE COLUMN_DIR DIRECT /end RECORD_LAYOUT
/begin RECORD_LAYOUT Lookup1D_X_FLOAT32_IEEE AXIS_PTS_X 1 FLOAT32_IEEE INDEX_INCR DIRECT /end RECORD_LAYOUT
/begin CHARACTERISTIC INP_pVacPres_CUR_v "" CURVE 0x70012212 Lookup1D_FLOAT32_IEEE 0 VBU0513_CM_single_Kpa 0.0 10000.0
 /begin AXIS_DESCR COM_AXIS NO_INPUT_QUANTITY VBU0513_CM_single_mV 6 0.0 5000.0 AXIS_PTS_REF INP_uVacPres_CUR_x /end AXIS_DESCR
/end CHARACTERISTIC
/begin AXIS_PTS INP_uVacPres_CUR_x "" 0x7001222a NO_INPUT_QUANTITY Lookup1D_X_FLOAT32_IEEE 0 VBU0513_CM_single_mV 6 0.0 5000.0 /end AXIS_PTS
/begin CHARACTERISTIC INP_tDCChPortTemp_CUR_v "" CURVE 0x70013f2e Lookup1D_FLOAT32_IEEE 0 VBU0513_CM_single_C -100.0 200.0
 /begin AXIS_DESCR COM_AXIS NO_INPUT_QUANTITY VBU0513_CM_single_mV 17 0.0 5.0 AXIS_PTS_REF INP_uDCChPortTemp_CUR_x /end AXIS_DESCR
/end CHARACTERISTIC
/begin AXIS_PTS INP_uDCChPortTemp_CUR_x "" 0x70013ffa NO_INPUT_QUANTITY Lookup1D_X_FLOAT32_IEEE 0 VBU0513_CM_single_mV 17 0.0 5.0 /end AXIS_PTS
/begin CHARACTERISTIC INP_tDCChPortTempNegative_CUR_v "" CURVE 0x70013eea Lookup1D_FLOAT32_IEEE 0 VBU0513_CM_single_C -100.0 200.0
 /begin AXIS_DESCR COM_AXIS NO_INPUT_QUANTITY VBU0513_CM_single_mV 17 0.0 5.0 AXIS_PTS_REF INP_uDCChPortTempNegative_CUR_x /end AXIS_DESCR
/end CHARACTERISTIC
/begin AXIS_PTS INP_uDCChPortTempNegative_CUR_x "" 0x70013fb6 NO_INPUT_QUANTITY Lookup1D_X_FLOAT32_IEEE 0 VBU0513_CM_single_mV 17 0.0 5.0 /end AXIS_PTS
/begin CHARACTERISTIC INP_tEDSOutTemp_CUR_v "" CURVE 0x70013f72 Lookup1D_FLOAT32_IEEE 0 VBU0513_CM_single_C -100.0 200.0
 /begin AXIS_DESCR COM_AXIS NO_INPUT_QUANTITY VBU0513_CM_single_mV 17 0.0 5.0 AXIS_PTS_REF INP_uEDSOutTemp_CUR_x /end AXIS_DESCR
/end CHARACTERISTIC
/begin AXIS_PTS INP_uEDSOutTemp_CUR_x "" 0x7001403e NO_INPUT_QUANTITY Lookup1D_X_FLOAT32_IEEE 0 VBU0513_CM_single_mV 17 0.0 5.0 /end AXIS_PTS
/begin CHARACTERISTIC APO_ACOvrdVal_C "" VALUE 0x700101b0 Scalar_FLOAT32_IEEE 0 VBU0513_CM_single_cnt -3.4028234663852886E+38 3.4028234663852886E+38 /end CHARACTERISTIC
/begin CHARACTERISTIC APO_ACPowerOvrdVal_C "" VALUE 0x700101b4 Scalar_FLOAT32_IEEE 0 VBU0513_CM_single_cnt -3.4028234663852886E+38 3.4028234663852886E+38 /end CHARACTERISTIC
/begin CHARACTERISTIC APO_ACSpeedOvrdVal_C "" VALUE 0x700101b8 Scalar_FLOAT32_IEEE 0 VBU0513_CM_single_cnt -3.4028234663852886E+38 3.4028234663852886E+38 /end CHARACTERISTIC
/begin CHARACTERISTIC APO_AxAccelerationOvrdVal_C "" VALUE 0x700101bc Scalar_FLOAT32_IEEE 0 VBU0513_CM_single_cnt -3.4028234663852886E+38 3.4028234663852886E+38 /end CHARACTERISTIC
/begin CHARACTERISTIC APO_AyAccelerationOvrdVal_C "" VALUE 0x700101c0 Scalar_FLOAT32_IEEE 0 VBU0513_CM_single_cnt -3.4028234663852886E+38 3.4028234663852886E+38 /end CHARACTERISTIC
/begin CHARACTERISTIC APO_AzAccelerationOvrdVal_C "" VALUE 0x700101c4 Scalar_FLOAT32_IEEE 0 VBU0513_CM_single_cnt -3.4028234663852886E+38 3.4028234663852886E+38 /end CHARACTERISTIC
/begin CHARACTERISTIC APO_BrakWarningOvrdVal_C "" VALUE 0x700101c8 Scalar_FLOAT32_IEEE 0 VBU0513_CM_single_cnt -3.4028234663852886E+38 3.4028234663852886E+38 /end CHARACTERISTIC
/begin CHARACTERISTIC APO_BrkingWhileDrivingOvrdVal_C "" VALUE 0x700101cc Scalar_FLOAT32_IEEE 0 VBU0513_CM_single_cnt -3.4028234663852886E+38 3.4028234663852886E+38 /end CHARACTERISTIC
/begin CHARACTERISTIC APO_CruiseStatusOvrdVal_C "" VALUE 0x700101d0 Scalar_FLOAT32_IEEE 0 VBU0513_CM_single_cnt -3.4028234663852886E+38 3.4028234663852886E+38 /end CHARACTERISTIC
/begin CHARACTERISTIC APO_EPBCtrlModeOvrdVal_C "" VALUE 0x700101d4 Scalar_FLOAT32_IEEE 0 VBU0513_CM_single_cnt -3.4028234663852886E+38 3.4028234663852886E+38 /end CHARACTERISTIC
/begin CHARACTERISTIC APO_EPBFaultOvrdVal_C "" VALUE 0x700101d8 Scalar_FLOAT32_IEEE 0 VBU0513_CM_single_cnt -3.4028234663852886E+38 3.4028234663852886E+38 /end CHARACTERISTIC
/begin CHARACTERISTIC APO_EPFaultLevelWarningOvrdVal_C "" VALUE 0x700101dc Scalar_FLOAT32_IEEE 0 VBU0513_CM_single_cnt -3.4028234663852886E+38 3.4028234663852886E+38 /end CHARACTERISTIC
/begin CHARACTERISTIC APO_EPSFaultOvrdVal_C "" VALUE 0x700101e0 Scalar_FLOAT32_IEEE 0 VBU0513_CM_single_cnt -3.4028234663852886E+38 3.4028234663852886E+38 /end CHARACTERISTIC
/begin CHARACTERISTIC APO_HundredKmTripEnergyOvrdVal_C "" VALUE 0x700101e4 Scalar_FLOAT32_IEEE 0 VBU0513_CM_single_cnt -3.4028234663852886E+38 3.4028234663852886E+38 /end CHARACTERISTIC
/begin CHARACTERISTIC APO_LimpHomeOvrdVal_C "" VALUE 0x700101e8 Scalar_FLOAT32_IEEE 0 VBU0513_CM_single_cnt -3.4028234663852886E+38 3.4028234663852886E+38 /end CHARACTERISTIC
/begin CHARACTERISTIC APO_OverSpeedOvrdVal_C "" VALUE 0x700101ec Scalar_FLOAT32_IEEE 0 VBU0513_CM_single_cnt -3.4028234663852886E+38 3.4028234663852886E+38 /end CHARACTERISTIC
/begin CHARACTERISTIC APO_PlsUSE750VDCOvrdVal_C "" VALUE 0x700101f0 Scalar_FLOAT32_IEEE 0 VBU0513_CM_single_cnt -3.4028234663852886E+38 3.4028234663852886E+38 /end CHARACTERISTIC
/begin CHARACTERISTIC APO_PowerModeOvrdVal_C "" VALUE 0x700101f4 Scalar_FLOAT32_IEEE 0 VBU0513_CM_single_cnt -3.4028234663852886E+38 3.4028234663852886E+38 /end CHARACTERISTIC
/begin CHARACTERISTIC APO_RemainingChargingTimeOvrdVal_C "" VALUE 0x700101f8 Scalar_FLOAT32_IEEE 0 VBU0513_CM_single_cnt -3.4028234663852886E+38 3.4028234663852886E+38 /end CHARACTERISTIC
/begin CHARACTERISTIC APO_RemainingDrivingRangeOvrdVal_C "" VALUE 0x700101fc Scalar_FLOAT32_IEEE 0 VBU0513_CM_single_cnt -3.4028234663852886E+38 3.4028234663852886E+38 /end CHARACTERISTIC
/begin CHARACTERISTIC APO_SOCLowWarningOvrdVal_C "" VALUE 0x70010200 Scalar_FLOAT32_IEEE 0 VBU0513_CM_single_cnt -3.4028234663852886E+38 3.4028234663852886E+38 /end CHARACTERISTIC
/begin CHARACTERISTIC APO_TenkmTripEnergyOvrdVal_C "" VALUE 0x70010204 Scalar_FLOAT32_IEEE 0 VBU0513_CM_single_cnt -3.4028234663852886E+38 3.4028234663852886E+38 /end CHARACTERISTIC
/begin CHARACTERISTIC APO_TotalChargeEnergyOvrdVal_C "" VALUE 0x70010208 Scalar_FLOAT32_IEEE 0 VBU0513_CM_single_cnt -3.4028234663852886E+38 3.4028234663852886E+38 /end CHARACTERISTIC
/begin CHARACTERISTIC APO_TotalDischargeEnergyOvrdVal_C "" VALUE 0x7001020c Scalar_FLOAT32_IEEE 0 VBU0513_CM_single_cnt -3.4028234663852886E+38 3.4028234663852886E+38 /end CHARACTERISTIC
/begin CHARACTERISTIC APO_VCURemainingRngOvrdVal_C "" VALUE 0x70010210 Scalar_FLOAT32_IEEE 0 VBU0513_CM_single_cnt -3.4028234663852886E+38 3.4028234663852886E+38 /end CHARACTERISTIC
/begin CHARACTERISTIC APO_VehicleModeOvrdVal_C "" VALUE 0x70010214 Scalar_FLOAT32_IEEE 0 VBU0513_CM_single_cnt -3.4028234663852886E+38 3.4028234663852886E+38 /end CHARACTERISTIC
/begin CHARACTERISTIC APO_YawrateOvrdVal_C "" VALUE 0x70010218 Scalar_FLOAT32_IEEE 0 VBU0513_CM_single_cnt -3.4028234663852886E+38 3.4028234663852886E+38 /end CHARACTERISTIC
/begin CHARACTERISTIC APO_flgBMSThermalRunawayOvrdVal_C "" VALUE 0x70010234 Scalar_FLOAT32_IEEE 0 VBU0513_CM_single_cnt -3.4028234663852886E+38 3.4028234663852886E+38 /end CHARACTERISTIC
/begin CHARACTERISTIC APO_flgBrkSwtOvrdVal_C "" VALUE 0x70010238 Scalar_FLOAT32_IEEE 0 VBU0513_CM_single_cnt -3.4028234663852886E+38 3.4028234663852886E+38 /end CHARACTERISTIC
/begin CHARACTERISTIC APO_iBMSPackCurrentOvrdVal_C "" VALUE 0x7001023c Scalar_FLOAT32_IEEE 0 VBU0513_CM_single_cnt -3.4028234663852886E+38 3.4028234663852886E+38 /end CHARACTERISTIC
/begin CHARACTERISTIC APO_pBrkPressOvrdVal_C "" VALUE 0x70010240 Scalar_FLOAT32_IEEE 0 VBU0513_CM_single_cnt -3.4028234663852886E+38 3.4028234663852886E+38 /end CHARACTERISTIC
/begin CHARACTERISTIC APO_pctAccPedPosOvrdVal_C "" VALUE 0x70010248 Scalar_FLOAT32_IEEE 0 VBU0513_CM_single_cnt -3.4028234663852886E+38 3.4028234663852886E+38 /end CHARACTERISTIC
/begin CHARACTERISTIC APO_pctBMSDIsplaySOCOvrdVal_C "" VALUE 0x7001024c Scalar_FLOAT32_IEEE 0 VBU0513_CM_single_cnt -3.4028234663852886E+38 3.4028234663852886E+38 /end CHARACTERISTIC
/begin CHARACTERISTIC APO_pctBMSSOCOvrdVal_C "" VALUE 0x70010250 Scalar_FLOAT32_IEEE 0 VBU0513_CM_single_cnt -3.4028234663852886E+38 3.4028234663852886E+38 /end CHARACTERISTIC
/begin CHARACTERISTIC APO_pctEfcAccPdlOvrdVal_C "" VALUE 0x70010254 Scalar_FLOAT32_IEEE 0 VBU0513_CM_single_cnt -3.4028234663852886E+38 3.4028234663852886E+38 /end CHARACTERISTIC
/begin CHARACTERISTIC APO_tBMSInletTempOvrdVal_C "" VALUE 0x70010268 Scalar_FLOAT32_IEEE 0 VBU0513_CM_single_cnt -3.4028234663852886E+38 3.4028234663852886E+38 /end CHARACTERISTIC
/begin CHARACTERISTIC APO_tBMSOutletTempOvrdVal_C "" VALUE 0x7001026c Scalar_FLOAT32_IEEE 0 VBU0513_CM_single_cnt -3.4028234663852886E+38 3.4028234663852886E+38 /end CHARACTERISTIC
/begin CHARACTERISTIC APO_uLVBattOvrdVal_C "" VALUE 0x70010270 Scalar_FLOAT32_IEEE 0 VBU0513_CM_single_cnt -3.4028234663852886E+38 3.4028234663852886E+38 /end CHARACTERISTIC
/begin CHARACTERISTIC APO_vBMSPackVoltageOvrdVal_C "" VALUE 0x70010274 Scalar_FLOAT32_IEEE 0 VBU0513_CM_single_cnt -3.4028234663852886E+38 3.4028234663852886E+38 /end CHARACTERISTIC
/begin CHARACTERISTIC BCV_facHVADC "" VALUE 0x700103d8 Scalar_FLOAT32_IEEE 0 VBU0513_CM_single_cnt 0.0 1000.0 /end CHARACTERISTIC
/begin CHARACTERISTIC BCV_facPEURCurrent "" VALUE 0x900046bc Scalar_FLOAT32_IEEE 0 VBU0513_CM_single -3.4E+38 3.4E+38 /end CHARACTERISTIC
/begin CHARACTERISTIC CcBMM_CurrentStableThreshold_A "" VALUE 0x70010550 Scalar_FLOAT32_IEEE 0 VBU0513_CM_single_cnt -3.4028234663852886E+38 3.4028234663852886E+38 /end CHARACTERISTIC
/begin CHARACTERISTIC CcBMM_MaxInitializeTime_ms "" VALUE 0x70010558 Scalar_FLOAT32_IEEE 0 VBU0513_CM_single_cnt -3.4028234663852886E+38 3.4028234663852886E+38 /end CHARACTERISTIC
/begin CHARACTERISTIC CcISO_DrvISODecThr_kohm "" VALUE 0x70010770 Scalar_FLOAT32_IEEE 0 VBU0513_CM_single_kohm -3.4028234663852886E+38 3.4028234663852886E+38 /end CHARACTERISTIC
/begin CHARACTERISTIC CcISO_DrvISODecThr_pct "" VALUE 0x70010774 Scalar_FLOAT32_IEEE 0 VBU0513_CM_single_pct -3.4028234663852886E+38 3.4028234663852886E+38 /end CHARACTERISTIC
/begin CHARACTERISTIC CcISO_DrvISOLowThr40_kohm "" VALUE 0x70010778 Scalar_FLOAT32_IEEE 0 VBU0513_CM_single_kohm -3.4028234663852886E+38 3.4028234663852886E+38 /end CHARACTERISTIC
/begin CHARACTERISTIC CcISO_DrvISOLowThr_kohm "" VALUE 0x7001077c Scalar_FLOAT32_IEEE 0 VBU0513_CM_single_kohm -3.4028234663852886E+38 3.4028234663852886E+38 /end CHARACTERISTIC
/begin CHARACTERISTIC CcISO_FccISODecThr_kohm "" VALUE 0x70010780 Scalar_FLOAT32_IEEE 0 VBU0513_CM_single_kohm -3.4028234663852886E+38 3.4028234663852886E+38 /end CHARACTERISTIC
/begin CHARACTERISTIC CcISO_FccISODecThr_pct "" VALUE 0x70010784 Scalar_FLOAT32_IEEE 0 VBU0513_CM_single_pct -3.4028234663852886E+38 3.4028234663852886E+38 /end CHARACTERISTIC
/begin CHARACTERISTIC CcISO_FccISOLowThr40_kohm "" VALUE 0x70010788 Scalar_FLOAT32_IEEE 0 VBU0513_CM_single_kohm -3.4028234663852886E+38 3.4028234663852886E+38 /end CHARACTERISTIC
/begin CHARACTERISTIC CcISO_FccISOLowThr_kohm "" VALUE 0x7001078c Scalar_FLOAT32_IEEE 0 VBU0513_CM_single_kohm -3.4028234663852886E+38 3.4028234663852886E+38 /end CHARACTERISTIC
/begin CHARACTERISTIC CcISO_PackISODecThr_kohm "" VALUE 0x70010798 Scalar_FLOAT32_IEEE 0 VBU0513_CM_single_kohm -3.4028234663852886E+38 3.4028234663852886E+38 /end CHARACTERISTIC
/begin CHARACTERISTIC CcISO_PackISODecThr_pct "" VALUE 0x7001079c Scalar_FLOAT32_IEEE 0 VBU0513_CM_single_pct -3.4028234663852886E+38 3.4028234663852886E+38 /end CHARACTERISTIC
/begin CHARACTERISTIC CcISO_PackISOLowThr_kohm "" VALUE 0x700107a0 Scalar_FLOAT32_IEEE 0 VBU0513_CM_single_kohm -3.4028234663852886E+38 3.4028234663852886E+38 /end CHARACTERISTIC
/begin CHARACTERISTIC CcRTC_FastWakeUpSOCLowerLimit_pct "" VALUE 0x700107a8 Scalar_FLOAT32_IEEE 0 VBU0513_CM_single_cnt -3.4028234663852886E+38 3.4028234663852886E+38 /end CHARACTERISTIC
/begin CHARACTERISTIC CcRTC_FastWakeUpSOCUpperLimit_pct "" VALUE 0x700107ac Scalar_FLOAT32_IEEE 0 VBU0513_CM_single_cnt -3.4028234663852886E+38 3.4028234663852886E+38 /end CHARACTERISTIC
/begin CHARACTERISTIC CcRTC_FastWakeUpTempMiddleLimit_C "" VALUE 0x700107b0 Scalar_FLOAT32_IEEE 0 VBU0513_CM_single_cnt -3.4028234663852886E+38 3.4028234663852886E+38 /end CHARACTERISTIC
/begin CHARACTERISTIC CcRTC_FastWakeUpTempUpperLimit_C "" VALUE 0x700107b4 Scalar_FLOAT32_IEEE 0 VBU0513_CM_single_cnt -3.4028234663852886E+38 3.4028234663852886E+38 /end CHARACTERISTIC
/begin CHARACTERISTIC CcSYS_NominalCellCapacity_Ah "" VALUE 0x70010ad0 Scalar_FLOAT32_IEEE 0 VBU0513_CM_single_cnt -3.4028234663852886E+38 3.4028234663852886E+38 /end CHARACTERISTIC
/begin CHARACTERISTIC DCH_cBCPNrmCapOvrdVal_C "" VALUE 0x70010c98 Scalar_FLOAT32_IEEE 0 VBU0513_CM_single_cnt -3.4028234663852886E+38 3.4028234663852886E+38 /end CHARACTERISTIC
/begin CHARACTERISTIC DCH_iBCPMaxChCurrOvrdVal_C "" VALUE 0x70010cb8 Scalar_FLOAT32_IEEE 0 VBU0513_CM_single_cnt -3.4028234663852886E+38 3.4028234663852886E+38 /end CHARACTERISTIC
/begin CHARACTERISTIC DCH_iBCSChCurrMeasureOvrdVal_C "" VALUE 0x70010cbc Scalar_FLOAT32_IEEE 0 VBU0513_CM_single_cnt -3.4028234663852886E+38 3.4028234663852886E+38 /end CHARACTERISTIC
/begin CHARACTERISTIC DCH_numBCSMaxCellVltgNumOvrdVal_C "" VALUE 0x70010cf0 Scalar_FLOAT32_IEEE 0 VBU0513_CM_single_cnt -3.4028234663852886E+38 3.4028234663852886E+38 /end CHARACTERISTIC
/begin CHARACTERISTIC DCH_pctBCPSocOvrdVal_C "" VALUE 0x70010d5c Scalar_FLOAT32_IEEE 0 VBU0513_CM_single_cnt -3.4028234663852886E+38 3.4028234663852886E+38 /end CHARACTERISTIC
/begin CHARACTERISTIC DCH_pctBCSCurrSocOvrdVal_C "" VALUE 0x70010d60 Scalar_FLOAT32_IEEE 0 VBU0513_CM_single_cnt -3.4028234663852886E+38 3.4028234663852886E+38 /end CHARACTERISTIC
/begin CHARACTERISTIC DCH_tBCPMaxPermitTempOvrdVal_C "" VALUE 0x70010d6c Scalar_FLOAT32_IEEE 0 VBU0513_CM_single_cnt -3.4028234663852886E+38 3.4028234663852886E+38 /end CHARACTERISTIC
/begin CHARACTERISTIC DCH_tiBCSChNeedTOvrdVal_C "" VALUE 0x70010db0 Scalar_FLOAT32_IEEE 0 VBU0513_CM_single_cnt -3.4028234663852886E+38 3.4028234663852886E+38 /end CHARACTERISTIC
/begin CHARACTERISTIC DCH_uBCPBattVltgOvrdVal_C "" VALUE 0x70010e30 Scalar_FLOAT32_IEEE 0 VBU0513_CM_single_cnt -3.4028234663852886E+38 3.4028234663852886E+38 /end CHARACTERISTIC
/begin CHARACTERISTIC DCH_uBCPMaxCellVltgForChOvrdVal_C "" VALUE 0x70010e34 Scalar_FLOAT32_IEEE 0 VBU0513_CM_single_cnt -3.4028234663852886E+38 3.4028234663852886E+38 /end CHARACTERISTIC
/begin CHARACTERISTIC DCH_uBCPMaxVltgForChOvrdVal_C "" VALUE 0x70010e38 Scalar_FLOAT32_IEEE 0 VBU0513_CM_single_cnt -3.4028234663852886E+38 3.4028234663852886E+38 /end CHARACTERISTIC
/begin CHARACTERISTIC DCH_uBCSChVltgMeasureOvrdVal_C "" VALUE 0x70010e3c Scalar_FLOAT32_IEEE 0 VBU0513_CM_single_cnt -3.4028234663852886E+38 3.4028234663852886E+38 /end CHARACTERISTIC
/begin CHARACTERISTIC DCH_uBCSMaxCellVltgOvrdVal_C "" VALUE 0x70010e40 Scalar_FLOAT32_IEEE 0 VBU0513_CM_single_cnt -3.4028234663852886E+38 3.4028234663852886E+38 /end CHARACTERISTIC
/begin CHARACTERISTIC EDIS_pwrCurrPwrOvrdVal_C "" VALUE 0x70011138 Scalar_FLOAT32_IEEE 0 VBU0513_CM_single_cnt -3.4028234663852886E+38 3.4028234663852886E+38 /end CHARACTERISTIC
/begin CHARACTERISTIC EDIS_pwrDcdcPwrLim_C "" VALUE 0x70011140 Scalar_FLOAT32_IEEE 0 VBU0513_CM_single_cnt 0.0 1.0E+23 /end CHARACTERISTIC
/begin CHARACTERISTIC EPFaultLevelWarning "" VALUE 0x70011228 Scalar_FLOAT32_IEEE 0 VBU0513_CM_single_cnt 0.0 1.0E+23 /end CHARACTERISTIC
/begin CHARACTERISTIC FCC_pctVCRVCUMaxChrgSOCSet "" VALUE 0x70011260 Scalar_FLOAT32_IEEE 0 VBU0513_CM_single -3.4E+38 3.4E+38 /end CHARACTERISTIC
/begin CHARACTERISTIC HALIn_facIgnOnThd_C "" VALUE 0x700112d8 Scalar_FLOAT32_IEEE 0 VBU0513_CM_single_fac -1000.0 1000.0 /end CHARACTERISTIC
/begin CHARACTERISTIC HALIn_vBrkSwtThold_C "" VALUE 0x700112dc Scalar_FLOAT32_IEEE 0 VBU0513_CM_single -3.4E+38 3.4E+38 /end CHARACTERISTIC
/begin CHARACTERISTIC HVBattCutOffOvrdVal_C "" VALUE 0x700112e0 Scalar_FLOAT32_IEEE 0 VBU0513_CM_single_cnt -3.4028234663852886E+38 3.4028234663852886E+38 /end CHARACTERISTIC
/begin CHARACTERISTIC INP_pVacPresCaliOvrdVal_C "" VALUE 0x70011304 Scalar_FLOAT32_IEEE 0 VBU0513_CM_single_bar 0.0 200.0 /end CHARACTERISTIC
/begin CHARACTERISTIC INP_tDCChPortTempCaliOvrdVal_C "" VALUE 0x70011308 Scalar_FLOAT32_IEEE 0 VBU0513_CM_single_C -100.0 200.0 /end CHARACTERISTIC
/begin CHARACTERISTIC INP_tDCChPortTempNegativeCaliOvrdVal_C "" VALUE 0x7001130c Scalar_FLOAT32_IEEE 0 VBU0513_CM_single_cnt -3.4E+38 3.4E+38 /end CHARACTERISTIC
/begin CHARACTERISTIC INP_tDCChPortTempNegativeSafetyVal_C "" VALUE 0x70011310 Scalar_FLOAT32_IEEE 0 VBU0513_CM_single_cnt -3.4E+38 3.4E+38 /end CHARACTERISTIC
/begin CHARACTERISTIC INP_tDCChPortTempSafetyVal_C "" VALUE 0x70011314 Scalar_FLOAT32_IEEE 0 VBU0513_CM_single_cnt -3.4E+38 3.4E+38 /end CHARACTERISTIC
/begin CHARACTERISTIC INP_tEDSOutTempCaliOvrdVal_C "" VALUE 0x70011318 Scalar_FLOAT32_IEEE 0 VBU0513_CM_single_cnt -3.4E+38 3.4E+38 /end CHARACTERISTIC
/begin CHARACTERISTIC INP_tEDSOutTempSafetyVal_C "" VALUE 0x7001131c Scalar_FLOAT32_IEEE 0 VBU0513_CM_single_cnt -3.4E+38 3.4E+38 /end CHARACTERISTIC
/begin CHARACTERISTIC INP_uAccPed1CaliOvrdVal_C "" VALUE 0x70011320 Scalar_FLOAT32_IEEE 0 VBU0513_CM_single_cnt 0.0 30.0 /end CHARACTERISTIC
/begin CHARACTERISTIC INP_uAccPed1RangeMax_C "" VALUE 0x70011324 Scalar_FLOAT32_IEEE 0 VBU0513_CM_single_cnt 0.0 30.0 /end CHARACTERISTIC
/begin CHARACTERISTIC INP_uAccPed1RangeMin_C "" VALUE 0x70011328 Scalar_FLOAT32_IEEE 0 VBU0513_CM_single_cnt 0.0 30.0 /end CHARACTERISTIC
/begin CHARACTERISTIC INP_uAccPed1SafetyVal_C "" VALUE 0x7001132c Scalar_FLOAT32_IEEE 0 VBU0513_CM_single_cnt 0.0 30.0 /end CHARACTERISTIC
/begin CHARACTERISTIC INP_uAccPed2CaliOvrdVal_C "" VALUE 0x70011330 Scalar_FLOAT32_IEEE 0 VBU0513_CM_single_cnt 0.0 30.0 /end CHARACTERISTIC
/begin CHARACTERISTIC INP_uAccPed2RangeMax_C "" VALUE 0x70011334 Scalar_FLOAT32_IEEE 0 VBU0513_CM_single_cnt 0.0 30.0 /end CHARACTERISTIC
/begin CHARACTERISTIC INP_uAccPed2RangeMin_C "" VALUE 0x70011338 Scalar_FLOAT32_IEEE 0 VBU0513_CM_single_cnt 0.0 30.0 /end CHARACTERISTIC
/begin CHARACTERISTIC INP_uAccPed2SafetyVal_C "" VALUE 0x7001133c Scalar_FLOAT32_IEEE 0 VBU0513_CM_single_cnt 0.0 30.0 /end CHARACTERISTIC
/begin CHARACTERISTIC INP_uBrkPresCaliOvrdVal_C "" VALUE 0x70011340 Scalar_FLOAT32_IEEE 0 VBU0513_CM_single_cnt 0.0 30.0 /end CHARACTERISTIC
/begin CHARACTERISTIC INP_uBrkPresRangeMax_C "" VALUE 0x70011344 Scalar_FLOAT32_IEEE 0 VBU0513_CM_single_cnt 0.0 30.0 /end CHARACTERISTIC
/begin CHARACTERISTIC INP_uBrkPresRangeMin_C "" VALUE 0x70011348 Scalar_FLOAT32_IEEE 0 VBU0513_CM_single_cnt 0.0 30.0 /end CHARACTERISTIC
/begin CHARACTERISTIC INP_uBrkPresSafetyVal_C "" VALUE 0x7001134c Scalar_FLOAT32_IEEE 0 VBU0513_CM_single_cnt -3.4E+38 3.4E+38 /end CHARACTERISTIC
/begin CHARACTERISTIC INP_uDCChCC2CaliOvrdVal_C "" VALUE 0x70011350 Scalar_FLOAT32_IEEE 0 VBU0513_CM_single_cnt 0.0 30.0 /end CHARACTERISTIC
/begin CHARACTERISTIC INP_uDCChCC2RangeMax_C "" VALUE 0x70011354 Scalar_FLOAT32_IEEE 0 VBU0513_CM_single_cnt 0.0 30.0 /end CHARACTERISTIC
/begin CHARACTERISTIC INP_uDCChCC2RangeMin_C "" VALUE 0x70011358 Scalar_FLOAT32_IEEE 0 VBU0513_CM_single_cnt 0.0 30.0 /end CHARACTERISTIC
/begin CHARACTERISTIC INP_uDCChCC2SafetyVal_C "" VALUE 0x7001135c Scalar_FLOAT32_IEEE 0 VBU0513_CM_single_cnt 0.0 30.0 /end CHARACTERISTIC
/begin CHARACTERISTIC INP_uDCChPortTempNegativeRangeMax_C "" VALUE 0x70011360 Scalar_FLOAT32_IEEE 0 VBU0513_CM_single_cnt 0.0 30.0 /end CHARACTERISTIC
/begin CHARACTERISTIC INP_uDCChPortTempNegativeRangeMin_C "" VALUE 0x70011364 Scalar_FLOAT32_IEEE 0 VBU0513_CM_single_cnt 0.0 30.0 /end CHARACTERISTIC
/begin CHARACTERISTIC INP_uDCChPortTempRangeMax_C "" VALUE 0x70011368 Scalar_FLOAT32_IEEE 0 VBU0513_CM_single_cnt 0.0 30.0 /end CHARACTERISTIC
/begin CHARACTERISTIC INP_uDCChPortTempRangeMin_C "" VALUE 0x7001136c Scalar_FLOAT32_IEEE 0 VBU0513_CM_single_cnt 0.0 30.0 /end CHARACTERISTIC
/begin CHARACTERISTIC INP_uEDSOutTempRangeMax_C "" VALUE 0x70011370 Scalar_FLOAT32_IEEE 0 VBU0513_CM_single_cnt 0.0 30.0 /end CHARACTERISTIC
/begin CHARACTERISTIC INP_uEDSOutTempRangeMin_C "" VALUE 0x70011374 Scalar_FLOAT32_IEEE 0 VBU0513_CM_single_cnt 0.0 30.0 /end CHARACTERISTIC
/begin CHARACTERISTIC INP_uVacPresRangeMax_C "" VALUE 0x70011378 Scalar_FLOAT32_IEEE 0 VBU0513_CM_single_mV 0.0 30.0 /end CHARACTERISTIC
/begin CHARACTERISTIC INP_uVacPresRangeMin_C "" VALUE 0x7001137c Scalar_FLOAT32_IEEE 0 VBU0513_CM_single_mV 0.0 30.0 /end CHARACTERISTIC
/begin CHARACTERISTIC INP_uVacPresSafetyVal_C "" VALUE 0x70011380 Scalar_FLOAT32_IEEE 0 VBU0513_CM_single_mV -3.4E+38 3.4E+38 /end CHARACTERISTIC
/begin CHARACTERISTIC LVC_uDCDCReqOvrdVal_C "" VALUE 0x700113d8 Scalar_FLOAT32_IEEE 0 VBU0513_CM_single_cnt -3.4028234663852886E+38 3.4028234663852886E+38 /end CHARACTERISTIC
/begin CHARACTERISTIC LowBatteryWarningOvrdVal_C "" VALUE 0x700113f4 Scalar_FLOAT32_IEEE 0 VBU0513_CM_single_cnt -3.4028234663852886E+38 3.4028234663852886E+38 /end CHARACTERISTIC
/begin CHARACTERISTIC ONE_HUNDRED_PERCENT "" VALUE 0x70011420 Scalar_FLOAT32_IEEE 0 VBU0513_CM_single_cnt 0.0 255.0 /end CHARACTERISTIC
/begin CHARACTERISTIC SOC_pctMaxSOCSet_C "" VALUE 0x700115fc Scalar_FLOAT32_IEEE 0 VBU0513_CM_single_cnt 0.0 100.0 /end CHARACTERISTIC
/begin CHARACTERISTIC SPD_vVehSpdOvrdVal_C "" VALUE 0x70011648 Scalar_FLOAT32_IEEE 0 VBU0513_CM_single_cnt -3.4028234663852886E+38 3.4028234663852886E+38 /end CHARACTERISTIC
/begin CHARACTERISTIC TQO_trqRMotrOvrdVal_C "" VALUE 0x70011900 Scalar_FLOAT32_IEEE 0 VBU0513_CM_single_cnt -3.4028234663852886E+38 3.4028234663852886E+38 /end CHARACTERISTIC
/begin CHARACTERISTIC VCUImdStopDrivingOvrdVal_C "" VALUE 0x70011908 Scalar_FLOAT32_IEEE 0 VBU0513_CM_single_cnt -3.4028234663852886E+38 3.4028234663852886E+38 /end CHARACTERISTIC
/begin CHARACTERISTIC VCURmvAcChgerOvrdVal_C "" VALUE 0x7001190c Scalar_FLOAT32_IEEE 0 VBU0513_CM_single_cnt -3.4028234663852886E+38 3.4028234663852886E+38 /end CHARACTERISTIC
/begin CHARACTERISTIC VehPwrLimdLampReqOvrdVal_C "" VALUE 0x700119b4 Scalar_FLOAT32_IEEE 0 VBU0513_CM_single_cnt -3.4028234663852886E+38 3.4028234663852886E+38 /end CHARACTERISTIC
/begin CHARACTERISTIC Veh_flgHVILOvrdVal_C "" VALUE 0x700119c0 Scalar_FLOAT32_IEEE 0 VBU0513_CM_single_cnt -3.4028234663852886E+38 3.4028234663852886E+38 /end CHARACTERISTIC
/begin CHARACTERISTIC CcBMM_AbnormalEventFlagLockTime_ms "" VALUE 0x7001054c Scalar_ULONG 0 VBU0513_CM_uint32_cnt 0.0 4.294967295E+9 /end CHARACTERISTIC
/begin CHARACTERISTIC CcISO_IsolationSeverseLimited_Kohm "" VALUE 0x70010790 Scalar_ULONG 0 VBU0513_CM_uint32_kohm 0.0 4.294967295E+9 /end CHARACTERISTIC
/begin CHARACTERISTIC CcISO_IsolationWarningLimited_Kohm "" VALUE 0x70010794 Scalar_ULONG 0 VBU0513_CM_uint32_kohm 0.0 4.294967295E+9 /end CHARACTERISTIC
/begin CHARACTERISTIC CcRTC_nbrRealtimeClockFIC "" VALUE 0x700107b8 Scalar_ULONG 0 VBU0513_CM_uint32_cnt 0.0 4.294967295E+9 /end CHARACTERISTIC
/begin CHARACTERISTIC CcRTC_nbrRealtimeClockPIC "" VALUE 0x700107bc Scalar_ULONG 0 VBU0513_CM_uint32_cnt 0.0 4.294967295E+9 /end CHARACTERISTIC
/begin CHARACTERISTIC VTestR "" VALUE 0x700119b0 Scalar_ULONG 0 VBU0513_CM_uint32 0 4294967295 /end CHARACTERISTIC
/begin CHARACTERISTIC BCV_BATTERY_OVER_CURRENT_FAULT "" VALUE 0x70010000 Scalar_UWORD 0 VBU0513_CM_uint16_cnt 0.0 330.0 /end CHARACTERISTIC
/begin CHARACTERISTIC BCV_BATTERY_OVER_VOLTAGE_FAULT "" VALUE 0x70010002 Scalar_UWORD 0 VBU0513_CM_uint16_cnt 0.0 330.0 /end CHARACTERISTIC
/begin CHARACTERISTIC BCV_BATTERY_OVER_VOLTAGE_WARNING_FAULT "" VALUE 0x70010004 Scalar_UWORD 0 VBU0513_CM_uint16_cnt 0.0 330.0 /end CHARACTERISTIC
/begin CHARACTERISTIC CTD_MAIN_NEGATIVE_CONTACTOR_WELD_FAULT "" VALUE 0x70010008 Scalar_UWORD 0 VBU0513_CM_uint16_cnt 0.0 330.0 /end CHARACTERISTIC
/begin CHARACTERISTIC CTD_MAIN_POSITIVE_CONTACTOR_WELD_FAULT "" VALUE 0x7001000a Scalar_UWORD 0 VBU0513_CM_uint16_cnt 0.0 330.0 /end CHARACTERISTIC
/begin CHARACTERISTIC CTD_PARKING_MAIN_NEGATIVE_CONTACTOR_STUCK_OPEN_FAULT "" VALUE 0x7001000c Scalar_UWORD 0 VBU0513_CM_uint16_cnt 0.0 330.0 /end CHARACTERISTIC
/begin CHARACTERISTIC CTD_PARKING_MAIN_POSITIVE_CONTACTOR_STUCK_OPEN_FAULT "" VALUE 0x7001000e Scalar_UWORD 0 VBU0513_CM_uint16_cnt 0.0 330.0 /end CHARACTERISTIC
/begin CHARACTERISTIC CTD_PRECHARGE_ENERGY_HIGH_FAULT "" VALUE 0x70010010 Scalar_UWORD 0 VBU0513_CM_uint16_cnt 0.0 330.0 /end CHARACTERISTIC
/begin CHARACTERISTIC CTD_PRECHARGE_RELAY_STUCK_OPEN_FAULT "" VALUE 0x70010012 Scalar_UWORD 0 VBU0513_CM_uint16_cnt 0.0 330.0 /end CHARACTERISTIC
/begin CHARACTERISTIC CTD_PRECHARGE_RESISTANCE_BLOWN_FAULT "" VALUE 0x70010014 Scalar_UWORD 0 VBU0513_CM_uint16_cnt 0.0 330.0 /end CHARACTERISTIC
/begin CHARACTERISTIC CTD_PRECHARG_TIMEOUT_FAULT "" VALUE 0x70010016 Scalar_UWORD 0 VBU0513_CM_uint16_cnt 0.0 330.0 /end CHARACTERISTIC
/begin CHARACTERISTIC CTM_CELL_OVER_TEMP_FAULT "" VALUE 0x7001001a Scalar_UWORD 0 VBU0513_CM_uint16_cnt 0.0 330.0 /end CHARACTERISTIC
/begin CHARACTERISTIC CVT_CELL_OVER_VOLTAGE_FAULT "" VALUE 0x70010024 Scalar_UWORD 0 VBU0513_CM_uint16_cnt 0.0 330.0 /end CHARACTERISTIC
/begin CHARACTERISTIC CVT_CELL_UNDER_VOLTAGE_FAULT "" VALUE 0x70010026 Scalar_UWORD 0 VBU0513_CM_uint16_cnt 0.0 330.0 /end CHARACTERISTIC
/begin CHARACTERISTIC CcBMM_CurrentStableDelayTime_ms "" VALUE 0x7001003a Scalar_UWORD 0 VBU0513_CM_uint16_cnt 0.0 65535.0 /end CHARACTERISTIC
/begin CHARACTERISTIC CcBMM_DeepSleepUploadTime_s "" VALUE 0x7001003c Scalar_UWORD 0 VBU0513_CM_uint16_cnt 0.0 65535.0 /end CHARACTERISTIC
/begin CHARACTERISTIC CcBMM_PeriodicalUploadTime_s "" VALUE 0x70010040 Scalar_UWORD 0 VBU0513_CM_uint16_cnt 0.0 65535.0 /end CHARACTERISTIC
/begin CHARACTERISTIC CcISO_BDMOutputDelayTime_ms "" VALUE 0x700100ae Scalar_UWORD 0 VBU0513_CM_uint16_ms 0.0 65535.0 /end CHARACTERISTIC
/begin CHARACTERISTIC CcISO_FaultReverseConfirmTime_ms "" VALUE 0x700100b2 Scalar_UWORD 0 VBU0513_CM_uint16_ms 0.0 65535.0 /end CHARACTERISTIC
/begin CHARACTERISTIC CcRTC_FastWakeUpCycle_min "" VALUE 0x700100b8 Scalar_UWORD 0 VBU0513_CM_uint16_cnt 0.0 65535.0 /end CHARACTERISTIC
/begin CHARACTERISTIC CcRTC_RTCWakeupLVBattDelay_min "" VALUE 0x0000 Scalar_UWORD 0 VBU0513_CM_uint16_cnt 0.0 65535.0 /end CHARACTERISTIC
/begin CHARACTERISTIC CcRTC_SlowWakeUpCycle_min "" VALUE 0x700100ba Scalar_UWORD 0 VBU0513_CM_uint16_cnt 0.0 65535.0 /end CHARACTERISTIC
/begin CHARACTERISTIC CcWRT_BatteryCapacityCycleORV_n "" VALUE 0x70010126 Scalar_UWORD 0 VBU0513_CM_uint16_cnt 0.0 65535.0 /end CHARACTERISTIC
/begin CHARACTERISTIC FCC_CHARGE_CURRENT_OVER_FAULT "" VALUE 0x7001012c Scalar_UWORD 0 VBU0513_CM_uint16_cnt 0.0 330.0 /end CHARACTERISTIC
/begin CHARACTERISTIC MILISECONDS_PER_SECOND "" VALUE 0x70010136 Scalar_UWORD 0 VBU0513_CM_uint16_cnt 0.0 65535.0 /end CHARACTERISTIC
/begin CHARACTERISTIC SAMPLE_TIME_TASK_A "" VALUE 0x7001013c Scalar_UWORD 0 VBU0513_CM_uint16_cnt 0.0 65535.0 /end CHARACTERISTIC
/begin CHARACTERISTIC SAMPLE_TIME_TASK_B "" VALUE 0x7001013e Scalar_UWORD 0 VBU0513_CM_uint16_cnt 0.0 65535.0 /end CHARACTERISTIC
/begin CHARACTERISTIC SOF_CHARGE_OVER_POWER_FAULT "" VALUE 0x7001014a Scalar_UWORD 0 VBU0513_CM_uint16_cnt 0.0 330.0 /end CHARACTERISTIC
/begin CHARACTERISTIC APO_ACOvrd_C "" VALUE 0x700209ac Scalar_BOOLEAN 0 VBU0513_CM_boolean_cnt 0.0 1.0 /end CHARACTERISTIC
/begin CHARACTERISTIC APO_ACPowerOvrd_C "" VALUE 0x700209ad Scalar_BOOLEAN 0 VBU0513_CM_boolean_cnt 0.0 1.0 /end CHARACTERISTIC
/begin CHARACTERISTIC APO_ACSpeedOvrd_C "" VALUE 0x700209ae Scalar_BOOLEAN 0 VBU0513_CM_boolean_cnt 0.0 1.0 /end CHARACTERISTIC
/begin CHARACTERISTIC APO_AyAccelerationOvrd_C "" VALUE 0x700209af Scalar_BOOLEAN 0 VBU0513_CM_boolean_cnt 0.0 1.0 /end CHARACTERISTIC
/begin CHARACTERISTIC APO_AzAccelerationOvrd_C "" VALUE 0x700209b0 Scalar_BOOLEAN 0 VBU0513_CM_boolean_cnt 0.0 1.0 /end CHARACTERISTIC
/begin CHARACTERISTIC APO_BrakWarningOvrd_C "" VALUE 0x700209b1 Scalar_BOOLEAN 0 VBU0513_CM_boolean_cnt 0.0 1.0 /end CHARACTERISTIC
/begin CHARACTERISTIC APO_BrkingWhileDrivingOvrd_C "" VALUE 0x700209b2 Scalar_BOOLEAN 0 VBU0513_CM_boolean_cnt 0.0 1.0 /end CHARACTERISTIC
/begin CHARACTERISTIC APO_CruiseStatusOvrd_C "" VALUE 0x700209b3 Scalar_BOOLEAN 0 VBU0513_CM_boolean_cnt 0.0 1.0 /end CHARACTERISTIC
/begin CHARACTERISTIC APO_EPBCtrlModeOvrd_C "" VALUE 0x700209b4 Scalar_BOOLEAN 0 VBU0513_CM_boolean_cnt 0.0 1.0 /end CHARACTERISTIC
/begin CHARACTERISTIC APO_EPFaultLevelWarningOvrd_C "" VALUE 0x700209b5 Scalar_BOOLEAN 0 VBU0513_CM_boolean_cnt 0.0 1.0 /end CHARACTERISTIC
/begin CHARACTERISTIC APO_HundredKmTripEnergyOvrd_C "" VALUE 0x700209b6 Scalar_BOOLEAN 0 VBU0513_CM_boolean_cnt 0.0 1.0 /end CHARACTERISTIC
/begin CHARACTERISTIC APO_LimpHomeOvrd_C "" VALUE 0x700209b7 Scalar_BOOLEAN 0 VBU0513_CM_boolean_cnt 0.0 1.0 /end CHARACTERISTIC
/begin CHARACTERISTIC APO_OverSpeedOvrd_C "" VALUE 0x700209b8 Scalar_BOOLEAN 0 VBU0513_CM_boolean_cnt 0.0 1.0 /end CHARACTERISTIC
/begin CHARACTERISTIC APO_PlsUSE750VDCOvrd_C "" VALUE 0x700209b9 Scalar_BOOLEAN 0 VBU0513_CM_boolean_cnt 0.0 1.0 /end CHARACTERISTIC
/begin CHARACTERISTIC APO_PowerModeOvrd_C "" VALUE 0x700209ba Scalar_BOOLEAN 0 VBU0513_CM_boolean_cnt 0.0 1.0 /end CHARACTERISTIC
/begin CHARACTERISTIC APO_RemainingChargingTimeOvrd_C "" VALUE 0x700209bb Scalar_BOOLEAN 0 VBU0513_CM_boolean_cnt 0.0 1.0 /end CHARACTERISTIC
/begin CHARACTERISTIC APO_RemainingDrivingRangeOvrd_C "" VALUE 0x700209bc Scalar_BOOLEAN 0 VBU0513_CM_boolean_cnt 0.0 1.0 /end CHARACTERISTIC
/begin CHARACTERISTIC APO_SOCLowWarningOvrd_C "" VALUE 0x700209bd Scalar_BOOLEAN 0 VBU0513_CM_boolean_cnt 0.0 1.0 /end CHARACTERISTIC
/begin CHARACTERISTIC APO_TenkmTripEnergyOvrd_C "" VALUE 0x700209be Scalar_BOOLEAN 0 VBU0513_CM_boolean_cnt 0.0 1.0 /end CHARACTERISTIC
/begin CHARACTERISTIC APO_TotalChargeEnergyOvrd_C "" VALUE 0x700209bf Scalar_BOOLEAN 0 VBU0513_CM_boolean_cnt 0.0 1.0 /end CHARACTERISTIC
/begin CHARACTERISTIC APO_TotalDischargeEnergyOvrd_C "" VALUE 0x700209c0 Scalar_BOOLEAN 0 VBU0513_CM_boolean_cnt 0.0 1.0 /end CHARACTERISTIC
/begin CHARACTERISTIC APO_VCURemainingRngOvrd_C "" VALUE 0x700209c1 Scalar_BOOLEAN 0 VBU0513_CM_boolean_cnt 0.0 1.0 /end CHARACTERISTIC
/begin CHARACTERISTIC APO_VehicleModeOvrd_C "" VALUE 0x700209c2 Scalar_BOOLEAN 0 VBU0513_CM_boolean_cnt 0.0 1.0 /end CHARACTERISTIC
/begin CHARACTERISTIC APO_YawrateOvrd_C "" VALUE 0x700209c3 Scalar_BOOLEAN 0 VBU0513_CM_boolean_cnt 0.0 1.0 /end CHARACTERISTIC
/begin CHARACTERISTIC APO_flgAccPedPosOvrd_C "" VALUE 0x700209ca Scalar_BOOLEAN 0 VBU0513_CM_boolean_cnt 0.0 1.0 /end CHARACTERISTIC
/begin CHARACTERISTIC APO_flgAxAccelerationOvrd_C "" VALUE 0x700209cb Scalar_BOOLEAN 0 VBU0513_CM_boolean_cnt 0.0 1.0 /end CHARACTERISTIC
/begin CHARACTERISTIC APO_flgBMSCellTempHighAlarmOvrd_C "" VALUE 0x700209d6 Scalar_BOOLEAN 0 VBU0513_CM_boolean_cnt 0.0 1.0 /end CHARACTERISTIC
/begin CHARACTERISTIC APO_flgBMSCellTempLowAlarmOvrd_C "" VALUE 0x700209d7 Scalar_BOOLEAN 0 VBU0513_CM_boolean_cnt 0.0 1.0 /end CHARACTERISTIC
/begin CHARACTERISTIC APO_flgBMSChargeStateOvrd_C "" VALUE 0x700209d8 Scalar_BOOLEAN 0 VBU0513_CM_boolean_flg 0.0 1.0 /end CHARACTERISTIC
/begin CHARACTERISTIC APO_flgBMSDIsplaySOCOvrd_C "" VALUE 0x700209d9 Scalar_BOOLEAN 0 VBU0513_CM_boolean_cnt 0.0 1.0 /end CHARACTERISTIC
/begin CHARACTERISTIC APO_flgBMSFaultLevelOvrd_C "" VALUE 0x700209da Scalar_BOOLEAN 0 VBU0513_CM_boolean_cnt 0.0 1.0 /end CHARACTERISTIC
/begin CHARACTERISTIC APO_flgBMSInletTempOvrd_C "" VALUE 0x700209db Scalar_BOOLEAN 0 VBU0513_CM_boolean_cnt 0.0 1.0 /end CHARACTERISTIC
/begin CHARACTERISTIC APO_flgBMSMainRelayStatusOvrd_C "" VALUE 0x700209dc Scalar_BOOLEAN 0 VBU0513_CM_boolean_cnt 0.0 1.0 /end CHARACTERISTIC
/begin CHARACTERISTIC APO_flgBMSOutletTempOvrd_C "" VALUE 0x700209dd Scalar_BOOLEAN 0 VBU0513_CM_boolean_cnt 0.0 1.0 /end CHARACTERISTIC
/begin CHARACTERISTIC APO_flgBMSPackCurrentOvrd_C "" VALUE 0x700209de Scalar_BOOLEAN 0 VBU0513_CM_boolean_cnt 0.0 1.0 /end CHARACTERISTIC
/begin CHARACTERISTIC APO_flgBMSPackVoltageOvrd_C "" VALUE 0x700209df Scalar_BOOLEAN 0 VBU0513_CM_boolean_cnt 0.0 1.0 /end CHARACTERISTIC
/begin CHARACTERISTIC APO_flgBMSSOCOvrd_C "" VALUE 0x700209e0 Scalar_BOOLEAN 0 VBU0513_CM_boolean_cnt 0.0 1.0 /end CHARACTERISTIC
/begin CHARACTERISTIC APO_flgBMSThermalRunawayOvrd_C "" VALUE 0x700209e1 Scalar_BOOLEAN 0 VBU0513_CM_boolean_cnt 0.0 1.0 /end CHARACTERISTIC
/begin CHARACTERISTIC APO_flgBattPackTempWarningOvrd_C "" VALUE 0x700209ec Scalar_BOOLEAN 0 VBU0513_CM_boolean_cnt 0.0 1.0 /end CHARACTERISTIC
/begin CHARACTERISTIC APO_flgBrkPressOvrd_C "" VALUE 0x700209ed Scalar_BOOLEAN 0 VBU0513_CM_boolean_cnt 0.0 1.0 /end CHARACTERISTIC
/begin CHARACTERISTIC APO_flgBrkSwtOvrd_C "" VALUE 0x700209ee Scalar_BOOLEAN 0 VBU0513_CM_boolean_cnt 0.0 1.0 /end CHARACTERISTIC
/begin CHARACTERISTIC APO_flgCellTempHighAlarmOvrdVal_C "" VALUE 0x700209ef Scalar_BOOLEAN 0 VBU0513_CM_boolean_cnt 0.0 1.0 /end CHARACTERISTIC
/begin CHARACTERISTIC APO_flgCellTempLowAlarmOvrdVal_C "" VALUE 0x700209f0 Scalar_BOOLEAN 0 VBU0513_CM_boolean_cnt 0.0 1.0 /end CHARACTERISTIC
/begin CHARACTERISTIC APO_flgEPBFaultOvrd_C "" VALUE 0x700209f3 Scalar_BOOLEAN 0 VBU0513_CM_boolean_cnt 0.0 1.0 /end CHARACTERISTIC
/begin CHARACTERISTIC APO_flgEPSFaultOvrd_C "" VALUE 0x700209f4 Scalar_BOOLEAN 0 VBU0513_CM_boolean_cnt 0.0 1.0 /end CHARACTERISTIC
/begin CHARACTERISTIC APO_flgEfcAccPdlOvrd_C "" VALUE 0x700209f5 Scalar_BOOLEAN 0 VBU0513_CM_boolean_cnt 0.0 1.0 /end CHARACTERISTIC
/begin CHARACTERISTIC APO_flgHVBattWarningOvrd_C "" VALUE 0x700209f7 Scalar_BOOLEAN 0 VBU0513_CM_boolean_cnt 0.0 1.0 /end CHARACTERISTIC
/begin CHARACTERISTIC APO_flgHVOnOvrd_C "" VALUE 0x700209f8 Scalar_BOOLEAN 0 VBU0513_CM_boolean_flg 0.0 1.0 /end CHARACTERISTIC
/begin CHARACTERISTIC APO_flgIsolutionWarningOvrd_C "" VALUE 0x700209fa Scalar_BOOLEAN 0 VBU0513_CM_boolean_cnt 0.0 1.0 /end CHARACTERISTIC
/begin CHARACTERISTIC APO_flgLVBattOvrd_C "" VALUE 0x700209fb Scalar_BOOLEAN 0 VBU0513_CM_boolean_cnt 0.0 1.0 /end CHARACTERISTIC
/begin CHARACTERISTIC CGW_flgVehDrvModeOvrd_C "" VALUE 0x70020a5b Scalar_BOOLEAN 0 VBU0513_CM_boolean_cnt 0.0 1.0 /end CHARACTERISTIC
/begin CHARACTERISTIC CGW_stVehRgnModeOvrd_C "" VALUE 0x70020a6b Scalar_BOOLEAN 0 VBU0513_CM_boolean_cnt 0.0 1.0 /end CHARACTERISTIC
/begin CHARACTERISTIC CHARGING_MODEOvrd_C "" VALUE 0x70020a7f Scalar_BOOLEAN 0 VBU0513_CM_boolean_cnt 0.0 1.0 /end CHARACTERISTIC
/begin CHARACTERISTIC CURRENT_REQUIREMENTOvrd_C "" VALUE 0x70020aa3 Scalar_BOOLEAN 0 VBU0513_CM_boolean_cnt 0.0 1.0 /end CHARACTERISTIC
/begin CHARACTERISTIC CaCSC_CellBalanceRequestORF_flg "" VAL_BLK 0x70020f4c Scalar_BOOLEAN 0 VBU0513_CM_boolean_cnt 0.0 1.0 NUMBER 198 /end CHARACTERISTIC
/begin CHARACTERISTIC CaCSC_CellBalanceRequestORV_flg "" VAL_BLK 0x70021012 Scalar_BOOLEAN 0 VBU0513_CM_boolean_cnt 0.0 1.0 NUMBER 198 /end CHARACTERISTIC
/begin CHARACTERISTIC CbBMM_AbnormalEventDetectedORF_flg "" VALUE 0x70020ac9 Scalar_BOOLEAN 0 VBU0513_CM_boolean_cnt 0.0 1.0 /end CHARACTERISTIC
/begin CHARACTERISTIC CbBMM_AbnormalEventDetectedORV_flg "" VALUE 0x70020aca Scalar_BOOLEAN 0 VBU0513_CM_boolean_cnt 0.0 1.0 /end CHARACTERISTIC
/begin CHARACTERISTIC CbBMM_AbnormalPowerOffOverride_flg "" VALUE 0x70020acb Scalar_BOOLEAN 0 VBU0513_CM_boolean_cnt 0.0 1.0 /end CHARACTERISTIC
/begin CHARACTERISTIC CbBMM_AbnormalResetOverride_flg "" VALUE 0x70020acc Scalar_BOOLEAN 0 VBU0513_CM_boolean_cnt 0.0 1.0 /end CHARACTERISTIC
/begin CHARACTERISTIC CbBMM_flgNVMReadCheckEnable_C "" VALUE 0x70020ad0 Scalar_BOOLEAN 0 VBU0513_CM_boolean_cnt 0.0 1.0 /end CHARACTERISTIC
/begin CHARACTERISTIC CbISO_IsolationSevere_flg "" VALUE 0x70020b0e Scalar_BOOLEAN 0 VBU0513_CM_boolean_flg 0.0 1.0 /end CHARACTERISTIC
/begin CHARACTERISTIC CbISO_IsolationWarning_flg "" VALUE 0x70020b0f Scalar_BOOLEAN 0 VBU0513_CM_boolean_flg 0.0 1.0 /end CHARACTERISTIC
/begin CHARACTERISTIC CbNVM_DataReadFaultEnable_flg "" VALUE 0x70020b10 Scalar_BOOLEAN 0 VBU0513_CM_boolean_cnt 0.0 1.0 /end CHARACTERISTIC
/begin CHARACTERISTIC CbNVM_DataWriteFaultEnable_flg "" VALUE 0x70020b11 Scalar_BOOLEAN 0 VBU0513_CM_boolean_cnt 0.0 1.0 /end CHARACTERISTIC
/begin CHARACTERISTIC CbNVM_EepromCrcCheckFaultEnable_flg "" VALUE 0x70020b12 Scalar_BOOLEAN 0 VBU0513_CM_boolean_cnt 0.0 1.0 /end CHARACTERISTIC
/begin CHARACTERISTIC CbRTC_ActualTimeInit_flg "" VALUE 0x70020b14 Scalar_BOOLEAN 0 VBU0513_CM_boolean_cnt 0.0 1.0 /end CHARACTERISTIC
/begin CHARACTERISTIC CbRTC_flgRealtimeClockFaultEnable "" VALUE 0x70020b16 Scalar_BOOLEAN 0 VBU0513_CM_boolean_cnt 0.0 1.0 /end CHARACTERISTIC
/begin CHARACTERISTIC CbSYS_flgAbnormalResetRecoverEnable "" VALUE 0x70020b2d Scalar_BOOLEAN 0 VBU0513_CM_boolean_cnt 0.0 1.0 /end CHARACTERISTIC
/begin CHARACTERISTIC CbWRT_BatteryCapacityCycleORF_flg "" VALUE 0x70020bc2 Scalar_BOOLEAN 0 VBU0513_CM_boolean_cnt 0.0 1.0 /end CHARACTERISTIC
/begin CHARACTERISTIC DCH_cBCPNrmCapOvrd_C "" VALUE 0x70020cae Scalar_BOOLEAN 0 VBU0513_CM_boolean_cnt 0.0 1.0 /end CHARACTERISTIC
/begin CHARACTERISTIC DCH_flgDSPLChStsOvrd_C "" VALUE 0x70020d0e Scalar_BOOLEAN 0 VBU0513_CM_boolean_cnt 0.0 1.0 /end CHARACTERISTIC
/begin CHARACTERISTIC DCH_iBCPMaxChCurrOvrd_C "" VALUE 0x70020d23 Scalar_BOOLEAN 0 VBU0513_CM_boolean_cnt 0.0 1.0 /end CHARACTERISTIC
/begin CHARACTERISTIC DCH_iBCSChCurrMeasureOvrd_C "" VALUE 0x70020d24 Scalar_BOOLEAN 0 VBU0513_CM_boolean_cnt 0.0 1.0 /end CHARACTERISTIC
/begin CHARACTERISTIC DCH_numBCSMaxCellVltgNumOvrd_C "" VALUE 0x70020d25 Scalar_BOOLEAN 0 VBU0513_CM_boolean_cnt 0.0 1.0 /end CHARACTERISTIC
/begin CHARACTERISTIC DCH_pctBCPSocOvrd_C "" VALUE 0x70020d34 Scalar_BOOLEAN 0 VBU0513_CM_boolean_cnt 0.0 1.0 /end CHARACTERISTIC
/begin CHARACTERISTIC DCH_pctBCSCurrSocOvrd_C "" VALUE 0x70020d35 Scalar_BOOLEAN 0 VBU0513_CM_boolean_cnt 0.0 1.0 /end CHARACTERISTIC
/begin CHARACTERISTIC DCH_tBCPMaxPermitTempOvrd_C "" VALUE 0x70020d8f Scalar_BOOLEAN 0 VBU0513_CM_boolean_cnt 0.0 1.0 /end CHARACTERISTIC
/begin CHARACTERISTIC DCH_tiBCSChNeedTOvrd_C "" VALUE 0x70020d90 Scalar_BOOLEAN 0 VBU0513_CM_boolean_cnt 0.0 1.0 /end CHARACTERISTIC
/begin CHARACTERISTIC DCH_uBCPBattVltgOvrd_C "" VALUE 0x70020d91 Scalar_BOOLEAN 0 VBU0513_CM_boolean_cnt 0.0 1.0 /end CHARACTERISTIC
/begin CHARACTERISTIC DCH_uBCPMaxCellVltgForChOvrd_C "" VALUE 0x70020d92 Scalar_BOOLEAN 0 VBU0513_CM_boolean_cnt 0.0 1.0 /end CHARACTERISTIC
/begin CHARACTERISTIC DCH_uBCPMaxVltgForChOvrd_C "" VALUE 0x70020d93 Scalar_BOOLEAN 0 VBU0513_CM_boolean_cnt 0.0 1.0 /end CHARACTERISTIC
/begin CHARACTERISTIC DCH_uBCSChVltgMeasureOvrd_C "" VALUE 0x70020d94 Scalar_BOOLEAN 0 VBU0513_CM_boolean_cnt 0.0 1.0 /end CHARACTERISTIC
/begin CHARACTERISTIC DCH_uBCSMaxCellVltgOvrd_C "" VALUE 0x70020d95 Scalar_BOOLEAN 0 VBU0513_CM_boolean_cnt 0.0 1.0 /end CHARACTERISTIC
/begin CHARACTERISTIC EDIS_flgCurrPwrOvrd_C "" VALUE 0x70020db1 Scalar_BOOLEAN 0 VBU0513_CM_boolean_cnt 0.0 1.0 /end CHARACTERISTIC
/begin CHARACTERISTIC Gear_flgEPBReqOvrd_C "" VALUE 0x70020df3 Scalar_BOOLEAN 0 VBU0513_CM_boolean_cnt 0.0 1.0 /end CHARACTERISTIC
/begin CHARACTERISTIC Gear_stCurrentGearDisplayOvrd_C "" VALUE 0x70020dfa Scalar_BOOLEAN 0 VBU0513_CM_boolean_cnt 0.0 1.0 /end CHARACTERISTIC
/begin CHARACTERISTIC HALIn_MotOverTempOvrdVal_C "" VALUE 0x70020e12 Scalar_BOOLEAN 0 VBU0513_CM_boolean_cnt 0.0 1.0 /end CHARACTERISTIC
/begin CHARACTERISTIC HALIn_flgMotOverTempOvrd_C "" VALUE 0x70020e13 Scalar_BOOLEAN 0 VBU0513_CM_boolean_cnt 0.0 1.0 /end CHARACTERISTIC
/begin CHARACTERISTIC HALOut_flgAccPed2VccEn_C "" VALUE 0x70020e14 Scalar_BOOLEAN 0 VBU0513_CM_boolean_flg 0.0 1.0 /end CHARACTERISTIC
/begin CHARACTERISTIC HALOut_flgAccPedlVccEn_C "" VALUE 0x70020e15 Scalar_BOOLEAN 0 VBU0513_CM_boolean_flg 0.0 1.0 /end CHARACTERISTIC
/begin CHARACTERISTIC HALOut_flgBekPressVccEn_C "" VALUE 0x70020e16 Scalar_BOOLEAN 0 VBU0513_CM_boolean_flg 0.0 1.0 /end CHARACTERISTIC
/begin CHARACTERISTIC HALOut_flgVcuumPumpVccEn_C "" VALUE 0x70020e17 Scalar_BOOLEAN 0 VBU0513_CM_boolean_flg 0.0 1.0 /end CHARACTERISTIC
/begin CHARACTERISTIC HVBattCutOffOvrd_C "" VALUE 0x70020e19 Scalar_BOOLEAN 0 VBU0513_CM_boolean_cnt 0.0 1.0 /end CHARACTERISTIC
/begin CHARACTERISTIC INP_flgAccPed1CaliOvrd_C "" VALUE 0x70020e1c Scalar_BOOLEAN 0 VBU0513_CM_boolean_cnt 0.0 1.0 /end CHARACTERISTIC
/begin CHARACTERISTIC INP_flgAccPed1SafetyEnable_C "" VALUE 0x70020e1d Scalar_BOOLEAN 0 VBU0513_CM_boolean_cnt 0.0 1.0 /end CHARACTERISTIC
/begin CHARACTERISTIC INP_flgAccPed2CaliOvrd_C "" VALUE 0x70020e1e Scalar_BOOLEAN 0 VBU0513_CM_boolean_cnt 0.0 1.0 /end CHARACTERISTIC
/begin CHARACTERISTIC INP_flgAccPed2SafetyEnable_C "" VALUE 0x70020e1f Scalar_BOOLEAN 0 VBU0513_CM_boolean_cnt 0.0 1.0 /end CHARACTERISTIC
/begin CHARACTERISTIC INP_flgBrkPresCaliOvrd_C "" VALUE 0x70020e20 Scalar_BOOLEAN 0 VBU0513_CM_boolean_cnt 0.0 1.0 /end CHARACTERISTIC
/begin CHARACTERISTIC INP_flgBrkPresSafetyEnable_C "" VALUE 0x70020e21 Scalar_BOOLEAN 0 VBU0513_CM_boolean_cnt 0.0 1.0 /end CHARACTERISTIC
/begin CHARACTERISTIC INP_flgDCChCC2CaliOvrd_C "" VALUE 0x70020e22 Scalar_BOOLEAN 0 VBU0513_CM_boolean_cnt 0.0 1.0 /end CHARACTERISTIC
/begin CHARACTERISTIC INP_flgDCChCC2SafetyEnable_C "" VALUE 0x70020e23 Scalar_BOOLEAN 0 VBU0513_CM_boolean_cnt 0.0 1.0 /end CHARACTERISTIC
/begin CHARACTERISTIC INP_flgDCChPortTempCaliOvrd_C "" VALUE 0x70020e24 Scalar_BOOLEAN 0 VBU0513_CM_boolean_C 0.0 1.0 /end CHARACTERISTIC
/begin CHARACTERISTIC INP_flgDCChPortTempNegativeCaliOvrd_C "" VALUE 0x70020e25 Scalar_BOOLEAN 0 VBU0513_CM_boolean_cnt 0.0 1.0 /end CHARACTERISTIC
/begin CHARACTERISTIC INP_flgDCChPortTempNegativeSafetyEnable_C "" VALUE 0x70020e26 Scalar_BOOLEAN 0 VBU0513_CM_boolean_cnt 0.0 1.0 /end CHARACTERISTIC
/begin CHARACTERISTIC INP_flgDCChPortTempSafetyEnable_C "" VALUE 0x70020e27 Scalar_BOOLEAN 0 VBU0513_CM_boolean_cnt 0.0 1.0 /end CHARACTERISTIC
/begin CHARACTERISTIC INP_flgEDSOutTempCaliOvrd_C "" VALUE 0x70020e28 Scalar_BOOLEAN 0 VBU0513_CM_boolean_cnt 0.0 1.0 /end CHARACTERISTIC
/begin CHARACTERISTIC INP_flgEDSOutTempSafetyEnable_C "" VALUE 0x70020e29 Scalar_BOOLEAN 0 VBU0513_CM_boolean_cnt 0.0 1.0 /end CHARACTERISTIC
/begin CHARACTERISTIC INP_flgVacPresCaliOvrd_C "" VALUE 0x70020e2a Scalar_BOOLEAN 0 VBU0513_CM_boolean_cnt 0.0 1.0 /end CHARACTERISTIC
/begin CHARACTERISTIC INP_flgVacPresSafetyEnable_C "" VALUE 0x70020e2b Scalar_BOOLEAN 0 VBU0513_CM_boolean_cnt 0.0 1.0 /end CHARACTERISTIC
/begin CHARACTERISTIC LVC_flgDCDCReqOvrd_C "" VALUE 0x70020e47 Scalar_BOOLEAN 0 VBU0513_CM_boolean_cnt 0.0 1.0 /end CHARACTERISTIC
/begin CHARACTERISTIC LVC_flgDcdcCtrlReqOvrdVal_C "" VALUE 0x70020e48 Scalar_BOOLEAN 0 VBU0513_CM_boolean_cnt 0.0 1.0 /end CHARACTERISTIC
/begin CHARACTERISTIC LVC_flgDcdcCtrlReqOvrd_C "" VALUE 0x70020e49 Scalar_BOOLEAN 0 VBU0513_CM_boolean_cnt 0.0 1.0 /end CHARACTERISTIC
/begin CHARACTERISTIC LowBatteryWarningOvrd_C "" VALUE 0x70020e4f Scalar_BOOLEAN 0 VBU0513_CM_boolean_cnt 0.0 1.0 /end CHARACTERISTIC
/begin CHARACTERISTIC MotorFaultLevelOvrdVal_C "" VALUE 0x70020e68 Scalar_BOOLEAN 0 VBU0513_CM_boolean_cnt 0.0 1.0 /end CHARACTERISTIC
/begin CHARACTERISTIC MotorFaultLevelOvrd_C "" VALUE 0x70020e69 Scalar_BOOLEAN 0 VBU0513_CM_boolean_cnt 0.0 1.0 /end CHARACTERISTIC
/begin CHARACTERISTIC OUTP_flgDCRelayStatusORF "" VALUE 0x70020e72 Scalar_BOOLEAN 0 VBU0513_CM_boolean 0 1 /end CHARACTERISTIC
/begin CHARACTERISTIC OUTP_flgDCRelayStatusORFV "" VALUE 0x70020e73 Scalar_BOOLEAN 0 VBU0513_CM_boolean 0 1 /end CHARACTERISTIC
/begin CHARACTERISTIC PMM_flgRMCUActvDisChReqOvrdVal_C "" VALUE 0x70020e88 Scalar_BOOLEAN 0 VBU0513_CM_boolean_cnt 0.0 1.0 /end CHARACTERISTIC
/begin CHARACTERISTIC PMM_flgRMCUActvDisChReqOvrd_C "" VALUE 0x70020e89 Scalar_BOOLEAN 0 VBU0513_CM_boolean_cnt 0.0 1.0 /end CHARACTERISTIC
/begin CHARACTERISTIC PMM_flgVehRdyOvrdVal_C "" VALUE 0x70020e93 Scalar_BOOLEAN 0 VBU0513_CM_boolean_cnt 0.0 1.0 /end CHARACTERISTIC
/begin CHARACTERISTIC PMM_flgVehRdyOvrd_C "" VALUE 0x70020e94 Scalar_BOOLEAN 0 VBU0513_CM_boolean_cnt 0.0 1.0 /end CHARACTERISTIC
/begin CHARACTERISTIC SPD_vVehSpdOvrd_C "" VALUE 0x70020ed5 Scalar_BOOLEAN 0 VBU0513_CM_boolean_cnt 0.0 1.0 /end CHARACTERISTIC
/begin CHARACTERISTIC TQO_flgCtrlRMotrOvrd_C "" VALUE 0x70020f07 Scalar_BOOLEAN 0 VBU0513_CM_boolean_cnt 0.0 1.0 /end CHARACTERISTIC
/begin CHARACTERISTIC TQO_trqRMotrOvrd_C "" VALUE 0x70020f09 Scalar_BOOLEAN 0 VBU0513_CM_boolean_cnt 0.0 1.0 /end CHARACTERISTIC
/begin CHARACTERISTIC VCUImdStopDrivingOvrd_C "" VALUE 0x70020f10 Scalar_BOOLEAN 0 VBU0513_CM_boolean_cnt 0.0 1.0 /end CHARACTERISTIC
/begin CHARACTERISTIC VCURmvAcChgerOvrd_C "" VALUE 0x70020f11 Scalar_BOOLEAN 0 VBU0513_CM_boolean_cnt 0.0 1.0 /end CHARACTERISTIC
/begin CHARACTERISTIC VM_flgVehLimActvOvrdVal_C "" VALUE 0x70020f13 Scalar_BOOLEAN 0 VBU0513_CM_boolean_cnt 0.0 1.0 /end CHARACTERISTIC
/begin CHARACTERISTIC VM_flgVehLimActvOvrd_C "" VALUE 0x70020f14 Scalar_BOOLEAN 0 VBU0513_CM_boolean_cnt 0.0 1.0 /end CHARACTERISTIC
/begin CHARACTERISTIC VOLTAGE_REQUIREMENTOvrd_C "" VALUE 0x70020f1c Scalar_BOOLEAN 0 VBU0513_CM_boolean_cnt 0.0 1.0 /end CHARACTERISTIC
/begin CHARACTERISTIC VehPwrLimdLampReqOvrd_C "" VALUE 0x70020f21 Scalar_BOOLEAN 0 VBU0513_CM_boolean_cnt 0.0 1.0 /end CHARACTERISTIC
/begin CHARACTERISTIC Veh_flgHVILOvrd_C "" VALUE 0x70020f24 Scalar_BOOLEAN 0 VBU0513_CM_boolean_cnt 0.0 1.0 /end CHARACTERISTIC
/begin CHARACTERISTIC CcISO_IsolationSevereFaultFIC_n "" VALUE 0x70020c35 Scalar_BYTE 0 VBU0513_CM_int8_n -128.0 127.0 /end CHARACTERISTIC
/begin CHARACTERISTIC CcISO_IsolationSevereFaultPIC_n "" VALUE 0x70020c36 Scalar_BYTE 0 VBU0513_CM_int8_n -128.0 127.0 /end CHARACTERISTIC
/begin CHARACTERISTIC CcISO_IsolationWarningFaultFIC_n "" VALUE 0x70020c37 Scalar_BYTE 0 VBU0513_CM_int8_n -128.0 127.0 /end CHARACTERISTIC
/begin CHARACTERISTIC CcISO_IsolationWarningFaultPIC_n "" VALUE 0x70020c38 Scalar_BYTE 0 VBU0513_CM_int8_n -128.0 127.0 /end CHARACTERISTIC
/begin CHARACTERISTIC CcNVM_DataReadFIC_n "" VALUE 0x70020c39 Scalar_BYTE 0 VBU0513_CM_int8_cnt -128.0 127.0 /end CHARACTERISTIC
/begin CHARACTERISTIC CcNVM_DataReadPIC_n "" VALUE 0x70020c3a Scalar_BYTE 0 VBU0513_CM_int8_cnt -128.0 127.0 /end CHARACTERISTIC
/begin CHARACTERISTIC CcNVM_DataWriteFIC_n "" VALUE 0x0000 Scalar_BYTE 0 VBU0513_CM_int8_cnt -128.0 127.0 /end CHARACTERISTIC
/begin CHARACTERISTIC CcNVM_DataWritePIC_n "" VALUE 0x70020c3b Scalar_BYTE 0 VBU0513_CM_int8_cnt -128.0 127.0 /end CHARACTERISTIC
/begin CHARACTERISTIC CcNVM_EepromCrcCheckFIC_n "" VALUE 0x70020c3c Scalar_BYTE 0 VBU0513_CM_int8_cnt -128.0 127.0 /end CHARACTERISTIC
/begin CHARACTERISTIC CcNVM_EepromCrcCheckPIC_n "" VALUE 0x70020c3d Scalar_BYTE 0 VBU0513_CM_int8_cnt -128.0 127.0 /end CHARACTERISTIC
/begin CHARACTERISTIC APO_stBMSChargeStateOvrdVal_C "" VALUE 0x70020a07 Scalar_UBYTE 0 VBU0513_CM_uint8_cnt 0.0 255.0 /end CHARACTERISTIC
/begin CHARACTERISTIC APO_stBMSFaultLevelOvrdVal_C "" VALUE 0x70020a08 Scalar_UBYTE 0 VBU0513_CM_uint8_cnt 0.0 255.0 /end CHARACTERISTIC
/begin CHARACTERISTIC APO_stBMSMainRelayStatusOvrdVal_C "" VALUE 0x70020a09 Scalar_UBYTE 0 VBU0513_CM_uint8_cnt 0.0 255.0 /end CHARACTERISTIC
/begin CHARACTERISTIC APO_stBattPackTempWarningOvrdVal_C "" VALUE 0x70020a0a Scalar_UBYTE 0 VBU0513_CM_uint8_cnt 0.0 255.0 /end CHARACTERISTIC
/begin CHARACTERISTIC APO_stHVBattWarningOvrdVal_C "" VALUE 0x70020a0b Scalar_UBYTE 0 VBU0513_CM_uint8_cnt 0.0 255.0 /end CHARACTERISTIC
/begin CHARACTERISTIC APO_stHVOnOvrdVal_C "" VALUE 0x70020a0c Scalar_UBYTE 0 VBU0513_CM_uint8_cnt 0.0 255.0 /end CHARACTERISTIC
/begin CHARACTERISTIC APO_stIsolutionWarningOvrdVal_C "" VALUE 0x70020a0d Scalar_UBYTE 0 VBU0513_CM_uint8_cnt 0.0 255.0 /end CHARACTERISTIC
/begin CHARACTERISTIC BMM_BMU_POWEROFF_NORMAL "" VALUE 0x70020a2a Scalar_UBYTE 0 VBU0513_CM_uint8_cnt 0.0 255.0 /end CHARACTERISTIC
/begin CHARACTERISTIC BMM_BMU_RESET_NONE "" VALUE 0x70020a2b Scalar_UBYTE 0 VBU0513_CM_uint8_cnt 0.0 255.0 /end CHARACTERISTIC
/begin CHARACTERISTIC BMM_STATE_AFTER_RUN "" VALUE 0x70020a2c Scalar_UBYTE 0 VBU0513_CM_uint8_cnt 0.0 255.0 /end CHARACTERISTIC
/begin CHARACTERISTIC BMM_STATE_DRIVE_MODE "" VALUE 0x70020a2d Scalar_UBYTE 0 VBU0513_CM_uint8_cnt 0.0 255.0 /end CHARACTERISTIC
/begin CHARACTERISTIC BMM_STATE_FAST_CHARGE "" VALUE 0x70020a2e Scalar_UBYTE 0 VBU0513_CM_uint8_cnt 0.0 255.0 /end CHARACTERISTIC
/begin CHARACTERISTIC BMM_STATE_IDLE "" VALUE 0x70020a2f Scalar_UBYTE 0 VBU0513_CM_uint8_cnt 0.0 255.0 /end CHARACTERISTIC
/begin CHARACTERISTIC BMM_STATE_INITIALIZATION "" VALUE 0x70020a30 Scalar_UBYTE 0 VBU0513_CM_uint8_cnt 0.0 255.0 /end CHARACTERISTIC
/begin CHARACTERISTIC BMM_STATE_ONBOARD_CHARGE "" VALUE 0x70020a31 Scalar_UBYTE 0 VBU0513_CM_uint8_cnt 0.0 255.0 /end CHARACTERISTIC
/begin CHARACTERISTIC BMM_STATE_RTC "" VALUE 0x70020a33 Scalar_UBYTE 0 VBU0513_CM_uint8_cnt 0.0 255.0 /end CHARACTERISTIC
/begin CHARACTERISTIC BMM_STATE_SHUT_DOWN "" VALUE 0x70020a34 Scalar_UBYTE 0 VBU0513_CM_uint8_cnt 0.0 255.0 /end CHARACTERISTIC
/begin CHARACTERISTIC CGW_stVehDrvModeOvrdVal_C "" VALUE 0x70020a65 Scalar_UBYTE 0 VBU0513_CM_uint8_cnt 0.0 255.0 /end CHARACTERISTIC
/begin CHARACTERISTIC CGW_stVehRgnModeOvrdVal_C "" VALUE 0x70020a6a Scalar_UBYTE 0 VBU0513_CM_uint8_cnt 0.0 255.0 /end CHARACTERISTIC
/begin CHARACTERISTIC CHARGING_MODEOvrdVal_C "" VALUE 0x70020a7e Scalar_UBYTE 0 VBU0513_CM_uint8_cnt 0.0 255.0 /end CHARACTERISTIC
/begin CHARACTERISTIC CTD_MAIN_CONTACTOR_STATUS_CLOSED "" VALUE 0x70020a84 Scalar_UBYTE 0 VBU0513_CM_uint8_cnt 0.0 255.0 /end CHARACTERISTIC
/begin CHARACTERISTIC CTD_MAIN_CONTACTOR_STATUS_OPENED "" VALUE 0x70020a85 Scalar_UBYTE 0 VBU0513_CM_uint8_cnt 0.0 255.0 /end CHARACTERISTIC
/begin CHARACTERISTIC CURRENT_REQUIREMENTOvrdVal_C "" VALUE 0x70020aa2 Scalar_UBYTE 0 VBU0513_CM_uint8_cnt 0.0 255.0 /end CHARACTERISTIC
/begin CHARACTERISTIC CYCLE_WAKEUP_STATE_PERIODICAL_UPLOAD "" VALUE 0x70020aa7 Scalar_UBYTE 0 VBU0513_CM_uint8_cnt 0.0 255.0 /end CHARACTERISTIC
/begin CHARACTERISTIC CcISO_AllowableIsolationWarningTimes_n "" VALUE 0x70020c34 Scalar_UBYTE 0 VBU0513_CM_uint8_n 0.0 255.0 /end CHARACTERISTIC
/begin CHARACTERISTIC DCH_stDSPLChStsOvrdVal_C "" VALUE 0x70020d5e Scalar_UBYTE 0 VBU0513_CM_uint8_cnt 0.0 255.0 /end CHARACTERISTIC
/begin CHARACTERISTIC DSM_FDCFaultStatus_C "" VAL_BLK 0x70021600 Scalar_UBYTE 0 VBU0513_CM_uint8_cnt 0.0 1.0 NUMBER 330 /end CHARACTERISTIC
/begin CHARACTERISTIC Gear_stCurrentGearDisplayOvrdVal_C "" VALUE 0x70020df9 Scalar_UBYTE 0 VBU0513_CM_uint8_cnt 0.0 255.0 /end CHARACTERISTIC
/begin CHARACTERISTIC Gear_stEPBReqOvrdVal_C "" VALUE 0x70020e07 Scalar_UBYTE 0 VBU0513_CM_uint8_cnt 0.0 255.0 /end CHARACTERISTIC
/begin CHARACTERISTIC INP_numAccPed1CounterLim_C "" VALUE 0x70020e2c Scalar_UBYTE 0 VBU0513_CM_uint8_cnt 0.0 100.0 /end CHARACTERISTIC
/begin CHARACTERISTIC INP_numAccPed1DecCounter_C "" VALUE 0x70020e2d Scalar_UBYTE 0 VBU0513_CM_uint8_cnt 0.0 100.0 /end CHARACTERISTIC
/begin CHARACTERISTIC INP_numAccPed1IncCounter_C "" VALUE 0x70020e2e Scalar_UBYTE 0 VBU0513_CM_uint8_cnt 0.0 100.0 /end CHARACTERISTIC
/begin CHARACTERISTIC INP_numAccPed2CounterLim_C "" VALUE 0x70020e2f Scalar_UBYTE 0 VBU0513_CM_uint8_cnt 0.0 100.0 /end CHARACTERISTIC
/begin CHARACTERISTIC INP_numAccPed2DecCounter_C "" VALUE 0x70020e30 Scalar_UBYTE 0 VBU0513_CM_uint8_cnt 0.0 100.0 /end CHARACTERISTIC
/begin CHARACTERISTIC INP_numAccPed2IncCounter_C "" VALUE 0x70020e31 Scalar_UBYTE 0 VBU0513_CM_uint8_cnt 0.0 100.0 /end CHARACTERISTIC
/begin CHARACTERISTIC INP_numBrkPresCounterLim_C "" VALUE 0x70020e32 Scalar_UBYTE 0 VBU0513_CM_uint8_cnt 0.0 100.0 /end CHARACTERISTIC
/begin CHARACTERISTIC INP_numBrkPresDecCounter_C "" VALUE 0x70020e33 Scalar_UBYTE 0 VBU0513_CM_uint8_cnt 0.0 100.0 /end CHARACTERISTIC
/begin CHARACTERISTIC INP_numBrkPresIncCounter_C "" VALUE 0x70020e34 Scalar_UBYTE 0 VBU0513_CM_uint8_cnt 0.0 100.0 /end CHARACTERISTIC
/begin CHARACTERISTIC INP_numDCChCC2CounterLim_C "" VALUE 0x70020e35 Scalar_UBYTE 0 VBU0513_CM_uint8_cnt 0.0 100.0 /end CHARACTERISTIC
/begin CHARACTERISTIC INP_numDCChCC2DecCounter_C "" VALUE 0x70020e36 Scalar_UBYTE 0 VBU0513_CM_uint8_cnt 0.0 100.0 /end CHARACTERISTIC
/begin CHARACTERISTIC INP_numDCChCC2IncCounter_C "" VALUE 0x70020e37 Scalar_UBYTE 0 VBU0513_CM_uint8_cnt 0.0 100.0 /end CHARACTERISTIC
/begin CHARACTERISTIC INP_numDCChPortTempCounterLim_C "" VALUE 0x70020e38 Scalar_UBYTE 0 VBU0513_CM_uint8_cnt 0.0 100.0 /end CHARACTERISTIC
/begin CHARACTERISTIC INP_numDCChPortTempDecCounter_C "" VALUE 0x70020e39 Scalar_UBYTE 0 VBU0513_CM_uint8_cnt 0.0 100.0 /end CHARACTERISTIC
/begin CHARACTERISTIC INP_numDCChPortTempIncCounter_C "" VALUE 0x70020e3a Scalar_UBYTE 0 VBU0513_CM_uint8_cnt 0.0 100.0 /end CHARACTERISTIC
/begin CHARACTERISTIC INP_numDCChPortTempNegativeCounterLim_C "" VALUE 0x70020e3b Scalar_UBYTE 0 VBU0513_CM_uint8_cnt 0.0 100.0 /end CHARACTERISTIC
/begin CHARACTERISTIC INP_numDCChPortTempNegativeDecCounter_C "" VALUE 0x70020e3c Scalar_UBYTE 0 VBU0513_CM_uint8_cnt 0.0 100.0 /end CHARACTERISTIC
/begin CHARACTERISTIC INP_numDCChPortTempNegativeIncCounter_C "" VALUE 0x70020e3d Scalar_UBYTE 0 VBU0513_CM_uint8_cnt 0.0 100.0 /end CHARACTERISTIC
/begin CHARACTERISTIC INP_numEDSOutTempCounterLim_C "" VALUE 0x70020e3e Scalar_UBYTE 0 VBU0513_CM_uint8_cnt 0.0 100.0 /end CHARACTERISTIC
/begin CHARACTERISTIC INP_numEDSOutTempDecCounter_C "" VALUE 0x70020e3f Scalar_UBYTE 0 VBU0513_CM_uint8_cnt 0.0 100.0 /end CHARACTERISTIC
/begin CHARACTERISTIC INP_numEDSOutTempIncCounter_C "" VALUE 0x70020e40 Scalar_UBYTE 0 VBU0513_CM_uint8_cnt 0.0 100.0 /end CHARACTERISTIC
/begin CHARACTERISTIC INP_numVacPresCounterLim_C "" VALUE 0x70020e41 Scalar_UBYTE 0 VBU0513_CM_uint8_cnt 0.0 100.0 /end CHARACTERISTIC
/begin CHARACTERISTIC INP_numVacPresDecCounter_C "" VALUE 0x70020e42 Scalar_UBYTE 0 VBU0513_CM_uint8_cnt 0.0 100.0 /end CHARACTERISTIC
/begin CHARACTERISTIC INP_numVacPresIncCounter_C "" VALUE 0x70020e43 Scalar_UBYTE 0 VBU0513_CM_uint8_cnt 0.0 100.0 /end CHARACTERISTIC
/begin CHARACTERISTIC ISO_ISOLATION_SEVERE_FAULT "" VALUE 0x70020e44 Scalar_UBYTE 0 VBU0513_CM_uint8_n 0.0 255.0 /end CHARACTERISTIC
/begin CHARACTERISTIC ISO_ISOLATION_WARNING_FAULT "" VALUE 0x70020e45 Scalar_UBYTE 0 VBU0513_CM_uint8_n 0.0 255.0 /end CHARACTERISTIC
/begin CHARACTERISTIC NVM_DATA_READ_FAULT "" VALUE 0x70020e6c Scalar_UBYTE 0 VBU0513_CM_uint8_cnt 0.0 255.0 /end CHARACTERISTIC
/begin CHARACTERISTIC NVM_DATA_WRITE_FAULT "" VALUE 0x70020e6d Scalar_UBYTE 0 VBU0513_CM_uint8_cnt 0.0 255.0 /end CHARACTERISTIC
/begin CHARACTERISTIC NVM_EEPROM_CRC_CHECK_FAULT "" VALUE 0x70020e6e Scalar_UBYTE 0 VBU0513_CM_uint8_cnt 0.0 255.0 /end CHARACTERISTIC
/begin CHARACTERISTIC NVM_READ_CRC_FAIL "" VALUE 0x70020e6f Scalar_UBYTE 0 VBU0513_CM_uint8_cnt 0.0 255.0 /end CHARACTERISTIC
/begin CHARACTERISTIC NVM_READ_HARDWARE_FAIL "" VALUE 0x70020e70 Scalar_UBYTE 0 VBU0513_CM_uint8_cnt 0.0 255.0 /end CHARACTERISTIC
/begin CHARACTERISTIC PMM_stDCChMode_SY "" VALUE 0x70020e9c Scalar_UBYTE 0 VBU0513_CM_uint8_cnt 0.0 255.0 /end CHARACTERISTIC
/begin CHARACTERISTIC RTC_REALTIME_CLOCK_FAULT "" VALUE 0x70020ec0 Scalar_UBYTE 0 VBU0513_CM_uint8_cnt 0.0 255.0 /end CHARACTERISTIC
/begin CHARACTERISTIC TQO_stCtrlRMotrOvrdVal_C "" VALUE 0x70020f08 Scalar_UBYTE 0 VBU0513_CM_uint8_cnt 0.0 255.0 /end CHARACTERISTIC
/begin CHARACTERISTIC VOLTAGE_REQUIREMENTOvrdVal_C "" VALUE 0x70020f1b Scalar_UBYTE 0 VBU0513_CM_uint8_cnt 0.0 255.0 /end CHARACTERISTIC
/begin MEASUREMENT VTestW "" ULONG VBU0513_CM_uint32 0 0 0 4294967295 ECU_ADDRESS 0x90002536 /end MEASUREMENT
/begin MEASUREMENT W3_Test "" ULONG VBU0513_CM_uint32 0 0 0 4294967295 ECU_ADDRESS 0x9000253a /end MEASUREMENT
/begin MEASUREMENT R3_test "" ULONG VBU0513_CM_uint32 0 0 0 4294967295 ECU_ADDRESS 0x9000246a /end MEASUREMENT
/begin MEASUREMENT WRT_numOpenContactorWithLoadTimes1 "" ULONG VBU0513_CM_uint32 0 0 0 4294967295 ECU_ADDRESS 0x90002232 /end MEASUREMENT
/begin MEASUREMENT WRT_numOpenContactorWithLoadTimes2 "" ULONG VBU0513_CM_uint32 0 0 0 4294967295 ECU_ADDRESS 0x90002236 /end MEASUREMENT
/begin MEASUREMENT INP_uLVBatt "" FLOAT32_IEEE VBU0513_CM_single 0 0 0.0 28.0 ECU_ADDRESS 0x90001ef6 /end MEASUREMENT
/begin MEASUREMENT TQC_TrqDes "" FLOAT32_IEEE VBU0513_CM_single 0 0 -9000.0 9000.0 ECU_ADDRESS 0x9000203a /end MEASUREMENT
/begin MEASUREMENT WRT_numBatteryCapacityCycle "" FLOAT32_IEEE VBU0513_CM_single 0 0 -3.4E+38 3.4E+38 ECU_ADDRESS 0x9000222e /end MEASUREMENT
/begin MEASUREMENT WRT_AhOverallDischarged "" FLOAT32_IEEE VBU0513_CM_single 0 0 -3.4E+38 3.4E+38 ECU_ADDRESS 0x90002226 /end MEASUREMENT
/begin MEASUREMENT WRT_AhOverallFastcharged "" FLOAT32_IEEE VBU0513_CM_single 0 0 -3.4E+38 3.4E+38 ECU_ADDRESS 0x9000222a /end MEASUREMENT
/begin MEASUREMENT CellTemp1 "" FLOAT32_IEEE VBU0513_CM_single 0 0 -3.4E+38 3.4E+38 ECU_ADDRESS 0x900023fa /end MEASUREMENT
/begin MEASUREMENT BCV_uHALBatteryVoltageRaw "" FLOAT32_IEEE VBU0513_CM_single 0 0 -3.4E+38 3.4E+38 ECU_ADDRESS 0x900023de /end MEASUREMENT
/begin MEASUREMENT BCV_uHALVx2VoltageRaw "" FLOAT32_IEEE VBU0513_CM_single 0 0 -3.4E+38 3.4E+38 ECU_ADDRESS 0x900023ea /end MEASUREMENT
/begin MEASUREMENT BCV_uHALBusNegativeVoltageRaw "" FLOAT32_IEEE VBU0513_CM_single 0 0 -3.4E+38 3.4E+38 ECU_ADDRESS 0x900023e2 /end MEASUREMENT
/begin MEASUREMENT BCV_uHALFuseVoltageRaw "" FLOAT32_IEEE VBU0513_CM_single 0 0 -3.4E+38 3.4E+38 ECU_ADDRESS 0x900023e6 /end MEASUREMENT
/begin MEASUREMENT BSWIN_BatteryPre_f "" UWORD VBU0513_CM_uint16 0 0 0 65535 ECU_ADDRESS 0x900039d2 /end MEASUREMENT
/begin MEASUREMENT BSWIN_BatteryPre_du "" UWORD VBU0513_CM_uint16 0 0 0 65535 ECU_ADDRESS 0x900039d0 /end MEASUREMENT
/begin MEASUREMENT BSWIN_HVIL_f "" UWORD VBU0513_CM_uint16 0 0 0 65535 ECU_ADDRESS 0x9000379c /end MEASUREMENT
/begin MEASUREMENT BSWIN_HVIL_du "" UWORD VBU0513_CM_uint16 0 0 0 65535 ECU_ADDRESS 0x9000379a /end MEASUREMENT
/begin MEASUREMENT BSWIN_DCChAPlusWkup "" UWORD VBU0513_CM_uint16 0 0 0 65535 ECU_ADDRESS 0x900039d4 /end MEASUREMENT
/begin MEASUREMENT uflgIgnOnRaw "" UWORD VBU0513_CM_uint16 0 0 0 65535 ECU_ADDRESS 0x900039f4 /end MEASUREMENT
/begin MEASUREMENT uLVBattRaw "" UWORD VBU0513_CM_uint16 0 0 0 65535 ECU_ADDRESS 0x900039f2 /end MEASUREMENT
/begin MEASUREMENT uDCChCC2 "" UWORD VBU0513_CM_uint16 0 0 0 65535 ECU_ADDRESS 0x900039a6 /end MEASUREMENT
/begin MEASUREMENT BSWIN_EDSInletCoolTemp "" UWORD VBU0513_CM_uint16 0 0 0 65535 ECU_ADDRESS 0x900039d6 /end MEASUREMENT
/begin MEASUREMENT uDCChPortTempNegativeRaw "" UWORD VBU0513_CM_uint16 0 0 0 65535 ECU_ADDRESS 0x900039a8 /end MEASUREMENT
/begin MEASUREMENT uDCChPortPosTempRaw "" UWORD VBU0513_CM_uint16 0 0 0 65535 ECU_ADDRESS 0x900039f0 /end MEASUREMENT
/begin MEASUREMENT uAccPed2Raw "" UWORD VBU0513_CM_uint16 0 0 0 65535 ECU_ADDRESS 0x900039a2 /end MEASUREMENT
/begin MEASUREMENT uAccPed1Raw "" UWORD VBU0513_CM_uint16 0 0 0 65535 ECU_ADDRESS 0x900039a0 /end MEASUREMENT
/begin MEASUREMENT BSWIN_uVacuumPre "" UWORD VBU0513_CM_uint16 0 0 0 65535 ECU_ADDRESS 0x900039d8 /end MEASUREMENT
/begin MEASUREMENT uBrkPresRaw "" UWORD VBU0513_CM_uint16 0 0 0 65535 ECU_ADDRESS 0x900039a4 /end MEASUREMENT
/begin MEASUREMENT MsgRxFlg_MCU_305 "" UBYTE VBU0513_CM_boolean 0 0 0 1 ECU_ADDRESS 0x900041b6 /end MEASUREMENT
/begin MEASUREMENT BSWIN_Crank "" UBYTE VBU0513_CM_boolean 0 0 0 1 ECU_ADDRESS 0x90004293 /end MEASUREMENT
/begin MEASUREMENT BSWIN_ACSwicth "" UBYTE VBU0513_CM_boolean 0 0 0 1 ECU_ADDRESS 0x90004292 /end MEASUREMENT
/begin MEASUREMENT BSWIN_ACPreSw "" UBYTE VBU0513_CM_boolean 0 0 0 1 ECU_ADDRESS 0x90004291 /end MEASUREMENT
/begin MEASUREMENT BSWIN_flgGearH3 "" UBYTE VBU0513_CM_boolean 0 0 0 1 ECU_ADDRESS 0x900040f6 /end MEASUREMENT
/begin MEASUREMENT BSWIN_flgGearH2 "" UBYTE VBU0513_CM_boolean 0 0 0 1 ECU_ADDRESS 0x900040f5 /end MEASUREMENT
/begin MEASUREMENT BSWIN_flgGearH1 "" UBYTE VBU0513_CM_boolean 0 0 0 1 ECU_ADDRESS 0x900040f4 /end MEASUREMENT
/begin MEASUREMENT INP_flgBrkSwt "" UBYTE VBU0513_CM_boolean 0 0 0.0 1.0 ECU_ADDRESS 0x9000404b /end MEASUREMENT
/begin MEASUREMENT BSWIN_BrkLmpSwtRaw "" UBYTE VBU0513_CM_boolean 0 0 0 1 ECU_ADDRESS 0x900040f3 /end MEASUREMENT
/begin MEASUREMENT INP_flgDCChAPlusWkup "" UBYTE VBU0513_CM_boolean 0 0 0.0 1.0 ECU_ADDRESS 0x9000404c /end MEASUREMENT
/begin MEASUREMENT INP_flgIgnOn "" UBYTE VBU0513_CM_boolean 0 0 0.0 1.0 ECU_ADDRESS 0x90004051 /end MEASUREMENT
/begin MEASUREMENT NVM_flgNVMValid "" UBYTE VBU0513_CM_boolean 0 0 0 1 ECU_ADDRESS 0x9000405b /end MEASUREMENT
/begin MEASUREMENT BMM_flgDefaultState "" UBYTE VBU0513_CM_boolean 0 0 0.0 1.0 ECU_ADDRESS 0x90003fdf /end MEASUREMENT
/begin MEASUREMENT BMM_flgBatteryAbnormalAlarm2 "" UBYTE VBU0513_CM_boolean 0 0 0 1 ECU_ADDRESS 0x900040ef /end MEASUREMENT
/begin MEASUREMENT BMM_flgBatteryAbnormalAlarm3 "" UBYTE VBU0513_CM_boolean 0 0 0 1 ECU_ADDRESS 0x900040f0 /end MEASUREMENT
/begin MEASUREMENT BMM_flgBatteryAbnormalAlarm1 "" UBYTE VBU0513_CM_boolean 0 0 0 1 ECU_ADDRESS 0x900040ee /end MEASUREMENT
/begin MEASUREMENT BMM_flgBMUAbnormalReset "" UBYTE VBU0513_CM_boolean 0 0 0 1 ECU_ADDRESS 0x90003fde /end MEASUREMENT
/begin MEASUREMENT BMM_flgBMUAbnormalPowerOff "" UBYTE VBU0513_CM_boolean 0 0 0.0 1.0 ECU_ADDRESS 0x90003fdd /end MEASUREMENT
/begin MEASUREMENT BMM_flg12VBatteryVoltageAbnormal "" UBYTE VBU0513_CM_boolean 0 0 0 1 ECU_ADDRESS 0x900040ed /end MEASUREMENT
/begin MEASUREMENT EcBCV_iABatteryCurrentZeroDrift "" FLOAT32_IEEE VBU0513_CM_single 0 0 -3.4E+38 3.4E+38 ECU_ADDRESS 0x90002292 /end MEASUREMENT
/begin MEASUREMENT EaSOC_CellSoc_pct "" FLOAT32_IEEE VBU0513_CM_single 0 0 -3.4E+38 3.4E+38 ARRAY_SIZE 198 ECU_ADDRESS 0x90000358 /end MEASUREMENT
/begin MEASUREMENT EaSOH_AhCellCapacityBase1 "" FLOAT32_IEEE VBU0513_CM_single 0 0 -3.4E+38 3.4E+38 ARRAY_SIZE 198 ECU_ADDRESS 0x90000988 /end MEASUREMENT
/begin MEASUREMENT EaSOH_AhCellCapacity "" FLOAT32_IEEE VBU0513_CM_single 0 0 -3.4E+38 3.4E+38 ARRAY_SIZE 198 ECU_ADDRESS 0x90000670 /end MEASUREMENT
/begin MEASUREMENT EcSOC_BatteryDisplaySoc_pct "" FLOAT32_IEEE VBU0513_CM_single 0 0 -3.4E+38 3.4E+38 ECU_ADDRESS 0x90002296 /end MEASUREMENT
/begin MEASUREMENT EcSOC_BatterySoc_pct "" FLOAT32_IEEE VBU0513_CM_single 0 0 -3.4E+38 3.4E+38 ECU_ADDRESS 0x9000229a /end MEASUREMENT
/begin MEASUREMENT EcSOH_pctCellResistanceIncRatio "" FLOAT32_IEEE VBU0513_CM_single 0 0 -3.4E+38 3.4E+38 ECU_ADDRESS 0x900022b6 /end MEASUREMENT
/begin MEASUREMENT EcSOH_AhChargeStart "" FLOAT32_IEEE VBU0513_CM_single 0 0 -3.4E+38 3.4E+38 ECU_ADDRESS 0x90001ed6 /end MEASUREMENT
/begin MEASUREMENT EcSOH_AhDischargeStart "" FLOAT32_IEEE VBU0513_CM_single 0 0 -3.4E+38 3.4E+38 ECU_ADDRESS 0x90001eda /end MEASUREMENT
/begin MEASUREMENT EcSOH_tisLifeTimeOperateTime "" FLOAT32_IEEE VBU0513_CM_single 0 0 -3.4E+38 3.4E+38 ECU_ADDRESS 0x90001ede /end MEASUREMENT
/begin MEASUREMENT TaskTimer "" FLOAT32_IEEE VBU0513_CM_single 0 0 -3.4E+38 3.4E+38 ECU_ADDRESS 0x900020de /end MEASUREMENT
/begin MEASUREMENT LcBMM_timsInitializeTimer "" FLOAT32_IEEE VBU0513_CM_single 0 0 -3.4E+38 3.4E+38 ECU_ADDRESS 0x900022da /end MEASUREMENT
/begin MEASUREMENT LcBMM_timsShutdownTimer "" FLOAT32_IEEE VBU0513_CM_single 0 0 -3.4E+38 3.4E+38 ECU_ADDRESS 0x900022de /end MEASUREMENT
/begin MEASUREMENT EcSOC_LoadDefaultSOCCnt_n "" ULONG VBU0513_CM_uint32 0 0 0 4294967295 ECU_ADDRESS 0x900022ae /end MEASUREMENT
/begin MEASUREMENT EcSOC_CellSocMaxOverrunCounter_n "" ULONG VBU0513_CM_uint32 0 0 0 4294967295 ECU_ADDRESS 0x9000229e /end MEASUREMENT
/begin MEASUREMENT EcSOC_CellSocMinOverrunCounter_n "" ULONG VBU0513_CM_uint32 0 0 0 4294967295 ECU_ADDRESS 0x900022a2 /end MEASUREMENT
/begin MEASUREMENT EcSOC_LastCorrectionTime_s "" ULONG VBU0513_CM_uint32 0 0 0 4294967295 ECU_ADDRESS 0x900022a6 /end MEASUREMENT
/begin MEASUREMENT EcSOC_ShortTimeLastCorrectionTime_s "" ULONG VBU0513_CM_uint32 0 0 0 4294967295 ECU_ADDRESS 0x900022b2 /end MEASUREMENT
/begin MEASUREMENT EcSOC_LastShutdownTime_s "" ULONG VBU0513_CM_uint32 0 0 0 4294967295 ECU_ADDRESS 0x900022aa /end MEASUREMENT
/begin MEASUREMENT LINTx_ESV06 "" UBYTE VBU0513_CM_uint8 0 0 0 255 ARRAY_SIZE 8 ECU_ADDRESS 0x90003f6e /end MEASUREMENT
/begin MEASUREMENT LINTx_VBU "" UBYTE VBU0513_CM_uint8 0 0 0 255 ARRAY_SIZE 8 ECU_ADDRESS 0x90003f7e /end MEASUREMENT
/begin COMPU_METHOD VBU0513_CM_single_Kpa "Q = V" RAT_FUNC "%8.6" "Kpa" COEFFS 0 1 0 0 0 1 /end COMPU_METHOD
/begin COMPU_METHOD VBU0513_CM_single_mV "Q = V" RAT_FUNC "%8.6" "mV" COEFFS 0 1 0 0 0 1 /end COMPU_METHOD
/begin COMPU_METHOD VBU0513_CM_single_C "Q = V" RAT_FUNC "%8.6" "C" COEFFS 0 1 0 0 0 1 /end COMPU_METHOD
/begin COMPU_METHOD VBU0513_CM_single_cnt "Q = V" RAT_FUNC "%8.6" "cnt" COEFFS 0 1 0 0 0 1 /end COMPU_METHOD
/begin COMPU_METHOD VBU0513_CM_single_bar "Q = V" RAT_FUNC "%8.6" "bar" COEFFS 0 1 0 0 0 1 /end COMPU_METHOD
/begin COMPU_METHOD VBU0513_CM_uint16_cnt "Q = V" RAT_FUNC "%5.0" "cnt" COEFFS 0 1 0 0 0 1 /end COMPU_METHOD
/begin COMPU_METHOD VBU0513_CM_single_pct "Q = V" RAT_FUNC "%8.6" "pct" COEFFS 0 1 0 0 0 1 /end COMPU_METHOD
/begin COMPU_METHOD VBU0513_CM_single_fac "Q = V" RAT_FUNC "%8.6" "fac" COEFFS 0 1 0 0 0 1 /end COMPU_METHOD
/begin COMPU_METHOD VBU0513_CM_uint8 "Q = V" RAT_FUNC "%3.0" "" COEFFS 0 1 0 0 0 1 /end COMPU_METHOD
/begin COMPU_METHOD VBU0513_CM_uint16 "Q = V" RAT_FUNC "%5.0" "" COEFFS 0 1 0 0 0 1 /end COMPU_METHOD
/begin COMPU_METHOD VBU0513_CM_single "Q = V" RAT_FUNC "%8.6" "" COEFFS 0 1 0 0 0 1 /end COMPU_METHOD
/begin COMPU_METHOD VBU0513_CM_single_kohm "Q = V" RAT_FUNC "%8.6" "kohm" COEFFS 0 1 0 0 0 1 /end COMPU_METHOD
/begin COMPU_METHOD VBU0513_CM_uint32_cnt "Q = V" RAT_FUNC "%10.0" "cnt" COEFFS 0 1 0 0 0 1 /end COMPU_METHOD
/begin COMPU_METHOD VBU0513_CM_uint32_kohm "Q = V" RAT_FUNC "%10.0" "kohm" COEFFS 0 1 0 0 0 1 /end COMPU_METHOD
/begin COMPU_METHOD VBU0513_CM_uint32 "Q = V" RAT_FUNC "%10.0" "" COEFFS 0 1 0 0 0 1 /end COMPU_METHOD
/begin COMPU_METHOD VBU0513_CM_uint16_ms "Q = V" RAT_FUNC "%5.0" "ms" COEFFS 0 1 0 0 0 1 /end COMPU_METHOD
/begin COMPU_METHOD VBU0513_CM_boolean_flg "Q = V" RAT_FUNC "%1.0" "flg" COEFFS 0 1 0 0 0 1 /end COMPU_METHOD
/begin COMPU_METHOD VBU0513_CM_boolean_cnt "Q = V" RAT_FUNC "%1.0" "cnt" COEFFS 0 1 0 0 0 1 /end COMPU_METHOD
/begin COMPU_METHOD VBU0513_CM_boolean "Q = V" RAT_FUNC "%1.0" "" COEFFS 0 1 0 0 0 1 /end COMPU_METHOD
/begin COMPU_METHOD VBU0513_CM_boolean_C "Q = V" RAT_FUNC "%1.0" "C" COEFFS 0 1 0 0 0 1 /end COMPU_METHOD
/begin COMPU_METHOD VBU0513_CM_int8_cnt "Q = V" RAT_FUNC "%3.0" "cnt" COEFFS 0 1 0 0 0 1 /end COMPU_METHOD
/begin COMPU_METHOD VBU0513_CM_int8_n "Q = V" RAT_FUNC "%3.0" "n" COEFFS 0 1 0 0 0 1 /end COMPU_METHOD
/begin COMPU_METHOD VBU0513_CM_uint8_cnt "Q = V" RAT_FUNC "%3.0" "cnt" COEFFS 0 1 0 0 0 1 /end COMPU_METHOD
/begin COMPU_METHOD VBU0513_CM_uint8_n "Q = V" RAT_FUNC "%3.0" "n" COEFFS 0 1 0 0 0 1 /end COMPU_METHOD
/begin GROUP VBU0513 "VBU0513" /* Root */ ROOT /begin SUB_GROUP Root_VBUSystem /end SUB_GROUP /begin REF_MEASUREMENT EcBCV_iABatteryCurrentZeroDrift /end REF_MEASUREMENT /end GROUP
/begin GROUP Root_VBUSystem "VBU0513/VBUSystem" /begin SUB_GROUP S1_BMS S1_GetEE S1_HALIn S1_HALOut S1_VCU_ /end SUB_GROUP
 /begin REF_MEASUREMENT EaSOC_CellSoc_pct EaSOH_AhCellCapacity EaSOH_AhCellCapacityBase1 EcSOC_BatteryDisplaySoc_pct EcSOC_BatterySoc_pct EcSOC_CellSocMaxOverrunCounter_n EcSOC_CellSocMinOverrunCounter_n EcSOC_LastCorrectionTime_s EcSOC_LastShutdownTime_s EcSOC_LoadDefaultSOCCnt_n EcSOC_ShortTimeLastCorrectionTime_s EcSOH_AhChargeStart EcSOH_AhDischargeStart EcSOH_pctCellResistanceIncRatio EcSOH_tisLifeTimeOperateTime VTestW /end REF_MEASUREMENT
/end GROUP
/begin GROUP S1_BMS "VBU0513/VBUSystem/BMS"
 /begin SUB_GROUP S2_BCV S2_BMM S2_CBL S2_CSC S2_CSD_ S2_CTC S2_CTD S2_CTM S2_CTS S2_CVT S2_DSM S2_FCC_ S2_ISO S2_NVM_ S2_OCV S2_RTC S2_SOC S2_SOE S2_SOF S2_SOH S2_Subsystem S2_THM S2_VCT S2_WRT /end SUB_GROUP
 /begin REF_MEASUREMENT TaskTimer /end REF_MEASUREMENT
/end GROUP
/begin GROUP S1_GetEE "VBU0513/VBUSystem/GetEE" /begin REF_MEASUREMENT R3_test /end REF_MEASUREMENT /end GROUP
/begin GROUP S1_HALIn "VBU0513/VBUSystem/HALIn" /begin SUB_GROUP S4_HW S4_PTCAN S4_PrivateCAN /end SUB_GROUP /end GROUP
/begin GROUP S1_HALOut "VBU0513/VBUSystem/HALOut" /begin SUB_GROUP S5_HWOut S5_LIN S5_PT_PrivateCAN /end SUB_GROUP /end GROUP
/begin GROUP S1_VCU_ "VBU0513/VBUSystem/VCU "
 /begin SUB_GROUP S8_APO2HAL S8_DCH S8_DSPL_ S8_EDIS S8_LVC S8_PMM S8_SPD S8_THM S8_TQC S8_TQD S8_TQO S8_VTQA S8_VehINP /end SUB_GROUP
/end GROUP
/begin GROUP S2_BCV "VBU0513/VBUSystem/BMS/BCV" /begin SUB_GROUP S9_BCV /end SUB_GROUP /begin REF_CHARACTERISTIC BCV_facPEURCurrent /end REF_CHARACTERISTIC /end GROUP
/begin GROUP S2_BMM "VBU0513/VBUSystem/BMS/BMM" /begin SUB_GROUP S10_BMM /end SUB_GROUP /end GROUP
/begin GROUP S2_CBL "VBU0513/VBUSystem/BMS/CBL" /begin SUB_GROUP S11_Subsystem8 /end SUB_GROUP /end GROUP
/begin GROUP S2_CSC "VBU0513/VBUSystem/BMS/CSC" /begin SUB_GROUP S12_Subsystem7 /end SUB_GROUP /end GROUP
/begin GROUP S2_CSD_ "VBU0513/VBUSystem/BMS/CSD " /begin SUB_GROUP S13_Subsystem /end SUB_GROUP /end GROUP
/begin GROUP S2_CTC "VBU0513/VBUSystem/BMS/CTC" /begin SUB_GROUP S14_Subsystem1 /end SUB_GROUP /end GROUP
/begin GROUP S2_CTD "VBU0513/VBUSystem/BMS/CTD" /begin SUB_GROUP S15_Subsystem /end SUB_GROUP /end GROUP
/begin GROUP S2_CTM "VBU0513/VBUSystem/BMS/CTM" /begin SUB_GROUP S16_CTM /end SUB_GROUP /end GROUP
/begin GROUP S2_CTS "VBU0513/VBUSystem/BMS/CTS" /begin SUB_GROUP S17_CTS /end SUB_GROUP /end GROUP
/begin GROUP S2_CVT "VBU0513/VBUSystem/BMS/CVT" /begin SUB_GROUP S18_CVT /end SUB_GROUP /end GROUP
/begin GROUP S2_DSM "VBU0513/VBUSystem/BMS/DSM" /begin SUB_GROUP S20_Subsystem10 /end SUB_GROUP /end GROUP
/begin GROUP S2_FCC_ "VBU0513/VBUSystem/BMS/FCC " /begin SUB_GROUP S21_FCC /end SUB_GROUP /end GROUP
/begin GROUP S2_ISO "VBU0513/VBUSystem/BMS/ISO"
 /begin SUB_GROUP S22_Determine_FaultDetection_Check S22_Determine_IsoLowItems S22_ISOSourceDiag /end SUB_GROUP
 /begin REF_CHARACTERISTIC BMM_STATE_FAST_CHARGE BMM_STATE_ONBOARD_CHARGE CTD_MAIN_CONTACTOR_STATUS_CLOSED CTD_MAIN_CONTACTOR_STATUS_OPENED /end REF_CHARACTERISTIC
/end GROUP
/begin GROUP S2_NVM_ "VBU0513/VBUSystem/BMS/NVM " /begin SUB_GROUP S23_Subsystem3 /end SUB_GROUP /end GROUP
/begin GROUP S2_OCV "VBU0513/VBUSystem/BMS/OCV" /begin SUB_GROUP S24_OCV /end SUB_GROUP /end GROUP
/begin GROUP S2_RTC "VBU0513/VBUSystem/BMS/RTC" /begin SUB_GROUP S25_RTC /end SUB_GROUP /end GROUP
/begin GROUP S2_SOC "VBU0513/VBUSystem/BMS/SOC" /begin SUB_GROUP S26_Subsystem5 /end SUB_GROUP /end GROUP
/begin GROUP S2_SOE "VBU0513/VBUSystem/BMS/SOE" /begin SUB_GROUP S27_Subsystem2 /end SUB_GROUP /end GROUP
/begin GROUP S2_SOF "VBU0513/VBUSystem/BMS/SOF" /begin SUB_GROUP S28_Subsystem6 /end SUB_GROUP /end GROUP
/begin GROUP S2_SOH "VBU0513/VBUSystem/BMS/SOH" /begin SUB_GROUP S29_Subsystem4 /end SUB_GROUP /end GROUP
/begin GROUP S2_Subsystem "VBU0513/VBUSystem/BMS/Subsystem" /begin SUB_GROUP S30_FaultDealTemp /end SUB_GROUP /end GROUP
/begin GROUP S2_THM "VBU0513/VBUSystem/BMS/THM" /begin SUB_GROUP S31_Subsystem /end SUB_GROUP /end GROUP
/begin GROUP S2_VCT "VBU0513/VBUSystem/BMS/VCT" /begin SUB_GROUP S32_Subsystem /end SUB_GROUP /end GROUP
/begin GROUP S2_WRT "VBU0513/VBUSystem/BMS/WRT" /begin SUB_GROUP S33_Subsystem9 /end SUB_GROUP /end GROUP
/begin GROUP S4_HW "VBU0513/VBUSystem/HALIn/HW" /begin SUB_GROUP S1825_Subsystem S1825_Subsystem1 S1825_Subsystem2 /end SUB_GROUP /end GROUP
/begin GROUP S4_PTCAN "VBU0513/VBUSystem/HALIn/PTCAN" /begin SUB_GROUP S1827_Subsystem /end SUB_GROUP /end GROUP
/begin GROUP S4_PrivateCAN "VBU0513/VBUSystem/HALIn/PrivateCAN" /begin SUB_GROUP S1828_CanMsgUnpack1 /end SUB_GROUP /end GROUP
/begin GROUP S5_HWOut "VBU0513/VBUSystem/HALOut/HWOut" /begin SUB_GROUP S2950_SetEE /end SUB_GROUP
 /begin REF_CHARACTERISTIC HALOut_flgAccPed2VccEn_C HALOut_flgAccPedlVccEn_C HALOut_flgBekPressVccEn_C HALOut_flgVcuumPumpVccEn_C /end REF_CHARACTERISTIC
/end GROUP
/begin GROUP S5_LIN "VBU0513/VBUSystem/HALOut/LIN" /begin REF_MEASUREMENT LINTx_ESV06 LINTx_VBU /end REF_MEASUREMENT /end GROUP
/begin GROUP S5_PT_PrivateCAN "VBU0513/VBUSystem/HALOut/PT_PrivateCAN" /begin REF_CHARACTERISTIC SAMPLE_TIME_TASK_B /end REF_CHARACTERISTIC /end GROUP
/begin GROUP S8_APO2HAL "VBU0513/VBUSystem/VCU /APO2HAL" /begin SUB_GROUP S3021_PTCAN1Transmit S3021_Subsystem1 S3021_Subsystem2 /end SUB_GROUP /end GROUP
/begin GROUP S8_DCH "VBU0513/VBUSystem/VCU /DCH" /begin SUB_GROUP S3024_DCH_Overall /end SUB_GROUP /end GROUP
/begin GROUP S8_DSPL_ "VBU0513/VBUSystem/VCU /DSPL " /begin SUB_GROUP S3025_DSPL /end SUB_GROUP /end GROUP
/begin GROUP S8_EDIS "VBU0513/VBUSystem/VCU /EDIS" /begin SUB_GROUP S3026_EDIS_Ctrl /end SUB_GROUP /end GROUP
/begin GROUP S8_LVC "VBU0513/VBUSystem/VCU /LVC" /begin SUB_GROUP S3027_LVC /end SUB_GROUP /end GROUP
/begin GROUP S8_PMM "VBU0513/VBUSystem/VCU /PMM" /begin SUB_GROUP S3028_PMM_Ctrl /end SUB_GROUP /end GROUP
/begin GROUP S8_SPD "VBU0513/VBUSystem/VCU /SPD" /begin SUB_GROUP S3029_SPD /end SUB_GROUP /end GROUP
/begin GROUP S8_THM "VBU0513/VBUSystem/VCU /THM" /begin SUB_GROUP S3030_Subsystem S3030_THM /end SUB_GROUP /end GROUP
/begin GROUP S8_TQC "VBU0513/VBUSystem/VCU /TQC" /begin SUB_GROUP S3031_TQC /end SUB_GROUP /end GROUP
/begin GROUP S8_TQD "VBU0513/VBUSystem/VCU /TQD" /begin SUB_GROUP S3032_TrqDem /end SUB_GROUP /end GROUP
/begin GROUP S8_TQO "VBU0513/VBUSystem/VCU /TQO" /begin SUB_GROUP S3033_TQOAll /end SUB_GROUP /end GROUP
/begin GROUP S8_VTQA "VBU0513/VBUSystem/VCU /VTQA" /begin SUB_GROUP S3035_Subsystem /end SUB_GROUP /end GROUP
/begin GROUP S8_VehINP "VBU0513/VBUSystem/VCU /VehINP" /begin SUB_GROUP S3036_VehINP_Logic /end SUB_GROUP /end GROUP
/begin GROUP S9_BCV "VBU0513/VBUSystem/BMS/BCV/BCV" /begin SUB_GROUP S34_Subsystem /end SUB_GROUP /end GROUP
/begin GROUP S10_BMM "VBU0513/VBUSystem/BMS/BMM/BMM"
 /begin SUB_GROUP S232_BMU_PowerOff_Check S232_BMU_Reset_Check S232_BMU_State_Management S232_DetermineAbnormalEventFlag S232_DetermineCycleUpload S232_Determine_Hold_Afterrun S232_Determine_Wakeup_Mode S232_Subsystem /end SUB_GROUP
 /begin REF_CHARACTERISTIC CbBMM_flgNVMReadCheckEnable_C /end REF_CHARACTERISTIC
/end GROUP
/begin GROUP S11_Subsystem8 "VBU0513/VBUSystem/BMS/CBL/Subsystem8" /begin SUB_GROUP S286_Subsystem /end SUB_GROUP /end GROUP
/begin GROUP S12_Subsystem7 "VBU0513/VBUSystem/BMS/CSC/Subsystem7" /begin SUB_GROUP S346_Determine_Cell_Balance /end SUB_GROUP /end GROUP
/begin GROUP S13_Subsystem "VBU0513/VBUSystem/BMS/CSD /Subsystem" /begin REF_MEASUREMENT CellTemp1 /end REF_MEASUREMENT /end GROUP
/begin GROUP S14_Subsystem1 "VBU0513/VBUSystem/BMS/CTC/Subsystem1" /begin SUB_GROUP S355_Subsystem /end SUB_GROUP /end GROUP
/begin GROUP S15_Subsystem "VBU0513/VBUSystem/BMS/CTD/Subsystem" /begin SUB_GROUP S372_Subsystem4 /end SUB_GROUP /end GROUP
/begin GROUP S16_CTM "VBU0513/VBUSystem/BMS/CTM/CTM" /begin SUB_GROUP S540_Subsystem /end SUB_GROUP /end GROUP
/begin GROUP S17_CTS "VBU0513/VBUSystem/BMS/CTS/CTS" /begin SUB_GROUP S618_Subsystem /end SUB_GROUP /end GROUP
/begin GROUP S18_CVT "VBU0513/VBUSystem/BMS/CVT/CVT" /begin SUB_GROUP S648_Subsystem /end SUB_GROUP /end GROUP
/begin GROUP S20_Subsystem10 "VBU0513/VBUSystem/BMS/DSM/Subsystem10" /begin SUB_GROUP S708_Subsystem /end SUB_GROUP /end GROUP
/begin GROUP S21_FCC "VBU0513/VBUSystem/BMS/FCC /FCC" /begin SUB_GROUP S740_Subsystem /end SUB_GROUP /end GROUP
/begin GROUP S22_Determine_FaultDetection_Check "VBU0513/VBUSystem/BMS/ISO/Determine_FaultDetection_Check"
 /begin SUB_GROUP S861_DetermineIsolationSevereTestFail S861_DetermineIsolationWarningTestFail S861_Status_Process /end SUB_GROUP
 /begin REF_CHARACTERISTIC CbISO_IsolationSevere_flg CbISO_IsolationWarning_flg CcISO_FaultReverseConfirmTime_ms CcISO_IsolationSevereFaultFIC_n CcISO_IsolationSevereFaultPIC_n CcISO_IsolationWarningFaultFIC_n CcISO_IsolationWarningFaultPIC_n ISO_ISOLATION_SEVERE_FAULT ISO_ISOLATION_WARNING_FAULT SAMPLE_TIME_TASK_B /end REF_CHARACTERISTIC
/end GROUP
/begin GROUP S22_Determine_IsoLowItems "VBU0513/VBUSystem/BMS/ISO/Determine_IsoLowItems"
 /begin SUB_GROUP S862_ISO_DCCharging_Dec S862_ISO_Normal_Dec S862_ISO_Pack_Dec /end SUB_GROUP
/end GROUP
/begin GROUP S22_ISOSourceDiag "VBU0513/VBUSystem/BMS/ISO/ISOSourceDiag" /begin REF_CHARACTERISTIC CcISO_BDMOutputDelayTime_ms SAMPLE_TIME_TASK_B /end REF_CHARACTERISTIC /end GROUP
/begin GROUP S23_Subsystem3 "VBU0513/VBUSystem/BMS/NVM /Subsystem3" /begin SUB_GROUP S902_Diagnose_NVM S902_Read_NVM_Data /end SUB_GROUP /end GROUP
/begin GROUP S24_OCV "VBU0513/VBUSystem/BMS/OCV/OCV" /begin SUB_GROUP S922_Subsystem /end SUB_GROUP /end GROUP
/begin GROUP S25_RTC "VBU0513/VBUSystem/BMS/RTC/RTC"
 /begin SUB_GROUP S931_Calculate_Actual_Time S931_Calculate_RelativeActual_Time S931_Determine_VCU_ActualTime S931_Diagnose_RTC S931_Reset_TimeInit_flg S931_Set_RTC_Wakeup /end SUB_GROUP
/end GROUP
/begin GROUP S26_Subsystem5 "VBU0513/VBUSystem/BMS/SOC/Subsystem5" /begin SUB_GROUP S958_Subsystem /end SUB_GROUP /end GROUP
/begin GROUP S27_Subsystem2 "VBU0513/VBUSystem/BMS/SOE/Subsystem2" /begin SUB_GROUP S1135_Subsystem /end SUB_GROUP /end GROUP
/begin GROUP S28_Subsystem6 "VBU0513/VBUSystem/BMS/SOF/Subsystem6" /begin SUB_GROUP S1187_Subsystem /end SUB_GROUP /end GROUP
/begin GROUP S29_Subsystem4 "VBU0513/VBUSystem/BMS/SOH/Subsystem4" /begin SUB_GROUP S1414_Subsystem1 /end SUB_GROUP /end GROUP
/begin GROUP S30_FaultDealTemp "VBU0513/VBUSystem/BMS/Subsystem/FaultDealTemp"
 /begin REF_CHARACTERISTIC BCV_BATTERY_OVER_CURRENT_FAULT BCV_BATTERY_OVER_VOLTAGE_FAULT BCV_BATTERY_OVER_VOLTAGE_WARNING_FAULT CTD_MAIN_NEGATIVE_CONTACTOR_WELD_FAULT CTD_MAIN_POSITIVE_CONTACTOR_WELD_FAULT CTD_PARKING_MAIN_NEGATIVE_CONTACTOR_STUCK_OPEN_FAULT CTD_PARKING_MAIN_POSITIVE_CONTACTOR_STUCK_OPEN_FAULT CTD_PRECHARGE_ENERGY_HIGH_FAULT CTD_PRECHARGE_RELAY_STUCK_OPEN_FAULT CTD_PRECHARGE_RESISTANCE_BLOWN_FAULT CTD_PRECHARG_TIMEOUT_FAULT CTM_CELL_OVER_TEMP_FAULT CVT_CELL_OVER_VOLTAGE_FAULT CVT_CELL_UNDER_VOLTAGE_FAULT FCC_CHARGE_CURRENT_OVER_FAULT SOF_CHARGE_OVER_POWER_FAULT /end REF_CHARACTERISTIC
/end GROUP
/begin GROUP S31_Subsystem "VBU0513/VBUSystem/BMS/THM/Subsystem" /begin SUB_GROUP S1545_Subsystem /end SUB_GROUP /end GROUP
/begin GROUP S32_Subsystem "VBU0513/VBUSystem/BMS/VCT/Subsystem" /begin SUB_GROUP S1619_Subsystem /end SUB_GROUP /end GROUP
/begin GROUP S33_Subsystem9 "VBU0513/VBUSystem/BMS/WRT/Subsystem9" /begin SUB_GROUP S1822_Subsystem /end SUB_GROUP /end GROUP
/begin GROUP S1825_Subsystem "VBU0513/VBUSystem/HALIn/HW/Subsystem"
 /begin SUB_GROUP S1859_Input_HW_Signal_Range_Check2 S1859_Input_HW_Signal_Range_Check3 S1859_Input_HW_Signal_Range_Check4 S1859_Input_HW_Signal_Range_Check6 S1859_Input_HW_Signal_Range_Check_Table1 S1859_Input_HW_Signal_Range_Check_Table2 S1859_Input_HW_Signal_Range_Check_Table4 S1859_Input_HW_Signal_Range_Check_Table5 /end SUB_GROUP
 /begin REF_CHARACTERISTIC HALIn_facIgnOnThd_C /end REF_CHARACTERISTIC
 /begin REF_MEASUREMENT BSWIN_DCChAPlusWkup BSWIN_EDSInletCoolTemp BSWIN_uVacuumPre INP_flgDCChAPlusWkup INP_flgIgnOn INP_uLVBatt uAccPed1Raw uAccPed2Raw uBrkPresRaw uDCChCC2 uDCChPortPosTempRaw uDCChPortTempNegativeRaw uLVBattRaw uflgIgnOnRaw /end REF_MEASUREMENT
/end GROUP
/begin GROUP S1825_Subsystem1 "VBU0513/VBUSystem/HALIn/HW/Subsystem1"
 /begin SUB_GROUP S1860_BrkLmpSwtConfirm S1860_INP_flgGearH1Confirm S1860_INP_flgGearH2Confirm S1860_INP_flgGearH3Confirm S1860_IN_ACMidPreConfirm S1860_IN_CrankConfirm S1860_IN_DriverACOnConfirm /end SUB_GROUP
 /begin REF_CHARACTERISTIC HALIn_vBrkSwtThold_C /end REF_CHARACTERISTIC
 /begin REF_MEASUREMENT BSWIN_ACPreSw BSWIN_ACSwicth BSWIN_BrkLmpSwtRaw BSWIN_Crank BSWIN_flgGearH1 BSWIN_flgGearH2 BSWIN_flgGearH3 INP_flgBrkSwt /end REF_MEASUREMENT
/end GROUP
/begin GROUP S1825_Subsystem2 "VBU0513/VBUSystem/HALIn/HW/Subsystem2"
 /begin SUB_GROUP S1861_Input_HW_Signal_Range_Check1 S1861_Input_HW_Signal_Range_Check2 S1861_Input_HW_Signal_Range_Check3 S1861_Input_HW_Signal_Range_Check7 /end SUB_GROUP
 /begin REF_MEASUREMENT BSWIN_BatteryPre_du BSWIN_BatteryPre_f BSWIN_HVIL_du BSWIN_HVIL_f /end REF_MEASUREMENT
/end GROUP
/begin GROUP S1827_Subsystem "VBU0513/VBUSystem/HALIn/PTCAN/Subsystem"
 /begin SUB_GROUP S2010_20ms S2010_50ms S2010_CanMsgReceive S2010_CanMsgUnpack S2010_Subsystem2 S2010_Subsystem3 S2010_Subsystem4 /end SUB_GROUP
/end GROUP
/begin GROUP S1828_CanMsgUnpack1 "VBU0513/VBUSystem/HALIn/PrivateCAN/CanMsgUnpack1"
 /begin SUB_GROUP S2715_MsgRxData_Unpack1 S2715_MsgRxData_Unpack10 S2715_MsgRxData_Unpack11 S2715_MsgRxData_Unpack12 S2715_MsgRxData_Unpack13 S2715_MsgRxData_Unpack14 S2715_MsgRxData_Unpack15 S2715_MsgRxData_Unpack16 S2715_MsgRxData_Unpack17 S2715_MsgRxData_Unpack18 S2715_MsgRxData_Unpack19 S2715_MsgRxData_Unpack2 S2715_MsgRxData_Unpack20 S2715_MsgRxData_Unpack21 S2715_MsgRxData_Unpack22 S2715_MsgRxData_Unpack23 S2715_MsgRxData_Unpack24 S2715_MsgRxData_Unpack25 S2715_MsgRxData_Unpack26 S2715_MsgRxData_Unpack27 S2715_MsgRxData_Unpack28 S2715_MsgRxData_Unpack29 S2715_MsgRxData_Unpack3 S2715_MsgRxData_Unpack30 S2715_MsgRxData_Unpack31 S2715_MsgRxData_Unpack32 S2715_MsgRxData_Unpack33 S2715_MsgRxData_Unpack34 S2715_MsgRxData_Unpack35 S2715_MsgRxData_Unpack36 S2715_MsgRxData_Unpack37 S2715_MsgRxData_Unpack38 S2715_MsgRxData_Unpack39 S2715_MsgRxData_Unpack4 S2715_MsgRxData_Unpack40 S2715_MsgRxData_Unpack41 S2715_MsgRxData_Unpack42 S2715_MsgRxData_Unpack43 S2715_MsgRxData_Unpack44 S2715_MsgRxData_Unpack45 S2715_MsgRxData_Unpack46 S2715_MsgRxData_Unpack47 S2715_MsgRxData_Unpack48 S2715_MsgRxData_Unpack49 S2715_MsgRxData_Unpack5 S2715_MsgRxData_Unpack50 S2715_MsgRxData_Unpack51 S2715_MsgRxData_Unpack52 S2715_MsgRxData_Unpack53 S2715_MsgRxData_Unpack54 S2715_MsgRxData_Unpack55 S2715_MsgRxData_Unpack56 S2715_MsgRxData_Unpack57 S2715_MsgRxData_Unpack58 S2715_MsgRxData_Unpack59 S2715_MsgRxData_Unpack6 S2715_MsgRxData_Unpack60 S2715_MsgRxData_Unpack61 S2715_MsgRxData_Unpack62 S2715_MsgRxData_Unpack63 S2715_MsgRxData_Unpack64 S2715_MsgRxData_Unpack65 S2715_MsgRxData_Unpack66 S2715_MsgRxData_Unpack67 S2715_MsgRxData_Unpack68 S2715_MsgRxData_Unpack69 S2715_MsgRxData_Unpack7 S2715_MsgRxData_Unpack70 S2715_MsgRxData_Unpack71 S2715_MsgRxData_Unpack72 S2715_MsgRxData_Unpack73 S2715_MsgRxData_Unpack74 S2715_MsgRxData_Unpack75 S2715_MsgRxData_Unpack76 S2715_MsgRxData_Unpack77 S2715_MsgRxData_Unpack78 S2715_MsgRxData_Unpack8 S2715_MsgRxData_Unpack9 /end SUB_GROUP
/end GROUP
/begin GROUP S2950_SetEE "VBU0513/VBUSystem/HALOut/HWOut/SetEE" /begin REF_CHARACTERISTIC VTestR /end REF_CHARACTERISTIC /begin REF_MEASUREMENT W3_Test /end REF_MEASUREMENT /end GROUP
/begin GROUP S3021_PTCAN1Transmit "VBU0513/VBUSystem/VCU /APO2HAL/PTCAN1Transmit"
 /begin SUB_GROUP S3038_VCU_151 S3038_VCU_153 S3038_VCU_201 S3038_VCU_501 S3038_VCU_502 S3038_VCU_AC_238 S3038_VCU_DCDC_250 S3038_VCU_EPB_155 S3038_VCU_IC_210 S3038_VCU_MCU_105 /end SUB_GROUP
/end GROUP
/begin GROUP S3021_Subsystem1 "VBU0513/VBUSystem/VCU /APO2HAL/Subsystem1"
 /begin SUB_GROUP S3039_BCL S3039_BCP S3039_BCS S3039_BEM S3039_BHM S3039_BRM S3039_BRO S3039_BSD S3039_BSM S3039_BST_ S3039_J1939TxEna /end SUB_GROUP
/end GROUP
/begin GROUP S3021_Subsystem2 "VBU0513/VBUSystem/VCU /APO2HAL/Subsystem2" /begin SUB_GROUP S3040_Subsystem /end SUB_GROUP /end GROUP
/begin GROUP S3024_DCH_Overall "VBU0513/VBUSystem/VCU /DCH/DCH_Overall"
 /begin SUB_GROUP S3235_DCH_DCChargeCtrlOverall S3235_DCH_J1939InputProcess S3235_DCH_J1939OutputSignalProcess /end SUB_GROUP
/end GROUP
/begin GROUP S3025_DSPL "VBU0513/VBUSystem/VCU /DSPL /DSPL" /begin SUB_GROUP S3360_DriveRange S3360_Other S3360_RegenLight /end SUB_GROUP /end GROUP
/begin GROUP S3026_EDIS_Ctrl "VBU0513/VBUSystem/VCU /EDIS/EDIS_Ctrl"
 /begin SUB_GROUP S3503_BatDis_Power_Lim_Calc S3503_battery_power_calculate S3503_drive_power_calculate /end SUB_GROUP
 /begin REF_CHARACTERISTIC PMM_stDCChMode_SY /end REF_CHARACTERISTIC
/end GROUP
/begin GROUP S3027_LVC "VBU0513/VBUSystem/VCU /LVC/LVC" /begin SUB_GROUP S3586_LVC_DIAG S3586_LowVoltageBalanceControl /end SUB_GROUP /begin REF_CHARACTERISTIC EDIS_pwrDcdcPwrLim_C /end REF_CHARACTERISTIC /end GROUP
/begin GROUP S3028_PMM_Ctrl "VBU0513/VBUSystem/VCU /PMM/PMM_Ctrl"
 /begin SUB_GROUP S3631_DrvMod_Ctrl S3631_LvWakeUp_Ctrl S3631_PMM_DIAG S3631_PwrMod_Ctrl /end SUB_GROUP
/end GROUP
/begin GROUP S3029_SPD "VBU0513/VBUSystem/VCU /SPD/SPD" /begin SUB_GROUP S3744_SignalProcessing_10ms /end SUB_GROUP /end GROUP
/begin GROUP S3030_Subsystem "VBU0513/VBUSystem/VCU /THM/Subsystem"
 /begin SUB_GROUP S3779_AC S3779_EVX S3779_FAN S3779_FPV S3779_Others S3779_PTC S3779_Pump /end SUB_GROUP
/end GROUP
/begin GROUP S3030_THM "VBU0513/VBUSystem/VCU /THM/THM"
 /begin SUB_GROUP S3780_Active S3780_Compre S3780_EVXRaw S3780_FANRaw S3780_FPVRaw S3780_PTC S3780_PumpRaw S3780_ThermalMode /end SUB_GROUP
/end GROUP
/begin GROUP S3031_TQC "VBU0513/VBUSystem/VCU /TQC/TQC" /begin SUB_GROUP S3827_TQC_VehSpdLimit S3827_VehInfo1 /end SUB_GROUP /begin REF_MEASUREMENT TQC_TrqDes /end REF_MEASUREMENT /end GROUP
/begin GROUP S3032_TrqDem "VBU0513/VBUSystem/VCU /TQD/TrqDem"
 /begin SUB_GROUP S3873_BrkRgn_Cal S3873_TrqDem_Arb S3873_TrqDem_DrvTrq_Cal S3873_TrqDem_InputTransfer /end SUB_GROUP
/end GROUP
/begin GROUP S3033_TQOAll "VBU0513/VBUSystem/VCU /TQO/TQOAll"
 /begin SUB_GROUP S3899_STC S3899_Schedule S3899_TQARB S3899_TQCMP S3899_TQDIS S3899_TQDMP S3899_TQO /end SUB_GROUP
/end GROUP
/begin GROUP S3035_Subsystem "VBU0513/VBUSystem/VCU /VTQA/Subsystem" /begin SUB_GROUP S4018_MTrqLim S4018_VehTrqArb /end SUB_GROUP /end GROUP
/begin GROUP S3036_VehINP_Logic "VBU0513/VBUSystem/VCU /VehINP/VehINP_Logic"
 /begin SUB_GROUP S4052_APD S4052_DCPortTemp S4052_FPV S4052_GearShift S4052_Mode S4052_PEU_InverterStatus S4052_SWReset S4052_TireType S4052_VacuumPump_Control S4052_VehINP_BPD S4052_Veh_Status /end SUB_GROUP
/end GROUP
/begin GROUP S34_Subsystem "VBU0513/VBUSystem/BMS/BCV/BCV/Subsystem"
 /begin SUB_GROUP S35_Calculate_BatteryCurrent S35_Calculate_BatteryVoltage S35_Calculate_Lifetime_Data S35_Diagnose_BCV_Communication_Fault S35_Diagnose_BCV_Data_Fault S35_Interface_Switch S35_Interface_Switch1 S35_Interface_Switch2 S35_Interface_Switch3 S35_Interface_Switch4 S35_Interface_Switch5 S35_Interface_Switch6 S35_Interface_Switch7 S35_Interface_Switch8 S35_Interface_Switch9 S35_Monitor_BCV_Performance S35_Unpackage_LEM_Msg /end SUB_GROUP
 /begin REF_CHARACTERISTIC BCV_facHVADC /end REF_CHARACTERISTIC
 /begin REF_MEASUREMENT BCV_uHALBatteryVoltageRaw BCV_uHALBusNegativeVoltageRaw BCV_uHALFuseVoltageRaw BCV_uHALVx2VoltageRaw /end REF_MEASUREMENT
/end GROUP
/begin GROUP S232_BMU_PowerOff_Check "VBU0513/VBUSystem/BMS/BMM/BMM/BMU_PowerOff_Check"
 /begin SUB_GROUP S233_BDM_KL30Voltage_Diagnostic S233_Monitor_BMM_Performance S233_Override1 /end SUB_GROUP
 /begin REF_CHARACTERISTIC BMM_BMU_POWEROFF_NORMAL CbBMM_AbnormalPowerOffOverride_flg /end REF_CHARACTERISTIC
 /begin REF_MEASUREMENT BMM_flg12VBatteryVoltageAbnormal BMM_flgBMUAbnormalPowerOff /end REF_MEASUREMENT
/end GROUP
/begin GROUP S232_BMU_Reset_Check "VBU0513/VBUSystem/BMS/BMM/BMM/BMU_Reset_Check" /begin REF_CHARACTERISTIC BMM_BMU_RESET_NONE CbBMM_AbnormalResetOverride_flg /end REF_CHARACTERISTIC /begin REF_MEASUREMENT BMM_flgBMUAbnormalReset /end REF_MEASUREMENT /end GROUP
/begin GROUP S232_BMU_State_Management "VBU0513/VBUSystem/BMS/BMM/BMM/BMU_State_Management"
 /begin REF_CHARACTERISTIC BMM_STATE_AFTER_RUN BMM_STATE_DRIVE_MODE BMM_STATE_FAST_CHARGE BMM_STATE_IDLE BMM_STATE_INITIALIZATION BMM_STATE_SHUT_DOWN CcBMM_MaxInitializeTime_ms SAMPLE_TIME_TASK_B /end REF_CHARACTERISTIC
 /begin REF_MEASUREMENT LcBMM_timsInitializeTimer LcBMM_timsShutdownTimer /end REF_MEASUREMENT
/end GROUP
/begin GROUP S232_DetermineAbnormalEventFlag "VBU0513/VBUSystem/BMS/BMM/BMM/DetermineAbnormalEventFlag" /begin SUB_GROUP S236_DetermineSOCJump /end SUB_GROUP
 /begin REF_CHARACTERISTIC BMM_STATE_SHUT_DOWN CbBMM_AbnormalEventDetectedORF_flg CbBMM_AbnormalEventDetectedORV_flg CcBMM_AbnormalEventFlagLockTime_ms CcBMM_CurrentStableDelayTime_ms CcBMM_CurrentStableThreshold_A SAMPLE_TIME_TASK_B /end REF_CHARACTERISTIC
 /begin REF_MEASUREMENT BMM_flgBatteryAbnormalAlarm1 BMM_flgBatteryAbnormalAlarm2 BMM_flgBatteryAbnormalAlarm3 /end REF_MEASUREMENT
/end GROUP
/begin GROUP S232_DetermineCycleUpload "VBU0513/VBUSystem/BMS/BMM/BMM/DetermineCycleUpload" /begin SUB_GROUP S237_CycleWakeupStateMachine S237_GetValueInNVM /end SUB_GROUP
 /begin REF_CHARACTERISTIC BMM_STATE_AFTER_RUN BMM_STATE_RTC CYCLE_WAKEUP_STATE_PERIODICAL_UPLOAD CcBMM_DeepSleepUploadTime_s CcBMM_PeriodicalUploadTime_s /end REF_CHARACTERISTIC
 /begin REF_MEASUREMENT BMM_flgDefaultState /end REF_MEASUREMENT
/end GROUP
/begin GROUP S232_Determine_Hold_Afterrun "VBU0513/VBUSystem/BMS/BMM/BMM/Determine_Hold_Afterrun" /begin SUB_GROUP S238_Determine_HoldAfterrun_Condition /end SUB_GROUP /begin REF_CHARACTERISTIC BMM_STATE_AFTER_RUN /end REF_CHARACTERISTIC /end GROUP
/begin GROUP S232_Determine_Wakeup_Mode "VBU0513/VBUSystem/BMS/BMM/BMM/Determine_Wakeup_Mode"
 /begin SUB_GROUP S239_Determine_Wakeup_Bywire S239_Wakeup_Fast_Charge S239_Wakeup_Ignition_On /end SUB_GROUP
/end GROUP
/begin GROUP S232_Subsystem "VBU0513/VBUSystem/BMS/BMM/BMM/Subsystem" /begin SUB_GROUP S240_EEPROM_BlockStoreEnable /end SUB_GROUP /end GROUP
/begin GROUP S286_Subsystem "VBU0513/VBUSystem/BMS/CBL/Subsystem8/Subsystem"
 /begin SUB_GROUP S287_Balance_EnableCondition S287_Determine_BoardTemAvailableCheck S287_Determine_CSCCellBalanceRequest S287_Override /end SUB_GROUP
/end GROUP
/begin GROUP S346_Determine_Cell_Balance "VBU0513/VBUSystem/BMS/CSC/Subsystem7/Determine_Cell_Balance" /begin SUB_GROUP S347_LOW_HIGH2 /end SUB_GROUP
 /begin REF_CHARACTERISTIC CaCSC_CellBalanceRequestORF_flg CaCSC_CellBalanceRequestORV_flg /end REF_CHARACTERISTIC
/end GROUP
/begin GROUP S355_Subsystem "VBU0513/VBUSystem/BMS/CTC/Subsystem1/Subsystem"
 /begin SUB_GROUP S356_ControlPrechargeRelay S356_ControlResetRelays S356_ControlmainNegativeRelay S356_ControlmainPositiveRelay S356_DetermineRelayCommandStatus S356_Determine_Openings_Number /end SUB_GROUP
/end GROUP
/begin GROUP S372_Subsystem4 "VBU0513/VBUSystem/BMS/CTD/Subsystem/Subsystem4"
 /begin SUB_GROUP S373_Determine_MainContactor_Status S373_DiagnoseRelayWeld S373_LV_Battery_Voltage S373_Lockout_Precharge_Process S373_MainFuseDiagnostic S373_Precharge_Resistance_Diagnostic S373_PrechrgProcessMonitoring S373_Stuck_Open_Diagnostic S373_Subsystem S373_Subsystem1 S373_Subsystem2 S373_Subsystem3 /end SUB_GROUP
/end GROUP
/begin GROUP S540_Subsystem "VBU0513/VBUSystem/BMS/CTM/CTM/Subsystem"
 /begin SUB_GROUP S541_BoardTemp_ValidCheck S541_CellTemp_ValidCheck S541_Determine_BoardTemp_OverUnderFaults S541_Determine_CellTemp S541_Determine_CellTemp_OverDeviationFaults S541_Determine_CellTemp_OverUnderFaults S541_Determine_Thermal_Runaway S541_PowerOnTempVoltageValid /end SUB_GROUP
/end GROUP
/begin GROUP S618_Subsystem "VBU0513/VBUSystem/BMS/CTS/CTS/Subsystem"
 /begin SUB_GROUP S619_Contactors_Timing_Control S619_DeterminePrechargeConditions S619_Determine_Contactor_Request S619_Determine_Emergency_Open S619_Determine_Precharge_Times /end SUB_GROUP
/end GROUP
/begin GROUP S648_Subsystem "VBU0513/VBUSystem/BMS/CVT/CVT/Subsystem"
 /begin SUB_GROUP S649_CellVoltage_ValidCheck S649_Determine_CellVoltage_ExtremeData S649_Determine_CellVoltage_OverUnderFaults S649_Monitor_CVT_DeviationDynamic S649_Monitor_CVT_Performance /end SUB_GROUP
/end GROUP
/begin GROUP S708_Subsystem "VBU0513/VBUSystem/BMS/DSM/Subsystem10/Subsystem"
 /begin SUB_GROUP S709_Clear_Fault_Data S709_Determine_Abnormal_In_PeriodicalUpload S709_Determine_CSC_Inhibit S709_Determine_Drive_Cycle S709_Determine_Fault_Category S709_Determine_MIL_Request S709_Determine_No_Charge S709_Determine_No_Restart /end SUB_GROUP
 /begin REF_CHARACTERISTIC DSM_FDCFaultStatus_C /end REF_CHARACTERISTIC
/end GROUP
/begin GROUP S740_Subsystem "VBU0513/VBUSystem/BMS/FCC /FCC/Subsystem"
 /begin SUB_GROUP S741_Calculate_Fastcharge_Time S741_Determine_Fastcharge_Request S741_Fastcharge_Conditions_Check S741_Fastcharge_State_Management S741_Fastcharge_Violation_Diagnostic S741_MapingSOC /end SUB_GROUP
 /begin REF_CHARACTERISTIC FCC_pctVCRVCUMaxChrgSOCSet /end REF_CHARACTERISTIC
/end GROUP
/begin GROUP S861_DetermineIsolationSevereTestFail "VBU0513/VBUSystem/BMS/ISO/Determine_FaultDetection_Check/DetermineIsolationSevereTestFail"
 /begin REF_CHARACTERISTIC CcISO_AllowableIsolationWarningTimes_n CcISO_IsolationSeverseLimited_Kohm /end REF_CHARACTERISTIC
/end GROUP
/begin GROUP S861_DetermineIsolationWarningTestFail "VBU0513/VBUSystem/BMS/ISO/Determine_FaultDetection_Check/DetermineIsolationWarningTestFail"
 /begin REF_CHARACTERISTIC CcISO_AllowableIsolationWarningTimes_n CcISO_IsolationWarningLimited_Kohm /end REF_CHARACTERISTIC
/end GROUP
/begin GROUP S861_Status_Process "VBU0513/VBUSystem/BMS/ISO/Determine_FaultDetection_Check/Status_Process" /begin SUB_GROUP S871_Determine_EVMandStatus S871_Determine_IsolationLevel /end SUB_GROUP /end GROUP
/begin GROUP S862_ISO_DCCharging_Dec "VBU0513/VBUSystem/BMS/ISO/Determine_IsoLowItems/ISO_DCCharging_Dec"
 /begin REF_CHARACTERISTIC CcISO_FccISODecThr_kohm CcISO_FccISODecThr_pct CcISO_FccISOLowThr40_kohm CcISO_FccISOLowThr_kohm ONE_HUNDRED_PERCENT /end REF_CHARACTERISTIC
/end GROUP
/begin GROUP S862_ISO_Normal_Dec "VBU0513/VBUSystem/BMS/ISO/Determine_IsoLowItems/ISO_Normal_Dec"
 /begin REF_CHARACTERISTIC CcISO_DrvISODecThr_kohm CcISO_DrvISODecThr_pct CcISO_DrvISOLowThr40_kohm CcISO_DrvISOLowThr_kohm ONE_HUNDRED_PERCENT /end REF_CHARACTERISTIC
/end GROUP
/begin GROUP S862_ISO_Pack_Dec "VBU0513/VBUSystem/BMS/ISO/Determine_IsoLowItems/ISO_Pack_Dec"
 /begin REF_CHARACTERISTIC CcISO_PackISODecThr_kohm CcISO_PackISODecThr_pct CcISO_PackISOLowThr_kohm ONE_HUNDRED_PERCENT /end REF_CHARACTERISTIC
/end GROUP
/begin GROUP S902_Diagnose_NVM "VBU0513/VBUSystem/BMS/NVM /Subsystem3/Diagnose_NVM"
 /begin REF_CHARACTERISTIC BMM_STATE_DRIVE_MODE CbNVM_DataReadFaultEnable_flg CbNVM_DataWriteFaultEnable_flg CbNVM_EepromCrcCheckFaultEnable_flg CcNVM_DataReadFIC_n CcNVM_DataReadPIC_n CcNVM_DataWriteFIC_n CcNVM_DataWritePIC_n CcNVM_EepromCrcCheckFIC_n CcNVM_EepromCrcCheckPIC_n NVM_DATA_READ_FAULT NVM_DATA_WRITE_FAULT NVM_EEPROM_CRC_CHECK_FAULT NVM_READ_CRC_FAIL NVM_READ_HARDWARE_FAIL /end REF_CHARACTERISTIC
/end GROUP
/begin GROUP S902_Read_NVM_Data "VBU0513/VBUSystem/BMS/NVM /Subsystem3/Read_NVM_Data" /begin SUB_GROUP S904_Check_First_Run S904_Check_NVM_Read /end SUB_GROUP /begin REF_MEASUREMENT NVM_flgNVMValid /end REF_MEASUREMENT /end GROUP
/begin GROUP S922_Subsystem "VBU0513/VBUSystem/BMS/OCV/OCV/Subsystem"
 /begin SUB_GROUP S923_Determine_Criteria S923_Determine_Relax_ElapsedTime S923_Determine_Relax_MinTime S923_OCV_Valid_Check /end SUB_GROUP
/end GROUP
/begin GROUP S931_Calculate_Actual_Time "VBU0513/VBUSystem/BMS/RTC/RTC/Calculate_Actual_Time" /begin SUB_GROUP S932_Initialize_Actual_Time /end SUB_GROUP /begin REF_CHARACTERISTIC CbSYS_flgAbnormalResetRecoverEnable /end REF_CHARACTERISTIC /end GROUP
/begin GROUP S931_Calculate_RelativeActual_Time "VBU0513/VBUSystem/BMS/RTC/RTC/Calculate_RelativeActual_Time" /begin REF_CHARACTERISTIC MILISECONDS_PER_SECOND SAMPLE_TIME_TASK_A /end REF_CHARACTERISTIC /end GROUP
/begin GROUP S931_Determine_VCU_ActualTime "VBU0513/VBUSystem/BMS/RTC/RTC/Determine_VCU_ActualTime" /begin SUB_GROUP S934_Calculate_Time_Deviation /end SUB_GROUP /begin REF_CHARACTERISTIC BMM_STATE_INITIALIZATION CbRTC_ActualTimeInit_flg /end REF_CHARACTERISTIC /end GROUP
/begin GROUP S931_Diagnose_RTC "VBU0513/VBUSystem/BMS/RTC/RTC/Diagnose_RTC"
 /begin REF_CHARACTERISTIC CbRTC_flgRealtimeClockFaultEnable CcRTC_nbrRealtimeClockFIC CcRTC_nbrRealtimeClockPIC RTC_REALTIME_CLOCK_FAULT /end REF_CHARACTERISTIC
/end GROUP
/begin GROUP S931_Reset_TimeInit_flg "VBU0513/VBUSystem/BMS/RTC/RTC/Reset_TimeInit_flg" /begin REF_CHARACTERISTIC CbRTC_ActualTimeInit_flg /end REF_CHARACTERISTIC /end GROUP
/begin GROUP S931_Set_RTC_Wakeup "VBU0513/VBUSystem/BMS/RTC/RTC/Set_RTC_Wakeup"
 /begin REF_CHARACTERISTIC CcRTC_FastWakeUpCycle_min CcRTC_FastWakeUpSOCLowerLimit_pct CcRTC_FastWakeUpSOCUpperLimit_pct CcRTC_FastWakeUpTempMiddleLimit_C CcRTC_FastWakeUpTempUpperLimit_C CcRTC_RTCWakeupLVBattDelay_min CcRTC_SlowWakeUpCycle_min /end REF_CHARACTERISTIC
/end GROUP
/begin GROUP S958_Subsystem "VBU0513/VBUSystem/BMS/SOC/Subsystem5/Subsystem"
 /begin SUB_GROUP S959_Battery_SoC_Diagnostic S959_Determine_AhIntegral_SoC S959_Determine_Battery_SOC S959_Determine_CellData_Validation S959_Determine_Cell_SOC S959_Determine_Correction_Condition S959_Determine_Display_SOC S959_Determine_FastChargeCorrection_Soc S959_Determine_Initial_SoC S959_Determine_Initialization_Condition S959_Determine_OcvSoc S959_Determine_ShortTimeCorrection_Condition S959_Ocv_ShortTimeCorrection S959_Soc_Data_Storage /end SUB_GROUP
 /begin REF_CHARACTERISTIC SOC_pctMaxSOCSet_C /end REF_CHARACTERISTIC
/end GROUP
/begin GROUP S1135_Subsystem "VBU0513/VBUSystem/BMS/SOE/Subsystem2/Subsystem"
 /begin SUB_GROUP S1136_Calculate_History_Average_Current S1136_Calculate_Pack_Remaining_Energy S1136_Calculate_Pack_Remaining_Energy_SOC S1136_Rate_Limit_and_Output S1136_Rate_Limit_and_Output_SOC /end SUB_GROUP
/end GROUP
/begin GROUP S1187_Subsystem "VBU0513/VBUSystem/BMS/SOF/Subsystem6/Subsystem"
 /begin SUB_GROUP S1188_Calculate_ActualPower S1188_Calculate_PowerLimit S1188_Count_LowTempOverCurrent S1188_Determine_Currentlimit_Target S1188_Rate_CurrentLimit S1188_Rate_PowerLimit S1188_SOF_Diagnostic /end SUB_GROUP
/end GROUP
/begin GROUP S1414_Subsystem1 "VBU0513/VBUSystem/BMS/SOH/Subsystem4/Subsystem1"
 /begin SUB_GROUP S1415_Calculate_Capacity S1415_Calculate_Resistance S1415_Monitor_SOH S1415_SOH_Diagnositic S1415_Subsystem /end SUB_GROUP
/end GROUP
/begin GROUP S1545_Subsystem "VBU0513/VBUSystem/BMS/THM/Subsystem/Subsystem"
 /begin SUB_GROUP S1546_Calculate_PipeTemperature S1546_Charge_Mode_Temp_Request S1546_Cooling_Request_Respond_Check S1546_Diagnose_InletCoolingHighTemperture_Fault S1546_Diagnose_InletCoolingLowTemperture_Fault S1546_Diagnose_InletOutletTempDelta_Fault S1546_Diagnose_OutletCoolingHighTemperture_Fault S1546_Diagnose_OutletCoolingLowTemperture_Fault S1546_Thermal_System_Damage_Judgement S1546_Valid_Condition_Determination /end SUB_GROUP
/end GROUP
/begin GROUP S1619_Subsystem "VBU0513/VBUSystem/BMS/VCT/Subsystem/Subsystem"
 /begin SUB_GROUP S1620_Determine_BMS_VCU_267 S1620_Determine_BMS_VCU_268 S1620_Determine_BMS_VCU_269 S1620_Determine_BMS_VCU_26A S1620_Determine_BMS_VCU_26F S1620_Determine_BMS_VCU_270 S1620_Determine_BMS_VCU_271 S1620_Determine_BMS_VCU_272 S1620_Determine_BMS_VCU_273 S1620_Determine_BMS_VCU_34 S1620_Determine_BMS_VCU_372 S1620_Determine_BMS_VCU_373 S1620_Determine_BMS_VCU_AC S1620_Determine_BMS_VCU_AD S1620_Determine_BMS_VCU_AE /end SUB_GROUP
/end GROUP
/begin GROUP S1822_Subsystem "VBU0513/VBUSystem/BMS/WRT/Subsystem9/Subsystem"
 /begin REF_CHARACTERISTIC CbWRT_BatteryCapacityCycleORF_flg CcSYS_NominalCellCapacity_Ah CcWRT_BatteryCapacityCycleORV_n /end REF_CHARACTERISTIC
 /begin REF_MEASUREMENT WRT_AhOverallDischarged WRT_AhOverallFastcharged WRT_numBatteryCapacityCycle WRT_numOpenContactorWithLoadTimes1 WRT_numOpenContactorWithLoadTimes2 /end REF_MEASUREMENT
/end GROUP
/begin GROUP S1859_Input_HW_Signal_Range_Check2 "VBU0513/VBUSystem/HALIn/HW/Subsystem/Input_HW_Signal_Range_Check2" /begin SUB_GROUP S1863_override_signal_Status /end SUB_GROUP
 /begin REF_CHARACTERISTIC INP_flgAccPed1CaliOvrd_C INP_flgAccPed1SafetyEnable_C INP_numAccPed1CounterLim_C INP_numAccPed1DecCounter_C INP_numAccPed1IncCounter_C INP_uAccPed1CaliOvrdVal_C INP_uAccPed1RangeMax_C INP_uAccPed1RangeMin_C INP_uAccPed1SafetyVal_C /end REF_CHARACTERISTIC
/end GROUP
/begin GROUP S1859_Input_HW_Signal_Range_Check3 "VBU0513/VBUSystem/HALIn/HW/Subsystem/Input_HW_Signal_Range_Check3" /begin SUB_GROUP S1864_override_signal_Status /end SUB_GROUP
 /begin REF_CHARACTERISTIC INP_flgBrkPresCaliOvrd_C INP_flgBrkPresSafetyEnable_C INP_numBrkPresCounterLim_C INP_numBrkPresDecCounter_C INP_numBrkPresIncCounter_C INP_uBrkPresCaliOvrdVal_C INP_uBrkPresRangeMax_C INP_uBrkPresRangeMin_C INP_uBrkPresSafetyVal_C /end REF_CHARACTERISTIC
/end GROUP
/begin GROUP S1859_Input_HW_Signal_Range_Check4 "VBU0513/VBUSystem/HALIn/HW/Subsystem/Input_HW_Signal_Range_Check4" /begin SUB_GROUP S1865_override_signal_Status /end SUB_GROUP
 /begin REF_CHARACTERISTIC INP_flgAccPed2CaliOvrd_C INP_flgAccPed2SafetyEnable_C INP_numAccPed2CounterLim_C INP_numAccPed2DecCounter_C INP_numAccPed2IncCounter_C INP_uAccPed2CaliOvrdVal_C INP_uAccPed2RangeMax_C INP_uAccPed2RangeMin_C INP_uAccPed2SafetyVal_C /end REF_CHARACTERISTIC
/end GROUP
/begin GROUP S1859_Input_HW_Signal_Range_Check6 "VBU0513/VBUSystem/HALIn/HW/Subsystem/Input_HW_Signal_Range_Check6" /begin SUB_GROUP S1866_override_signal_Status /end SUB_GROUP
 /begin REF_CHARACTERISTIC INP_flgDCChCC2CaliOvrd_C INP_flgDCChCC2SafetyEnable_C INP_numDCChCC2CounterLim_C INP_numDCChCC2DecCounter_C INP_numDCChCC2IncCounter_C INP_uDCChCC2CaliOvrdVal_C INP_uDCChCC2RangeMax_C INP_uDCChCC2RangeMin_C INP_uDCChCC2SafetyVal_C /end REF_CHARACTERISTIC
/end GROUP
/begin GROUP S1859_Input_HW_Signal_Range_Check_Table1 "VBU0513/VBUSystem/HALIn/HW/Subsystem/Input_HW_Signal_Range_Check_Table1" /begin SUB_GROUP S1867_override_signal_Status /end SUB_GROUP
 /begin REF_CHARACTERISTIC INP_flgVacPresCaliOvrd_C INP_flgVacPresSafetyEnable_C INP_numVacPresCounterLim_C INP_numVacPresDecCounter_C INP_numVacPresIncCounter_C INP_pVacPresCaliOvrdVal_C INP_pVacPres_CUR_v INP_uVacPresRangeMax_C INP_uVacPresRangeMin_C INP_uVacPresSafetyVal_C /end REF_CHARACTERISTIC
/end GROUP
/begin GROUP S1859_Input_HW_Signal_Range_Check_Table2 "VBU0513/VBUSystem/HALIn/HW/Subsystem/Input_HW_Signal_Range_Check_Table2" /begin SUB_GROUP S1868_override_signal_Status /end SUB_GROUP
 /begin REF_CHARACTERISTIC INP_flgDCChPortTempCaliOvrd_C INP_flgDCChPortTempSafetyEnable_C INP_numDCChPortTempCounterLim_C INP_numDCChPortTempDecCounter_C INP_numDCChPortTempIncCounter_C INP_tDCChPortTempCaliOvrdVal_C INP_tDCChPortTempSafetyVal_C INP_tDCChPortTemp_CUR_v INP_uDCChPortTempRangeMax_C INP_uDCChPortTempRangeMin_C /end REF_CHARACTERISTIC
/end GROUP
/begin GROUP S1859_Input_HW_Signal_Range_Check_Table4 "VBU0513/VBUSystem/HALIn/HW/Subsystem/Input_HW_Signal_Range_Check_Table4" /begin SUB_GROUP S1869_override_signal_Status /end SUB_GROUP
 /begin REF_CHARACTERISTIC INP_flgDCChPortTempNegativeCaliOvrd_C INP_flgDCChPortTempNegativeSafetyEnable_C INP_numDCChPortTempNegativeCounterLim_C INP_numDCChPortTempNegativeDecCounter_C INP_numDCChPortTempNegativeIncCounter_C INP_tDCChPortTempNegativeCaliOvrdVal_C INP_tDCChPortTempNegativeSafetyVal_C INP_tDCChPortTempNegative_CUR_v INP_uDCChPortTempNegativeRangeMax_C INP_uDCChPortTempNegativeRangeMin_C /end REF_CHARACTERISTIC
/end GROUP
/begin GROUP S1859_Input_HW_Signal_Range_Check_Table5 "VBU0513/VBUSystem/HALIn/HW/Subsystem/Input_HW_Signal_Range_Check_Table5" /begin SUB_GROUP S1870_override_signal_Status /end SUB_GROUP
 /begin REF_CHARACTERISTIC INP_flgEDSOutTempCaliOvrd_C INP_flgEDSOutTempSafetyEnable_C INP_numEDSOutTempCounterLim_C INP_numEDSOutTempDecCounter_C INP_numEDSOutTempIncCounter_C INP_tEDSOutTempCaliOvrdVal_C INP_tEDSOutTempSafetyVal_C INP_tEDSOutTemp_CUR_v INP_uEDSOutTempRangeMax_C INP_uEDSOutTempRangeMin_C /end REF_CHARACTERISTIC
/end GROUP
/begin GROUP S1860_BrkLmpSwtConfirm "VBU0513/VBUSystem/HALIn/HW/Subsystem1/BrkLmpSwtConfirm" /begin SUB_GROUP S1943_override_signal /end SUB_GROUP /end GROUP
/begin GROUP S1860_INP_flgGearH1Confirm "VBU0513/VBUSystem/HALIn/HW/Subsystem1/INP_flgGearH1Confirm" /begin SUB_GROUP S1944_override_signal /end SUB_GROUP /end GROUP
/begin GROUP S1860_INP_flgGearH2Confirm "VBU0513/VBUSystem/HALIn/HW/Subsystem1/INP_flgGearH2Confirm" /begin SUB_GROUP S1945_override_signal /end SUB_GROUP /end GROUP
/begin GROUP S1860_INP_flgGearH3Confirm "VBU0513/VBUSystem/HALIn/HW/Subsystem1/INP_flgGearH3Confirm" /begin SUB_GROUP S1946_override_signal /end SUB_GROUP /end GROUP
/begin GROUP S1860_IN_ACMidPreConfirm "VBU0513/VBUSystem/HALIn/HW/Subsystem1/IN_ACMidPreConfirm" /begin SUB_GROUP S1947_override_signal /end SUB_GROUP /end GROUP
/begin GROUP S1860_IN_CrankConfirm "VBU0513/VBUSystem/HALIn/HW/Subsystem1/IN_CrankConfirm" /begin SUB_GROUP S1948_override_signal /end SUB_GROUP /end GROUP
/begin GROUP S1860_IN_DriverACOnConfirm "VBU0513/VBUSystem/HALIn/HW/Subsystem1/IN_DriverACOnConfirm" /begin SUB_GROUP S1949_override_signal /end SUB_GROUP /end GROUP
/begin GROUP S1861_Input_HW_Signal_Range_Check1 "VBU0513/VBUSystem/HALIn/HW/Subsystem2/Input_HW_Signal_Range_Check1" /begin SUB_GROUP S1964_override_signal_Status /end SUB_GROUP /end GROUP
/begin GROUP S1861_Input_HW_Signal_Range_Check2 "VBU0513/VBUSystem/HALIn/HW/Subsystem2/Input_HW_Signal_Range_Check2" /begin SUB_GROUP S1965_override_signal_Status /end SUB_GROUP /end GROUP
/begin GROUP S1861_Input_HW_Signal_Range_Check3 "VBU0513/VBUSystem/HALIn/HW/Subsystem2/Input_HW_Signal_Range_Check3" /begin SUB_GROUP S1966_override_signal_Status /end SUB_GROUP /end GROUP
/begin GROUP S1861_Input_HW_Signal_Range_Check7 "VBU0513/VBUSystem/HALIn/HW/Subsystem2/Input_HW_Signal_Range_Check7" /begin SUB_GROUP S1967_override_signal_Status /end SUB_GROUP /end GROUP
/begin GROUP S2010_20ms "VBU0513/VBUSystem/HALIn/PTCAN/Subsystem/20ms"
 /begin SUB_GROUP S2011_ABS_0x068 S2011_ABS_0x115 S2011_ABS_0x75 S2011_ABS_0x79 S2011_EPB_0x80 S2011_EPS_0x70 S2011_MCU_205 /end SUB_GROUP
/end GROUP
/begin GROUP S2010_50ms "VBU0513/VBUSystem/HALIn/PTCAN/Subsystem/50ms" /begin SUB_GROUP S2012_BCM_0x18FE0121 S2012_MCU_305 /end SUB_GROUP /end GROUP
/begin GROUP S2010_CanMsgReceive "VBU0513/VBUSystem/HALIn/PTCAN/Subsystem/CanMsgReceive" /begin REF_MEASUREMENT MsgRxFlg_MCU_305 /end REF_MEASUREMENT /end GROUP
/begin GROUP S2010_CanMsgUnpack "VBU0513/VBUSystem/HALIn/PTCAN/Subsystem/CanMsgUnpack"
 /begin SUB_GROUP S2015_MsgRxData_Unpack1 S2015_MsgRxData_Unpack10 S2015_MsgRxData_Unpack11 S2015_MsgRxData_Unpack12 S2015_MsgRxData_Unpack13 S2015_MsgRxData_Unpack14 S2015_MsgRxData_Unpack15 S2015_MsgRxData_Unpack16 S2015_MsgRxData_Unpack17 S2015_MsgRxData_Unpack18 S2015_MsgRxData_Unpack19 S2015_MsgRxData_Unpack2 S2015_MsgRxData_Unpack20 S2015_MsgRxData_Unpack3 S2015_MsgRxData_Unpack4 S2015_MsgRxData_Unpack5 S2015_MsgRxData_Unpack6 S2015_MsgRxData_Unpack7 S2015_MsgRxData_Unpack8 S2015_MsgRxData_Unpack9 /end SUB_GROUP
/end GROUP
/begin GROUP S2010_Subsystem2 "VBU0513/VBUSystem/HALIn/PTCAN/Subsystem/Subsystem2" /begin SUB_GROUP S2017_AVAS_1801D0D3 S2017_IC_401 S2017_MCU_505 /end SUB_GROUP /end GROUP
/begin GROUP S2010_Subsystem3 "VBU0513/VBUSystem/HALIn/PTCAN/Subsystem/Subsystem3" /begin SUB_GROUP S2018_DCDC_509 /end SUB_GROUP /end GROUP
/begin GROUP S2010_Subsystem4 "VBU0513/VBUSystem/HALIn/PTCAN/Subsystem/Subsystem4" /begin SUB_GROUP S2019_AC_248 S2019_CDC_220 S2019_DCDC_303 S2019_MCU_405 /end SUB_GROUP /end GROUP
/begin GROUP S2715_MsgRxData_Unpack1 "VBU0513/VBUSystem/HALIn/PrivateCAN/CanMsgUnpack1/MsgRxData_Unpack1" /begin SUB_GROUP S2716_CanRxData_Unpack /end SUB_GROUP /end GROUP
/begin GROUP S2715_MsgRxData_Unpack10 "VBU0513/VBUSystem/HALIn/PrivateCAN/CanMsgUnpack1/MsgRxData_Unpack10" /begin SUB_GROUP S2717_CanRxData_Unpack /end SUB_GROUP /end GROUP
/begin GROUP S2715_MsgRxData_Unpack11 "VBU0513/VBUSystem/HALIn/PrivateCAN/CanMsgUnpack1/MsgRxData_Unpack11" /begin SUB_GROUP S2718_CanRxData_Unpack /end SUB_GROUP /end GROUP
/begin GROUP S2715_MsgRxData_Unpack12 "VBU0513/VBUSystem/HALIn/PrivateCAN/CanMsgUnpack1/MsgRxData_Unpack12" /begin SUB_GROUP S2719_CanRxData_Unpack /end SUB_GROUP /end GROUP
/begin GROUP S2715_MsgRxData_Unpack13 "VBU0513/VBUSystem/HALIn/PrivateCAN/CanMsgUnpack1/MsgRxData_Unpack13" /begin SUB_GROUP S2720_CanRxData_Unpack /end SUB_GROUP /end GROUP
/begin GROUP S2715_MsgRxData_Unpack14 "VBU0513/VBUSystem/HALIn/PrivateCAN/CanMsgUnpack1/MsgRxData_Unpack14" /begin SUB_GROUP S2721_CanRxData_Unpack /end SUB_GROUP /end GROUP
/begin GROUP S2715_MsgRxData_Unpack15 "VBU0513/VBUSystem/HALIn/PrivateCAN/CanMsgUnpack1/MsgRxData_Unpack15" /begin SUB_GROUP S2722_CanRxData_Unpack /end SUB_GROUP /end GROUP
/begin GROUP S2715_MsgRxData_Unpack16 "VBU0513/VBUSystem/HALIn/PrivateCAN/CanMsgUnpack1/MsgRxData_Unpack16" /begin SUB_GROUP S2723_CanRxData_Unpack /end SUB_GROUP /end GROUP
/begin GROUP S2715_MsgRxData_Unpack17 "VBU0513/VBUSystem/HALIn/PrivateCAN/CanMsgUnpack1/MsgRxData_Unpack17" /begin SUB_GROUP S2724_CanRxData_Unpack /end SUB_GROUP /end GROUP
/begin GROUP S2715_MsgRxData_Unpack18 "VBU0513/VBUSystem/HALIn/PrivateCAN/CanMsgUnpack1/MsgRxData_Unpack18" /begin SUB_GROUP S2725_CanRxData_Unpack /end SUB_GROUP /end GROUP
/begin GROUP S2715_MsgRxData_Unpack19 "VBU0513/VBUSystem/HALIn/PrivateCAN/CanMsgUnpack1/MsgRxData_Unpack19" /begin SUB_GROUP S2726_CanRxData_Unpack /end SUB_GROUP /end GROUP
/begin GROUP S2715_MsgRxData_Unpack2 "VBU0513/VBUSystem/HALIn/PrivateCAN/CanMsgUnpack1/MsgRxData_Unpack2" /begin SUB_GROUP S2727_CanRxData_Unpack /end SUB_GROUP /end GROUP
/begin GROUP S2715_MsgRxData_Unpack20 "VBU0513/VBUSystem/HALIn/PrivateCAN/CanMsgUnpack1/MsgRxData_Unpack20" /begin SUB_GROUP S2728_CanRxData_Unpack /end SUB_GROUP /end GROUP
/begin GROUP S2715_MsgRxData_Unpack21 "VBU0513/VBUSystem/HALIn/PrivateCAN/CanMsgUnpack1/MsgRxData_Unpack21" /begin SUB_GROUP S2729_CanRxData_Unpack /end SUB_GROUP /end GROUP
/begin GROUP S2715_MsgRxData_Unpack22 "VBU0513/VBUSystem/HALIn/PrivateCAN/CanMsgUnpack1/MsgRxData_Unpack22" /begin SUB_GROUP S2730_CanRxData_Unpack /end SUB_GROUP /end GROUP
/begin GROUP S2715_MsgRxData_Unpack23 "VBU0513/VBUSystem/HALIn/PrivateCAN/CanMsgUnpack1/MsgRxData_Unpack23" /begin SUB_GROUP S2731_CanRxData_Unpack /end SUB_GROUP /end GROUP
/begin GROUP S2715_MsgRxData_Unpack24 "VBU0513/VBUSystem/HALIn/PrivateCAN/CanMsgUnpack1/MsgRxData_Unpack24" /begin SUB_GROUP S2732_CanRxData_Unpack /end SUB_GROUP /end GROUP
/begin GROUP S2715_MsgRxData_Unpack25 "VBU0513/VBUSystem/HALIn/PrivateCAN/CanMsgUnpack1/MsgRxData_Unpack25" /begin SUB_GROUP S2733_CanRxData_Unpack /end SUB_GROUP /end GROUP
/begin GROUP S2715_MsgRxData_Unpack26 "VBU0513/VBUSystem/HALIn/PrivateCAN/CanMsgUnpack1/MsgRxData_Unpack26" /begin SUB_GROUP S2734_CanRxData_Unpack /end SUB_GROUP /end GROUP
/begin GROUP S2715_MsgRxData_Unpack27 "VBU0513/VBUSystem/HALIn/PrivateCAN/CanMsgUnpack1/MsgRxData_Unpack27" /begin SUB_GROUP S2735_CanRxData_Unpack /end SUB_GROUP /end GROUP
/begin GROUP S2715_MsgRxData_Unpack28 "VBU0513/VBUSystem/HALIn/PrivateCAN/CanMsgUnpack1/MsgRxData_Unpack28" /begin SUB_GROUP S2736_CanRxData_Unpack /end SUB_GROUP /end GROUP
/begin GROUP S2715_MsgRxData_Unpack29 "VBU0513/VBUSystem/HALIn/PrivateCAN/CanMsgUnpack1/MsgRxData_Unpack29" /begin SUB_GROUP S2737_CanRxData_Unpack /end SUB_GROUP /end GROUP
/begin GROUP S2715_MsgRxData_Unpack3 "VBU0513/VBUSystem/HALIn/PrivateCAN/CanMsgUnpack1/MsgRxData_Unpack3" /begin SUB_GROUP S2738_CanRxData_Unpack /end SUB_GROUP /end GROUP
/begin GROUP S2715_MsgRxData_Unpack30 "VBU0513/VBUSystem/HALIn/PrivateCAN/CanMsgUnpack1/MsgRxData_Unpack30" /begin SUB_GROUP S2739_CanRxData_Unpack /end SUB_GROUP /end GROUP
/begin GROUP S2715_MsgRxData_Unpack31 "VBU0513/VBUSystem/HALIn/PrivateCAN/CanMsgUnpack1/MsgRxData_Unpack31" /begin SUB_GROUP S2740_CanRxData_Unpack /end SUB_GROUP /end GROUP
/begin GROUP S2715_MsgRxData_Unpack32 "VBU0513/VBUSystem/HALIn/PrivateCAN/CanMsgUnpack1/MsgRxData_Unpack32" /begin SUB_GROUP S2741_CanRxData_Unpack /end SUB_GROUP /end GROUP
/begin GROUP S2715_MsgRxData_Unpack33 "VBU0513/VBUSystem/HALIn/PrivateCAN/CanMsgUnpack1/MsgRxData_Unpack33" /begin SUB_GROUP S2742_CanRxData_Unpack /end SUB_GROUP /end GROUP
/begin GROUP S2715_MsgRxData_Unpack34 "VBU0513/VBUSystem/HALIn/PrivateCAN/CanMsgUnpack1/MsgRxData_Unpack34" /begin SUB_GROUP S2743_CanRxData_Unpack /end SUB_GROUP /end GROUP
/begin GROUP S2715_MsgRxData_Unpack35 "VBU0513/VBUSystem/HALIn/PrivateCAN/CanMsgUnpack1/MsgRxData_Unpack35" /begin SUB_GROUP S2744_CanRxData_Unpack /end SUB_GROUP /end GROUP
/begin GROUP S2715_MsgRxData_Unpack36 "VBU0513/VBUSystem/HALIn/PrivateCAN/CanMsgUnpack1/MsgRxData_Unpack36" /begin SUB_GROUP S2745_CanRxData_Unpack /end SUB_GROUP /end GROUP
/begin GROUP S2715_MsgRxData_Unpack37 "VBU0513/VBUSystem/HALIn/PrivateCAN/CanMsgUnpack1/MsgRxData_Unpack37" /begin SUB_GROUP S2746_CanRxData_Unpack /end SUB_GROUP /end GROUP
/begin GROUP S2715_MsgRxData_Unpack38 "VBU0513/VBUSystem/HALIn/PrivateCAN/CanMsgUnpack1/MsgRxData_Unpack38" /begin SUB_GROUP S2747_CanRxData_Unpack /end SUB_GROUP /end GROUP
/begin GROUP S2715_MsgRxData_Unpack39 "VBU0513/VBUSystem/HALIn/PrivateCAN/CanMsgUnpack1/MsgRxData_Unpack39" /begin SUB_GROUP S2748_CanRxData_Unpack /end SUB_GROUP /end GROUP
/begin GROUP S2715_MsgRxData_Unpack4 "VBU0513/VBUSystem/HALIn/PrivateCAN/CanMsgUnpack1/MsgRxData_Unpack4" /begin SUB_GROUP S2749_CanRxData_Unpack /end SUB_GROUP /end GROUP
/begin GROUP S2715_MsgRxData_Unpack40 "VBU0513/VBUSystem/HALIn/PrivateCAN/CanMsgUnpack1/MsgRxData_Unpack40" /begin SUB_GROUP S2750_CanRxData_Unpack /end SUB_GROUP /end GROUP
/begin GROUP S2715_MsgRxData_Unpack41 "VBU0513/VBUSystem/HALIn/PrivateCAN/CanMsgUnpack1/MsgRxData_Unpack41" /begin SUB_GROUP S2751_CanRxData_Unpack /end SUB_GROUP /end GROUP
/begin GROUP S2715_MsgRxData_Unpack42 "VBU0513/VBUSystem/HALIn/PrivateCAN/CanMsgUnpack1/MsgRxData_Unpack42" /begin SUB_GROUP S2752_CanRxData_Unpack /end SUB_GROUP /end GROUP
/begin GROUP S2715_MsgRxData_Unpack43 "VBU0513/VBUSystem/HALIn/PrivateCAN/CanMsgUnpack1/MsgRxData_Unpack43" /begin SUB_GROUP S2753_CanRxData_Unpack /end SUB_GROUP /end GROUP
/begin GROUP S2715_MsgRxData_Unpack44 "VBU0513/VBUSystem/HALIn/PrivateCAN/CanMsgUnpack1/MsgRxData_Unpack44" /begin SUB_GROUP S2754_CanRxData_Unpack /end SUB_GROUP /end GROUP
/begin GROUP S2715_MsgRxData_Unpack45 "VBU0513/VBUSystem/HALIn/PrivateCAN/CanMsgUnpack1/MsgRxData_Unpack45" /begin SUB_GROUP S2755_CanRxData_Unpack /end SUB_GROUP /end GROUP
/begin GROUP S2715_MsgRxData_Unpack46 "VBU0513/VBUSystem/HALIn/PrivateCAN/CanMsgUnpack1/MsgRxData_Unpack46" /begin SUB_GROUP S2756_CanRxData_Unpack /end SUB_GROUP /end GROUP
/begin GROUP S2715_MsgRxData_Unpack47 "VBU0513/VBUSystem/HALIn/PrivateCAN/CanMsgUnpack1/MsgRxData_Unpack47" /begin SUB_GROUP S2757_CanRxData_Unpack /end SUB_GROUP /end GROUP
/begin GROUP S2715_MsgRxData_Unpack48 "VBU0513/VBUSystem/HALIn/PrivateCAN/CanMsgUnpack1/MsgRxData_Unpack48" /begin SUB_GROUP S2758_CanRxData_Unpack /end SUB_GROUP /end GROUP
/begin GROUP S2715_MsgRxData_Unpack49 "VBU0513/VBUSystem/HALIn/PrivateCAN/CanMsgUnpack1/MsgRxData_Unpack49" /begin SUB_GROUP S2759_CanRxData_Unpack /end SUB_GROUP /end GROUP
/begin GROUP S2715_MsgRxData_Unpack5 "VBU0513/VBUSystem/HALIn/PrivateCAN/CanMsgUnpack1/MsgRxData_Unpack5" /begin SUB_GROUP S2760_CanRxData_Unpack /end SUB_GROUP /end GROUP
/begin GROUP S2715_MsgRxData_Unpack50 "VBU0513/VBUSystem/HALIn/PrivateCAN/CanMsgUnpack1/MsgRxData_Unpack50" /begin SUB_GROUP S2761_CanRxData_Unpack /end SUB_GROUP /end GROUP
/begin GROUP S2715_MsgRxData_Unpack51 "VBU0513/VBUSystem/HALIn/PrivateCAN/CanMsgUnpack1/MsgRxData_Unpack51" /begin SUB_GROUP S2762_CanRxData_Unpack /end SUB_GROUP /end GROUP
/begin GROUP S2715_MsgRxData_Unpack52 "VBU0513/VBUSystem/HALIn/PrivateCAN/CanMsgUnpack1/MsgRxData_Unpack52" /begin SUB_GROUP S2763_CanRxData_Unpack /end SUB_GROUP /end GROUP
/begin GROUP S2715_MsgRxData_Unpack53 "VBU0513/VBUSystem/HALIn/PrivateCAN/CanMsgUnpack1/MsgRxData_Unpack53" /begin SUB_GROUP S2764_CanRxData_Unpack /end SUB_GROUP /end GROUP
/begin GROUP S2715_MsgRxData_Unpack54 "VBU0513/VBUSystem/HALIn/PrivateCAN/CanMsgUnpack1/MsgRxData_Unpack54" /begin SUB_GROUP S2765_CanRxData_Unpack /end SUB_GROUP /end GROUP
/begin GROUP S2715_MsgRxData_Unpack55 "VBU0513/VBUSystem/HALIn/PrivateCAN/CanMsgUnpack1/MsgRxData_Unpack55" /begin SUB_GROUP S2766_CanRxData_Unpack /end SUB_GROUP /end GROUP
/begin GROUP S2715_MsgRxData_Unpack56 "VBU0513/VBUSystem/HALIn/PrivateCAN/CanMsgUnpack1/MsgRxData_Unpack56" /begin SUB_GROUP S2767_CanRxData_Unpack /end SUB_GROUP /end GROUP
/begin GROUP S2715_MsgRxData_Unpack57 "VBU0513/VBUSystem/HALIn/PrivateCAN/CanMsgUnpack1/MsgRxData_Unpack57" /begin SUB_GROUP S2768_CanRxData_Unpack /end SUB_GROUP /end GROUP
/begin GROUP S2715_MsgRxData_Unpack58 "VBU0513/VBUSystem/HALIn/PrivateCAN/CanMsgUnpack1/MsgRxData_Unpack58" /begin SUB_GROUP S2769_CanRxData_Unpack /end SUB_GROUP /end GROUP
/begin GROUP S2715_MsgRxData_Unpack59 "VBU0513/VBUSystem/HALIn/PrivateCAN/CanMsgUnpack1/MsgRxData_Unpack59" /begin SUB_GROUP S2770_CanRxData_Unpack /end SUB_GROUP /end GROUP
/begin GROUP S2715_MsgRxData_Unpack6 "VBU0513/VBUSystem/HALIn/PrivateCAN/CanMsgUnpack1/MsgRxData_Unpack6" /begin SUB_GROUP S2771_CanRxData_Unpack /end SUB_GROUP /end GROUP
/begin GROUP S2715_MsgRxData_Unpack60 "VBU0513/VBUSystem/HALIn/PrivateCAN/CanMsgUnpack1/MsgRxData_Unpack60" /begin SUB_GROUP S2772_CanRxData_Unpack /end SUB_GROUP /end GROUP
/begin GROUP S2715_MsgRxData_Unpack61 "VBU0513/VBUSystem/HALIn/PrivateCAN/CanMsgUnpack1/MsgRxData_Unpack61" /begin SUB_GROUP S2773_CanRxData_Unpack /end SUB_GROUP /end GROUP
/begin GROUP S2715_MsgRxData_Unpack62 "VBU0513/VBUSystem/HALIn/PrivateCAN/CanMsgUnpack1/MsgRxData_Unpack62" /begin SUB_GROUP S2774_CanRxData_Unpack /end SUB_GROUP /end GROUP
/begin GROUP S2715_MsgRxData_Unpack63 "VBU0513/VBUSystem/HALIn/PrivateCAN/CanMsgUnpack1/MsgRxData_Unpack63" /begin SUB_GROUP S2775_CanRxData_Unpack /end SUB_GROUP /end GROUP
/begin GROUP S2715_MsgRxData_Unpack64 "VBU0513/VBUSystem/HALIn/PrivateCAN/CanMsgUnpack1/MsgRxData_Unpack64" /begin SUB_GROUP S2776_CanRxData_Unpack /end SUB_GROUP /end GROUP
/begin GROUP S2715_MsgRxData_Unpack65 "VBU0513/VBUSystem/HALIn/PrivateCAN/CanMsgUnpack1/MsgRxData_Unpack65" /begin SUB_GROUP S2777_CanRxData_Unpack /end SUB_GROUP /end GROUP
/begin GROUP S2715_MsgRxData_Unpack66 "VBU0513/VBUSystem/HALIn/PrivateCAN/CanMsgUnpack1/MsgRxData_Unpack66" /begin SUB_GROUP S2778_CanRxData_Unpack /end SUB_GROUP /end GROUP
/begin GROUP S2715_MsgRxData_Unpack67 "VBU0513/VBUSystem/HALIn/PrivateCAN/CanMsgUnpack1/MsgRxData_Unpack67" /begin SUB_GROUP S2779_CanRxData_Unpack /end SUB_GROUP /end GROUP
/begin GROUP S2715_MsgRxData_Unpack68 "VBU0513/VBUSystem/HALIn/PrivateCAN/CanMsgUnpack1/MsgRxData_Unpack68" /begin SUB_GROUP S2780_CanRxData_Unpack /end SUB_GROUP /end GROUP
/begin GROUP S2715_MsgRxData_Unpack69 "VBU0513/VBUSystem/HALIn/PrivateCAN/CanMsgUnpack1/MsgRxData_Unpack69" /begin SUB_GROUP S2781_CanRxData_Unpack /end SUB_GROUP /end GROUP
/begin GROUP S2715_MsgRxData_Unpack7 "VBU0513/VBUSystem/HALIn/PrivateCAN/CanMsgUnpack1/MsgRxData_Unpack7" /begin SUB_GROUP S2782_CanRxData_Unpack /end SUB_GROUP /end GROUP
/begin GROUP S2715_MsgRxData_Unpack70 "VBU0513/VBUSystem/HALIn/PrivateCAN/CanMsgUnpack1/MsgRxData_Unpack70" /begin SUB_GROUP S2783_CanRxData_Unpack /end SUB_GROUP /end GROUP
/begin GROUP S2715_MsgRxData_Unpack71 "VBU0513/VBUSystem/HALIn/PrivateCAN/CanMsgUnpack1/MsgRxData_Unpack71" /begin SUB_GROUP S2784_CanRxData_Unpack /end SUB_GROUP /end GROUP
/begin GROUP S2715_MsgRxData_Unpack72 "VBU0513/VBUSystem/HALIn/PrivateCAN/CanMsgUnpack1/MsgRxData_Unpack72" /begin SUB_GROUP S2785_CanRxData_Unpack /end SUB_GROUP /end GROUP
/begin GROUP S2715_MsgRxData_Unpack73 "VBU0513/VBUSystem/HALIn/PrivateCAN/CanMsgUnpack1/MsgRxData_Unpack73" /begin SUB_GROUP S2786_CanRxData_Unpack /end SUB_GROUP /end GROUP
/begin GROUP S2715_MsgRxData_Unpack74 "VBU0513/VBUSystem/HALIn/PrivateCAN/CanMsgUnpack1/MsgRxData_Unpack74" /begin SUB_GROUP S2787_CanRxData_Unpack /end SUB_GROUP /end GROUP
/begin GROUP S2715_MsgRxData_Unpack75 "VBU0513/VBUSystem/HALIn/PrivateCAN/CanMsgUnpack1/MsgRxData_Unpack75" /begin SUB_GROUP S2788_CanRxData_Unpack /end SUB_GROUP /end GROUP
/begin GROUP S2715_MsgRxData_Unpack76 "VBU0513/VBUSystem/HALIn/PrivateCAN/CanMsgUnpack1/MsgRxData_Unpack76" /begin SUB_GROUP S2789_CanRxData_Unpack /end SUB_GROUP /end GROUP
/begin GROUP S2715_MsgRxData_Unpack77 "VBU0513/VBUSystem/HALIn/PrivateCAN/CanMsgUnpack1/MsgRxData_Unpack77" /begin SUB_GROUP S2790_CanRxData_Unpack /end SUB_GROUP /end GROUP
/begin GROUP S2715_MsgRxData_Unpack78 "VBU0513/VBUSystem/HALIn/PrivateCAN/CanMsgUnpack1/MsgRxData_Unpack78" /begin SUB_GROUP S2791_CanRxData_Unpack /end SUB_GROUP /end GROUP
/begin GROUP S2715_MsgRxData_Unpack8 "VBU0513/VBUSystem/HALIn/PrivateCAN/CanMsgUnpack1/MsgRxData_Unpack8" /begin SUB_GROUP S2792_CanRxData_Unpack /end SUB_GROUP /end GROUP
/begin GROUP S2715_MsgRxData_Unpack9 "VBU0513/VBUSystem/HALIn/PrivateCAN/CanMsgUnpack1/MsgRxData_Unpack9" /begin SUB_GROUP S2793_CanRxData_Unpack /end SUB_GROUP /end GROUP
/begin GROUP S3038_VCU_151 "VBU0513/VBUSystem/VCU /APO2HAL/PTCAN1Transmit/VCU_151"
 /begin REF_CHARACTERISTIC APO_flgAccPedPosOvrd_C APO_flgBrkPressOvrd_C APO_flgBrkSwtOvrdVal_C APO_flgBrkSwtOvrd_C APO_flgEfcAccPdlOvrd_C APO_pBrkPressOvrdVal_C APO_pctAccPedPosOvrdVal_C APO_pctEfcAccPdlOvrdVal_C /end REF_CHARACTERISTIC
/end GROUP
/begin GROUP S3038_VCU_153 "VBU0513/VBUSystem/VCU /APO2HAL/PTCAN1Transmit/VCU_153"
 /begin REF_CHARACTERISTIC APO_flgBMSCellTempHighAlarmOvrd_C APO_flgBMSCellTempLowAlarmOvrd_C APO_flgBMSDIsplaySOCOvrd_C APO_flgBMSFaultLevelOvrd_C APO_flgBMSInletTempOvrd_C APO_flgBMSMainRelayStatusOvrd_C APO_flgBMSOutletTempOvrd_C APO_flgBMSPackCurrentOvrd_C APO_flgBMSPackVoltageOvrd_C APO_flgBMSSOCOvrd_C APO_flgBMSThermalRunawayOvrdVal_C APO_flgBMSThermalRunawayOvrd_C APO_flgCellTempHighAlarmOvrdVal_C APO_flgCellTempLowAlarmOvrdVal_C APO_iBMSPackCurrentOvrdVal_C APO_pctBMSDIsplaySOCOvrdVal_C APO_pctBMSSOCOvrdVal_C APO_stBMSFaultLevelOvrdVal_C APO_stBMSMainRelayStatusOvrdVal_C APO_tBMSInletTempOvrdVal_C APO_tBMSOutletTempOvrdVal_C APO_vBMSPackVoltageOvrdVal_C /end REF_CHARACTERISTIC
/end GROUP
/begin GROUP S3038_VCU_201 "VBU0513/VBUSystem/VCU /APO2HAL/PTCAN1Transmit/VCU_201"
 /begin REF_CHARACTERISTIC APO_AxAccelerationOvrdVal_C APO_AyAccelerationOvrdVal_C APO_AyAccelerationOvrd_C APO_AzAccelerationOvrdVal_C APO_AzAccelerationOvrd_C APO_YawrateOvrdVal_C APO_YawrateOvrd_C APO_flgAxAccelerationOvrd_C /end REF_CHARACTERISTIC
/end GROUP
/begin GROUP S3038_VCU_501 "VBU0513/VBUSystem/VCU /APO2HAL/PTCAN1Transmit/VCU_501"
 /begin REF_CHARACTERISTIC APO_HundredKmTripEnergyOvrdVal_C APO_HundredKmTripEnergyOvrd_C APO_RemainingChargingTimeOvrdVal_C APO_RemainingChargingTimeOvrd_C APO_RemainingDrivingRangeOvrdVal_C APO_RemainingDrivingRangeOvrd_C APO_SOCLowWarningOvrdVal_C APO_SOCLowWarningOvrd_C APO_TenkmTripEnergyOvrdVal_C APO_TenkmTripEnergyOvrd_C APO_flgLVBattOvrd_C APO_uLVBattOvrdVal_C /end REF_CHARACTERISTIC
/end GROUP
/begin GROUP S3038_VCU_502 "VBU0513/VBUSystem/VCU /APO2HAL/PTCAN1Transmit/VCU_502"
 /begin REF_CHARACTERISTIC APO_TotalChargeEnergyOvrdVal_C APO_TotalChargeEnergyOvrd_C APO_TotalDischargeEnergyOvrdVal_C APO_TotalDischargeEnergyOvrd_C /end REF_CHARACTERISTIC
/end GROUP
/begin GROUP S3038_VCU_AC_238 "VBU0513/VBUSystem/VCU /APO2HAL/PTCAN1Transmit/VCU_AC_238"
 /begin REF_CHARACTERISTIC APO_ACOvrdVal_C APO_ACOvrd_C APO_ACPowerOvrdVal_C APO_ACPowerOvrd_C APO_ACSpeedOvrdVal_C APO_ACSpeedOvrd_C /end REF_CHARACTERISTIC
/end GROUP
/begin GROUP S3038_VCU_DCDC_250 "VBU0513/VBUSystem/VCU /APO2HAL/PTCAN1Transmit/VCU_DCDC_250"
 /begin REF_CHARACTERISTIC LVC_flgDCDCReqOvrd_C LVC_flgDcdcCtrlReqOvrdVal_C LVC_flgDcdcCtrlReqOvrd_C LVC_uDCDCReqOvrdVal_C /end REF_CHARACTERISTIC
/end GROUP
/begin GROUP S3038_VCU_EPB_155 "VBU0513/VBUSystem/VCU /APO2HAL/PTCAN1Transmit/VCU_EPB_155"
 /begin REF_CHARACTERISTIC APO_BrkingWhileDrivingOvrdVal_C APO_BrkingWhileDrivingOvrd_C APO_EPBCtrlModeOvrdVal_C APO_EPBCtrlModeOvrd_C Gear_flgEPBReqOvrd_C Gear_stEPBReqOvrdVal_C SPD_vVehSpdOvrdVal_C SPD_vVehSpdOvrd_C /end REF_CHARACTERISTIC
/end GROUP
/begin GROUP S3038_VCU_IC_210 "VBU0513/VBUSystem/VCU /APO2HAL/PTCAN1Transmit/VCU_IC_210"
 /begin REF_CHARACTERISTIC APO_BrakWarningOvrdVal_C APO_BrakWarningOvrd_C APO_CruiseStatusOvrdVal_C APO_CruiseStatusOvrd_C APO_EPBFaultOvrdVal_C APO_EPFaultLevelWarningOvrdVal_C APO_EPFaultLevelWarningOvrd_C APO_EPSFaultOvrdVal_C APO_LimpHomeOvrdVal_C APO_LimpHomeOvrd_C APO_OverSpeedOvrdVal_C APO_OverSpeedOvrd_C APO_PlsUSE750VDCOvrdVal_C APO_PlsUSE750VDCOvrd_C APO_PowerModeOvrdVal_C APO_PowerModeOvrd_C APO_VCURemainingRngOvrdVal_C APO_VCURemainingRngOvrd_C APO_VehicleModeOvrdVal_C APO_VehicleModeOvrd_C APO_flgBMSChargeStateOvrd_C APO_flgBattPackTempWarningOvrd_C APO_flgEPBFaultOvrd_C APO_flgEPSFaultOvrd_C APO_flgHVBattWarningOvrd_C APO_flgHVOnOvrd_C APO_flgIsolutionWarningOvrd_C APO_stBMSChargeStateOvrdVal_C APO_stBattPackTempWarningOvrdVal_C APO_stHVBattWarningOvrdVal_C APO_stHVOnOvrdVal_C APO_stIsolutionWarningOvrdVal_C CGW_flgVehDrvModeOvrd_C CGW_stVehDrvModeOvrdVal_C CGW_stVehRgnModeOvrdVal_C CGW_stVehRgnModeOvrd_C DCH_flgDSPLChStsOvrd_C DCH_stDSPLChStsOvrdVal_C EDIS_flgCurrPwrOvrd_C EDIS_pwrCurrPwrOvrdVal_C EPFaultLevelWarning Gear_stCurrentGearDisplayOvrdVal_C Gear_stCurrentGearDisplayOvrd_C HALIn_MotOverTempOvrdVal_C HALIn_flgMotOverTempOvrd_C HVBattCutOffOvrdVal_C HVBattCutOffOvrd_C LowBatteryWarningOvrdVal_C LowBatteryWarningOvrd_C MotorFaultLevelOvrdVal_C MotorFaultLevelOvrd_C PMM_flgVehRdyOvrdVal_C PMM_flgVehRdyOvrd_C VCUImdStopDrivingOvrdVal_C VCUImdStopDrivingOvrd_C VCURmvAcChgerOvrdVal_C VCURmvAcChgerOvrd_C VM_flgVehLimActvOvrdVal_C VM_flgVehLimActvOvrd_C VehPwrLimdLampReqOvrdVal_C VehPwrLimdLampReqOvrd_C Veh_flgHVILOvrdVal_C Veh_flgHVILOvrd_C /end REF_CHARACTERISTIC
/end GROUP
/begin GROUP S3038_VCU_MCU_105 "VBU0513/VBUSystem/VCU /APO2HAL/PTCAN1Transmit/VCU_MCU_105"
 /begin REF_CHARACTERISTIC OUTP_flgDCRelayStatusORF OUTP_flgDCRelayStatusORFV PMM_flgRMCUActvDisChReqOvrdVal_C PMM_flgRMCUActvDisChReqOvrd_C TQO_flgCtrlRMotrOvrd_C TQO_stCtrlRMotrOvrdVal_C TQO_trqRMotrOvrdVal_C TQO_trqRMotrOvrd_C /end REF_CHARACTERISTIC
/end GROUP
/begin GROUP S3039_BCL "VBU0513/VBUSystem/VCU /APO2HAL/Subsystem1/BCL"
 /begin REF_CHARACTERISTIC CHARGING_MODEOvrdVal_C CHARGING_MODEOvrd_C CURRENT_REQUIREMENTOvrdVal_C CURRENT_REQUIREMENTOvrd_C VOLTAGE_REQUIREMENTOvrdVal_C VOLTAGE_REQUIREMENTOvrd_C /end REF_CHARACTERISTIC
/end GROUP
/begin GROUP S3039_BCP "VBU0513/VBUSystem/VCU /APO2HAL/Subsystem1/BCP"
 /begin REF_CHARACTERISTIC DCH_cBCPNrmCapOvrdVal_C DCH_cBCPNrmCapOvrd_C DCH_iBCPMaxChCurrOvrdVal_C DCH_iBCPMaxChCurrOvrd_C DCH_pctBCPSocOvrdVal_C DCH_pctBCPSocOvrd_C DCH_tBCPMaxPermitTempOvrdVal_C DCH_tBCPMaxPermitTempOvrd_C DCH_uBCPBattVltgOvrdVal_C DCH_uBCPBattVltgOvrd_C DCH_uBCPMaxCellVltgForChOvrdVal_C DCH_uBCPMaxCellVltgForChOvrd_C DCH_uBCPMaxVltgForChOvrdVal_C DCH_uBCPMaxVltgForChOvrd_C /end REF_CHARACTERISTIC
/end GROUP
/begin GROUP S3039_BCS "VBU0513/VBUSystem/VCU /APO2HAL/Subsystem1/BCS"
 /begin REF_CHARACTERISTIC DCH_iBCSChCurrMeasureOvrdVal_C DCH_iBCSChCurrMeasureOvrd_C DCH_numBCSMaxCellVltgNumOvrdVal_C DCH_numBCSMaxCellVltgNumOvrd_C DCH_pctBCSCurrSocOvrdVal_C DCH_pctBCSCurrSocOvrd_C DCH_tiBCSChNeedTOvrdVal_C DCH_tiBCSChNeedTOvrd_C DCH_uBCSChVltgMeasureOvrdVal_C DCH_uBCSChVltgMeasureOvrd_C DCH_uBCSMaxCellVltgOvrdVal_C DCH_uBCSMaxCellVltgOvrd_C /end REF_CHARACTERISTIC
/end GROUP
/begin GROUP S35_Monitor_BCV_Performance "VBU0513/VBUSystem/BMS/BCV/BCV/Subsystem/Monitor_BCV_Performance" /begin REF_CHARACTERISTIC SAMPLE_TIME_TASK_B /end REF_CHARACTERISTIC /end GROUP
/begin GROUP S233_Monitor_BMM_Performance "VBU0513/VBUSystem/BMS/BMM/BMM/BMU_PowerOff_Check/Monitor_BMM_Performance" /begin REF_CHARACTERISTIC SAMPLE_TIME_TASK_B /end REF_CHARACTERISTIC /end GROUP
/begin GROUP S236_DetermineSOCJump "VBU0513/VBUSystem/BMS/BMM/BMM/DetermineAbnormalEventFlag/DetermineSOCJump" /begin REF_CHARACTERISTIC SAMPLE_TIME_TASK_B /end REF_CHARACTERISTIC /end GROUP
/begin GROUP S237_CycleWakeupStateMachine "VBU0513/VBUSystem/BMS/BMM/BMM/DetermineCycleUpload/CycleWakeupStateMachine" /begin REF_CHARACTERISTIC CYCLE_WAKEUP_STATE_PERIODICAL_UPLOAD /end REF_CHARACTERISTIC /end GROUP
/begin GROUP S238_Determine_HoldAfterrun_Condition "VBU0513/VBUSystem/BMS/BMM/BMM/Determine_Hold_Afterrun/Determine_HoldAfterrun_Condition" /begin REF_CHARACTERISTIC BMM_STATE_INITIALIZATION BMM_STATE_RTC /end REF_CHARACTERISTIC /end GROUP
/begin GROUP S239_Determine_Wakeup_Bywire "VBU0513/VBUSystem/BMS/BMM/BMM/Determine_Wakeup_Mode/Determine_Wakeup_Bywire" /begin REF_CHARACTERISTIC SAMPLE_TIME_TASK_B /end REF_CHARACTERISTIC /end GROUP
/begin GROUP S356_ControlPrechargeRelay "VBU0513/VBUSystem/BMS/CTC/Subsystem1/Subsystem/ControlPrechargeRelay" /begin REF_CHARACTERISTIC CTD_MAIN_CONTACTOR_STATUS_CLOSED /end REF_CHARACTERISTIC /end GROUP
/begin GROUP S356_ControlResetRelays "VBU0513/VBUSystem/BMS/CTC/Subsystem1/Subsystem/ControlResetRelays"
 /begin REF_CHARACTERISTIC CTD_MAIN_CONTACTOR_STATUS_CLOSED CTD_MAIN_CONTACTOR_STATUS_OPENED /end REF_CHARACTERISTIC
/end GROUP
/begin GROUP S356_ControlmainNegativeRelay "VBU0513/VBUSystem/BMS/CTC/Subsystem1/Subsystem/ControlmainNegativeRelay" /begin REF_CHARACTERISTIC CTD_MAIN_CONTACTOR_STATUS_CLOSED /end REF_CHARACTERISTIC /end GROUP
/begin GROUP S356_ControlmainPositiveRelay "VBU0513/VBUSystem/BMS/CTC/Subsystem1/Subsystem/ControlmainPositiveRelay" /begin REF_CHARACTERISTIC CTD_MAIN_CONTACTOR_STATUS_CLOSED /end REF_CHARACTERISTIC /end GROUP
/begin GROUP S373_Determine_MainContactor_Status "VBU0513/VBUSystem/BMS/CTD/Subsystem/Subsystem4/Determine_MainContactor_Status"
 /begin REF_CHARACTERISTIC CTD_MAIN_CONTACTOR_STATUS_CLOSED CTD_MAIN_CONTACTOR_STATUS_OPENED /end REF_CHARACTERISTIC
/end GROUP
/begin GROUP S373_Precharge_Resistance_Diagnostic "VBU0513/VBUSystem/BMS/CTD/Subsystem/Subsystem4/Precharge_Resistance_Diagnostic" /begin REF_CHARACTERISTIC CTD_PRECHARGE_RESISTANCE_BLOWN_FAULT /end REF_CHARACTERISTIC /end GROUP
/begin GROUP S373_Subsystem "VBU0513/VBUSystem/BMS/CTD/Subsystem/Subsystem4/Subsystem"
 /begin REF_CHARACTERISTIC CTD_MAIN_CONTACTOR_STATUS_CLOSED CTD_MAIN_CONTACTOR_STATUS_OPENED /end REF_CHARACTERISTIC
/end GROUP
/begin GROUP S373_Subsystem1 "VBU0513/VBUSystem/BMS/CTD/Subsystem/Subsystem4/Subsystem1" /begin REF_CHARACTERISTIC CTD_MAIN_CONTACTOR_STATUS_CLOSED /end REF_CHARACTERISTIC /end GROUP
/begin GROUP S373_Subsystem2 "VBU0513/VBUSystem/BMS/CTD/Subsystem/Subsystem4/Subsystem2" /begin REF_CHARACTERISTIC CTD_MAIN_CONTACTOR_STATUS_CLOSED /end REF_CHARACTERISTIC /end GROUP
/begin GROUP S373_Subsystem3 "VBU0513/VBUSystem/BMS/CTD/Subsystem/Subsystem4/Subsystem3" /begin REF_CHARACTERISTIC CTD_MAIN_CONTACTOR_STATUS_CLOSED /end REF_CHARACTERISTIC /end GROUP
/begin GROUP S541_Determine_CellTemp_OverUnderFaults "VBU0513/VBUSystem/BMS/CTM/CTM/Subsystem/Determine_CellTemp_OverUnderFaults" /begin REF_CHARACTERISTIC CTM_CELL_OVER_TEMP_FAULT /end REF_CHARACTERISTIC /end GROUP
/begin GROUP S619_Contactors_Timing_Control "VBU0513/VBUSystem/BMS/CTS/CTS/Subsystem/Contactors_Timing_Control"
 /begin REF_CHARACTERISTIC CTD_MAIN_CONTACTOR_STATUS_CLOSED CTD_MAIN_CONTACTOR_STATUS_OPENED SAMPLE_TIME_TASK_B /end REF_CHARACTERISTIC
/end GROUP
/begin GROUP S619_Determine_Precharge_Times "VBU0513/VBUSystem/BMS/CTS/CTS/Subsystem/Determine_Precharge_Times" /begin REF_CHARACTERISTIC SAMPLE_TIME_TASK_B /end REF_CHARACTERISTIC /end GROUP
/begin GROUP S649_Determine_CellVoltage_OverUnderFaults "VBU0513/VBUSystem/BMS/CVT/CVT/Subsystem/Determine_CellVoltage_OverUnderFaults"
 /begin REF_CHARACTERISTIC BMM_STATE_INITIALIZATION BMM_STATE_ONBOARD_CHARGE CVT_CELL_OVER_VOLTAGE_FAULT CVT_CELL_UNDER_VOLTAGE_FAULT MILISECONDS_PER_SECOND /end REF_CHARACTERISTIC
/end GROUP
/begin GROUP S709_Determine_CSC_Inhibit "VBU0513/VBUSystem/BMS/DSM/Subsystem10/Subsystem/Determine_CSC_Inhibit" /begin REF_CHARACTERISTIC BMM_STATE_AFTER_RUN /end REF_CHARACTERISTIC /end GROUP
/begin GROUP S709_Determine_Drive_Cycle "VBU0513/VBUSystem/BMS/DSM/Subsystem10/Subsystem/Determine_Drive_Cycle"
 /begin REF_CHARACTERISTIC BMM_STATE_FAST_CHARGE BMM_STATE_ONBOARD_CHARGE SAMPLE_TIME_TASK_A /end REF_CHARACTERISTIC
/end GROUP
/begin GROUP S709_Determine_No_Restart "VBU0513/VBUSystem/BMS/DSM/Subsystem10/Subsystem/Determine_No_Restart" /begin REF_CHARACTERISTIC BMM_STATE_AFTER_RUN /end REF_CHARACTERISTIC /end GROUP
/begin GROUP S741_Fastcharge_State_Management "VBU0513/VBUSystem/BMS/FCC /FCC/Subsystem/Fastcharge_State_Management" /begin REF_CHARACTERISTIC BMM_STATE_FAST_CHARGE /end REF_CHARACTERISTIC /end GROUP
/begin GROUP S741_Fastcharge_Violation_Diagnostic "VBU0513/VBUSystem/BMS/FCC /FCC/Subsystem/Fastcharge_Violation_Diagnostic" /begin REF_CHARACTERISTIC BMM_STATE_FAST_CHARGE FCC_CHARGE_CURRENT_OVER_FAULT /end REF_CHARACTERISTIC /end GROUP
/begin GROUP S741_MapingSOC "VBU0513/VBUSystem/BMS/FCC /FCC/Subsystem/MapingSOC" /begin REF_CHARACTERISTIC ONE_HUNDRED_PERCENT /end REF_CHARACTERISTIC /end GROUP
/begin GROUP S871_Determine_IsolationLevel "VBU0513/VBUSystem/BMS/ISO/Determine_FaultDetection_Check/Status_Process/Determine_IsolationLevel" /begin REF_CHARACTERISTIC SAMPLE_TIME_TASK_B /end REF_CHARACTERISTIC /end GROUP
/begin GROUP S904_Check_NVM_Read "VBU0513/VBUSystem/BMS/NVM /Subsystem3/Read_NVM_Data/Check_NVM_Read" /begin REF_CHARACTERISTIC NVM_READ_CRC_FAIL NVM_READ_HARDWARE_FAIL /end REF_CHARACTERISTIC /end GROUP
/begin GROUP S959_Determine_Battery_SOC "VBU0513/VBUSystem/BMS/SOC/Subsystem5/Subsystem/Determine_Battery_SOC" /begin REF_CHARACTERISTIC ONE_HUNDRED_PERCENT /end REF_CHARACTERISTIC /end GROUP
/begin GROUP S959_Determine_Display_SOC "VBU0513/VBUSystem/BMS/SOC/Subsystem5/Subsystem/Determine_Display_SOC" /begin REF_CHARACTERISTIC ONE_HUNDRED_PERCENT /end REF_CHARACTERISTIC /end GROUP
/begin GROUP S1136_Calculate_Pack_Remaining_Energy_SOC "VBU0513/VBUSystem/BMS/SOE/Subsystem2/Subsystem/Calculate_Pack_Remaining_Energy_SOC" /begin REF_CHARACTERISTIC CcSYS_NominalCellCapacity_Ah ONE_HUNDRED_PERCENT /end REF_CHARACTERISTIC /end GROUP
/begin GROUP S1136_Rate_Limit_and_Output "VBU0513/VBUSystem/BMS/SOE/Subsystem2/Subsystem/Rate_Limit_and_Output" /begin REF_CHARACTERISTIC MILISECONDS_PER_SECOND /end REF_CHARACTERISTIC /end GROUP
/begin GROUP S1136_Rate_Limit_and_Output_SOC "VBU0513/VBUSystem/BMS/SOE/Subsystem2/Subsystem/Rate_Limit_and_Output_SOC" /begin REF_CHARACTERISTIC MILISECONDS_PER_SECOND /end REF_CHARACTERISTIC /end GROUP
/begin GROUP S1188_Count_LowTempOverCurrent "VBU0513/VBUSystem/BMS/SOF/Subsystem6/Subsystem/Count_LowTempOverCurrent" /begin REF_CHARACTERISTIC MILISECONDS_PER_SECOND /end REF_CHARACTERISTIC /end GROUP
/begin GROUP S1188_Rate_CurrentLimit "VBU0513/VBUSystem/BMS/SOF/Subsystem6/Subsystem/Rate_CurrentLimit" /begin REF_CHARACTERISTIC MILISECONDS_PER_SECOND /end REF_CHARACTERISTIC /end GROUP
/begin GROUP S1188_Rate_PowerLimit "VBU0513/VBUSystem/BMS/SOF/Subsystem6/Subsystem/Rate_PowerLimit" /begin REF_CHARACTERISTIC MILISECONDS_PER_SECOND /end REF_CHARACTERISTIC /end GROUP
/begin GROUP S1188_SOF_Diagnostic "VBU0513/VBUSystem/BMS/SOF/Subsystem6/Subsystem/SOF_Diagnostic" /begin REF_CHARACTERISTIC MILISECONDS_PER_SECOND SOF_CHARGE_OVER_POWER_FAULT /end REF_CHARACTERISTIC /end GROUP
/begin GROUP S1546_Charge_Mode_Temp_Request "VBU0513/VBUSystem/BMS/THM/Subsystem/Subsystem/Charge_Mode_Temp_Request" /begin REF_CHARACTERISTIC BMM_STATE_FAST_CHARGE BMM_STATE_ONBOARD_CHARGE /end REF_CHARACTERISTIC /end GROUP
/begin GROUP S1546_Cooling_Request_Respond_Check "VBU0513/VBUSystem/BMS/THM/Subsystem/Subsystem/Cooling_Request_Respond_Check" /begin REF_CHARACTERISTIC MILISECONDS_PER_SECOND /end REF_CHARACTERISTIC /end GROUP
/begin GROUP S1546_Thermal_System_Damage_Judgement "VBU0513/VBUSystem/BMS/THM/Subsystem/Subsystem/Thermal_System_Damage_Judgement" /begin REF_CHARACTERISTIC MILISECONDS_PER_SECOND /end REF_CHARACTERISTIC /end GROUP
/begin GROUP S1546_Valid_Condition_Determination "VBU0513/VBUSystem/BMS/THM/Subsystem/Subsystem/Valid_Condition_Determination" /begin REF_CHARACTERISTIC BMM_STATE_FAST_CHARGE BMM_STATE_ONBOARD_CHARGE /end REF_CHARACTERISTIC /end GROUP
/begin GROUP S1620_Determine_BMS_VCU_272 "VBU0513/VBUSystem/BMS/VCT/Subsystem/Subsystem/Determine_BMS_VCU_272" /begin REF_CHARACTERISTIC SAMPLE_TIME_TASK_B /end REF_CHARACTERISTIC /end GROUP
/begin GROUP S3239_DCH_J1939OutputProcessBCP "VBU0513/VBUSystem/VCU /DCH/DCH_Overall/DCH_J1939OutputSignalProcess/DCH_J1939OutputProcessBCP"
 /begin REF_CHARACTERISTIC DCH_cBCPNrmCapOvrdVal_C DCH_iBCPMaxChCurrOvrdVal_C DCH_pctBCPSocOvrdVal_C DCH_tBCPMaxPermitTempOvrdVal_C DCH_uBCPBattVltgOvrdVal_C DCH_uBCPMaxCellVltgForChOvrdVal_C DCH_uBCPMaxVltgForChOvrdVal_C /end REF_CHARACTERISTIC
/end GROUP
/begin GROUP S3239_DCH_J1939OutputProcessBCS "VBU0513/VBUSystem/VCU /DCH/DCH_Overall/DCH_J1939OutputSignalProcess/DCH_J1939OutputProcessBCS"
 /begin REF_CHARACTERISTIC DCH_iBCSChCurrMeasureOvrdVal_C DCH_numBCSMaxCellVltgNumOvrdVal_C DCH_pctBCSCurrSocOvrdVal_C DCH_tiBCSChNeedTOvrdVal_C DCH_uBCSChVltgMeasureOvrdVal_C DCH_uBCSMaxCellVltgOvrdVal_C /end REF_CHARACTERISTIC
/end GROUP
/begin GROUP S3632_DVM_SetRdy "VBU0513/VBUSystem/VCU /PMM/PMM_Ctrl/DrvMod_Ctrl/DVM_SetRdy" /begin REF_CHARACTERISTIC PMM_flgVehRdyOvrdVal_C /end REF_CHARACTERISTIC /end GROUP
/begin GROUP S3633_LvWakeUp_Mode_Calc "VBU0513/VBUSystem/VCU /PMM/PMM_Ctrl/LvWakeUp_Ctrl/LvWakeUp_Mode_Calc" /begin REF_CHARACTERISTIC PMM_stDCChMode_SY /end REF_CHARACTERISTIC /end GROUP
/begin GROUP S36_Correct_BatteryCurrent "VBU0513/VBUSystem/BMS/BCV/BCV/Subsystem/Calculate_BatteryCurrent/Correct_BatteryCurrent" /begin REF_CHARACTERISTIC SAMPLE_TIME_TASK_B /end REF_CHARACTERISTIC /end GROUP
/begin GROUP S37_Check_BatteryVoltage_Valid "VBU0513/VBUSystem/BMS/BCV/BCV/Subsystem/Calculate_BatteryVoltage/Check_BatteryVoltage_Valid" /begin REF_CHARACTERISTIC SAMPLE_TIME_TASK_B /end REF_CHARACTERISTIC /end GROUP
/begin GROUP S37_Check_BusNegativeVoltage_Valid "VBU0513/VBUSystem/BMS/BCV/BCV/Subsystem/Calculate_BatteryVoltage/Check_BusNegativeVoltage_Valid" /begin REF_CHARACTERISTIC SAMPLE_TIME_TASK_B /end REF_CHARACTERISTIC /end GROUP
/begin GROUP S37_Check_BusVoltage_Valid "VBU0513/VBUSystem/BMS/BCV/BCV/Subsystem/Calculate_BatteryVoltage/Check_BusVoltage_Valid" /begin REF_CHARACTERISTIC SAMPLE_TIME_TASK_B /end REF_CHARACTERISTIC /end GROUP
/begin GROUP S37_Check_FuseVoltage_Valid "VBU0513/VBUSystem/BMS/BCV/BCV/Subsystem/Calculate_BatteryVoltage/Check_FuseVoltage_Valid" /begin REF_CHARACTERISTIC SAMPLE_TIME_TASK_B /end REF_CHARACTERISTIC /end GROUP
/begin GROUP S37_Check_PrechargeVoltage_Valid "VBU0513/VBUSystem/BMS/BCV/BCV/Subsystem/Calculate_BatteryVoltage/Check_PrechargeVoltage_Valid" /begin REF_CHARACTERISTIC SAMPLE_TIME_TASK_B /end REF_CHARACTERISTIC /end GROUP
/begin GROUP S37_Check_Vx1Voltage_Valid "VBU0513/VBUSystem/BMS/BCV/BCV/Subsystem/Calculate_BatteryVoltage/Check_Vx1Voltage_Valid" /begin REF_CHARACTERISTIC SAMPLE_TIME_TASK_B /end REF_CHARACTERISTIC /end GROUP
/begin GROUP S37_Check_Vx2Voltage_Valid "VBU0513/VBUSystem/BMS/BCV/BCV/Subsystem/Calculate_BatteryVoltage/Check_Vx2Voltage_Valid" /begin REF_CHARACTERISTIC SAMPLE_TIME_TASK_B /end REF_CHARACTERISTIC /end GROUP
/begin GROUP S38_Calculate_FuseProtect_Counter "VBU0513/VBUSystem/BMS/BCV/BCV/Subsystem/Calculate_Lifetime_Data/Calculate_FuseProtect_Counter" /begin REF_CHARACTERISTIC SAMPLE_TIME_TASK_B /end REF_CHARACTERISTIC /end GROUP
/begin GROUP S38_Calculate_LifeTimeCoulomb "VBU0513/VBUSystem/BMS/BCV/BCV/Subsystem/Calculate_Lifetime_Data/Calculate_LifeTimeCoulomb" /begin REF_CHARACTERISTIC MILISECONDS_PER_SECOND SAMPLE_TIME_TASK_B /end REF_CHARACTERISTIC /end GROUP
/begin GROUP S40_Diagnose_VoltageCurrent_Fault "VBU0513/VBUSystem/BMS/BCV/BCV/Subsystem/Diagnose_BCV_Data_Fault/Diagnose_VoltageCurrent_Fault"
 /begin REF_CHARACTERISTIC BCV_BATTERY_OVER_CURRENT_FAULT BCV_BATTERY_OVER_VOLTAGE_FAULT BCV_BATTERY_OVER_VOLTAGE_WARNING_FAULT SAMPLE_TIME_TASK_B /end REF_CHARACTERISTIC
/end GROUP
/begin GROUP S51_Diagnose_BDM_FastChargeContactorOverCurrentAlarm "VBU0513/VBUSystem/BMS/BCV/BCV/Subsystem/Monitor_BCV_Performance/Diagnose_BDM_FastChargeContactorOverCurrentAlarm" /begin REF_CHARACTERISTIC SAMPLE_TIME_TASK_B /end REF_CHARACTERISTIC /end GROUP
/begin GROUP S288_DetermineSOCBalance_EnableCondition "VBU0513/VBUSystem/BMS/CBL/Subsystem8/Subsystem/Balance_EnableCondition/DetermineSOCBalance_EnableCondition" /begin REF_CHARACTERISTIC MILISECONDS_PER_SECOND /end REF_CHARACTERISTIC /end GROUP
/begin GROUP S288_DetermineVoltaageBalance_EnableCondition "VBU0513/VBUSystem/BMS/CBL/Subsystem8/Subsystem/Balance_EnableCondition/DetermineVoltaageBalance_EnableCondition" /begin REF_CHARACTERISTIC MILISECONDS_PER_SECOND /end REF_CHARACTERISTIC /end GROUP
/begin GROUP S375_DetermineRatioPEUtoBat "VBU0513/VBUSystem/BMS/CTD/Subsystem/Subsystem4/DiagnoseRelayWeld/DetermineRatioPEUtoBat" /begin REF_CHARACTERISTIC ONE_HUNDRED_PERCENT SAMPLE_TIME_TASK_B /end REF_CHARACTERISTIC /end GROUP
/begin GROUP S375_MNC_Weld_Check "VBU0513/VBUSystem/BMS/CTD/Subsystem/Subsystem4/DiagnoseRelayWeld/MNC_Weld_Check" /begin REF_CHARACTERISTIC CTD_MAIN_NEGATIVE_CONTACTOR_WELD_FAULT ONE_HUNDRED_PERCENT /end REF_CHARACTERISTIC /end GROUP
/begin GROUP S375_MPC_Weld_Check "VBU0513/VBUSystem/BMS/CTD/Subsystem/Subsystem4/DiagnoseRelayWeld/MPC_Weld_Check" /begin REF_CHARACTERISTIC CTD_MAIN_POSITIVE_CONTACTOR_WELD_FAULT /end REF_CHARACTERISTIC /end GROUP
/begin GROUP S379_CONTACTOR_STATUS_CLOSED1 "VBU0513/VBUSystem/BMS/CTD/Subsystem/Subsystem4/Precharge_Resistance_Diagnostic/CONTACTOR_STATUS_CLOSED1" /begin REF_CHARACTERISTIC CTD_MAIN_CONTACTOR_STATUS_CLOSED /end REF_CHARACTERISTIC /end GROUP
/begin GROUP S379_CONTACTOR_STATUS_OPENED1 "VBU0513/VBUSystem/BMS/CTD/Subsystem/Subsystem4/Precharge_Resistance_Diagnostic/CONTACTOR_STATUS_OPENED1" /begin REF_CHARACTERISTIC CTD_MAIN_CONTACTOR_STATUS_OPENED /end REF_CHARACTERISTIC /end GROUP
/begin GROUP S380_Determine_Precharge_Timer "VBU0513/VBUSystem/BMS/CTD/Subsystem/Subsystem4/PrechrgProcessMonitoring/Determine_Precharge_Timer" /begin REF_CHARACTERISTIC SAMPLE_TIME_TASK_B /end REF_CHARACTERISTIC /end GROUP
/begin GROUP S380_Determine_Ratio_BusVBatV "VBU0513/VBUSystem/BMS/CTD/Subsystem/Subsystem4/PrechrgProcessMonitoring/Determine_Ratio_BusVBatV" /begin REF_CHARACTERISTIC ONE_HUNDRED_PERCENT /end REF_CHARACTERISTIC /end GROUP
/begin GROUP S380_Precharge_Timeout_Diagnostic "VBU0513/VBUSystem/BMS/CTD/Subsystem/Subsystem4/PrechrgProcessMonitoring/Precharge_Timeout_Diagnostic" /begin REF_CHARACTERISTIC CTD_PRECHARG_TIMEOUT_FAULT /end REF_CHARACTERISTIC /end GROUP
/begin GROUP S381_MPR_Stuck_Open "VBU0513/VBUSystem/BMS/CTD/Subsystem/Subsystem4/Stuck_Open_Diagnostic/MPR_Stuck_Open" /begin REF_CHARACTERISTIC CTD_PRECHARGE_RELAY_STUCK_OPEN_FAULT /end REF_CHARACTERISTIC /end GROUP
/begin GROUP S381_StuckOpenAssistantConditons "VBU0513/VBUSystem/BMS/CTD/Subsystem/Subsystem4/Stuck_Open_Diagnostic/StuckOpenAssistantConditons" /begin REF_CHARACTERISTIC SAMPLE_TIME_TASK_B /end REF_CHARACTERISTIC /end GROUP
/begin GROUP S621_Energy_Protection_Check "VBU0513/VBUSystem/BMS/CTS/CTS/Subsystem/DeterminePrechargeConditions/Energy_Protection_Check" /begin REF_CHARACTERISTIC BMM_STATE_DRIVE_MODE /end REF_CHARACTERISTIC /end GROUP
/begin GROUP S621_SoC_Initialization_Check "VBU0513/VBUSystem/BMS/CTS/CTS/Subsystem/DeterminePrechargeConditions/SoC_Initialization_Check" /begin REF_CHARACTERISTIC MILISECONDS_PER_SECOND SAMPLE_TIME_TASK_B /end REF_CHARACTERISTIC /end GROUP
/begin GROUP S622_Close_Comamnd "VBU0513/VBUSystem/BMS/CTS/CTS/Subsystem/Determine_Contactor_Request/Close_Comamnd"
 /begin REF_CHARACTERISTIC BMM_STATE_DRIVE_MODE BMM_STATE_FAST_CHARGE BMM_STATE_ONBOARD_CHARGE SAMPLE_TIME_TASK_B /end REF_CHARACTERISTIC
/end GROUP
/begin GROUP S622_Open_Comamnd "VBU0513/VBUSystem/BMS/CTS/CTS/Subsystem/Determine_Contactor_Request/Open_Comamnd" /begin REF_CHARACTERISTIC BMM_STATE_FAST_CHARGE /end REF_CHARACTERISTIC /end GROUP
/begin GROUP S655_Determine_CellVoltage_OverUnderBDM "VBU0513/VBUSystem/BMS/CVT/CVT/Subsystem/Monitor_CVT_Performance/Determine_CellVoltage_OverUnderBDM" /begin REF_CHARACTERISTIC BMM_STATE_INITIALIZATION /end REF_CHARACTERISTIC /end GROUP
/begin GROUP S742_Calculate_FastChargeBaseRemainTime "VBU0513/VBUSystem/BMS/FCC /FCC/Subsystem/Calculate_Fastcharge_Time/Calculate_FastChargeBaseRemainTime" /begin REF_CHARACTERISTIC ONE_HUNDRED_PERCENT /end REF_CHARACTERISTIC /end GROUP
/begin GROUP S742_EightyPercentCustomSOC_CaculateChargeTime "VBU0513/VBUSystem/BMS/FCC /FCC/Subsystem/Calculate_Fastcharge_Time/EightyPercentCustomSOC_CaculateChargeTime" /begin REF_CHARACTERISTIC ONE_HUNDRED_PERCENT /end REF_CHARACTERISTIC /end GROUP
/begin GROUP S742_EightyPercentCustomSOC_EnableInvalidChargeTimeFlag "VBU0513/VBUSystem/BMS/FCC /FCC/Subsystem/Calculate_Fastcharge_Time/EightyPercentCustomSOC_EnableInvalidChargeTimeFlag" /begin REF_CHARACTERISTIC BMM_STATE_FAST_CHARGE /end REF_CHARACTERISTIC /end GROUP
/begin GROUP S742_EightyPercentCustomSOC_UpdateChargeTimeFlag "VBU0513/VBUSystem/BMS/FCC /FCC/Subsystem/Calculate_Fastcharge_Time/EightyPercentCustomSOC_UpdateChargeTimeFlag" /begin REF_CHARACTERISTIC BMM_STATE_FAST_CHARGE MILISECONDS_PER_SECOND /end REF_CHARACTERISTIC /end GROUP
/begin GROUP S742_SendInvalidTime_flg "VBU0513/VBUSystem/BMS/FCC /FCC/Subsystem/Calculate_Fastcharge_Time/SendInvalidTime_flg" /begin REF_CHARACTERISTIC BMM_STATE_FAST_CHARGE /end REF_CHARACTERISTIC /end GROUP
/begin GROUP S742_UpdateTimeTrigger "VBU0513/VBUSystem/BMS/FCC /FCC/Subsystem/Calculate_Fastcharge_Time/UpdateTimeTrigger" /begin REF_CHARACTERISTIC BMM_STATE_FAST_CHARGE MILISECONDS_PER_SECOND /end REF_CHARACTERISTIC /end GROUP
/begin GROUP S743_Charge_Request_Protection "VBU0513/VBUSystem/BMS/FCC /FCC/Subsystem/Determine_Fastcharge_Request/Charge_Request_Protection" /begin REF_CHARACTERISTIC MILISECONDS_PER_SECOND /end REF_CHARACTERISTIC /end GROUP
/begin GROUP S924_Determine_OCV_Criteria "VBU0513/VBUSystem/BMS/OCV/OCV/Subsystem/Determine_Criteria/Determine_OCV_Criteria" /begin REF_CHARACTERISTIC CTD_MAIN_CONTACTOR_STATUS_OPENED /end REF_CHARACTERISTIC /end GROUP
/begin GROUP S924_Determine_QOCV_Criteria "VBU0513/VBUSystem/BMS/OCV/OCV/Subsystem/Determine_Criteria/Determine_QOCV_Criteria" /begin REF_CHARACTERISTIC CTD_MAIN_CONTACTOR_STATUS_CLOSED /end REF_CHARACTERISTIC /end GROUP
/begin GROUP S961_Determine_AhIntegral_Capacity "VBU0513/VBUSystem/BMS/SOC/Subsystem5/Subsystem/Determine_AhIntegral_SoC/Determine_AhIntegral_Capacity" /begin REF_CHARACTERISTIC MILISECONDS_PER_SECOND /end REF_CHARACTERISTIC /end GROUP
/begin GROUP S961_Determine_AhIntegral_SOC "VBU0513/VBUSystem/BMS/SOC/Subsystem5/Subsystem/Determine_AhIntegral_SoC/Determine_AhIntegral_SOC" /begin REF_CHARACTERISTIC ONE_HUNDRED_PERCENT /end REF_CHARACTERISTIC /end GROUP
/begin GROUP S966_Determine_BatterySOC_ChangeRate "VBU0513/VBUSystem/BMS/SOC/Subsystem5/Subsystem/Determine_Display_SOC/Determine_BatterySOC_ChangeRate" /begin REF_CHARACTERISTIC MILISECONDS_PER_SECOND ONE_HUNDRED_PERCENT /end REF_CHARACTERISTIC /end GROUP
/begin GROUP S966_DisplaySOC_Driving_Calculation "VBU0513/VBUSystem/BMS/SOC/Subsystem5/Subsystem/Determine_Display_SOC/DisplaySOC_Driving_Calculation" /begin REF_CHARACTERISTIC BMM_STATE_FAST_CHARGE /end REF_CHARACTERISTIC /end GROUP
/begin GROUP S967_Determine_InternalResistanceCausedDevCellVoltage "VBU0513/VBUSystem/BMS/SOC/Subsystem5/Subsystem/Determine_FastChargeCorrection_Soc/Determine_InternalResistanceCausedDevCellVoltage" /begin REF_CHARACTERISTIC BMM_STATE_FAST_CHARGE /end REF_CHARACTERISTIC /end GROUP
/begin GROUP S967_FastCharge_PreCorrection "VBU0513/VBUSystem/BMS/SOC/Subsystem5/Subsystem/Determine_FastChargeCorrection_Soc/FastCharge_PreCorrection" /begin REF_CHARACTERISTIC BMM_STATE_FAST_CHARGE /end REF_CHARACTERISTIC /end GROUP
/begin GROUP S967_FastCharge_TopofChargeCorrection "VBU0513/VBUSystem/BMS/SOC/Subsystem5/Subsystem/Determine_FastChargeCorrection_Soc/FastCharge_TopofChargeCorrection" /begin REF_CHARACTERISTIC BMM_STATE_FAST_CHARGE /end REF_CHARACTERISTIC /end GROUP
/begin GROUP S974_Data_Storage "VBU0513/VBUSystem/BMS/SOC/Subsystem5/Subsystem/Soc_Data_Storage/Data_Storage" /begin REF_CHARACTERISTIC NVM_EEPROM_CRC_CHECK_FAULT /end REF_CHARACTERISTIC /end GROUP
/begin GROUP S1137_Determine_History_Current_Data "VBU0513/VBUSystem/BMS/SOE/Subsystem2/Subsystem/Calculate_History_Average_Current/Determine_History_Current_Data" /begin REF_CHARACTERISTIC MILISECONDS_PER_SECOND /end REF_CHARACTERISTIC /end GROUP
/begin GROUP S1137_Time_Counter "VBU0513/VBUSystem/BMS/SOE/Subsystem2/Subsystem/Calculate_History_Average_Current/Time_Counter" /begin REF_CHARACTERISTIC MILISECONDS_PER_SECOND /end REF_CHARACTERISTIC /end GROUP
/begin GROUP S1138_Charge_and_Idle_Mode "VBU0513/VBUSystem/BMS/SOE/Subsystem2/Subsystem/Calculate_Pack_Remaining_Energy/Charge_and_Idle_Mode" /begin REF_CHARACTERISTIC CcSYS_NominalCellCapacity_Ah ONE_HUNDRED_PERCENT /end REF_CHARACTERISTIC /end GROUP
/begin GROUP S1138_Discharge_Mode "VBU0513/VBUSystem/BMS/SOE/Subsystem2/Subsystem/Calculate_Pack_Remaining_Energy/Discharge_Mode" /begin REF_CHARACTERISTIC ONE_HUNDRED_PERCENT /end REF_CHARACTERISTIC /end GROUP
/begin GROUP S1193_FCC_CHARGE_MODE1 "VBU0513/VBUSystem/BMS/SOF/Subsystem6/Subsystem/Rate_CurrentLimit/FCC_CHARGE_MODE1" /begin REF_CHARACTERISTIC BMM_STATE_FAST_CHARGE /end REF_CHARACTERISTIC /end GROUP
/begin GROUP S1416_Calculate_MinCellCapacity274_SlowCharge "VBU0513/VBUSystem/BMS/SOH/Subsystem4/Subsystem1/Calculate_Capacity/Calculate_MinCellCapacity274_SlowCharge" /begin REF_CHARACTERISTIC CcSYS_NominalCellCapacity_Ah ONE_HUNDRED_PERCENT /end REF_CHARACTERISTIC /end GROUP
/begin GROUP S1417_Compute_Resistance_Request "VBU0513/VBUSystem/BMS/SOH/Subsystem4/Subsystem1/Calculate_Resistance/Compute_Resistance_Request" /begin REF_CHARACTERISTIC CcSYS_NominalCellCapacity_Ah /end REF_CHARACTERISTIC /end GROUP
/begin GROUP S1621_FCC_CHARGE_MODE1 "VBU0513/VBUSystem/BMS/VCT/Subsystem/Subsystem/Determine_BMS_VCU_267/FCC_CHARGE_MODE1" /begin REF_CHARACTERISTIC BMM_STATE_FAST_CHARGE /end REF_CHARACTERISTIC /end GROUP
/begin GROUP S1630_CONTACTOR_STATUS_CLOSED1 "VBU0513/VBUSystem/BMS/VCT/Subsystem/Subsystem/Determine_BMS_VCU_34/CONTACTOR_STATUS_CLOSED1" /begin REF_CHARACTERISTIC CTD_MAIN_CONTACTOR_STATUS_CLOSED /end REF_CHARACTERISTIC /end GROUP
/begin GROUP S1630_CONTACTOR_STATUS_CLOSED2 "VBU0513/VBUSystem/BMS/VCT/Subsystem/Subsystem/Determine_BMS_VCU_34/CONTACTOR_STATUS_CLOSED2" /begin REF_CHARACTERISTIC CTD_MAIN_CONTACTOR_STATUS_CLOSED /end REF_CHARACTERISTIC /end GROUP
/begin GROUP S1630_CONTACTOR_STATUS_CLOSED3 "VBU0513/VBUSystem/BMS/VCT/Subsystem/Subsystem/Determine_BMS_VCU_34/CONTACTOR_STATUS_CLOSED3" /begin REF_CHARACTERISTIC CTD_MAIN_CONTACTOR_STATUS_CLOSED /end REF_CHARACTERISTIC /end GROUP
/begin GROUP S1630_CONTACTOR_STATUS_CLOSED4 "VBU0513/VBUSystem/BMS/VCT/Subsystem/Subsystem/Determine_BMS_VCU_34/CONTACTOR_STATUS_CLOSED4" /begin REF_CHARACTERISTIC CTD_MAIN_CONTACTOR_STATUS_CLOSED /end REF_CHARACTERISTIC /end GROUP
/begin GROUP S1630_CONTACTOR_STATUS_OPENED2 "VBU0513/VBUSystem/BMS/VCT/Subsystem/Subsystem/Determine_BMS_VCU_34/CONTACTOR_STATUS_OPENED2" /begin REF_CHARACTERISTIC CTD_MAIN_CONTACTOR_STATUS_OPENED /end REF_CHARACTERISTIC /end GROUP
/begin GROUP S1633_FCC_CHARGE_MODE1 "VBU0513/VBUSystem/BMS/VCT/Subsystem/Subsystem/Determine_BMS_VCU_AC/FCC_CHARGE_MODE1" /begin REF_CHARACTERISTIC BMM_STATE_FAST_CHARGE /end REF_CHARACTERISTIC /end GROUP
/begin GROUP S3365_ChargeConditon "VBU0513/VBUSystem/VCU /DSPL /DSPL/DriveRange/RemainingRange/ChargeConditon" /begin REF_CHARACTERISTIC PMM_stDCChMode_SY /end REF_CHARACTERISTIC /end GROUP
/begin GROUP S187_Diagnose_BdmVoltageCurrent_Fault "VBU0513/VBUSystem/BMS/BCV/BCV/Subsystem/Monitor_BCV_Performance/Diagnose_BDM_BCV_Data_Fault/Diagnose_BdmVoltageCurrent_Fault"
 /begin REF_CHARACTERISTIC BCV_BATTERY_OVER_CURRENT_FAULT BCV_BATTERY_OVER_VOLTAGE_FAULT /end REF_CHARACTERISTIC
/end GROUP
/begin GROUP S387_CONTACTOR_STATUS_OPENED1 "VBU0513/VBUSystem/BMS/CTD/Subsystem/Subsystem4/DiagnoseRelayWeld/MNC_Weld_Check/CONTACTOR_STATUS_OPENED1" /begin REF_CHARACTERISTIC CTD_MAIN_CONTACTOR_STATUS_OPENED /end REF_CHARACTERISTIC /end GROUP
/begin GROUP S388_CONTACTOR_STATUS_OPENED "VBU0513/VBUSystem/BMS/CTD/Subsystem/Subsystem4/DiagnoseRelayWeld/MPC_Weld_Check/CONTACTOR_STATUS_OPENED" /begin REF_CHARACTERISTIC CTD_MAIN_CONTACTOR_STATUS_OPENED /end REF_CHARACTERISTIC /end GROUP
/begin GROUP S388_CONTACTOR_STATUS_OPENED1 "VBU0513/VBUSystem/BMS/CTD/Subsystem/Subsystem4/DiagnoseRelayWeld/MPC_Weld_Check/CONTACTOR_STATUS_OPENED1" /begin REF_CHARACTERISTIC CTD_MAIN_CONTACTOR_STATUS_OPENED /end REF_CHARACTERISTIC /end GROUP
/begin GROUP S454_Determine_Precharge_JouleHeat "VBU0513/VBUSystem/BMS/CTD/Subsystem/Subsystem4/PrechrgProcessMonitoring/Precharge_Thermal_Management/Determine_Precharge_JouleHeat" /begin REF_CHARACTERISTIC MILISECONDS_PER_SECOND SAMPLE_TIME_TASK_B /end REF_CHARACTERISTIC /end GROUP
/begin GROUP S454_Perform_OverEnergy_Diagnostic "VBU0513/VBUSystem/BMS/CTD/Subsystem/Subsystem4/PrechrgProcessMonitoring/Precharge_Thermal_Management/Perform_OverEnergy_Diagnostic" /begin REF_CHARACTERISTIC CTD_PRECHARGE_ENERGY_HIGH_FAULT /end REF_CHARACTERISTIC /end GROUP
/begin GROUP S476_MNC_Stuck_Open_Without_VehicleSpeed "VBU0513/VBUSystem/BMS/CTD/Subsystem/Subsystem4/Stuck_Open_Diagnostic/MNC_Stuck_Open/MNC_Stuck_Open_Without_VehicleSpeed" /begin REF_CHARACTERISTIC CTD_PARKING_MAIN_NEGATIVE_CONTACTOR_STUCK_OPEN_FAULT /end REF_CHARACTERISTIC /end GROUP
/begin GROUP S477_MPC_Stuck_Open_Within_VehicleSpeed "VBU0513/VBUSystem/BMS/CTD/Subsystem/Subsystem4/Stuck_Open_Diagnostic/MPC_Stuck_Open/MPC_Stuck_Open_Within_VehicleSpeed" /begin REF_CHARACTERISTIC CTD_PARKING_MAIN_POSITIVE_CONTACTOR_STUCK_OPEN_FAULT /end REF_CHARACTERISTIC /end GROUP
/begin GROUP S478_CONTACTOR_STATUS_CLOSED1 "VBU0513/VBUSystem/BMS/CTD/Subsystem/Subsystem4/Stuck_Open_Diagnostic/MPR_Stuck_Open/CONTACTOR_STATUS_CLOSED1" /begin REF_CHARACTERISTIC CTD_MAIN_CONTACTOR_STATUS_CLOSED /end REF_CHARACTERISTIC /end GROUP
/begin GROUP S593_CellTemp_ChangeRate_Calculate "VBU0513/VBUSystem/BMS/CTM/CTM/Subsystem/Determine_Thermal_Runaway/DetermineTempRiseRate/CellTemp_ChangeRate_Calculate" /begin REF_CHARACTERISTIC MILISECONDS_PER_SECOND /end REF_CHARACTERISTIC /end GROUP
/begin GROUP S798_Decrease_ChargeCurrentRequest "VBU0513/VBUSystem/BMS/FCC /FCC/Subsystem/Determine_Fastcharge_Request/Charge_Request_Protection/Decrease_ChargeCurrentRequest" /begin REF_CHARACTERISTIC MILISECONDS_PER_SECOND /end REF_CHARACTERISTIC /end GROUP
/begin GROUP S832_Cell_Temp_Protection "VBU0513/VBUSystem/BMS/FCC /FCC/Subsystem/Fastcharge_Conditions_Check/Condition_Categorize/Cell_Temp_Protection" /begin REF_CHARACTERISTIC MILISECONDS_PER_SECOND /end REF_CHARACTERISTIC /end GROUP
/begin GROUP S832_Voltage_Protection "VBU0513/VBUSystem/BMS/FCC /FCC/Subsystem/Fastcharge_Conditions_Check/Condition_Categorize/Voltage_Protection" /begin REF_CHARACTERISTIC MILISECONDS_PER_SECOND /end REF_CHARACTERISTIC /end GROUP
/begin GROUP S986_Determine_Cell_Balanced_Capacity "VBU0513/VBUSystem/BMS/SOC/Subsystem5/Subsystem/Determine_AhIntegral_SoC/Determine_AhIntegral_Capacity/Determine_Cell_Balanced_Capacity" /begin REF_CHARACTERISTIC MILISECONDS_PER_SECOND ONE_HUNDRED_PERCENT /end REF_CHARACTERISTIC /end GROUP
/begin GROUP S988_CONTACTOR_STATUS_OPENED1 "VBU0513/VBUSystem/BMS/SOC/Subsystem5/Subsystem/Determine_AhIntegral_SoC/Determine_Module_Current/CONTACTOR_STATUS_OPENED1" /begin REF_CHARACTERISTIC CTD_MAIN_CONTACTOR_STATUS_OPENED /end REF_CHARACTERISTIC /end GROUP
/begin GROUP S1021_Determine_SOC_RateLimit "VBU0513/VBUSystem/BMS/SOC/Subsystem5/Subsystem/Determine_Display_SOC/DisplaySOC_Driving_Calculation/Determine_SOC_RateLimit" /begin REF_CHARACTERISTIC BMM_STATE_DRIVE_MODE /end REF_CHARACTERISTIC /end GROUP
/begin GROUP S1045_FastCharge_DynamicCorrection_Enable "VBU0513/VBUSystem/BMS/SOC/Subsystem5/Subsystem/Determine_FastChargeCorrection_Soc/FastCharge_DynamicCorrection/FastCharge_DynamicCorrection_Enable" /begin REF_CHARACTERISTIC CcSYS_NominalCellCapacity_Ah /end REF_CHARACTERISTIC /end GROUP
/begin GROUP S1082_Battery_SOC_Calculation "VBU0513/VBUSystem/BMS/SOC/Subsystem5/Subsystem/Determine_Initial_SoC/CellSOC_Startup_AbnormalReset/Battery_SOC_Calculation" /begin REF_CHARACTERISTIC ONE_HUNDRED_PERCENT /end REF_CHARACTERISTIC /end GROUP
/begin GROUP S1084_Battery_SOC_Calculation "VBU0513/VBUSystem/BMS/SOC/Subsystem5/Subsystem/Determine_Initial_SoC/CellSOC_Startup_Normal/Battery SOC Calculation" /begin REF_CHARACTERISTIC ONE_HUNDRED_PERCENT /end REF_CHARACTERISTIC /end GROUP
/begin GROUP S1149_Calculate_Energy_Retention_Factor "VBU0513/VBUSystem/BMS/SOE/Subsystem2/Subsystem/Calculate_Pack_Remaining_Energy/Discharge_Mode/Calculate_Energy_Retention_Factor" /begin REF_CHARACTERISTIC ONE_HUNDRED_PERCENT /end REF_CHARACTERISTIC /end GROUP
/begin GROUP S1149_Calculate_Remaining_Energy "VBU0513/VBUSystem/BMS/SOE/Subsystem2/Subsystem/Calculate_Pack_Remaining_Energy/Discharge_Mode/Calculate_Remaining_Energy" /begin REF_CHARACTERISTIC CcSYS_NominalCellCapacity_Ah ONE_HUNDRED_PERCENT /end REF_CHARACTERISTIC /end GROUP
/begin GROUP S1149_Predict_SOC_End "VBU0513/VBUSystem/BMS/SOE/Subsystem2/Subsystem/Calculate_Pack_Remaining_Energy/Discharge_Mode/Predict_SOC_End" /begin REF_CHARACTERISTIC ONE_HUNDRED_PERCENT /end REF_CHARACTERISTIC /end GROUP
/begin GROUP S1196_Calculate_Locked_SOC "VBU0513/VBUSystem/BMS/SOF/Subsystem6/Subsystem/Calculate_PowerLimit/Calculate_Pack_OCV/Calculate_Locked_SOC" /begin REF_CHARACTERISTIC ONE_HUNDRED_PERCENT /end REF_CHARACTERISTIC /end GROUP
/begin GROUP S1196_Rate_Limiter "VBU0513/VBUSystem/BMS/SOF/Subsystem6/Subsystem/Calculate_PowerLimit/Calculate_Pack_OCV/Rate_Limiter" /begin REF_CHARACTERISTIC MILISECONDS_PER_SECOND /end REF_CHARACTERISTIC /end GROUP
/begin GROUP S1198_Calculate_Locked_SOC "VBU0513/VBUSystem/BMS/SOF/Subsystem6/Subsystem/Calculate_PowerLimit/Determine_SOCP_PowerLimit/Calculate_Locked_SOC" /begin REF_CHARACTERISTIC ONE_HUNDRED_PERCENT /end REF_CHARACTERISTIC /end GROUP
/begin GROUP S1228_Calculate_CurrentLimit_Base "VBU0513/VBUSystem/BMS/SOF/Subsystem6/Subsystem/Determine_Currentlimit_Target/Calculate_CurrentLimit_Target/Calculate_CurrentLimit_Base" /begin REF_CHARACTERISTIC MILISECONDS_PER_SECOND /end REF_CHARACTERISTIC /end GROUP
/begin GROUP S1422_CellCapacity_Limit "VBU0513/VBUSystem/BMS/SOH/Subsystem4/Subsystem1/Calculate_Capacity/Calculate_CellCapacity/CellCapacity_Limit" /begin REF_CHARACTERISTIC CcSYS_NominalCellCapacity_Ah /end REF_CHARACTERISTIC /end GROUP
/begin GROUP S1422_Determine_PackSoh "VBU0513/VBUSystem/BMS/SOH/Subsystem4/Subsystem1/Calculate_Capacity/Calculate_CellCapacity/Determine_PackSoh" /begin REF_CHARACTERISTIC CcSYS_NominalCellCapacity_Ah ONE_HUNDRED_PERCENT /end REF_CHARACTERISTIC /end GROUP
/begin GROUP S1423_Caculate_CellCapacity "VBU0513/VBUSystem/BMS/SOH/Subsystem4/Subsystem1/Calculate_Capacity/Calculate_CellCapacity_SlowCharge/Caculate_CellCapacity" /begin REF_CHARACTERISTIC ONE_HUNDRED_PERCENT /end REF_CHARACTERISTIC /end GROUP
/begin GROUP S1493_CONTACTOR_STATUS_CLOSED "VBU0513/VBUSystem/BMS/SOH/Subsystem4/Subsystem1/Calculate_Resistance/Calculate_ModuleCurrent/CONTACTOR_STATUS_CLOSED" /begin REF_CHARACTERISTIC CTD_MAIN_CONTACTOR_STATUS_CLOSED /end REF_CHARACTERISTIC /end GROUP
/begin GROUP S1557_Determine_InletTemp_Validation "VBU0513/VBUSystem/BMS/THM/Subsystem/Subsystem/Calculate_PipeTemperature/Determine_CoolantSensorTemp_Validation/Determine_InletTemp_Validation" /begin REF_CHARACTERISTIC MILISECONDS_PER_SECOND /end REF_CHARACTERISTIC /end GROUP
/begin GROUP S1557_Determine_OutletTemp_Validation "VBU0513/VBUSystem/BMS/THM/Subsystem/Subsystem/Calculate_PipeTemperature/Determine_CoolantSensorTemp_Validation/Determine_OutletTemp_Validation" /begin REF_CHARACTERISTIC MILISECONDS_PER_SECOND /end REF_CHARACTERISTIC /end GROUP
/begin GROUP S56_Calculate_Current_ZeroDruft "VBU0513/VBUSystem/BMS/BCV/BCV/Subsystem/Calculate_BatteryCurrent/Correct_BatteryCurrent/Calculate_BatteryCurrent_ZeroDrift/Calculate_Current_ZeroDruft" /begin REF_CHARACTERISTIC SAMPLE_TIME_TASK_B /end REF_CHARACTERISTIC /end GROUP
/begin GROUP S324_Determine_CellBlanceTime "VBU0513/VBUSystem/BMS/CBL/Subsystem8/Subsystem/Determine_CSCCellBalanceRequest/Determine_CellBalanceRequest/Cell0/Determine_CellBlanceTime" /begin REF_CHARACTERISTIC ONE_HUNDRED_PERCENT /end REF_CHARACTERISTIC /end GROUP
/begin GROUP S480_CONTACTOR_STATUS_CLOSED1 "VBU0513/VBUSystem/BMS/CTD/Subsystem/Subsystem4/Stuck_Open_Diagnostic/MNC_Stuck_Open/MNC_Stuck_Open_With_VehicleSpeed/CONTACTOR_STATUS_CLOSED1" /begin REF_CHARACTERISTIC CTD_MAIN_CONTACTOR_STATUS_CLOSED /end REF_CHARACTERISTIC /end GROUP
/begin GROUP S481_CONTACTOR_STATUS_CLOSED1 "VBU0513/VBUSystem/BMS/CTD/Subsystem/Subsystem4/Stuck_Open_Diagnostic/MNC_Stuck_Open/MNC_Stuck_Open_Without_VehicleSpeed/CONTACTOR_STATUS_CLOSED1" /begin REF_CHARACTERISTIC CTD_MAIN_CONTACTOR_STATUS_CLOSED /end REF_CHARACTERISTIC /end GROUP
/begin GROUP S503_CONTACTOR_STATUS_CLOSED1 "VBU0513/VBUSystem/BMS/CTD/Subsystem/Subsystem4/Stuck_Open_Diagnostic/MPC_Stuck_Open/MPC_Stuck_Open_Within_VehicleSpeed/CONTACTOR_STATUS_CLOSED1" /begin REF_CHARACTERISTIC CTD_MAIN_CONTACTOR_STATUS_CLOSED /end REF_CHARACTERISTIC /end GROUP
/begin GROUP S504_CONTACTOR_STATUS_CLOSED1 "VBU0513/VBUSystem/BMS/CTD/Subsystem/Subsystem4/Stuck_Open_Diagnostic/MPC_Stuck_Open/MPC_Stuck_Open_Without_VehicleSpeed/CONTACTOR_STATUS_CLOSED1" /begin REF_CHARACTERISTIC CTD_MAIN_CONTACTOR_STATUS_CLOSED /end REF_CHARACTERISTIC /end GROUP
/begin GROUP S841_FullCharge_criteria1 "VBU0513/VBUSystem/BMS/FCC /FCC/Subsystem/Fastcharge_Conditions_Check/Condition_Categorize/Full_Charge_Determination/FullCharge_criteria1" /begin REF_CHARACTERISTIC MILISECONDS_PER_SECOND /end REF_CHARACTERISTIC /end GROUP
/begin GROUP S841_FullCharge_criteria2 "VBU0513/VBUSystem/BMS/FCC /FCC/Subsystem/Fastcharge_Conditions_Check/Condition_Categorize/Full_Charge_Determination/FullCharge_criteria2" /begin REF_CHARACTERISTIC MILISECONDS_PER_SECOND /end REF_CHARACTERISTIC /end GROUP
/begin GROUP S841_FullCharge_criteria4 "VBU0513/VBUSystem/BMS/FCC /FCC/Subsystem/Fastcharge_Conditions_Check/Condition_Categorize/Full_Charge_Determination/FullCharge_criteria4" /begin REF_CHARACTERISTIC MILISECONDS_PER_SECOND /end REF_CHARACTERISTIC /end GROUP
/begin GROUP S1055_Determine_CurrentStable_Condition "VBU0513/VBUSystem/BMS/SOC/Subsystem5/Subsystem/Determine_FastChargeCorrection_Soc/FastCharge_DynamicCorrection/FastCharge_DynamicCorrection_Enable/Determine_CurrentStable_Condition" /begin REF_CHARACTERISTIC ONE_HUNDRED_PERCENT /end REF_CHARACTERISTIC /end GROUP
/begin GROUP S1232_FastChrgOneThirdRateCurrentLimitCheck "VBU0513/VBUSystem/BMS/SOF/Subsystem6/Subsystem/Determine_Currentlimit_Target/Calculate_CurrentLimit_Target/CurrentLimit_FastCharge_Check/FastChrgOneThirdRateCurrentLimitCheck" /begin REF_CHARACTERISTIC MILISECONDS_PER_SECOND /end REF_CHARACTERISTIC /end GROUP
/begin GROUP S1233_Determine_StopCharge_Condition "VBU0513/VBUSystem/BMS/SOF/Subsystem6/Subsystem/Determine_Currentlimit_Target/Calculate_CurrentLimit_Target/CurrentLimit_Fault_Correct/Determine_StopCharge_Condition" /begin REF_CHARACTERISTIC MILISECONDS_PER_SECOND /end REF_CHARACTERISTIC /end GROUP
/begin GROUP S1427_Caculate_WeightingLifeTimeCharge "VBU0513/VBUSystem/BMS/SOH/Subsystem4/Subsystem1/Calculate_Capacity/Calculate_CellCapacity/Caculate_CellCapacity_LifeTimeQ/Caculate_WeightingLifeTimeCharge" /begin REF_CHARACTERISTIC ONE_HUNDRED_PERCENT /end REF_CHARACTERISTIC /end GROUP
/begin GROUP S1427_NVM_ReadWrite_Check "VBU0513/VBUSystem/BMS/SOH/Subsystem4/Subsystem1/Calculate_Capacity/Calculate_CellCapacity/Caculate_CellCapacity_LifeTimeQ/NVM_ReadWrite_Check" /begin REF_CHARACTERISTIC NVM_EEPROM_CRC_CHECK_FAULT /end REF_CHARACTERISTIC /end GROUP
/begin GROUP S1428_LimittedByNVMvalue "VBU0513/VBUSystem/BMS/SOH/Subsystem4/Subsystem1/Calculate_Capacity/Calculate_CellCapacity/CellCapacity_Limit/LimittedByNVMvalue" /begin REF_CHARACTERISTIC CcSYS_NominalCellCapacity_Ah ONE_HUNDRED_PERCENT /end REF_CHARACTERISTIC /end GROUP
/begin GROUP S1461_Determine_AhIntegral_Q "VBU0513/VBUSystem/BMS/SOH/Subsystem4/Subsystem1/Calculate_Capacity/Calculate_CellCapacity_SlowCharge/Determine_AhIntegral_DeltaQ/Determine_AhIntegral_Q" /begin REF_CHARACTERISTIC MILISECONDS_PER_SECOND /end REF_CHARACTERISTIC /end GROUP
/begin GROUP S1483_OBC_CHARGE_MODE1 "VBU0513/VBUSystem/BMS/SOH/Subsystem4/Subsystem1/Calculate_Capacity/Determine_CalculateCellCapacity_Condition/Determine_SlowCharge/OBC_CHARGE_MODE1" /begin REF_CHARACTERISTIC BMM_STATE_ONBOARD_CHARGE /end REF_CHARACTERISTIC /end GROUP
/begin GROUP S1501_NVM_ReadWrite_Check "VBU0513/VBUSystem/BMS/SOH/Subsystem4/Subsystem1/Calculate_Resistance/BasicCellResistance_Calculation_Check/ResistanceCalc_Check/NVM_ReadWrite_Check" /begin REF_CHARACTERISTIC NVM_EEPROM_CRC_CHECK_FAULT /end REF_CHARACTERISTIC /end GROUP
/begin GROUP S1516_Determine_FCCPulseCurrent_Condition "VBU0513/VBUSystem/BMS/SOH/Subsystem4/Subsystem1/Calculate_Resistance/Determine_Condition_Calculate_Pulse_Average_CurrentVoltage/Determine_Condition/Determine_FCCPulseCurrent_Condition" /begin REF_CHARACTERISTIC ONE_HUNDRED_PERCENT /end REF_CHARACTERISTIC /end GROUP
/begin GROUP S1516_Determine_OBCPulseCurrent_Condition "VBU0513/VBUSystem/BMS/SOH/Subsystem4/Subsystem1/Calculate_Resistance/Determine_Condition_Calculate_Pulse_Average_CurrentVoltage/Determine_Condition/Determine_OBCPulseCurrent_Condition" /begin REF_CHARACTERISTIC ONE_HUNDRED_PERCENT /end REF_CHARACTERISTIC /end GROUP
/begin GROUP S1558_Determinate_InletTempValidationDelay "VBU0513/VBUSystem/BMS/THM/Subsystem/Subsystem/Calculate_PipeTemperature/Determine_CoolantSensorTemp_Validation/Determine_InletTemp_Validation/Determinate_InletTempValidationDelay" /begin REF_CHARACTERISTIC MILISECONDS_PER_SECOND /end REF_CHARACTERISTIC /end GROUP
/begin GROUP S1559_Determinate_OutletTempValidationDelay "VBU0513/VBUSystem/BMS/THM/Subsystem/Subsystem/Calculate_PipeTemperature/Determine_CoolantSensorTemp_Validation/Determine_OutletTemp_Validation/Determinate_OutletTempValidationDelay" /begin REF_CHARACTERISTIC MILISECONDS_PER_SECOND /end REF_CHARACTERISTIC /end GROUP
/begin GROUP S58_Enabled_Subsystem "VBU0513/VBUSystem/BMS/BCV/BCV/Subsystem/Calculate_BatteryCurrent/Correct_BatteryCurrent/Calculate_BatteryCurrent_ZeroDrift/Calculate_Current_ZeroDruft/Enabled_Subsystem" /begin REF_CHARACTERISTIC SAMPLE_TIME_TASK_B /end REF_CHARACTERISTIC /end GROUP
/begin GROUP S460_Determine_Accumulated_Cooling "VBU0513/VBUSystem/BMS/CTD/Subsystem/Subsystem4/PrechrgProcessMonitoring/Precharge_Thermal_Management/Determine_Precharge_JouleHeat/Determine_Accumulated_RemainingHeat/Determine_Accumulated_Cooling" /begin REF_CHARACTERISTIC MILISECONDS_PER_SECOND SAMPLE_TIME_TASK_B /end REF_CHARACTERISTIC /end GROUP
/begin GROUP S1235_Calculate_Locked_SOC "VBU0513/VBUSystem/BMS/SOF/Subsystem6/Subsystem/Determine_Currentlimit_Target/Calculate_CurrentLimit_Target/Calculate_CurrentLimit_Base/Calculate_ContinuousChargeCurrent/Calculate_Locked_SOC" /begin REF_CHARACTERISTIC ONE_HUNDRED_PERCENT /end REF_CHARACTERISTIC /end GROUP
/begin GROUP S1235_Calculate_Locked_SOC1 "VBU0513/VBUSystem/BMS/SOF/Subsystem6/Subsystem/Determine_Currentlimit_Target/Calculate_CurrentLimit_Target/Calculate_CurrentLimit_Base/Calculate_ContinuousChargeCurrent/Calculate_Locked_SOC1" /begin REF_CHARACTERISTIC ONE_HUNDRED_PERCENT /end REF_CHARACTERISTIC /end GROUP
/begin GROUP S1235_Calculate_Locked_SOC2 "VBU0513/VBUSystem/BMS/SOF/Subsystem6/Subsystem/Determine_Currentlimit_Target/Calculate_CurrentLimit_Target/Calculate_CurrentLimit_Base/Calculate_ContinuousChargeCurrent/Calculate_Locked_SOC2" /begin REF_CHARACTERISTIC ONE_HUNDRED_PERCENT /end REF_CHARACTERISTIC /end GROUP
/begin GROUP S1236_Calculate_Locked_SOC "VBU0513/VBUSystem/BMS/SOF/Subsystem6/Subsystem/Determine_Currentlimit_Target/Calculate_CurrentLimit_Target/Calculate_CurrentLimit_Base/Calculate_ContinuousDischargeCurrent/Calculate_Locked_SOC" /begin REF_CHARACTERISTIC ONE_HUNDRED_PERCENT /end REF_CHARACTERISTIC /end GROUP
/begin GROUP S1236_Calculate_Locked_SOC1 "VBU0513/VBUSystem/BMS/SOF/Subsystem6/Subsystem/Determine_Currentlimit_Target/Calculate_CurrentLimit_Target/Calculate_CurrentLimit_Base/Calculate_ContinuousDischargeCurrent/Calculate_Locked_SOC1" /begin REF_CHARACTERISTIC ONE_HUNDRED_PERCENT /end REF_CHARACTERISTIC /end GROUP
/begin GROUP S1237_Calculate_Locked_SOC "VBU0513/VBUSystem/BMS/SOF/Subsystem6/Subsystem/Determine_Currentlimit_Target/Calculate_CurrentLimit_Target/Calculate_CurrentLimit_Base/Calculate_ShortPulseChargeCurrent/Calculate_Locked_SOC" /begin REF_CHARACTERISTIC ONE_HUNDRED_PERCENT /end REF_CHARACTERISTIC /end GROUP
/begin GROUP S1237_Calculate_Locked_SOC1 "VBU0513/VBUSystem/BMS/SOF/Subsystem6/Subsystem/Determine_Currentlimit_Target/Calculate_CurrentLimit_Target/Calculate_CurrentLimit_Base/Calculate_ShortPulseChargeCurrent/Calculate_Locked_SOC1" /begin REF_CHARACTERISTIC ONE_HUNDRED_PERCENT /end REF_CHARACTERISTIC /end GROUP
/begin GROUP S1238_Calculate_Locked_SOC "VBU0513/VBUSystem/BMS/SOF/Subsystem6/Subsystem/Determine_Currentlimit_Target/Calculate_CurrentLimit_Target/Calculate_CurrentLimit_Base/Calculate_ShortPulseDischargeCurrent/Calculate_Locked_SOC" /begin REF_CHARACTERISTIC ONE_HUNDRED_PERCENT /end REF_CHARACTERISTIC /end GROUP
/begin GROUP S1238_Calculate_Locked_SOC1 "VBU0513/VBUSystem/BMS/SOF/Subsystem6/Subsystem/Determine_Currentlimit_Target/Calculate_CurrentLimit_Target/Calculate_CurrentLimit_Base/Calculate_ShortPulseDischargeCurrent/Calculate_Locked_SOC1" /begin REF_CHARACTERISTIC ONE_HUNDRED_PERCENT /end REF_CHARACTERISTIC /end GROUP
/begin GROUP S1301_FCC_CHARGE_MODE1 "VBU0513/VBUSystem/BMS/SOF/Subsystem6/Subsystem/Determine_Currentlimit_Target/Calculate_CurrentLimit_Target/CurrentLimit_FastCharge_Check/FastChrgOneThirdRateCurrentLimitCheck/FCC_CHARGE_MODE1" /begin REF_CHARACTERISTIC BMM_STATE_FAST_CHARGE /end REF_CHARACTERISTIC /end GROUP
/begin GROUP S1302_FCC_CHARGE_MODE1 "VBU0513/VBUSystem/BMS/SOF/Subsystem6/Subsystem/Determine_Currentlimit_Target/Calculate_CurrentLimit_Target/CurrentLimit_FastCharge_Check/SegmentChargeCheck/FCC_CHARGE_MODE1" /begin REF_CHARACTERISTIC BMM_STATE_FAST_CHARGE /end REF_CHARACTERISTIC /end GROUP
/begin GROUP S1337_Calculate_CurrentLimit "VBU0513/VBUSystem/BMS/SOF/Subsystem6/Subsystem/Determine_Currentlimit_Target/Calculate_CurrentLimit_Target/CurrentLimit_Voltage_Correct/Correct_CurrentLimit/Calculate_CurrentLimit" /begin REF_CHARACTERISTIC BMM_STATE_FAST_CHARGE MILISECONDS_PER_SECOND /end REF_CHARACTERISTIC /end GROUP
/begin GROUP S1467_Determine_Cell_Balanced_Capacity "VBU0513/VBUSystem/BMS/SOH/Subsystem4/Subsystem1/Calculate_Capacity/Calculate_CellCapacity_SlowCharge/Determine_AhIntegral_DeltaQ/Determine_AhIntegral_Q/Determine_Cell_Balanced_Capacity" /begin REF_CHARACTERISTIC MILISECONDS_PER_SECOND ONE_HUNDRED_PERCENT /end REF_CHARACTERISTIC /end GROUP
/begin GROUP S1468_CONTACTOR_STATUS_OPENED1 "VBU0513/VBUSystem/BMS/SOH/Subsystem4/Subsystem1/Calculate_Capacity/Calculate_CellCapacity_SlowCharge/Determine_AhIntegral_DeltaQ/Determine_Module_Current/CONTACTOR_STATUS_OPENED1" /begin REF_CHARACTERISTIC CTD_MAIN_CONTACTOR_STATUS_OPENED /end REF_CHARACTERISTIC /end GROUP
/begin GROUP S1472_CONTACTOR_STATUS_OPENED1 "VBU0513/VBUSystem/BMS/SOH/Subsystem4/Subsystem1/Calculate_Capacity/Calculate_CellCapacity_SlowCharge/Determine_Soc/Determine_Module_Current/CONTACTOR_STATUS_OPENED1" /begin REF_CHARACTERISTIC CTD_MAIN_CONTACTOR_STATUS_OPENED /end REF_CHARACTERISTIC /end GROUP
/begin GROUP S64_Calculate_Current_Sum "VBU0513/VBUSystem/BMS/BCV/BCV/Subsystem/Calculate_BatteryCurrent/Correct_BatteryCurrent/Calculate_BatteryCurrent_ZeroDrift/Calculate_ExtremeData/Enabled_Subsystem/Calculate_Current_Sum" /begin REF_CHARACTERISTIC SAMPLE_TIME_TASK_B /end REF_CHARACTERISTIC /end GROUP
/begin GROUP S1282_Calculate_ChargeCurrentLimitBuffer_Use "VBU0513/VBUSystem/BMS/SOF/Subsystem6/Subsystem/Determine_Currentlimit_Target/Calculate_CurrentLimit_Target/Calculate_Dynamic_CurrentLimit/Calculate_Dynamic_ChargeCurrentLimit/Calculate_ChargeCurrentLimit_Buff/Calculate_ChargeCurrentLimitBuffer_Use" /begin REF_CHARACTERISTIC MILISECONDS_PER_SECOND /end REF_CHARACTERISTIC /end GROUP
/begin GROUP S1290_Calculate_DischargeCurrentLimitBuffer_Use "VBU0513/VBUSystem/BMS/SOF/Subsystem6/Subsystem/Determine_Currentlimit_Target/Calculate_CurrentLimit_Target/Calculate_Dynamic_CurrentLimit/Calculate_Dynamic_DischargeCurrentLimit/Calculate_DischargeCurrentLimit_Buff/Calculate_DischargeCurrentLimitBuffer_Use" /begin REF_CHARACTERISTIC MILISECONDS_PER_SECOND /end REF_CHARACTERISTIC /end GROUP
/begin GROUP S1291_Rate_Limiter "VBU0513/VBUSystem/BMS/SOF/Subsystem6/Subsystem/Determine_Currentlimit_Target/Calculate_CurrentLimit_Target/Calculate_Dynamic_CurrentLimit/Calculate_Dynamic_DischargeCurrentLimit/Calculate_Dynamic_DischargeCurrentLimit/Rate_Limiter" /begin REF_CHARACTERISTIC MILISECONDS_PER_SECOND /end REF_CHARACTERISTIC /end GROUP
/begin GROUP S1339_Rate_Limiter1 "VBU0513/VBUSystem/BMS/SOF/Subsystem6/Subsystem/Determine_Currentlimit_Target/Calculate_CurrentLimit_Target/CurrentLimit_Voltage_Correct/Correct_CurrentLimit/Calculate_CurrentLimit/Rate_Limiter1" /begin REF_CHARACTERISTIC MILISECONDS_PER_SECOND /end REF_CHARACTERISTIC /end GROUP
/begin GROUP S1342_Calculate_DCIR_Validation "VBU0513/VBUSystem/BMS/SOF/Subsystem6/Subsystem/Determine_Currentlimit_Target/Calculate_CurrentLimit_Target/CurrentLimit_Voltage_Correct/Correct_CurrentLimit/Calculate_CurrentLimit/Calculate_Cell_Discharge_DCIR/Calculate_DCIR_Validation" /begin REF_CHARACTERISTIC ONE_HUNDRED_PERCENT /end REF_CHARACTERISTIC /end GROUP
/end MODULE
/end PROJECT
/* (add any file trailer comments here) */ /* EOF VBU0513.a2l */
