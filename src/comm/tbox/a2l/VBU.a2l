ASAP2_VERSION 1 31
/begin PROJECT ProjectName "Project Comment Goes Here"
/begin HEADER "Header Comments go here" /end HEADER
/begin MODULE ModuleName "Module Comment Goes Here"
/begin MOD_COMMON "Mod Common Comment Here" BYTE_ORDER MSB_LAST /end MOD_COMMON
/begin RECORD_LAYOUT Scalar_BOOLEAN FNC_VALUES 1 UBYTE COLUMN_DIR DIRECT /end RECORD_LAYOUT
/begin RECORD_LAYOUT Scalar_UBYTE FNC_VALUES 1 UBYTE COLUMN_DIR DIRECT /end RECORD_LAYOUT
/begin RECORD_LAYOUT Scalar_BYTE FNC_VALUES 1 SBYTE COLUMN_DIR DIRECT /end RECORD_LAYOUT
/begin RECORD_LAYOUT Scalar_UWORD FNC_VALUES 1 UWORD COLUMN_DIR DIRECT /end RECORD_LAYOUT
/begin RECORD_LAYOUT Scalar_ULONG FNC_VALUES 1 ULONG COLUMN_DIR DIRECT /end RECORD_LAYOUT
/begin RECORD_LAYOUT Scalar_FLOAT32_IEEE FNC_VALUES 1 FLOAT32_IEEE COLUMN_DIR DIRECT /end RECORD_LAYOUT
/begin RECORD_LAYOUT Lookup1D_ULONG FNC_VALUES 1 ULONG COLUMN_DIR DIRECT /end RECORD_LAYOUT
/begin RECORD_LAYOUT Lookup1D_X_ULONG AXIS_PTS_X 1 ULONG INDEX_INCR DIRECT /end RECORD_LAYOUT
/begin RECORD_LAYOUT Lookup1D_SLONG FNC_VALUES 1 SLONG COLUMN_DIR DIRECT /end RECORD_LAYOUT
/begin RECORD_LAYOUT Lookup1D_X_LONG AXIS_PTS_X 1 SLONG INDEX_INCR DIRECT /end RECORD_LAYOUT
/begin RECORD_LAYOUT Lookup1D_FLOAT32_IEEE FNC_VALUES 1 FLOAT32_IEEE COLUMN_DIR DIRECT /end RECORD_LAYOUT
/begin RECORD_LAYOUT Lookup1D_X_FLOAT32_IEEE AXIS_PTS_X 1 FLOAT32_IEEE INDEX_INCR DIRECT /end RECORD_LAYOUT
/begin RECORD_LAYOUT Lookup2D_X_UWORD AXIS_PTS_X 1 UWORD INDEX_INCR DIRECT /end RECORD_LAYOUT
/begin RECORD_LAYOUT Lookup2D_FLOAT32_IEEE FNC_VALUES 1 FLOAT32_IEEE COLUMN_DIR DIRECT /end RECORD_LAYOUT
/begin RECORD_LAYOUT Lookup2D_X_FLOAT32_IEEE AXIS_PTS_X 1 FLOAT32_IEEE INDEX_INCR DIRECT /end RECORD_LAYOUT
/begin CHARACTERISTIC EDIS_pwrChDynSpare_CUR_v "" CURVE 0x700121e2 Lookup1D_FLOAT32_IEEE 0 VBU0513_CM_single_cnt -3.4028234663852886E+38 3.4028234663852886E+38
 /begin AXIS_DESCR COM_AXIS EDIS_pwrChLimLTRaw VBU0513_CM_single_cnt 6 -3.4028234663852886E+38 3.4028234663852886E+38 AXIS_PTS_REF EDIS_pwrChDyn_CUR_x /end AXIS_DESCR
/end CHARACTERISTIC
/begin AXIS_PTS EDIS_pwrChDyn_CUR_x "" 0x700121fa EDIS_pwrChLimLTRaw Lookup1D_X_FLOAT32_IEEE 0 VBU0513_CM_single_cnt 6 -3.4028234663852886E+38 3.4028234663852886E+38 /end AXIS_PTS
/begin CHARACTERISTIC THM_facDeltaCellTempESSPump_v "" CURVE 0x70011fde Lookup1D_FLOAT32_IEEE 0 VBU0513_CM_single_cnt -3.4028234663852886E+38 3.4028234663852886E+38
 /begin AXIS_DESCR COM_AXIS NO_INPUT_QUANTITY VBU0513_CM_single_cnt 5 -3.4028234663852886E+38 3.4028234663852886E+38 AXIS_PTS_REF THM_tDeltaCellTemp_x /end AXIS_DESCR
/end CHARACTERISTIC
/begin AXIS_PTS THM_tDeltaCellTemp_x "" 0x7001202e NO_INPUT_QUANTITY Lookup1D_X_FLOAT32_IEEE 0 VBU0513_CM_single_cnt 5 -3.4028234663852886E+38 3.4028234663852886E+38 /end AXIS_PTS
/begin CHARACTERISTIC THM_pctESSPumpCool_v "" CURVE 0x70012006 Lookup1D_FLOAT32_IEEE 0 VBU0513_CM_single_cnt -3.4028234663852886E+38 3.4028234663852886E+38
 /begin AXIS_DESCR COM_AXIS NO_INPUT_QUANTITY VBU0513_CM_single_cnt 5 -3.4028234663852886E+38 3.4028234663852886E+38 AXIS_PTS_REF THM_tESSPumpCoolTarDeltaTemp_x /end AXIS_DESCR
/end CHARACTERISTIC
/begin AXIS_PTS THM_tESSPumpCoolTarDeltaTemp_x "" 0x70012042 NO_INPUT_QUANTITY Lookup1D_X_FLOAT32_IEEE 0 VBU0513_CM_single_cnt 5 -3.4028234663852886E+38 3.4028234663852886E+38 /end AXIS_PTS
/begin CHARACTERISTIC THM_pctESSPumpHeat_v "" CURVE 0x7001201a Lookup1D_FLOAT32_IEEE 0 VBU0513_CM_single_cnt -3.4028234663852886E+38 3.4028234663852886E+38
 /begin AXIS_DESCR COM_AXIS NO_INPUT_QUANTITY VBU0513_CM_single_cnt 5 -3.4028234663852886E+38 3.4028234663852886E+38 AXIS_PTS_REF THM_tESSPumpHeatTarDeltaTemp_x /end AXIS_DESCR
/end CHARACTERISTIC
/begin AXIS_PTS THM_tESSPumpHeatTarDeltaTemp_x "" 0x70012056 NO_INPUT_QUANTITY Lookup1D_X_FLOAT32_IEEE 0 VBU0513_CM_single_cnt 5 -3.4028234663852886E+38 3.4028234663852886E+38 /end AXIS_PTS
/begin CHARACTERISTIC THM_facVheSpdRearPump_v "" CURVE 0x70011ff2 Lookup1D_FLOAT32_IEEE 0 VBU0513_CM_single_cnt -3.4028234663852886E+38 3.4028234663852886E+38
 /begin AXIS_DESCR COM_AXIS NO_INPUT_QUANTITY VBU0513_CM_single_cnt 5 -3.4028234663852886E+38 3.4028234663852886E+38 AXIS_PTS_REF THM_vVheSpdRearPump_x /end AXIS_DESCR
/end CHARACTERISTIC
/begin AXIS_PTS THM_vVheSpdRearPump_x "" 0x7001206a NO_INPUT_QUANTITY Lookup1D_X_FLOAT32_IEEE 0 VBU0513_CM_single_cnt 5 -3.4028234663852886E+38 3.4028234663852886E+38 /end AXIS_PTS
/begin CHARACTERISTIC THM_pctPEUStrRearPump_v "" CURVE 0x70012332 Lookup1D_FLOAT32_IEEE 0 VBU0513_CM_single_cnt -3.4028234663852886E+38 3.4028234663852886E+38
 /begin AXIS_DESCR COM_AXIS NO_INPUT_QUANTITY VBU0513_CM_single_cnt 6 -3.4028234663852886E+38 3.4028234663852886E+38 AXIS_PTS_REF THM_tPEUMaxStr_x /end AXIS_DESCR
/end CHARACTERISTIC
/begin AXIS_PTS THM_tPEUMaxStr_x "" 0x70012392 NO_INPUT_QUANTITY Lookup1D_X_FLOAT32_IEEE 0 VBU0513_CM_single_cnt 6 -3.4028234663852886E+38 3.4028234663852886E+38 /end AXIS_PTS
/begin CHARACTERISTIC THM_pctDCDCRearPump_v "" CURVE 0x700122a2 Lookup1D_FLOAT32_IEEE 0 VBU0513_CM_single_cnt -3.4028234663852886E+38 3.4028234663852886E+38
 /begin AXIS_DESCR COM_AXIS NO_INPUT_QUANTITY VBU0513_CM_single_cnt 6 -3.4028234663852886E+38 3.4028234663852886E+38 AXIS_PTS_REF THM_tDCDC_x /end AXIS_DESCR
/end CHARACTERISTIC
/begin AXIS_PTS THM_tDCDC_x "" 0x7001237a NO_INPUT_QUANTITY Lookup1D_X_FLOAT32_IEEE 0 VBU0513_CM_single_cnt 6 -3.4028234663852886E+38 3.4028234663852886E+38 /end AXIS_PTS
/begin CHARACTERISTIC THM_pctPEUPhUVWRearPump_v "" CURVE 0x7001231a Lookup1D_FLOAT32_IEEE 0 VBU0513_CM_single_cnt -3.4028234663852886E+38 3.4028234663852886E+38
 /begin AXIS_DESCR COM_AXIS NO_INPUT_QUANTITY VBU0513_CM_single_cnt 6 -3.4028234663852886E+38 3.4028234663852886E+38 AXIS_PTS_REF THM_tPEUPhUVW_x /end AXIS_DESCR
/end CHARACTERISTIC
/begin AXIS_PTS THM_tPEUPhUVW_x "" 0x700123aa NO_INPUT_QUANTITY Lookup1D_X_FLOAT32_IEEE 0 VBU0513_CM_single_cnt 6 -3.4028234663852886E+38 3.4028234663852886E+38 /end AXIS_PTS
/begin CHARACTERISTIC VM_aMSLimHomeD_CUR_v "" CURVE 0x70013c06 Lookup1D_FLOAT32_IEEE 0 VBU0513_CM_single_cnt -3.4028234663852886E+38 3.4028234663852886E+38
 /begin AXIS_DESCR COM_AXIS NO_INPUT_QUANTITY VBU0513_CM_single_cnt 14 -3.4028234663852886E+38 3.4028234663852886E+38 AXIS_PTS_REF VM_vMSLimHomeD_CUR_x /end AXIS_DESCR
/end CHARACTERISTIC
/begin AXIS_PTS VM_vMSLimHomeD_CUR_x "" 0x70013c76 NO_INPUT_QUANTITY Lookup1D_X_FLOAT32_IEEE 0 VBU0513_CM_single_cnt 14 -3.4028234663852886E+38 3.4028234663852886E+38 /end AXIS_PTS
/begin CHARACTERISTIC VM_aMSLimHomeR_CUR_v "" CURVE 0x700124ca Lookup1D_FLOAT32_IEEE 0 VBU0513_CM_single_cnt -3.4028234663852886E+38 3.4028234663852886E+38
 /begin AXIS_DESCR COM_AXIS NO_INPUT_QUANTITY VBU0513_CM_single_cnt 6 -3.4028234663852886E+38 3.4028234663852886E+38 AXIS_PTS_REF VM_vMSLimHomeR_CUR_x /end AXIS_DESCR
/end CHARACTERISTIC
/begin AXIS_PTS VM_vMSLimHomeR_CUR_x "" 0x700124fa NO_INPUT_QUANTITY Lookup1D_X_FLOAT32_IEEE 0 VBU0513_CM_single_cnt 6 -3.4028234663852886E+38 3.4028234663852886E+38 /end AXIS_PTS
/begin CHARACTERISTIC VM_aMSLimR_CUR_v "" CURVE 0x700124e2 Lookup1D_FLOAT32_IEEE 0 VBU0513_CM_single_cnt -3.4028234663852886E+38 3.4028234663852886E+38
 /begin AXIS_DESCR COM_AXIS NO_INPUT_QUANTITY VBU0513_CM_single_cnt 6 -3.4028234663852886E+38 3.4028234663852886E+38 AXIS_PTS_REF VM_vMSLimR_CUR_x /end AXIS_DESCR
/end CHARACTERISTIC
/begin AXIS_PTS VM_vMSLimR_CUR_x "" 0x70012512 NO_INPUT_QUANTITY Lookup1D_X_FLOAT32_IEEE 0 VBU0513_CM_single_cnt 6 -3.4028234663852886E+38 3.4028234663852886E+38 /end AXIS_PTS
/begin CHARACTERISTIC VM_aMSLimD_CUR_v "" CURVE 0x70013bce Lookup1D_FLOAT32_IEEE 0 VBU0513_CM_single_cnt -3.4028234663852886E+38 3.4028234663852886E+38
 /begin AXIS_DESCR COM_AXIS NO_INPUT_QUANTITY VBU0513_CM_single_cnt 14 -3.4028234663852886E+38 3.4028234663852886E+38 AXIS_PTS_REF VM_vMSLimD_CUR_x /end AXIS_DESCR
/end CHARACTERISTIC
/begin AXIS_PTS VM_vMSLimD_CUR_x "" 0x70013c3e NO_INPUT_QUANTITY Lookup1D_X_FLOAT32_IEEE 0 VBU0513_CM_single_cnt 14 -3.4028234663852886E+38 3.4028234663852886E+38 /end AXIS_PTS
/begin CHARACTERISTIC CrCtl_facDragSpeed_MAP_v "" MAP 0x70017abe Lookup2D_FLOAT32_IEEE 0 VBU0513_CM_single_cnt -3.4028234663852886E+38 3.4028234663852886E+38
 /begin AXIS_DESCR COM_AXIS NO_INPUT_QUANTITY VBU0513_CM_single_cnt 14 -3.4028234663852886E+38 3.4028234663852886E+38 AXIS_PTS_REF CrCtl_vDragSpeed_MAP_y /end AXIS_DESCR
 /begin AXIS_DESCR COM_AXIS NO_INPUT_QUANTITY VBU0513_CM_single_cnt 11 -3.4028234663852886E+38 3.4028234663852886E+38 AXIS_PTS_REF CrCtl_pctDragSpeed_MAP_x /end AXIS_DESCR
/end CHARACTERISTIC
/begin AXIS_PTS CrCtl_pctDragSpeed_MAP_x "" 0x70012e0e NO_INPUT_QUANTITY Lookup2D_X_FLOAT32_IEEE 0 VBU0513_CM_single_cnt 11 -3.4028234663852886E+38 3.4028234663852886E+38 /end AXIS_PTS
/begin AXIS_PTS CrCtl_vDragSpeed_MAP_y "" 0x70013b96 NO_INPUT_QUANTITY Lookup2D_X_FLOAT32_IEEE 0 VBU0513_CM_single_cnt 14 -3.4028234663852886E+38 3.4028234663852886E+38 /end AXIS_PTS
/begin CHARACTERISTIC TQD_trqTrqSetECO_MAP_v "" MAP 0x7001be26 Lookup2D_FLOAT32_IEEE 0 VBU0513_CM_single_Nm -10000.0 10000.0
 /begin AXIS_DESCR COM_AXIS TQD_vVehSpd VBU0513_CM_single_kph 21 0.0 110.0 AXIS_PTS_REF TQD_vSgndSpd_MAP_y /end AXIS_DESCR
 /begin AXIS_DESCR COM_AXIS TQD_pctAccPedPosFlt VBU0513_CM_single_pct 17 0.0 100.0 AXIS_PTS_REF TQD_pctAccPdl_MAP_x /end AXIS_DESCR
/end CHARACTERISTIC
/begin AXIS_PTS TQD_pctAccPdl_MAP_x "" 0x700140c6 TQD_pctAccPedPosFlt Lookup2D_X_FLOAT32_IEEE 0 VBU0513_CM_single_pct 17 0.0 100.0 /end AXIS_PTS
/begin AXIS_PTS TQD_vSgndSpd_MAP_y "" 0x700149de TQD_vVehSpd Lookup2D_X_FLOAT32_IEEE 0 VBU0513_CM_single_kph 21 0.0 110.0 /end AXIS_PTS
/begin CHARACTERISTIC TQD_trqTrqSetNormal_MAP_v "" MAP 0x7001c3ba Lookup2D_FLOAT32_IEEE 0 VBU0513_CM_single_Nm -10000.0 10000.0
 /begin AXIS_DESCR COM_AXIS TQD_vVehSpd VBU0513_CM_single_kph 21 0.0 110.0 AXIS_PTS_REF TQD_vSgndSpd_MAP_y /end AXIS_DESCR
 /begin AXIS_DESCR COM_AXIS TQD_pctAccPedPosFlt VBU0513_CM_single_pct 17 0.0 100.0 AXIS_PTS_REF TQD_pctAccPdl_MAP_x /end AXIS_DESCR
/end CHARACTERISTIC
/begin CHARACTERISTIC TQD_facTrqDesGrR_CUR_v "" CURVE 0x700129ae Lookup1D_FLOAT32_IEEE 0 VBU0513_CM_single_pct 0.0 100.0
 /begin AXIS_DESCR COM_AXIS TQD_vVehSpd VBU0513_CM_single_kph 9 0.0 110.0 AXIS_PTS_REF TQD_vSgndSpdGrFac_CUR_x /end AXIS_DESCR
/end CHARACTERISTIC
/begin AXIS_PTS TQD_vSgndSpdGrFac_CUR_x "" 0x700129f6 TQD_vVehSpd Lookup1D_X_FLOAT32_IEEE 0 VBU0513_CM_single_kph 9 0.0 110.0 /end AXIS_PTS
/begin CHARACTERISTIC TQD_pctCrpOff_CUR_v "" CURVE 0x7001410a Lookup1D_FLOAT32_IEEE 0 VBU0513_CM_single_pct 0.0 100.0
 /begin AXIS_DESCR COM_AXIS APD_pctAccPedPos VBU0513_CM_single_pct 17 0.0 100.0 AXIS_PTS_REF TQD_pctAccPdl_CUR_x /end AXIS_DESCR
/end CHARACTERISTIC
/begin AXIS_PTS TQD_pctAccPdl_CUR_x "" 0x70014082 APD_pctAccPedPos Lookup1D_X_FLOAT32_IEEE 0 VBU0513_CM_single_pct 17 0.0 100.0 /end AXIS_PTS
/begin CHARACTERISTIC TQD_trqRoad_CUR_v "" CURVE 0x70014936 Lookup1D_FLOAT32_IEEE 0 VBU0513_CM_single_Nm -10000.0 10000.0
 /begin AXIS_DESCR COM_AXIS TQD_vVehSpd VBU0513_CM_single_kph 21 -250.0 250.0 AXIS_PTS_REF TQD_vSgndSpd_CUR_x /end AXIS_DESCR
/end CHARACTERISTIC
/begin AXIS_PTS TQD_vSgndSpd_CUR_x "" 0x7001498a TQD_vVehSpd Lookup1D_X_FLOAT32_IEEE 0 VBU0513_CM_single_kph 21 -250.0 250.0 /end AXIS_PTS
/begin CHARACTERISTIC MTQL_trqMtrTrqDrvLT_CUR_v "" CURVE 0x70012942 Lookup1D_FLOAT32_IEEE 0 VBU0513_CM_single_cnt -3.4028234663852886E+38 3.4028234663852886E+38
 /begin AXIS_DESCR COM_AXIS NO_INPUT_QUANTITY VBU0513_CM_single_cnt 9 -3.4028234663852886E+38 3.4028234663852886E+38 AXIS_PTS_REF MTQL_nMotrLT_CUR_x /end AXIS_DESCR
/end CHARACTERISTIC
/begin AXIS_PTS MTQL_nMotrLT_CUR_x "" 0x700128fa NO_INPUT_QUANTITY Lookup1D_X_FLOAT32_IEEE 0 VBU0513_CM_single_cnt 9 -3.4028234663852886E+38 3.4028234663852886E+38 /end AXIS_PTS
/begin CHARACTERISTIC CaFCC_IdealRemainChargeTimeSocTempMapZ_min "" MAP 0x700171a2 Lookup2D_FLOAT32_IEEE 0 VBU0513_CM_single_cnt -3.4028234663852886E+38 3.4028234663852886E+38
 /begin AXIS_DESCR COM_AXIS NO_INPUT_QUANTITY VBU0513_CM_single_cnt 13 -3.4028234663852886E+38 3.4028234663852886E+38 AXIS_PTS_REF CaFCC_IdealRemainChargeTimeSocTempMapY_pct /end AXIS_DESCR
 /begin AXIS_DESCR COM_AXIS NO_INPUT_QUANTITY VBU0513_CM_single_cnt 11 -3.4028234663852886E+38 3.4028234663852886E+38 AXIS_PTS_REF CaFCC_IdealRemainChargeTimeSocTempMapX_C /end AXIS_DESCR
/end CHARACTERISTIC
/begin AXIS_PTS CaFCC_IdealRemainChargeTimeSocTempMapX_C "" 0x70012d32 NO_INPUT_QUANTITY Lookup2D_X_FLOAT32_IEEE 0 VBU0513_CM_single_cnt 11 -3.4028234663852886E+38 3.4028234663852886E+38 /end AXIS_PTS
/begin AXIS_PTS CaFCC_IdealRemainChargeTimeSocTempMapY_pct "" 0x70013452 NO_INPUT_QUANTITY Lookup2D_X_FLOAT32_IEEE 0 VBU0513_CM_single_cnt 13 -3.4028234663852886E+38 3.4028234663852886E+38 /end AXIS_PTS
/begin CHARACTERISTIC CaFCC_CurrentLimitRemainChargeTimeSocTempMapZ_min "" MAP 0x70016f66 Lookup2D_FLOAT32_IEEE 0 VBU0513_CM_single_cnt -3.4028234663852886E+38 3.4028234663852886E+38
 /begin AXIS_DESCR COM_AXIS NO_INPUT_QUANTITY VBU0513_CM_single_cnt 13 -3.4028234663852886E+38 3.4028234663852886E+38 AXIS_PTS_REF CaFCC_CurrentLimitRemainChargeTimeSocTempMapY_pct /end AXIS_DESCR
 /begin AXIS_DESCR COM_AXIS NO_INPUT_QUANTITY VBU0513_CM_single_cnt 11 -3.4028234663852886E+38 3.4028234663852886E+38 AXIS_PTS_REF CaFCC_CurrentLimitRemainChargeTimeSocTempMapX_C /end AXIS_DESCR
/end CHARACTERISTIC
/begin AXIS_PTS CaFCC_CurrentLimitRemainChargeTimeSocTempMapX_C "" 0x70012d06 NO_INPUT_QUANTITY Lookup2D_X_FLOAT32_IEEE 0 VBU0513_CM_single_cnt 11 -3.4028234663852886E+38 3.4028234663852886E+38 /end AXIS_PTS
/begin AXIS_PTS CaFCC_CurrentLimitRemainChargeTimeSocTempMapY_pct "" 0x7001341e NO_INPUT_QUANTITY Lookup2D_X_FLOAT32_IEEE 0 VBU0513_CM_single_cnt 13 -3.4028234663852886E+38 3.4028234663852886E+38 /end AXIS_PTS
/begin CHARACTERISTIC CaFCC_EstimateChargingTimeDeltaMapY_min "" CURVE 0x70011c1a Lookup1D_FLOAT32_IEEE 0 VBU0513_CM_single_cnt -3.4028234663852886E+38 3.4028234663852886E+38
 /begin AXIS_DESCR COM_AXIS LcFCC_timinEstimatePercTime VBU0513_CM_single_cnt 4 -3.4028234663852886E+38 3.4028234663852886E+38 AXIS_PTS_REF CaFCC_EstimateChargingTimeDeltaMapX_min /end AXIS_DESCR
/end CHARACTERISTIC
/begin AXIS_PTS CaFCC_EstimateChargingTimeDeltaMapX_min "" 0x70011c0a LcFCC_timinEstimatePercTime Lookup1D_X_FLOAT32_IEEE 0 VBU0513_CM_single_cnt 4 -3.4028234663852886E+38 3.4028234663852886E+38 /end AXIS_PTS
/begin CHARACTERISTIC CaOCV_QuasiOCVCurrentZ_A "" MAP 0x700151aa Lookup2D_FLOAT32_IEEE 0 VBU0513_CM_single_cnt -3.4028234663852886E+38 3.4028234663852886E+38
 /begin AXIS_DESCR COM_AXIS CVT_mvCellVoltageMin VBU0513_CM_uint16_cnt 7 0.0 65535.0 AXIS_PTS_REF CaOCV_QuasiOCVCurrentY_mV /end AXIS_DESCR
 /begin AXIS_DESCR COM_AXIS CTM_tCellTempMin VBU0513_CM_single_cnt 6 -3.4028234663852886E+38 3.4028234663852886E+38 AXIS_PTS_REF CaOCV_QuasiOCVCurrentX_C /end AXIS_DESCR
/end CHARACTERISTIC
/begin AXIS_PTS CaOCV_QuasiOCVCurrentX_C "" 0x7001213a CTM_tCellTempMin Lookup2D_X_FLOAT32_IEEE 0 VBU0513_CM_single_cnt 6 -3.4028234663852886E+38 3.4028234663852886E+38 /end AXIS_PTS
/begin AXIS_PTS CaOCV_QuasiOCVCurrentY_mV "" 0x70011bdc CVT_mvCellVoltageMin Lookup2D_X_UWORD 0 VBU0513_CM_uint16_cnt 7 0.0 65535.0 /end AXIS_PTS
/begin CHARACTERISTIC BPD_pctBrkPosOverrideVal_C "" VALUE 0x700103ec Scalar_FLOAT32_IEEE 0 VBU0513_CM_single_cnt -3.4028234663852886E+38 3.4028234663852886E+38 /end CHARACTERISTIC
/begin CHARACTERISTIC CBL_BALANCE_RESPOND_MISNATCH_REQUEST_FAULT "" VALUE 0x70010404 Scalar_FLOAT32_IEEE 0 VBU0513_CM_single_cnt -3.4028234663852886E+38 3.4028234663852886E+38 /end CHARACTERISTIC
/begin CHARACTERISTIC CcBCV_ABatteryCurrentOoR_C "" VALUE 0x70010494 Scalar_FLOAT32_IEEE 0 VBU0513_CM_single_A -3.4028234663852886E+38 3.4028234663852886E+38 /end CHARACTERISTIC
/begin CHARACTERISTIC CcBCV_BatteryBusVoltageMismatchFaultDelta_V "" VALUE 0x70010498 Scalar_FLOAT32_IEEE 0 VBU0513_CM_single_cnt -3.4028234663852886E+38 3.4028234663852886E+38 /end CHARACTERISTIC
/begin CHARACTERISTIC CcBCV_BatteryBusVoltageMismatchFault_V "" VALUE 0x7001049c Scalar_FLOAT32_IEEE 0 VBU0513_CM_single_cnt -3.4028234663852886E+38 3.4028234663852886E+38 /end CHARACTERISTIC
/begin CHARACTERISTIC CcBCV_BatteryCurrentOoR_A "" VALUE 0x700104a0 Scalar_FLOAT32_IEEE 0 VBU0513_CM_single_cnt -3.4028234663852886E+38 3.4028234663852886E+38 /end CHARACTERISTIC
/begin CHARACTERISTIC CcBCV_BatteryOverCurrentWarning_A "" VALUE 0x700104a8 Scalar_FLOAT32_IEEE 0 VBU0513_CM_single_cnt -3.4028234663852886E+38 3.4028234663852886E+38 /end CHARACTERISTIC
/begin CHARACTERISTIC CcBCV_BatteryOverCurrent_A "" VALUE 0x700104ac Scalar_FLOAT32_IEEE 0 VBU0513_CM_single_cnt -3.4028234663852886E+38 3.4028234663852886E+38 /end CHARACTERISTIC
/begin CHARACTERISTIC CcBCV_BatteryOverVoltageEVM_V "" VALUE 0x700104b0 Scalar_FLOAT32_IEEE 0 VBU0513_CM_single_cnt -3.4028234663852886E+38 3.4028234663852886E+38 /end CHARACTERISTIC
/begin CHARACTERISTIC CcBCV_BatteryOverVoltageWarning_V "" VALUE 0x700104b8 Scalar_FLOAT32_IEEE 0 VBU0513_CM_single_cnt -3.4028234663852886E+38 3.4028234663852886E+38 /end CHARACTERISTIC
/begin CHARACTERISTIC CcBCV_BatteryOverVoltage_V "" VALUE 0x700104bc Scalar_FLOAT32_IEEE 0 VBU0513_CM_single_cnt -3.4028234663852886E+38 3.4028234663852886E+38 /end CHARACTERISTIC
/begin CHARACTERISTIC CcBCV_BatteryUnderVoltage1_V "" VALUE 0x700104c0 Scalar_FLOAT32_IEEE 0 VBU0513_CM_single_cnt -3.4028234663852886E+38 3.4028234663852886E+38 /end CHARACTERISTIC
/begin CHARACTERISTIC CcBCV_BatteryUnderVoltage2_V "" VALUE 0x700104c4 Scalar_FLOAT32_IEEE 0 VBU0513_CM_single_cnt -3.4028234663852886E+38 3.4028234663852886E+38 /end CHARACTERISTIC
/begin CHARACTERISTIC CcBCV_BatteryUnderVoltageEVM1_V "" VALUE 0x700104c8 Scalar_FLOAT32_IEEE 0 VBU0513_CM_single_cnt -3.4028234663852886E+38 3.4028234663852886E+38 /end CHARACTERISTIC
/begin CHARACTERISTIC CcBCV_BatteryUnderVoltageEVM2_V "" VALUE 0x700104cc Scalar_FLOAT32_IEEE 0 VBU0513_CM_single_cnt -3.4028234663852886E+38 3.4028234663852886E+38 /end CHARACTERISTIC
/begin CHARACTERISTIC CcBCV_BatteryUnderVoltageTemp_C "" VALUE 0x700104d0 Scalar_FLOAT32_IEEE 0 VBU0513_CM_single_cnt -3.4028234663852886E+38 3.4028234663852886E+38 /end CHARACTERISTIC
/begin CHARACTERISTIC CcBCV_BatteryVoltageOoRHigh_V "" VALUE 0x700104d4 Scalar_FLOAT32_IEEE 0 VBU0513_CM_single_cnt -3.4028234663852886E+38 3.4028234663852886E+38 /end CHARACTERISTIC
/begin CHARACTERISTIC CcBCV_BatteryVoltageOoRLow_V "" VALUE 0x700104d8 Scalar_FLOAT32_IEEE 0 VBU0513_CM_single_cnt -3.4028234663852886E+38 3.4028234663852886E+38 /end CHARACTERISTIC
/begin CHARACTERISTIC CcBCV_DCContactorOverCurrent_A "" VALUE 0x70010504 Scalar_FLOAT32_IEEE 0 VBU0513_CM_single_cnt -3.4028234663852886E+38 3.4028234663852886E+38 /end CHARACTERISTIC
/begin CHARACTERISTIC CcBCV_FuseCurrentFactor1_n "" VALUE 0x70010508 Scalar_FLOAT32_IEEE 0 VBU0513_CM_single_cnt -3.4028234663852886E+38 3.4028234663852886E+38 /end CHARACTERISTIC
/begin CHARACTERISTIC CcBCV_FuseCurrentFactor2_n "" VALUE 0x7001050c Scalar_FLOAT32_IEEE 0 VBU0513_CM_single_cnt -3.4028234663852886E+38 3.4028234663852886E+38 /end CHARACTERISTIC
/begin CHARACTERISTIC CcBCV_FuseCurrentFactor3_n "" VALUE 0x70010510 Scalar_FLOAT32_IEEE 0 VBU0513_CM_single_cnt -3.4028234663852886E+38 3.4028234663852886E+38 /end CHARACTERISTIC
/begin CHARACTERISTIC CcBCV_FuseCurrentHigh1_A "" VALUE 0x70010514 Scalar_FLOAT32_IEEE 0 VBU0513_CM_single_cnt -3.4028234663852886E+38 3.4028234663852886E+38 /end CHARACTERISTIC
/begin CHARACTERISTIC CcBCV_FuseCurrentHigh2_A "" VALUE 0x70010518 Scalar_FLOAT32_IEEE 0 VBU0513_CM_single_cnt -3.4028234663852886E+38 3.4028234663852886E+38 /end CHARACTERISTIC
/begin CHARACTERISTIC CcBCV_FuseCurrentHigh3_A "" VALUE 0x7001051c Scalar_FLOAT32_IEEE 0 VBU0513_CM_single_cnt -3.4028234663852886E+38 3.4028234663852886E+38 /end CHARACTERISTIC
/begin CHARACTERISTIC CcBCV_FuseCurrentHigh4_A "" VALUE 0x70010520 Scalar_FLOAT32_IEEE 0 VBU0513_CM_single_cnt -3.4028234663852886E+38 3.4028234663852886E+38 /end CHARACTERISTIC
/begin CHARACTERISTIC CcBCV_FuseCurrentLow1_A "" VALUE 0x70010524 Scalar_FLOAT32_IEEE 0 VBU0513_CM_single_cnt -3.4028234663852886E+38 3.4028234663852886E+38 /end CHARACTERISTIC
/begin CHARACTERISTIC CcBCV_FuseCurrentLow2_A "" VALUE 0x70010528 Scalar_FLOAT32_IEEE 0 VBU0513_CM_single_cnt -3.4028234663852886E+38 3.4028234663852886E+38 /end CHARACTERISTIC
/begin CHARACTERISTIC CcBCV_FuseCurrentLow3_A "" VALUE 0x7001052c Scalar_FLOAT32_IEEE 0 VBU0513_CM_single_cnt -3.4028234663852886E+38 3.4028234663852886E+38 /end CHARACTERISTIC
/begin CHARACTERISTIC CcBCV_FuseCurrentLow4_A "" VALUE 0x70010530 Scalar_FLOAT32_IEEE 0 VBU0513_CM_single_cnt -3.4028234663852886E+38 3.4028234663852886E+38 /end CHARACTERISTIC
/begin CHARACTERISTIC CcBCV_FuseHealthThreshold_n "" VALUE 0x70010534 Scalar_FLOAT32_IEEE 0 VBU0513_CM_single_cnt -3.4028234663852886E+38 3.4028234663852886E+38 /end CHARACTERISTIC
/begin CHARACTERISTIC CcCBL_BalanceStartCellSoc_pct "" VALUE 0x70010560 Scalar_FLOAT32_IEEE 0 VBU0513_CM_single_cnt -3.4028234663852886E+38 3.4028234663852886E+38 /end CHARACTERISTIC
/begin CHARACTERISTIC CcCBL_BalanceStartCellTempMaxHysteresis_C "" VALUE 0x70010564 Scalar_FLOAT32_IEEE 0 VBU0513_CM_single_cnt -3.4028234663852886E+38 3.4028234663852886E+38 /end CHARACTERISTIC
/begin CHARACTERISTIC CcCBL_BalanceStartCellTempMax_C "" VALUE 0x70010568 Scalar_FLOAT32_IEEE 0 VBU0513_CM_single_cnt -3.4028234663852886E+38 3.4028234663852886E+38 /end CHARACTERISTIC
/begin CHARACTERISTIC CcCBL_BalanceStartDeltaSoc_pct "" VALUE 0x70010570 Scalar_FLOAT32_IEEE 0 VBU0513_CM_single_cnt -3.4028234663852886E+38 3.4028234663852886E+38 /end CHARACTERISTIC
/begin CHARACTERISTIC CcCBL_BalanceStartIsoResistance_Kohm "" VALUE 0x70010574 Scalar_FLOAT32_IEEE 0 VBU0513_CM_single_cnt -3.4028234663852886E+38 3.4028234663852886E+38 /end CHARACTERISTIC
/begin CHARACTERISTIC CcCBL_CellBalanceChargeCurrentHysteresis_A "" VALUE 0x70010584 Scalar_FLOAT32_IEEE 0 VBU0513_CM_single_cnt -3.4028234663852886E+38 3.4028234663852886E+38 /end CHARACTERISTIC
/begin CHARACTERISTIC CcCBL_CellBalanceChargeCurrent_A "" VALUE 0x70010588 Scalar_FLOAT32_IEEE 0 VBU0513_CM_single_cnt -3.4028234663852886E+38 3.4028234663852886E+38 /end CHARACTERISTIC
/begin CHARACTERISTIC CcCBL_CellBalanceDischargeCurrentHysteresis_A "" VALUE 0x7001058c Scalar_FLOAT32_IEEE 0 VBU0513_CM_single_cnt -3.4028234663852886E+38 3.4028234663852886E+38 /end CHARACTERISTIC
/begin CHARACTERISTIC CcCBL_CellBalanceDischargeCurrent_A "" VALUE 0x70010590 Scalar_FLOAT32_IEEE 0 VBU0513_CM_single_cnt -3.4028234663852886E+38 3.4028234663852886E+38 /end CHARACTERISTIC
/begin CHARACTERISTIC CcCBL_SocBalanceChargeCurrentHysteresis_A "" VALUE 0x70010598 Scalar_FLOAT32_IEEE 0 VBU0513_CM_single_cnt -3.4028234663852886E+38 3.4028234663852886E+38 /end CHARACTERISTIC
/begin CHARACTERISTIC CcCBL_SocBalanceChargeCurrent_A "" VALUE 0x7001059c Scalar_FLOAT32_IEEE 0 VBU0513_CM_single_cnt -3.4028234663852886E+38 3.4028234663852886E+38 /end CHARACTERISTIC
/begin CHARACTERISTIC CcCBL_SocBalanceDischargeCurrentHysteresis_A "" VALUE 0x700105a0 Scalar_FLOAT32_IEEE 0 VBU0513_CM_single_cnt -3.4028234663852886E+38 3.4028234663852886E+38 /end CHARACTERISTIC
/begin CHARACTERISTIC CcCBL_SocBalanceDischargeCurrent_A "" VALUE 0x700105a4 Scalar_FLOAT32_IEEE 0 VBU0513_CM_single_cnt -3.4028234663852886E+38 3.4028234663852886E+38 /end CHARACTERISTIC
/begin CHARACTERISTIC CcCBL_SystemVoltageMaxHysteresis_V "" VALUE 0x700105a8 Scalar_FLOAT32_IEEE 0 VBU0513_CM_single_cnt -3.4028234663852886E+38 3.4028234663852886E+38 /end CHARACTERISTIC
/begin CHARACTERISTIC CcCBL_SystemVoltageMax_V "" VALUE 0x700105ac Scalar_FLOAT32_IEEE 0 VBU0513_CM_single_cnt -3.4028234663852886E+38 3.4028234663852886E+38 /end CHARACTERISTIC
/begin CHARACTERISTIC CcCBL_SystemVoltageMinHysteresis_V "" VALUE 0x700105b0 Scalar_FLOAT32_IEEE 0 VBU0513_CM_single_cnt -3.4028234663852886E+38 3.4028234663852886E+38 /end CHARACTERISTIC
/begin CHARACTERISTIC CcCBL_SystemVoltageMin_V "" VALUE 0x700105b4 Scalar_FLOAT32_IEEE 0 VBU0513_CM_single_cnt -3.4028234663852886E+38 3.4028234663852886E+38 /end CHARACTERISTIC
/begin CHARACTERISTIC CcCTD_MessageDataValidDelay_ms "" VALUE 0x700105d8 Scalar_FLOAT32_IEEE 0 VBU0513_CM_single_cnt -3.4028234663852886E+38 3.4028234663852886E+38 /end CHARACTERISTIC
/begin CHARACTERISTIC CcCTD_MnNegContactorCloseDeltaVoltage_V "" VALUE 0x700105e0 Scalar_FLOAT32_IEEE 0 VBU0513_CM_single_cnt -3.4028234663852886E+38 3.4028234663852886E+38 /end CHARACTERISTIC
/begin CHARACTERISTIC CcCTD_MnPosContactorCloseDeltaVoltage_V "" VALUE 0x700105e8 Scalar_FLOAT32_IEEE 0 VBU0513_CM_single_cnt -3.4028234663852886E+38 3.4028234663852886E+38 /end CHARACTERISTIC
/begin CHARACTERISTIC CcCTD_PEUMessageDataValidDelay_ms "" VALUE 0x700105f4 Scalar_FLOAT32_IEEE 0 VBU0513_CM_single_cnt -3.4028234663852886E+38 3.4028234663852886E+38 /end CHARACTERISTIC
/begin CHARACTERISTIC CcCTD_PEURDCVoltageThreshold_V "" VALUE 0x700105f8 Scalar_FLOAT32_IEEE 0 VBU0513_CM_single_cnt -3.4028234663852886E+38 3.4028234663852886E+38 /end CHARACTERISTIC
/begin CHARACTERISTIC CcCTD_PEURVtoBatVThresholdLower_pct "" VALUE 0x700105fc Scalar_FLOAT32_IEEE 0 VBU0513_CM_single_cnt -3.4028234663852886E+38 3.4028234663852886E+38 /end CHARACTERISTIC
/begin CHARACTERISTIC CcCTD_PEURVtoBatVThresholdUpper_pct "" VALUE 0x70010600 Scalar_FLOAT32_IEEE 0 VBU0513_CM_single_cnt -3.4028234663852886E+38 3.4028234663852886E+38 /end CHARACTERISTIC
/begin CHARACTERISTIC CcCTD_PrechargeOverEnergyLockoutInterval_s "" VALUE 0x70010604 Scalar_FLOAT32_IEEE 0 VBU0513_CM_single_cnt 0.0 65535.0 /end CHARACTERISTIC
/begin CHARACTERISTIC CcCTD_PrechargeRelayStuckOpenDeltaVoltage_V "" VALUE 0x7001060c Scalar_FLOAT32_IEEE 0 VBU0513_CM_single_cnt -3.4028234663852886E+38 3.4028234663852886E+38 /end CHARACTERISTIC
/begin CHARACTERISTIC CcCTD_PrechargeSuccessMax_pct "" VALUE 0x70010618 Scalar_FLOAT32_IEEE 0 VBU0513_CM_single_cnt -3.4028234663852886E+38 3.4028234663852886E+38 /end CHARACTERISTIC
/begin CHARACTERISTIC CcCTD_PrechargeSuccessMin_pct "" VALUE 0x7001061c Scalar_FLOAT32_IEEE 0 VBU0513_CM_single_cnt -3.4028234663852886E+38 3.4028234663852886E+38 /end CHARACTERISTIC
/begin CHARACTERISTIC CcCTD_VehSpdPrechargeDiag_kmh "" VALUE 0x7001062c Scalar_FLOAT32_IEEE 0 VBU0513_CM_single_cnt -3.4028234663852886E+38 3.4028234663852886E+38 /end CHARACTERISTIC
/begin CHARACTERISTIC CcCTM_ThermalRunawayOverTemp_C "" VALUE 0x70010670 Scalar_FLOAT32_IEEE 0 VBU0513_CM_single_cnt -3.4028234663852886E+38 3.4028234663852886E+38 /end CHARACTERISTIC
/begin CHARACTERISTIC CcCTM_ThermalRunawayResetTemp_C "" VALUE 0x70010674 Scalar_FLOAT32_IEEE 0 VBU0513_CM_single_cnt -3.4028234663852886E+38 3.4028234663852886E+38 /end CHARACTERISTIC
/begin CHARACTERISTIC CcCTM_ThermalRunawayTempRiseDelayTime_ms "" VALUE 0x70010678 Scalar_FLOAT32_IEEE 0 VBU0513_CM_single_cnt -3.4028234663852886E+38 3.4028234663852886E+38 /end CHARACTERISTIC
/begin CHARACTERISTIC CcCTM_ThermalRunawayTriggerTime_ms "" VALUE 0x7001067c Scalar_FLOAT32_IEEE 0 VBU0513_CM_single_cnt -3.4028234663852886E+38 3.4028234663852886E+38 /end CHARACTERISTIC
/begin CHARACTERISTIC CcCTM_ThermalRunawayValidDelayTime_ms "" VALUE 0x70010680 Scalar_FLOAT32_IEEE 0 VBU0513_CM_single_cnt -3.4028234663852886E+38 3.4028234663852886E+38 /end CHARACTERISTIC
/begin CHARACTERISTIC CcCTS_BatteryVoltageMinLimit_V "" VALUE 0x70010684 Scalar_FLOAT32_IEEE 0 VBU0513_CM_single_cnt -3.4028234663852886E+38 3.4028234663852886E+38 /end CHARACTERISTIC
/begin CHARACTERISTIC CcCTS_CellVoltageMinLimitDelta_mV "" VALUE 0x70010688 Scalar_FLOAT32_IEEE 0 VBU0513_CM_single_cnt -3.4028234663852886E+38 3.4028234663852886E+38 /end CHARACTERISTIC
/begin CHARACTERISTIC CcCTS_CellVoltageMinLimit_mV "" VALUE 0x7001068c Scalar_FLOAT32_IEEE 0 VBU0513_CM_single_cnt -3.4028234663852886E+38 3.4028234663852886E+38 /end CHARACTERISTIC
/begin CHARACTERISTIC CcCTS_SocInitialDelayTime_s "" VALUE 0x700106a0 Scalar_FLOAT32_IEEE 0 VBU0513_CM_single_cnt -3.4028234663852886E+38 3.4028234663852886E+38 /end CHARACTERISTIC
/begin CHARACTERISTIC CcCVT_BdmCellVoltageOverDeviationDisableCrrnt_A "" VALUE 0x700106a4 Scalar_FLOAT32_IEEE 0 VBU0513_CM_single_A -3.4028234663852886E+38 3.4028234663852886E+38 /end CHARACTERISTIC
/begin CHARACTERISTIC CcFCC_BatteryChargeCurrentFactor_n "" VALUE 0x700106c4 Scalar_FLOAT32_IEEE 0 VBU0513_CM_single_cnt -3.4028234663852886E+38 3.4028234663852886E+38 /end CHARACTERISTIC
/begin CHARACTERISTIC CcFCC_CellVoltageMaxCorrectEndDelta_mV "" VALUE 0x700106c8 Scalar_FLOAT32_IEEE 0 VBU0513_CM_single_cnt -3.4028234663852886E+38 3.4028234663852886E+38 /end CHARACTERISTIC
/begin CHARACTERISTIC CcFCC_CellVoltageMaxCorrectMiddleDelta_mV "" VALUE 0x700106cc Scalar_FLOAT32_IEEE 0 VBU0513_CM_single_cnt -3.4028234663852886E+38 3.4028234663852886E+38 /end CHARACTERISTIC
/begin CHARACTERISTIC CcFCC_CellVoltageMaxCorrectSlopMax_nbr "" VALUE 0x700106d0 Scalar_FLOAT32_IEEE 0 VBU0513_CM_single_cnt -3.4028234663852886E+38 3.4028234663852886E+38 /end CHARACTERISTIC
/begin CHARACTERISTIC CcFCC_CellVoltageMaxCorrectSlopMin_nbr "" VALUE 0x700106d4 Scalar_FLOAT32_IEEE 0 VBU0513_CM_single_cnt -3.4028234663852886E+38 3.4028234663852886E+38 /end CHARACTERISTIC
/begin CHARACTERISTIC CcFCC_CellVoltageMaxCorrectStartDelta_mV "" VALUE 0x700106d8 Scalar_FLOAT32_IEEE 0 VBU0513_CM_single_cnt -3.4028234663852886E+38 3.4028234663852886E+38 /end CHARACTERISTIC
/begin CHARACTERISTIC CcFCC_CellVoltageMaxFactorEnd_nbr "" VALUE 0x700106dc Scalar_FLOAT32_IEEE 0 VBU0513_CM_single_cnt -3.4028234663852886E+38 3.4028234663852886E+38 /end CHARACTERISTIC
/begin CHARACTERISTIC CcFCC_CellVoltageMaxFactorMiddle_nbr "" VALUE 0x700106e0 Scalar_FLOAT32_IEEE 0 VBU0513_CM_single_cnt -3.4028234663852886E+38 3.4028234663852886E+38 /end CHARACTERISTIC
/begin CHARACTERISTIC CcFCC_CellVoltageMaxFactorStart_nbr "" VALUE 0x700106e4 Scalar_FLOAT32_IEEE 0 VBU0513_CM_single_cnt -3.4028234663852886E+38 3.4028234663852886E+38 /end CHARACTERISTIC
/begin CHARACTERISTIC CcFCC_ChargePowerDecRate_Kw "" VALUE 0x70010710 Scalar_FLOAT32_IEEE 0 VBU0513_CM_single_cnt -3.4028234663852886E+38 3.4028234663852886E+38 /end CHARACTERISTIC
/begin CHARACTERISTIC CcFCC_ChargePowerIncRate_Kw "" VALUE 0x70010714 Scalar_FLOAT32_IEEE 0 VBU0513_CM_single_cnt -3.4028234663852886E+38 3.4028234663852886E+38 /end CHARACTERISTIC
/begin CHARACTERISTIC CcFCC_ComputeResistanceCurrentDecRate_A "" VALUE 0x70010724 Scalar_FLOAT32_IEEE 0 VBU0513_CM_single_cnt -3.4028234663852886E+38 3.4028234663852886E+38 /end CHARACTERISTIC
/begin CHARACTERISTIC CcFCC_ComputeResistanceCurrentIncRate_A "" VALUE 0x70010728 Scalar_FLOAT32_IEEE 0 VBU0513_CM_single_cnt -3.4028234663852886E+38 3.4028234663852886E+38 /end CHARACTERISTIC
/begin CHARACTERISTIC CcFCC_CustomSetSOCEnable_pct "" VALUE 0x70010738 Scalar_FLOAT32_IEEE 0 VBU0513_CM_single_cnt -3.4028234663852886E+38 3.4028234663852886E+38 /end CHARACTERISTIC
/begin CHARACTERISTIC CcFCC_EstimateChargeTimeCurrent_A "" VALUE 0x70010744 Scalar_FLOAT32_IEEE 0 VBU0513_CM_single_cnt -3.4028234663852886E+38 3.4028234663852886E+38 /end CHARACTERISTIC
/begin CHARACTERISTIC CcFCC_FullChargeSoc1_pct "" VALUE 0x7001074c Scalar_FLOAT32_IEEE 0 VBU0513_CM_single_cnt -3.4028234663852886E+38 3.4028234663852886E+38 /end CHARACTERISTIC
/begin CHARACTERISTIC CcFCC_FullChargeSoc2_pct "" VALUE 0x70010750 Scalar_FLOAT32_IEEE 0 VBU0513_CM_single_cnt -3.4028234663852886E+38 3.4028234663852886E+38 /end CHARACTERISTIC
/begin CHARACTERISTIC CcFCC_FullChargeSoc3_pct "" VALUE 0x70010754 Scalar_FLOAT32_IEEE 0 VBU0513_CM_single_cnt -3.4028234663852886E+38 3.4028234663852886E+38 /end CHARACTERISTIC
/begin CHARACTERISTIC CcFCC_NoChargeHighTemp_C "" VALUE 0x70010760 Scalar_FLOAT32_IEEE 0 VBU0513_CM_single_C -40.0 200.0 /end CHARACTERISTIC
/begin CHARACTERISTIC CcFCC_NoChargeLowTemp_C "" VALUE 0x70010764 Scalar_FLOAT32_IEEE 0 VBU0513_CM_single_C -40.0 200.0 /end CHARACTERISTIC
/begin CHARACTERISTIC CcFCC_StandardPowerLimit_Kw "" VALUE 0x70010768 Scalar_FLOAT32_IEEE 0 VBU0513_CM_single_cnt -3.4028234663852886E+38 3.4028234663852886E+38 /end CHARACTERISTIC
/begin CHARACTERISTIC CcFCC_TrickleChargeCurrent_A "" VALUE 0x7001076c Scalar_FLOAT32_IEEE 0 VBU0513_CM_single_cnt -3.4028234663852886E+38 3.4028234663852886E+38 /end CHARACTERISTIC
/begin CHARACTERISTIC CcSOC_CellCapacityOvrdVal_Ah "" VALUE 0x70010830 Scalar_FLOAT32_IEEE 0 VBU0513_CM_single_cnt -3.4028234663852886E+38 3.4028234663852886E+38 /end CHARACTERISTIC
/begin CHARACTERISTIC CcSOC_MaxBalancedCapacity_As "" VALUE 0x70010878 Scalar_FLOAT32_IEEE 0 VBU0513_CM_single_cnt -3.4028234663852886E+38 3.4028234663852886E+38 /end CHARACTERISTIC
/begin CHARACTERISTIC CcSOC_MaxCurrentIntegral_As "" VALUE 0x7001087c Scalar_FLOAT32_IEEE 0 VBU0513_CM_single_cnt -3.4028234663852886E+38 3.4028234663852886E+38 /end CHARACTERISTIC
/begin CHARACTERISTIC CcSOC_MinBalancedCapacity_As "" VALUE 0x70010880 Scalar_FLOAT32_IEEE 0 VBU0513_CM_single_cnt -3.4028234663852886E+38 3.4028234663852886E+38 /end CHARACTERISTIC
/begin CHARACTERISTIC CcSOC_MinCurrentIntegral_As "" VALUE 0x70010884 Scalar_FLOAT32_IEEE 0 VBU0513_CM_single_cnt -3.4028234663852886E+38 3.4028234663852886E+38 /end CHARACTERISTIC
/begin CHARACTERISTIC CcSYS_MappedCellCapacity_Ah "" VALUE 0x70010ac8 Scalar_FLOAT32_IEEE 0 VBU0513_CM_single_cnt -3.4028234663852886E+38 3.4028234663852886E+38 /end CHARACTERISTIC
/begin CHARACTERISTIC LVC_iDCDCOutCrnt_C "" VALUE 0x70011384 Scalar_FLOAT32_IEEE 0 VBU0513_CM_single_cnt -3.4028234663852886E+38 3.4028234663852886E+38 /end CHARACTERISTIC
/begin CHARACTERISTIC LVC_iDiaUndrVltgPwrEnough_C "" VALUE 0x70011388 Scalar_FLOAT32_IEEE 0 VBU0513_CM_single_cnt -3.4028234663852886E+38 3.4028234663852886E+38 /end CHARACTERISTIC
/begin CHARACTERISTIC LVC_iDiaUndrVltgPwrLack_C "" VALUE 0x7001138c Scalar_FLOAT32_IEEE 0 VBU0513_CM_single_cnt -3.4028234663852886E+38 3.4028234663852886E+38 /end CHARACTERISTIC
/begin CHARACTERISTIC LVC_pwrDiaUndrVolHi_C "" VALUE 0x70011390 Scalar_FLOAT32_IEEE 0 VBU0513_CM_single_cnt -3.4028234663852886E+38 3.4028234663852886E+38 /end CHARACTERISTIC
/begin CHARACTERISTIC LVC_pwrDiaUndrVolLo_C "" VALUE 0x70011394 Scalar_FLOAT32_IEEE 0 VBU0513_CM_single_cnt -3.4028234663852886E+38 3.4028234663852886E+38 /end CHARACTERISTIC
/begin CHARACTERISTIC LVC_stDiaDCDCStsWrk_SY "" VALUE 0x7001139c Scalar_FLOAT32_IEEE 0 VBU0513_CM_single_cnt -3.4028234663852886E+38 3.4028234663852886E+38 /end CHARACTERISTIC
/begin CHARACTERISTIC LVC_tiDCDCOutCurnt_C "" VALUE 0x700113a0 Scalar_FLOAT32_IEEE 0 VBU0513_CM_single_cnt -3.4028234663852886E+38 3.4028234663852886E+38 /end CHARACTERISTIC
/begin CHARACTERISTIC LVC_tiDCDCOutVltg_C "" VALUE 0x700113a4 Scalar_FLOAT32_IEEE 0 VBU0513_CM_single_cnt -3.4028234663852886E+38 3.4028234663852886E+38 /end CHARACTERISTIC
/begin CHARACTERISTIC LVC_tiDcDcPTNodeAbsent_C "" VALUE 0x700113a8 Scalar_FLOAT32_IEEE 0 VBU0513_CM_single_cnt -3.4028234663852886E+38 3.4028234663852886E+38 /end CHARACTERISTIC
/begin CHARACTERISTIC LVC_tiDiaDCDCActnDly_C "" VALUE 0x700113ac Scalar_FLOAT32_IEEE 0 VBU0513_CM_single_cnt -3.4028234663852886E+38 3.4028234663852886E+38 /end CHARACTERISTIC
/begin CHARACTERISTIC LVC_tiDiaDCDCSmpl_SY "" VALUE 0x700113b0 Scalar_FLOAT32_IEEE 0 VBU0513_CM_single_cnt -3.4028234663852886E+38 3.4028234663852886E+38 /end CHARACTERISTIC
/begin CHARACTERISTIC LVC_tiHvRlyClReq_C "" VALUE 0x700113b4 Scalar_FLOAT32_IEEE 0 VBU0513_CM_single_cnt -3.4028234663852886E+38 3.4028234663852886E+38 /end CHARACTERISTIC
/begin CHARACTERISTIC LVC_tiIBSStatusErrAndParked_C "" VALUE 0x700113b8 Scalar_FLOAT32_IEEE 0 VBU0513_CM_single_cnt -3.4028234663852886E+38 3.4028234663852886E+38 /end CHARACTERISTIC
/begin CHARACTERISTIC LVC_tiLvBattVolLow_C "" VALUE 0x700113bc Scalar_FLOAT32_IEEE 0 VBU0513_CM_single_cnt -3.4028234663852886E+38 3.4028234663852886E+38 /end CHARACTERISTIC
/begin CHARACTERISTIC LVC_tiSample_SY "" VALUE 0x700113c0 Scalar_FLOAT32_IEEE 0 VBU0513_CM_single_cnt -3.4028234663852886E+38 3.4028234663852886E+38 /end CHARACTERISTIC
/begin CHARACTERISTIC LVC_uDCDCCrntDeltaLe_C "" VALUE 0x700113c8 Scalar_FLOAT32_IEEE 0 VBU0513_CM_single_cnt -3.4028234663852886E+38 3.4028234663852886E+38 /end CHARACTERISTIC
/begin CHARACTERISTIC LVC_uDCDCCrntDeltaRe_C "" VALUE 0x700113cc Scalar_FLOAT32_IEEE 0 VBU0513_CM_single_cnt -3.4028234663852886E+38 3.4028234663852886E+38 /end CHARACTERISTIC
/begin CHARACTERISTIC LVC_uDCDCOutCrntLe_C "" VALUE 0x700113d0 Scalar_FLOAT32_IEEE 0 VBU0513_CM_single_cnt -3.4028234663852886E+38 3.4028234663852886E+38 /end CHARACTERISTIC
/begin CHARACTERISTIC LVC_uDCDCOutCrntRe_C "" VALUE 0x700113d4 Scalar_FLOAT32_IEEE 0 VBU0513_CM_single_cnt -3.4028234663852886E+38 3.4028234663852886E+38 /end CHARACTERISTIC
/begin CHARACTERISTIC LVC_uDiaDCDCOutOvrVltgThres_C "" VALUE 0x700113e8 Scalar_FLOAT32_IEEE 0 VBU0513_CM_single_cnt -3.4028234663852886E+38 3.4028234663852886E+38 /end CHARACTERISTIC
/begin CHARACTERISTIC LVC_uDiaDCDCOutUndrVltgThres_C "" VALUE 0x700113ec Scalar_FLOAT32_IEEE 0 VBU0513_CM_single_cnt -3.4028234663852886E+38 3.4028234663852886E+38 /end CHARACTERISTIC
/begin CHARACTERISTIC LVC_uVolLowOnPark_C "" VALUE 0x700113f0 Scalar_FLOAT32_IEEE 0 VBU0513_CM_single_cnt -3.4028234663852886E+38 3.4028234663852886E+38 /end CHARACTERISTIC
/begin CHARACTERISTIC MTQL_facVehSpd2MotSpd_C "" VALUE 0x700113fc Scalar_FLOAT32_IEEE 0 VBU0513_CM_single_cnt 0.0 1000.0 /end CHARACTERISTIC
/begin CHARACTERISTIC MTQL_trqDecLim_C "" VALUE 0x70011400 Scalar_FLOAT32_IEEE 0 VBU0513_CM_single_cnt -10000.0 10000.0 /end CHARACTERISTIC
/begin CHARACTERISTIC MTQL_trqIncLim_C "" VALUE 0x70011404 Scalar_FLOAT32_IEEE 0 VBU0513_CM_single_cnt -10000.0 10000.0 /end CHARACTERISTIC
/begin CHARACTERISTIC MTQL_trqMtrDrvLimOvrdVal_C "" VALUE 0x70011408 Scalar_FLOAT32_IEEE 0 VBU0513_CM_single -3.4E+38 3.4E+38 /end CHARACTERISTIC
/begin CHARACTERISTIC MTQL_trqMtrRgnLimOvrdVal_C "" VALUE 0x7001140c Scalar_FLOAT32_IEEE 0 VBU0513_CM_single -3.4E+38 3.4E+38 /end CHARACTERISTIC
/begin CHARACTERISTIC MTQL_trqPEURDrvLowLim_C "" VALUE 0x70011410 Scalar_FLOAT32_IEEE 0 VBU0513_CM_single_cnt -10000.0 10000.0 /end CHARACTERISTIC
/begin CHARACTERISTIC MTQL_trqPEURDrvUpLim_C "" VALUE 0x70011414 Scalar_FLOAT32_IEEE 0 VBU0513_CM_single_cnt -10000.0 10000.0 /end CHARACTERISTIC
/begin CHARACTERISTIC MTQL_trqPEURRgnLowLim_C "" VALUE 0x70011418 Scalar_FLOAT32_IEEE 0 VBU0513_CM_single_cnt -10000.0 10000.0 /end CHARACTERISTIC
/begin CHARACTERISTIC MTQL_trqPEURRgnUpLim_C "" VALUE 0x7001141c Scalar_FLOAT32_IEEE 0 VBU0513_CM_single_cnt -10000.0 10000.0 /end CHARACTERISTIC
/begin CHARACTERISTIC PMM_tiDiaActvDisChDur_C "" VALUE 0x70011558 Scalar_FLOAT32_IEEE 0 VBU0513_CM_single_cnt -3.4028234663852886E+38 3.4028234663852886E+38 /end CHARACTERISTIC
/begin CHARACTERISTIC PMM_tiDiaHVRlyActnDly_C "" VALUE 0x7001155c Scalar_FLOAT32_IEEE 0 VBU0513_CM_single_cnt -3.4028234663852886E+38 3.4028234663852886E+38 /end CHARACTERISTIC
/begin CHARACTERISTIC PMM_tiDiaPreChDur_C "" VALUE 0x70011560 Scalar_FLOAT32_IEEE 0 VBU0513_CM_single_cnt -3.4028234663852886E+38 3.4028234663852886E+38 /end CHARACTERISTIC
/begin CHARACTERISTIC PMM_tiDiaPreChFail_C "" VALUE 0x70011564 Scalar_FLOAT32_IEEE 0 VBU0513_CM_single_cnt -3.4028234663852886E+38 3.4028234663852886E+38 /end CHARACTERISTIC
/begin CHARACTERISTIC PMM_tiDiaUnIntdPreRlyClsdMntn_C "" VALUE 0x70011568 Scalar_FLOAT32_IEEE 0 VBU0513_CM_single_cnt -3.4028234663852886E+38 3.4028234663852886E+38 /end CHARACTERISTIC
/begin CHARACTERISTIC PMM_tiDlyACTst_C "" VALUE 0x7001156c Scalar_FLOAT32_IEEE 0 VBU0513_CM_single_cnt -3.4028234663852886E+38 3.4028234663852886E+38 /end CHARACTERISTIC
/begin CHARACTERISTIC PMM_tiDlyDiaRlyOp_C "" VALUE 0x70011570 Scalar_FLOAT32_IEEE 0 VBU0513_CM_single_cnt -3.4028234663852886E+38 3.4028234663852886E+38 /end CHARACTERISTIC
/begin CHARACTERISTIC PMM_tiDlyPEUShtDwn_C "" VALUE 0x70011594 Scalar_FLOAT32_IEEE 0 VBU0513_CM_single_cnt -3.4028234663852886E+38 3.4028234663852886E+38 /end CHARACTERISTIC
/begin CHARACTERISTIC PMM_tiDlyPEUStandBy_C "" VALUE 0x70011598 Scalar_FLOAT32_IEEE 0 VBU0513_CM_single_cnt -3.4028234663852886E+38 3.4028234663852886E+38 /end CHARACTERISTIC
/begin CHARACTERISTIC PMM_tiDlySWReset_C "" VALUE 0x700115a0 Scalar_FLOAT32_IEEE 0 VBU0513_CM_single_cnt -3.4028234663852886E+38 3.4028234663852886E+38 /end CHARACTERISTIC
/begin CHARACTERISTIC PMM_tiDlySelfDiag_C "" VALUE 0x700115a4 Scalar_FLOAT32_IEEE 0 VBU0513_CM_single_cnt -3.4028234663852886E+38 3.4028234663852886E+38 /end CHARACTERISTIC
/begin CHARACTERISTIC PMM_tiMonDlyDiaPreCh_C "" VALUE 0x700115cc Scalar_FLOAT32_IEEE 0 VBU0513_CM_single_cnt -3.4028234663852886E+38 3.4028234663852886E+38 /end CHARACTERISTIC
/begin CHARACTERISTIC PMM_uDiaActvDisCh_C "" VALUE 0x700115e0 Scalar_FLOAT32_IEEE 0 VBU0513_CM_single_cnt 0.0 1000.0 /end CHARACTERISTIC
/begin CHARACTERISTIC PTC_PwrMax_C "" VALUE 0x700115ec Scalar_FLOAT32_IEEE 0 VBU0513_CM_single_cnt 0.0 1.0E+23 /end CHARACTERISTIC
/begin CHARACTERISTIC SPD_tiAxUpdate2_C "" VALUE 0x7001161c Scalar_FLOAT32_IEEE 0 VBU0513_CM_single_cnt -3.4028234663852886E+38 3.4028234663852886E+38 /end CHARACTERISTIC
/begin CHARACTERISTIC SPD_tiAxUpdate_C "" VALUE 0x70011620 Scalar_FLOAT32_IEEE 0 VBU0513_CM_single_cnt -3.4028234663852886E+38 3.4028234663852886E+38 /end CHARACTERISTIC
/begin CHARACTERISTIC SYS_facRPM2KPH_SY "" VALUE 0x70011658 Scalar_FLOAT32_IEEE 0 VBU0513_CM_single_cnt -3.4028234663852886E+38 3.4028234663852886E+38 /end CHARACTERISTIC
/begin CHARACTERISTIC SYS_lFWhlRadius_SY "" VALUE 0x7001165c Scalar_FLOAT32_IEEE 0 VBU0513_CM_single_cnt -3.4028234663852886E+38 3.4028234663852886E+38 /end CHARACTERISTIC
/begin CHARACTERISTIC SYS_lWheelBase_SY "" VALUE 0x70011660 Scalar_FLOAT32_IEEE 0 VBU0513_CM_single_cnt -3.4028234663852886E+38 3.4028234663852886E+38 /end CHARACTERISTIC
/begin CHARACTERISTIC SYS_stShftPosDrv_SY "" VALUE 0x70011664 Scalar_FLOAT32_IEEE 0 VBU0513_CM_single_cnt -3.4028234663852886E+38 3.4028234663852886E+38 /end CHARACTERISTIC
/begin CHARACTERISTIC SYS_stShftPosRev_SY "" VALUE 0x70011668 Scalar_FLOAT32_IEEE 0 VBU0513_CM_single_cnt -3.4028234663852886E+38 3.4028234663852886E+38 /end CHARACTERISTIC
/begin CHARACTERISTIC THM_pctESSPumpDftCmd_C "" VALUE 0x70011694 Scalar_FLOAT32_IEEE 0 VBU0513_CM_single_cnt -3.4028234663852886E+38 3.4028234663852886E+38 /end CHARACTERISTIC
/begin CHARACTERISTIC THM_ptcActvThemalMaxESSPump_C "" VALUE 0x700116b4 Scalar_FLOAT32_IEEE 0 VBU0513_CM_single_cnt -3.4028234663852886E+38 3.4028234663852886E+38 /end CHARACTERISTIC
/begin CHARACTERISTIC THM_tCoolDeltaMaxTemp_C "" VALUE 0x700116c4 Scalar_FLOAT32_IEEE 0 VBU0513_CM_single_cnt -3.4028234663852886E+38 3.4028234663852886E+38 /end CHARACTERISTIC
/begin CHARACTERISTIC THM_tCoolDeltaMinTemp_C "" VALUE 0x700116c8 Scalar_FLOAT32_IEEE 0 VBU0513_CM_single_cnt -3.4028234663852886E+38 3.4028234663852886E+38 /end CHARACTERISTIC
/begin CHARACTERISTIC THM_tCoolFrstDeltaMaxTemp_C "" VALUE 0x700116cc Scalar_FLOAT32_IEEE 0 VBU0513_CM_single_cnt -3.4028234663852886E+38 3.4028234663852886E+38 /end CHARACTERISTIC
/begin CHARACTERISTIC THM_tDCChCoolTar_C "" VALUE 0x700116d0 Scalar_FLOAT32_IEEE 0 VBU0513_CM_single_cnt -3.4028234663852886E+38 3.4028234663852886E+38 /end CHARACTERISTIC
/begin CHARACTERISTIC THM_tDCChHeatTar_C "" VALUE 0x700116d4 Scalar_FLOAT32_IEEE 0 VBU0513_CM_single_cnt -3.4028234663852886E+38 3.4028234663852886E+38 /end CHARACTERISTIC
/begin CHARACTERISTIC THM_tDrvCoolTar_C "" VALUE 0x700116d8 Scalar_FLOAT32_IEEE 0 VBU0513_CM_single_cnt -3.4028234663852886E+38 3.4028234663852886E+38 /end CHARACTERISTIC
/begin CHARACTERISTIC THM_tDrvHeatTar_C "" VALUE 0x700116dc Scalar_FLOAT32_IEEE 0 VBU0513_CM_single_cnt -3.4028234663852886E+38 3.4028234663852886E+38 /end CHARACTERISTIC
/begin CHARACTERISTIC THM_tHeatDeltaMaxTemp_C "" VALUE 0x700116e0 Scalar_FLOAT32_IEEE 0 VBU0513_CM_single_cnt -3.4028234663852886E+38 3.4028234663852886E+38 /end CHARACTERISTIC
/begin CHARACTERISTIC THM_tHeatDeltaMinTemp_C "" VALUE 0x700116e4 Scalar_FLOAT32_IEEE 0 VBU0513_CM_single_cnt -3.4028234663852886E+38 3.4028234663852886E+38 /end CHARACTERISTIC
/begin CHARACTERISTIC THM_vVehSpdHysBand_C "" VALUE 0x70011700 Scalar_FLOAT32_IEEE 0 VBU0513_CM_single_cnt -3.4028234663852886E+38 3.4028234663852886E+38 /end CHARACTERISTIC
/begin CHARACTERISTIC TQCMP_trqLowSpdRA "" VALUE 0x7001170c Scalar_FLOAT32_IEEE 0 VBU0513_CM_single_cnt -3.4028234663852886E+38 3.4028234663852886E+38 /end CHARACTERISTIC
/begin CHARACTERISTIC TQC_aAcc2TrqPrpHigh_SY "" VALUE 0x70011710 Scalar_FLOAT32_IEEE 0 VBU0513_CM_single_cnt -3.4028234663852886E+38 3.4028234663852886E+38 /end CHARACTERISTIC
/begin CHARACTERISTIC TQC_aDragLearnMax_C "" VALUE 0x70011714 Scalar_FLOAT32_IEEE 0 VBU0513_CM_single_cnt -3.4028234663852886E+38 3.4028234663852886E+38 /end CHARACTERISTIC
/begin CHARACTERISTIC TQC_aDragLearnMin_C "" VALUE 0x70011718 Scalar_FLOAT32_IEEE 0 VBU0513_CM_single_cnt -3.4028234663852886E+38 3.4028234663852886E+38 /end CHARACTERISTIC
/begin CHARACTERISTIC TQC_aSlopeLimitInit_C "" VALUE 0x7001171c Scalar_FLOAT32_IEEE 0 VBU0513_CM_single_cnt -3.4028234663852886E+38 3.4028234663852886E+38 /end CHARACTERISTIC
/begin CHARACTERISTIC TQC_aThresLe_C "" VALUE 0x70011720 Scalar_FLOAT32_IEEE 0 VBU0513_CM_single_cnt -3.4028234663852886E+38 3.4028234663852886E+38 /end CHARACTERISTIC
/begin CHARACTERISTIC TQC_aThresRi_C "" VALUE 0x70011724 Scalar_FLOAT32_IEEE 0 VBU0513_CM_single_cnt -3.4028234663852886E+38 3.4028234663852886E+38 /end CHARACTERISTIC
/begin CHARACTERISTIC TQC_aXFltGradDec_C "" VALUE 0x70011728 Scalar_FLOAT32_IEEE 0 VBU0513_CM_single_cnt -3.4028234663852886E+38 3.4028234663852886E+38 /end CHARACTERISTIC
/begin CHARACTERISTIC TQC_aXFltGradInc_C "" VALUE 0x7001172c Scalar_FLOAT32_IEEE 0 VBU0513_CM_single_cnt -3.4028234663852886E+38 3.4028234663852886E+38 /end CHARACTERISTIC
/begin CHARACTERISTIC TQC_facDecDrag_C "" VALUE 0x70011730 Scalar_FLOAT32_IEEE 0 VBU0513_CM_single_cnt -3.4028234663852886E+38 3.4028234663852886E+38 /end CHARACTERISTIC
/begin CHARACTERISTIC TQC_facDelayShiftFilter_C "" VALUE 0x70011734 Scalar_FLOAT32_IEEE 0 VBU0513_CM_single_cnt -3.4028234663852886E+38 3.4028234663852886E+38 /end CHARACTERISTIC
/begin CHARACTERISTIC TQC_facDragCalGradDec_C "" VALUE 0x70011738 Scalar_FLOAT32_IEEE 0 VBU0513_CM_single_cnt -3.4028234663852886E+38 3.4028234663852886E+38 /end CHARACTERISTIC
/begin CHARACTERISTIC TQC_facDragCalGradInc_C "" VALUE 0x7001173c Scalar_FLOAT32_IEEE 0 VBU0513_CM_single_cnt -3.4028234663852886E+38 3.4028234663852886E+38 /end CHARACTERISTIC
/begin CHARACTERISTIC TQC_facDragCalGradMax_C "" VALUE 0x70011740 Scalar_FLOAT32_IEEE 0 VBU0513_CM_single_cnt -3.4028234663852886E+38 3.4028234663852886E+38 /end CHARACTERISTIC
/begin CHARACTERISTIC TQC_facDragCalGradMin_C "" VALUE 0x70011744 Scalar_FLOAT32_IEEE 0 VBU0513_CM_single_cnt -3.4028234663852886E+38 3.4028234663852886E+38 /end CHARACTERISTIC
/begin CHARACTERISTIC TQC_facDragFastFilter_C "" VALUE 0x70011748 Scalar_FLOAT32_IEEE 0 VBU0513_CM_single_cnt -3.4028234663852886E+38 3.4028234663852886E+38 /end CHARACTERISTIC
/begin CHARACTERISTIC TQC_facDragNormalFilter_C "" VALUE 0x7001174c Scalar_FLOAT32_IEEE 0 VBU0513_CM_single_cnt -3.4028234663852886E+38 3.4028234663852886E+38 /end CHARACTERISTIC
/begin CHARACTERISTIC TQC_facDragShiftFilter_C "" VALUE 0x70011750 Scalar_FLOAT32_IEEE 0 VBU0513_CM_single_cnt -3.4028234663852886E+38 3.4028234663852886E+38 /end CHARACTERISTIC
/begin CHARACTERISTIC TQC_facDragWheelFilter_C "" VALUE 0x70011754 Scalar_FLOAT32_IEEE 0 VBU0513_CM_single_cnt -3.4028234663852886E+38 3.4028234663852886E+38 /end CHARACTERISTIC
/begin CHARACTERISTIC TQC_facMinDrag_C "" VALUE 0x70011758 Scalar_FLOAT32_IEEE 0 VBU0513_CM_single_cnt 0.0 1.0 /end CHARACTERISTIC
/begin CHARACTERISTIC TQC_facNormalDrag_C "" VALUE 0x7001175c Scalar_FLOAT32_IEEE 0 VBU0513_CM_single_cnt -3.4028234663852886E+38 3.4028234663852886E+38 /end CHARACTERISTIC
/begin CHARACTERISTIC TQC_facSlopeLimitIntegral_C "" VALUE 0x70011760 Scalar_FLOAT32_IEEE 0 VBU0513_CM_single_cnt -3.4028234663852886E+38 3.4028234663852886E+38 /end CHARACTERISTIC
/begin CHARACTERISTIC TQC_facSlopeLimitProportion_C "" VALUE 0x70011764 Scalar_FLOAT32_IEEE 0 VBU0513_CM_single_cnt -3.4028234663852886E+38 3.4028234663852886E+38 /end CHARACTERISTIC
/begin CHARACTERISTIC TQC_facTrqWheelFilter_C "" VALUE 0x70011768 Scalar_FLOAT32_IEEE 0 VBU0513_CM_single_cnt 0.0 1.0 /end CHARACTERISTIC
/begin CHARACTERISTIC TQC_facVehSpdFilter_C "" VALUE 0x7001176c Scalar_FLOAT32_IEEE 0 VBU0513_CM_single_cnt -3.4028234663852886E+38 3.4028234663852886E+38 /end CHARACTERISTIC
/begin CHARACTERISTIC TQC_mInrt_C "" VALUE 0x70011770 Scalar_FLOAT32_IEEE 0 VBU0513_CM_single_cnt -3.4028234663852886E+38 3.4028234663852886E+38 /end CHARACTERISTIC
/begin CHARACTERISTIC TQC_mVeh_C "" VALUE 0x70011774 Scalar_FLOAT32_IEEE 0 VBU0513_CM_single_kg 0.0 10000.0 /end CHARACTERISTIC
/begin CHARACTERISTIC TQC_numDragCalAverageAccStepDown_C "" VALUE 0x70011778 Scalar_FLOAT32_IEEE 0 VBU0513_CM_single_cnt -10000.0 10000.0 /end CHARACTERISTIC
/begin CHARACTERISTIC TQC_numDragCalAverageAccStepUp_C "" VALUE 0x7001177c Scalar_FLOAT32_IEEE 0 VBU0513_CM_single_cnt -10000.0 10000.0 /end CHARACTERISTIC
/begin CHARACTERISTIC TQC_numDragCalAverageAcc_C "" VALUE 0x70011780 Scalar_FLOAT32_IEEE 0 VBU0513_CM_single_cnt 0.0 255.0 /end CHARACTERISTIC
/begin CHARACTERISTIC TQC_numDragCalAverageBrk_C "" VALUE 0x70011784 Scalar_FLOAT32_IEEE 0 VBU0513_CM_single_cnt -3.4028234663852886E+38 3.4028234663852886E+38 /end CHARACTERISTIC
/begin CHARACTERISTIC TQC_numDragFastLearn_C "" VALUE 0x70011788 Scalar_FLOAT32_IEEE 0 VBU0513_CM_single_cnt -10000.0 10000.0 /end CHARACTERISTIC
/begin CHARACTERISTIC TQC_numDragLearnMin_C "" VALUE 0x7001178c Scalar_FLOAT32_IEEE 0 VBU0513_CM_single_cnt -3.4028234663852886E+38 3.4028234663852886E+38 /end CHARACTERISTIC
/begin CHARACTERISTIC TQC_numDragLearnStepDown_C "" VALUE 0x70011790 Scalar_FLOAT32_IEEE 0 VBU0513_CM_single_cnt -10000.0 10000.0 /end CHARACTERISTIC
/begin CHARACTERISTIC TQC_numDragLearnStepMax_C "" VALUE 0x70011794 Scalar_FLOAT32_IEEE 0 VBU0513_CM_single_cnt -10000.0 10000.0 /end CHARACTERISTIC
/begin CHARACTERISTIC TQC_numDragLearnStepUp_C "" VALUE 0x70011798 Scalar_FLOAT32_IEEE 0 VBU0513_CM_single_cnt -10000.0 10000.0 /end CHARACTERISTIC
/begin CHARACTERISTIC TQC_numDragLearnStep_C "" VALUE 0x7001179c Scalar_FLOAT32_IEEE 0 VBU0513_CM_single_cnt -10000.0 10000.0 /end CHARACTERISTIC
/begin CHARACTERISTIC TQC_numFltAccAverage_C "" VALUE 0x700117a0 Scalar_FLOAT32_IEEE 0 VBU0513_CM_single_cnt 0.0 255.0 /end CHARACTERISTIC
/begin CHARACTERISTIC TQC_numSlopeSample_C "" VALUE 0x700117a4 Scalar_FLOAT32_IEEE 0 VBU0513_CM_single_cnt -3.4028234663852886E+38 3.4028234663852886E+38 /end CHARACTERISTIC
/begin CHARACTERISTIC TQC_pctDragCalPedLe_C "" VALUE 0x700117a8 Scalar_FLOAT32_IEEE 0 VBU0513_CM_single_cnt 0.0 100.0 /end CHARACTERISTIC
/begin CHARACTERISTIC TQC_pctDragCalPedRi_C "" VALUE 0x700117ac Scalar_FLOAT32_IEEE 0 VBU0513_CM_single_cnt 0.0 100.0 /end CHARACTERISTIC
/begin CHARACTERISTIC TQC_rRatioReducer_C "" VALUE 0x700117b0 Scalar_FLOAT32_IEEE 0 VBU0513_CM_single_cnt 0.0 100.0 /end CHARACTERISTIC
/begin CHARACTERISTIC TQC_rTire19Wheel_C "" VALUE 0x700117b4 Scalar_FLOAT32_IEEE 0 VBU0513_CM_single_m 0.0 3.0 /end CHARACTERISTIC
/begin CHARACTERISTIC TQC_tiDelayDragTime_C "" VALUE 0x700117b8 Scalar_FLOAT32_IEEE 0 VBU0513_CM_single_cnt -3.4028234663852886E+38 3.4028234663852886E+38 /end CHARACTERISTIC
/begin CHARACTERISTIC TQC_tiDragDelayTime_C "" VALUE 0x700117bc Scalar_FLOAT32_IEEE 0 VBU0513_CM_single_cnt -3.4028234663852886E+38 3.4028234663852886E+38 /end CHARACTERISTIC
/begin CHARACTERISTIC TQC_tiSampleTime_C "" VALUE 0x700117c0 Scalar_FLOAT32_IEEE 0 VBU0513_CM_single_cnt -3.4028234663852886E+38 3.4028234663852886E+38 /end CHARACTERISTIC
/begin CHARACTERISTIC TQC_trqDefaultLimit_C "" VALUE 0x700117c4 Scalar_FLOAT32_IEEE 0 VBU0513_CM_single_cnt -10000.0 10000.0 /end CHARACTERISTIC
/begin CHARACTERISTIC TQC_trqDefaultSlope_C "" VALUE 0x700117c8 Scalar_FLOAT32_IEEE 0 VBU0513_CM_single_cnt -10000.0 10000.0 /end CHARACTERISTIC
/begin CHARACTERISTIC TQC_trqDragCalGradDec_C "" VALUE 0x700117cc Scalar_FLOAT32_IEEE 0 VBU0513_CM_single_cnt -10000.0 10000.0 /end CHARACTERISTIC
/begin CHARACTERISTIC TQC_trqDragCalGradInc_C "" VALUE 0x700117d0 Scalar_FLOAT32_IEEE 0 VBU0513_CM_single_cnt -10000.0 10000.0 /end CHARACTERISTIC
/begin CHARACTERISTIC TQC_trqDragMax_C "" VALUE 0x700117d4 Scalar_FLOAT32_IEEE 0 VBU0513_CM_single_cnt -10000.0 10000.0 /end CHARACTERISTIC
/begin CHARACTERISTIC TQC_trqSlopeLimitInit_C "" VALUE 0x700117d8 Scalar_FLOAT32_IEEE 0 VBU0513_CM_single_cnt -10000.0 10000.0 /end CHARACTERISTIC
/begin CHARACTERISTIC TQC_trqSlopeLimitMax_C "" VALUE 0x700117dc Scalar_FLOAT32_IEEE 0 VBU0513_CM_single_cnt -10000.0 10000.0 /end CHARACTERISTIC
/begin CHARACTERISTIC TQC_trqSlopeLimitMin_C "" VALUE 0x700117e0 Scalar_FLOAT32_IEEE 0 VBU0513_CM_single_cnt -10000.0 10000.0 /end CHARACTERISTIC
/begin CHARACTERISTIC TQC_trqVehMax_C "" VALUE 0x700117e4 Scalar_FLOAT32_IEEE 0 VBU0513_CM_single_cnt -10000.0 10000.0 /end CHARACTERISTIC
/begin CHARACTERISTIC TQC_trqVehMin_C "" VALUE 0x700117e8 Scalar_FLOAT32_IEEE 0 VBU0513_CM_single_cnt -10000.0 10000.0 /end CHARACTERISTIC
/begin CHARACTERISTIC TQC_vDragSpeedLe_C "" VALUE 0x700117ec Scalar_FLOAT32_IEEE 0 VBU0513_CM_single_cnt -3.4028234663852886E+38 3.4028234663852886E+38 /end CHARACTERISTIC
/begin CHARACTERISTIC TQC_vDragSpeedLearnLe_C "" VALUE 0x700117f0 Scalar_FLOAT32_IEEE 0 VBU0513_CM_single_cnt -3.4028234663852886E+38 3.4028234663852886E+38 /end CHARACTERISTIC
/begin CHARACTERISTIC TQC_vDragSpeedLearnRi_C "" VALUE 0x700117f4 Scalar_FLOAT32_IEEE 0 VBU0513_CM_single_cnt -3.4028234663852886E+38 3.4028234663852886E+38 /end CHARACTERISTIC
/begin CHARACTERISTIC TQC_vDragSpeedRi_C "" VALUE 0x700117f8 Scalar_FLOAT32_IEEE 0 VBU0513_CM_single_cnt -3.4028234663852886E+38 3.4028234663852886E+38 /end CHARACTERISTIC
/begin CHARACTERISTIC TQD_facBrkPressFilt_C "" VALUE 0x700118b4 Scalar_FLOAT32_IEEE 0 VBU0513_CM_single_cnt -3.4028234663852886E+38 3.4028234663852886E+38 /end CHARACTERISTIC
/begin CHARACTERISTIC TQD_facVehSpdFlt_C "" VALUE 0x700118b8 Scalar_FLOAT32_IEEE 0 VBU0513_CM_single_cnt -3.4028234663852886E+38 3.4028234663852886E+38 /end CHARACTERISTIC
/begin CHARACTERISTIC TQD_facVehSpdHys_C "" VALUE 0x700118bc Scalar_FLOAT32_IEEE 0 VBU0513_CM_single_cnt -3.4028234663852886E+38 3.4028234663852886E+38 /end CHARACTERISTIC
/begin CHARACTERISTIC TQD_pctAccPedalDeadband_C "" VALUE 0x700118c4 Scalar_FLOAT32_IEEE 0 VBU0513_CM_single_cnt -3.4028234663852886E+38 3.4028234663852886E+38 /end CHARACTERISTIC
/begin CHARACTERISTIC TQD_pctVehSlideRes_C "" VALUE 0x700118c8 Scalar_FLOAT32_IEEE 0 VBU0513_CM_single_cnt -3.4028234663852886E+38 3.4028234663852886E+38 /end CHARACTERISTIC
/begin CHARACTERISTIC TQD_vVehSlideEna_C "" VALUE 0x700118e0 Scalar_FLOAT32_IEEE 0 VBU0513_CM_single_cnt -3.4028234663852886E+38 3.4028234663852886E+38 /end CHARACTERISTIC
/begin CHARACTERISTIC TQD_vVehSlideRes_C "" VALUE 0x700118e4 Scalar_FLOAT32_IEEE 0 VBU0513_CM_single_cnt -3.4028234663852886E+38 3.4028234663852886E+38 /end CHARACTERISTIC
/begin CHARACTERISTIC VM_aVehLimDifNeg_C "" VALUE 0x70011914 Scalar_FLOAT32_IEEE 0 VBU0513_CM_single_cnt -3.4028234663852886E+38 3.4028234663852886E+38 /end CHARACTERISTIC
/begin CHARACTERISTIC VM_aVehLimDifPos_C "" VALUE 0x70011918 Scalar_FLOAT32_IEEE 0 VBU0513_CM_single_cnt -3.4028234663852886E+38 3.4028234663852886E+38 /end CHARACTERISTIC
/begin CHARACTERISTIC VM_aVehLimMax_C "" VALUE 0x7001191c Scalar_FLOAT32_IEEE 0 VBU0513_CM_single_cnt -3.4028234663852886E+38 3.4028234663852886E+38 /end CHARACTERISTIC
/begin CHARACTERISTIC VM_vVehLimExtDefault_C "" VALUE 0x0000 Scalar_FLOAT32_IEEE 0 VBU0513_CM_single_cnt -3.4028234663852886E+38 3.4028234663852886E+38 /end CHARACTERISTIC
/begin CHARACTERISTIC VM_vVehLimFix_C "" VALUE 0x70011920 Scalar_FLOAT32_IEEE 0 VBU0513_CM_single_cnt -3.4028234663852886E+38 3.4028234663852886E+38 /end CHARACTERISTIC
/begin CHARACTERISTIC VM_vVehLimMaxRThresHi_C "" VALUE 0x70011924 Scalar_FLOAT32_IEEE 0 VBU0513_CM_single_cnt -3.4028234663852886E+38 3.4028234663852886E+38 /end CHARACTERISTIC
/begin CHARACTERISTIC VM_vVehLimMaxRThresLo_C "" VALUE 0x70011928 Scalar_FLOAT32_IEEE 0 VBU0513_CM_single_cnt -3.4028234663852886E+38 3.4028234663852886E+38 /end CHARACTERISTIC
/begin CHARACTERISTIC VM_vVehLimMaxR_C "" VALUE 0x7001192c Scalar_FLOAT32_IEEE 0 VBU0513_CM_single_cnt -3.4028234663852886E+38 3.4028234663852886E+38 /end CHARACTERISTIC
/begin CHARACTERISTIC VM_vVehLimMaxThresHi_C "" VALUE 0x70011930 Scalar_FLOAT32_IEEE 0 VBU0513_CM_single_cnt -3.4028234663852886E+38 3.4028234663852886E+38 /end CHARACTERISTIC
/begin CHARACTERISTIC VM_vVehLimMaxThresLo_C "" VALUE 0x70011934 Scalar_FLOAT32_IEEE 0 VBU0513_CM_single_cnt -3.4028234663852886E+38 3.4028234663852886E+38 /end CHARACTERISTIC
/begin CHARACTERISTIC VM_vVehLimMax_C "" VALUE 0x70011938 Scalar_FLOAT32_IEEE 0 VBU0513_CM_single_cnt -3.4028234663852886E+38 3.4028234663852886E+38 /end CHARACTERISTIC
/begin CHARACTERISTIC VM_vVehLimServerGearD_C "" VALUE 0x7001193c Scalar_FLOAT32_IEEE 0 VBU0513_CM_single_cnt -3.4028234663852886E+38 3.4028234663852886E+38 /end CHARACTERISTIC
/begin CHARACTERISTIC VM_vVehLimServerGearR_C "" VALUE 0x70011940 Scalar_FLOAT32_IEEE 0 VBU0513_CM_single_cnt -3.4028234663852886E+38 3.4028234663852886E+38 /end CHARACTERISTIC
/begin CHARACTERISTIC VM_vVehLimThresD_C "" VALUE 0x70011944 Scalar_FLOAT32_IEEE 0 VBU0513_CM_single_cnt -3.4028234663852886E+38 3.4028234663852886E+38 /end CHARACTERISTIC
/begin CHARACTERISTIC VM_vVehLimThresR_C "" VALUE 0x70011948 Scalar_FLOAT32_IEEE 0 VBU0513_CM_single_cnt -3.4028234663852886E+38 3.4028234663852886E+38 /end CHARACTERISTIC
/begin CHARACTERISTIC VM_vVehLimpHomeThresD_C "" VALUE 0x7001194c Scalar_FLOAT32_IEEE 0 VBU0513_CM_single_cnt -3.4028234663852886E+38 3.4028234663852886E+38 /end CHARACTERISTIC
/begin CHARACTERISTIC VM_vVehLimpHomeThresR_C "" VALUE 0x70011950 Scalar_FLOAT32_IEEE 0 VBU0513_CM_single_cnt -3.4028234663852886E+38 3.4028234663852886E+38 /end CHARACTERISTIC
/begin CHARACTERISTIC VM_vVehSpdLimHiServerGearD_C "" VALUE 0x70011954 Scalar_FLOAT32_IEEE 0 VBU0513_CM_single_cnt -3.4028234663852886E+38 3.4028234663852886E+38 /end CHARACTERISTIC
/begin CHARACTERISTIC VM_vVehSpdLimHiServerGearR_C "" VALUE 0x70011958 Scalar_FLOAT32_IEEE 0 VBU0513_CM_single_cnt -3.4028234663852886E+38 3.4028234663852886E+38 /end CHARACTERISTIC
/begin CHARACTERISTIC VM_vVehSpdLimREDSServerGearDMax_C "" VALUE 0x7001195c Scalar_FLOAT32_IEEE 0 VBU0513_CM_single_cnt -3.4028234663852886E+38 3.4028234663852886E+38 /end CHARACTERISTIC
/begin CHARACTERISTIC VM_vVehSpdLimREDSServerGearDMin_C "" VALUE 0x70011960 Scalar_FLOAT32_IEEE 0 VBU0513_CM_single_cnt -3.4028234663852886E+38 3.4028234663852886E+38 /end CHARACTERISTIC
/begin CHARACTERISTIC VM_vVehSpdLimREDSServerGearR_C "" VALUE 0x70011964 Scalar_FLOAT32_IEEE 0 VBU0513_CM_single_cnt -3.4028234663852886E+38 3.4028234663852886E+38 /end CHARACTERISTIC
/begin CHARACTERISTIC VM_vVehSpdLimServerGearD_C "" VALUE 0x70011968 Scalar_FLOAT32_IEEE 0 VBU0513_CM_single_cnt -3.4028234663852886E+38 3.4028234663852886E+38 /end CHARACTERISTIC
/begin CHARACTERISTIC VM_vVehSpdLimServerGearR_C "" VALUE 0x7001196c Scalar_FLOAT32_IEEE 0 VBU0513_CM_single_cnt -3.4028234663852886E+38 3.4028234663852886E+38 /end CHARACTERISTIC
/begin CHARACTERISTIC CcBCV_BatteryOverCurrentWarningFaultDelay_ms "" VALUE 0x700104a4 Scalar_ULONG 0 VBU0513_CM_uint32_cnt 0.0 4.294967295E+9 /end CHARACTERISTIC
/begin CHARACTERISTIC CcBCV_BatteryOverVoltageWarningFaultDelay_ms "" VALUE 0x700104b4 Scalar_ULONG 0 VBU0513_CM_uint32_cnt 0.0 4.294967295E+9 /end CHARACTERISTIC
/begin CHARACTERISTIC CcFCC_BatteryCapacityCycle1_n "" VALUE 0x700106bc Scalar_ULONG 0 VBU0513_CM_uint32_cnt 0.0 4.294967295E+9 /end CHARACTERISTIC
/begin CHARACTERISTIC CcFCC_BatteryCapacityCycle2_n "" VALUE 0x700106c0 Scalar_ULONG 0 VBU0513_CM_uint32_cnt 0.0 4.294967295E+9 /end CHARACTERISTIC
/begin CHARACTERISTIC CcSOC_BatteryDisplaySocUpdateInterval_s "" VALUE 0x700107d4 Scalar_ULONG 0 VBU0513_CM_uint32_cnt 0.0 4.294967295E+9 /end CHARACTERISTIC
/begin CHARACTERISTIC CcSOC_InvalidLastShutdownTime_s "" VALUE 0x70010870 Scalar_ULONG 0 VBU0513_CM_uint32_cnt 0.0 4.294967295E+9 /end CHARACTERISTIC
/begin CHARACTERISTIC EcBCV_nbrFuseProtectCounter3W "" VALUE 0x7001125c Scalar_ULONG 0 VBU0513_CM_uint32 0 4294967295 /end CHARACTERISTIC
/begin CHARACTERISTIC CTM_CELL_THERMAL_RUNAWAY_FAULT "" VALUE 0x70010020 Scalar_UWORD 0 VBU0513_CM_uint16_cnt 0.0 65535.0 /end CHARACTERISTIC
/begin CHARACTERISTIC CcBCV_BatteryCurrentDelay_ms "" VALUE 0x7001002a Scalar_UWORD 0 VBU0513_CM_uint16_cnt 0.0 65535.0 /end CHARACTERISTIC
/begin CHARACTERISTIC CcBCV_FuseProtectDelay1_ms "" VALUE 0x7001002e Scalar_UWORD 0 VBU0513_CM_uint16_cnt 0.0 65535.0 /end CHARACTERISTIC
/begin CHARACTERISTIC CcBCV_FuseProtectDelay2_ms "" VALUE 0x70010030 Scalar_UWORD 0 VBU0513_CM_uint16_cnt 0.0 65535.0 /end CHARACTERISTIC
/begin CHARACTERISTIC CcBCV_FuseProtectDelay3_ms "" VALUE 0x70010032 Scalar_UWORD 0 VBU0513_CM_uint16_cnt 0.0 65535.0 /end CHARACTERISTIC
/begin CHARACTERISTIC CcBCV_FuseProtectDelay4_ms "" VALUE 0x70010034 Scalar_UWORD 0 VBU0513_CM_uint16_cnt 0.0 65535.0 /end CHARACTERISTIC
/begin CHARACTERISTIC CcBCV_HighVoltageDelay_ms "" VALUE 0x70010036 Scalar_UWORD 0 VBU0513_CM_uint16_cnt 0.0 65535.0 /end CHARACTERISTIC
/begin CHARACTERISTIC CcCBL_BalanceStartCellVoltageMinHysteresis_mV "" VALUE 0x70010048 Scalar_UWORD 0 VBU0513_CM_uint16_cnt 0.0 65535.0 /end CHARACTERISTIC
/begin CHARACTERISTIC CcCBL_BalanceStartCellVoltageMin_mV "" VALUE 0x7001004a Scalar_UWORD 0 VBU0513_CM_uint16_cnt 0.0 65535.0 /end CHARACTERISTIC
/begin CHARACTERISTIC CcCBL_BalanceStartDeltaVoltage_mV "" VALUE 0x7001004e Scalar_UWORD 0 VBU0513_CM_uint16_cnt 0.0 65535.0 /end CHARACTERISTIC
/begin CHARACTERISTIC CcCBL_CellBalanceCurrentCheckTime_s "" VALUE 0x70010050 Scalar_UWORD 0 VBU0513_CM_uint16_cnt 0.0 65535.0 /end CHARACTERISTIC
/begin CHARACTERISTIC CcCBL_SocBalanceCurrentCheckTime_s "" VALUE 0x70010058 Scalar_UWORD 0 VBU0513_CM_uint16_cnt 0.0 65535.0 /end CHARACTERISTIC
/begin CHARACTERISTIC CcCTD_PrechargeFailLockoutInterval_s "" VALUE 0x7001005a Scalar_UWORD 0 VBU0513_CM_uint16_cnt 0.0 65535.0 /end CHARACTERISTIC
/begin CHARACTERISTIC CcCTD_PrechargeTimeMax_ms "" VALUE 0x7001005c Scalar_UWORD 0 VBU0513_CM_uint16_cnt 0.0 65535.0 /end CHARACTERISTIC
/begin CHARACTERISTIC CcCTS_ContactorRequestCloseDelay_ms "" VALUE 0x70010062 Scalar_UWORD 0 VBU0513_CM_uint16_cnt 0.0 65535.0 /end CHARACTERISTIC
/begin CHARACTERISTIC CcCVT_BdmCellOverVoltageFault_mV "" VALUE 0x70010074 Scalar_UWORD 0 VBU0513_CM_uint16_mV 0.0 65535.0 /end CHARACTERISTIC
/begin CHARACTERISTIC CcCVT_BdmCellUnderVoltageFault_mV "" VALUE 0x70010076 Scalar_UWORD 0 VBU0513_CM_uint16_mV 0.0 65535.0 /end CHARACTERISTIC
/begin CHARACTERISTIC CcCVT_BdmCellVoltageOverDeviationFault_mV "" VALUE 0x70010078 Scalar_UWORD 0 VBU0513_CM_uint16_mV 0.0 65535.0 /end CHARACTERISTIC
/begin CHARACTERISTIC CcCVT_BdmDelayTime_ms "" VALUE 0x7001007a Scalar_UWORD 0 VBU0513_CM_uint16_ms 0.0 65535.0 /end CHARACTERISTIC
/begin CHARACTERISTIC CcCVT_BdmVoltageDeviationDynamic_mV "" VALUE 0x7001007c Scalar_UWORD 0 VBU0513_CM_uint16_mV 0.0 65535.0 /end CHARACTERISTIC
/begin CHARACTERISTIC CcFCC_CurrentValueCrossZeroFlagDelay_ms "" VALUE 0x700100a2 Scalar_UWORD 0 VBU0513_CM_uint16_cnt 0.0 65535.0 /end CHARACTERISTIC
/begin CHARACTERISTIC CcFCC_EstimateChargeTimeRefresh_s "" VALUE 0x700100a4 Scalar_UWORD 0 VBU0513_CM_uint16_cnt 0.0 65535.0 /end CHARACTERISTIC
/begin CHARACTERISTIC CcFCC_MaxValidChargeTime_min "" VALUE 0x700100ac Scalar_UWORD 0 VBU0513_CM_uint16_cnt 0.0 65535.0 /end CHARACTERISTIC
/begin CHARACTERISTIC CcSOC_ChargeStateDelay_ms "" VALUE 0x700100be Scalar_UWORD 0 VBU0513_CM_uint16_cnt 0.0 65535.0 /end CHARACTERISTIC
/begin CHARACTERISTIC MINUTES_PER_HOUR "" VALUE 0x7001013a Scalar_UWORD 0 VBU0513_CM_uint16_cnt 0.0 65535.0 /end CHARACTERISTIC
/begin CHARACTERISTIC SECONDS_PER_HOUR "" VALUE 0x70010144 Scalar_UWORD 0 VBU0513_CM_uint16_cnt 0.0 65535.0 /end CHARACTERISTIC
/begin CHARACTERISTIC BPD_flgBrkPosOverride_C "" VALUE 0x70020a3c Scalar_BOOLEAN 0 VBU0513_CM_boolean_cnt 0.0 1.0 /end CHARACTERISTIC
/begin CHARACTERISTIC BPD_flgBrkPosVldOverrideVal_C "" VALUE 0x70020a3d Scalar_BOOLEAN 0 VBU0513_CM_boolean_cnt 0.0 1.0 /end CHARACTERISTIC
/begin CHARACTERISTIC BPD_flgBrkPosVldOverride_C "" VALUE 0x70020a3e Scalar_BOOLEAN 0 VBU0513_CM_boolean_cnt 0.0 1.0 /end CHARACTERISTIC
/begin CHARACTERISTIC BPD_flgBrkSwtOverride_C "" VALUE 0x70020a3f Scalar_BOOLEAN 0 VBU0513_CM_boolean_cnt 0.0 1.0 /end CHARACTERISTIC
/begin CHARACTERISTIC CaDSM_CscValueUncertainFault_flg "" VAL_BLK 0x700210d8 Scalar_BOOLEAN 0 VBU0513_CM_boolean_cnt 0.0 1.0 NUMBER 330 /end CHARACTERISTIC
/begin CHARACTERISTIC CaDSM_CycleUploadAbnormalEvent_flg "" VAL_BLK 0x70021222 Scalar_BOOLEAN 0 VBU0513_CM_boolean_cnt 0.0 1.0 NUMBER 330 /end CHARACTERISTIC
/begin CHARACTERISTIC CaDSM_NoChargeFault_flg "" VAL_BLK 0x700214b6 Scalar_BOOLEAN 0 VBU0513_CM_boolean_cnt 0.0 1.0 NUMBER 330 /end CHARACTERISTIC
/begin CHARACTERISTIC CbBCV_BatteryBusVoltageMismatch_flg "" VALUE 0x70020aa9 Scalar_BOOLEAN 0 VBU0513_CM_boolean_cnt 0.0 1.0 /end CHARACTERISTIC
/begin CHARACTERISTIC CbBCV_BatteryCurrentOoR_flg "" VALUE 0x70020aaa Scalar_BOOLEAN 0 VBU0513_CM_boolean_cnt 0.0 1.0 /end CHARACTERISTIC
/begin CHARACTERISTIC CbBCV_BatteryCurrentZeroDriftEnable_flg "" VALUE 0x70020aab Scalar_BOOLEAN 0 VBU0513_CM_boolean_cnt 0.0 1.0 /end CHARACTERISTIC
/begin CHARACTERISTIC CbBCV_BatteryOverCurrentWarning_flg "" VALUE 0x70020aac Scalar_BOOLEAN 0 VBU0513_CM_boolean_cnt 0.0 1.0 /end CHARACTERISTIC
/begin CHARACTERISTIC CbBCV_BatteryOverCurrent_flg "" VALUE 0x70020aad Scalar_BOOLEAN 0 VBU0513_CM_boolean_cnt 0.0 1.0 /end CHARACTERISTIC
/begin CHARACTERISTIC CbBCV_BatteryOverVoltageEVMFaultEnable_flg "" VALUE 0x70020aae Scalar_BOOLEAN 0 VBU0513_CM_boolean_cnt 0.0 1.0 /end CHARACTERISTIC
/begin CHARACTERISTIC CbBCV_BatteryOverVoltageWarning_flg "" VALUE 0x70020aaf Scalar_BOOLEAN 0 VBU0513_CM_boolean_cnt 0.0 1.0 /end CHARACTERISTIC
/begin CHARACTERISTIC CbBCV_BatteryOverVoltage_flg "" VALUE 0x70020ab0 Scalar_BOOLEAN 0 VBU0513_CM_boolean_cnt 0.0 1.0 /end CHARACTERISTIC
/begin CHARACTERISTIC CbBCV_BatteryUnderVoltageEVMFaultEnable_flg "" VALUE 0x70020ab1 Scalar_BOOLEAN 0 VBU0513_CM_boolean_cnt 0.0 1.0 /end CHARACTERISTIC
/begin CHARACTERISTIC CbBCV_BatteryUnderVoltage_flg "" VALUE 0x70020ab2 Scalar_BOOLEAN 0 VBU0513_CM_boolean_cnt 0.0 1.0 /end CHARACTERISTIC
/begin CHARACTERISTIC CbBCV_BatteryVoltageOoR_flg "" VALUE 0x70020ab3 Scalar_BOOLEAN 0 VBU0513_CM_boolean_cnt 0.0 1.0 /end CHARACTERISTIC
/begin CHARACTERISTIC CbCBL_CellBalanceEnable_flg "" VALUE 0x70020ad3 Scalar_BOOLEAN 0 VBU0513_CM_boolean_cnt 0.0 1.0 /end CHARACTERISTIC
/begin CHARACTERISTIC CbCBL_CellBalanceOCVCheckEnable_flg "" VALUE 0x70020ad4 Scalar_BOOLEAN 0 VBU0513_CM_boolean_cnt 0.0 1.0 /end CHARACTERISTIC
/begin CHARACTERISTIC CbCBL_CellBalanceRespMismatchReqtFault_flg "" VALUE 0x70020ad5 Scalar_BOOLEAN 0 VBU0513_CM_boolean_cnt 0.0 1.0 /end CHARACTERISTIC
/begin CHARACTERISTIC CbCBL_CellTempCheckEnable_flg "" VALUE 0x70020ad6 Scalar_BOOLEAN 0 VBU0513_CM_boolean_cnt 0.0 1.0 /end CHARACTERISTIC
/begin CHARACTERISTIC CbCBL_IsolationResistanceEnable_flg "" VALUE 0x70020ad7 Scalar_BOOLEAN 0 VBU0513_CM_boolean_cnt 0.0 1.0 /end CHARACTERISTIC
/begin CHARACTERISTIC CbCTD_MnNegContactorWeldFaultEnable_flg "" VALUE 0x70020ada Scalar_BOOLEAN 0 VBU0513_CM_boolean_cnt 0.0 1.0 /end CHARACTERISTIC
/begin CHARACTERISTIC CbCTD_MnPosContactorWeldFaultEnable_flg "" VALUE 0x70020adc Scalar_BOOLEAN 0 VBU0513_CM_boolean_cnt 0.0 1.0 /end CHARACTERISTIC
/begin CHARACTERISTIC CbCTD_PrechargeOverEnergyLockoutEnable_flg "" VALUE 0x70020adf Scalar_BOOLEAN 0 VBU0513_CM_boolean_cnt 0.0 1.0 /end CHARACTERISTIC
/begin CHARACTERISTIC CbCTD_PrechargeRelayStuckOpenFaultEnable_flg "" VALUE 0x70020ae0 Scalar_BOOLEAN 0 VBU0513_CM_boolean_cnt 0.0 1.0 /end CHARACTERISTIC
/begin CHARACTERISTIC CbCTD_PrechargeTimeoutFaultEnable_flg "" VALUE 0x70020ae2 Scalar_BOOLEAN 0 VBU0513_CM_boolean_cnt 0.0 1.0 /end CHARACTERISTIC
/begin CHARACTERISTIC CbCVT_BdmCellOverVoltageFaultEnable_flg "" VALUE 0x70020af4 Scalar_BOOLEAN 0 VBU0513_CM_boolean_flg 0.0 1.0 /end CHARACTERISTIC
/begin CHARACTERISTIC CbCVT_BdmCellUnderVoltageFaultEnable_flg "" VALUE 0x70020af5 Scalar_BOOLEAN 0 VBU0513_CM_boolean_flg 0.0 1.0 /end CHARACTERISTIC
/begin CHARACTERISTIC CbCVT_BdmCellVoltageOverDeviationFaultEnable_flg "" VALUE 0x70020af6 Scalar_BOOLEAN 0 VBU0513_CM_boolean_flg 0.0 1.0 /end CHARACTERISTIC
/begin CHARACTERISTIC CbSOC_CellCapacityOvrdFlg_flg "" VALUE 0x70020b1b Scalar_BOOLEAN 0 VBU0513_CM_boolean_cnt 0.0 1.0 /end CHARACTERISTIC
/begin CHARACTERISTIC LVC_flgIbsSocLowHvRlyOpen_C "" VALUE 0x70020e4a Scalar_BOOLEAN 0 VBU0513_CM_boolean_cnt 0.0 1.0 /end CHARACTERISTIC
/begin CHARACTERISTIC MTQL_trqMtrDrvLimOvrd_C "" VALUE 0x70020e66 Scalar_BOOLEAN 0 VBU0513_CM_boolean 0 1 /end CHARACTERISTIC
/begin CHARACTERISTIC MTQL_trqMtrRgnLimOvrd_C "" VALUE 0x70020e67 Scalar_BOOLEAN 0 VBU0513_CM_boolean 0 1 /end CHARACTERISTIC
/begin CHARACTERISTIC PMM_flgAccDisblOvrdSwt_C "" VALUE 0x70020e78 Scalar_BOOLEAN 0 VBU0513_CM_boolean_cnt 0.0 1.0 /end CHARACTERISTIC
/begin CHARACTERISTIC PMM_flgAccDisblOvrdVal_C "" VALUE 0x70020e79 Scalar_BOOLEAN 0 VBU0513_CM_boolean_cnt 0.0 1.0 /end CHARACTERISTIC
/begin CHARACTERISTIC PMM_flgActvDisWihtHVRlyCldSwt_C "" VALUE 0x70020e7a Scalar_BOOLEAN 0 VBU0513_CM_boolean_cnt 0.0 1.0 /end CHARACTERISTIC
/begin CHARACTERISTIC PMM_flgActvDisWihtHVRlyCldVal_C "" VALUE 0x70020e7b Scalar_BOOLEAN 0 VBU0513_CM_boolean_cnt 0.0 1.0 /end CHARACTERISTIC
/begin CHARACTERISTIC PMM_flgHVPwrDwnEnaOvrdSwt_C "" VALUE 0x70020e7c Scalar_BOOLEAN 0 VBU0513_CM_boolean_cnt 0.0 1.0 /end CHARACTERISTIC
/begin CHARACTERISTIC PMM_flgHVPwrDwnEnaOvrdVal_C "" VALUE 0x70020e7d Scalar_BOOLEAN 0 VBU0513_CM_boolean_cnt 0.0 1.0 /end CHARACTERISTIC
/begin CHARACTERISTIC PMM_flgHVPwrUpEnaOvrdSwt_C "" VALUE 0x70020e7e Scalar_BOOLEAN 0 VBU0513_CM_boolean_cnt 0.0 1.0 /end CHARACTERISTIC
/begin CHARACTERISTIC PMM_flgHVPwrUpEnaOvrdVal_C "" VALUE 0x70020e7f Scalar_BOOLEAN 0 VBU0513_CM_boolean_cnt 0.0 1.0 /end CHARACTERISTIC
/begin CHARACTERISTIC PMM_flgHVRdyOvrdSwt_C "" VALUE 0x70020e80 Scalar_BOOLEAN 0 VBU0513_CM_boolean_cnt 0.0 1.0 /end CHARACTERISTIC
/begin CHARACTERISTIC PMM_flgHVRdyOvrdVal_C "" VALUE 0x70020e81 Scalar_BOOLEAN 0 VBU0513_CM_boolean_cnt 0.0 1.0 /end CHARACTERISTIC
/begin CHARACTERISTIC PMM_flgHVRlyReqOvrdSwt_C "" VALUE 0x70020e82 Scalar_BOOLEAN 0 VBU0513_CM_boolean_cnt 0.0 1.0 /end CHARACTERISTIC
/begin CHARACTERISTIC PMM_flgPEURActvDisChEnaOvrdSwt_C "" VALUE 0x70020e84 Scalar_BOOLEAN 0 VBU0513_CM_boolean_cnt 0.0 1.0 /end CHARACTERISTIC
/begin CHARACTERISTIC PMM_flgPEURActvDisChEnaOvrdVal_C "" VALUE 0x70020e85 Scalar_BOOLEAN 0 VBU0513_CM_boolean_cnt 0.0 1.0 /end CHARACTERISTIC
/begin CHARACTERISTIC PMM_flgPEURShtDwnOvrdSwt_C "" VALUE 0x70020e86 Scalar_BOOLEAN 0 VBU0513_CM_boolean_cnt 0.0 1.0 /end CHARACTERISTIC
/begin CHARACTERISTIC PMM_flgPEURShtDwnOvrdVal_C "" VALUE 0x70020e87 Scalar_BOOLEAN 0 VBU0513_CM_boolean_cnt 0.0 1.0 /end CHARACTERISTIC
/begin CHARACTERISTIC PMM_flgRMCUZrTrqReqOvrdSwt_C "" VALUE 0x70020e8a Scalar_BOOLEAN 0 VBU0513_CM_boolean_cnt 0.0 1.0 /end CHARACTERISTIC
/begin CHARACTERISTIC PMM_flgRMCUZrTrqReqOvrdVal_C "" VALUE 0x70020e8b Scalar_BOOLEAN 0 VBU0513_CM_boolean_cnt 0.0 1.0 /end CHARACTERISTIC
/begin CHARACTERISTIC PMM_flgSelfDiagEnaOvrdSwt_C "" VALUE 0x70020e8c Scalar_BOOLEAN 0 VBU0513_CM_boolean_cnt 0.0 1.0 /end CHARACTERISTIC
/begin CHARACTERISTIC PMM_flgSelfDiagEnaOvrdVal_C "" VALUE 0x70020e8d Scalar_BOOLEAN 0 VBU0513_CM_boolean_cnt 0.0 1.0 /end CHARACTERISTIC
/begin CHARACTERISTIC PMM_flgVehRdyOvrdSwt_C "" VALUE 0x70020e92 Scalar_BOOLEAN 0 VBU0513_CM_boolean_cnt 0.0 1.0 /end CHARACTERISTIC
/begin CHARACTERISTIC PMM_flgWkupModOvrdSwt_C "" VALUE 0x70020e97 Scalar_BOOLEAN 0 VBU0513_CM_boolean_cnt 0.0 1.0 /end CHARACTERISTIC
/begin CHARACTERISTIC TQC_flgDragCalEn_C "" VALUE 0x70020ef1 Scalar_BOOLEAN 0 VBU0513_CM_boolean_cnt 0.0 1.0 /end CHARACTERISTIC
/begin CHARACTERISTIC TQC_flgDragTrqMovingOn_C "" VALUE 0x70020ef2 Scalar_BOOLEAN 0 VBU0513_CM_boolean_cnt 0.0 1.0 /end CHARACTERISTIC
/begin CHARACTERISTIC TQC_flgSlopeLimitEn_C "" VALUE 0x70020ef3 Scalar_BOOLEAN 0 VBU0513_CM_boolean_cnt 0.0 1.0 /end CHARACTERISTIC
/begin CHARACTERISTIC TQC_flgVehAccCalcEnable_C "" VALUE 0x70020ef4 Scalar_BOOLEAN 0 VBU0513_CM_boolean_cnt 0.0 1.0 /end CHARACTERISTIC
/begin CHARACTERISTIC TQD_flgAPDFltByp_C "" VALUE 0x70020f01 Scalar_BOOLEAN 0 VBU0513_CM_boolean_cnt 0.0 1.0 /end CHARACTERISTIC
/begin CHARACTERISTIC TQD_flgVectorSpdUsed_C "" VALUE 0x70020f05 Scalar_BOOLEAN 0 VBU0513_CM_boolean_cnt 0.0 1.0 /end CHARACTERISTIC
/begin CHARACTERISTIC TQD_flgVirtualNeutralEnable_C "" VALUE 0x70020f06 Scalar_BOOLEAN 0 VBU0513_CM_boolean_cnt 0.0 1.0 /end CHARACTERISTIC
/begin CHARACTERISTIC VM_flgVehLimFixEnable_C "" VALUE 0x70020f15 Scalar_BOOLEAN 0 VBU0513_CM_boolean_cnt 0.0 1.0 /end CHARACTERISTIC
/begin CHARACTERISTIC CcBCV_BatteryBusVoltageMismatchFaultFIC_n "" VALUE 0x70020bc3 Scalar_BYTE 0 VBU0513_CM_int8_cnt -128.0 127.0 /end CHARACTERISTIC
/begin CHARACTERISTIC CcBCV_BatteryBusVoltageMismatchFaultPIC_n "" VALUE 0x70020bc4 Scalar_BYTE 0 VBU0513_CM_int8_cnt -128.0 127.0 /end CHARACTERISTIC
/begin CHARACTERISTIC CcBCV_BatteryCurrentOoRFaultFIC_n "" VALUE 0x70020bc5 Scalar_BYTE 0 VBU0513_CM_int8_cnt -128.0 127.0 /end CHARACTERISTIC
/begin CHARACTERISTIC CcBCV_BatteryCurrentOoRFaultPIC_n "" VALUE 0x70020bc6 Scalar_BYTE 0 VBU0513_CM_int8_cnt -128.0 127.0 /end CHARACTERISTIC
/begin CHARACTERISTIC CcBCV_BatteryOverCurrentFaultFIC_n "" VALUE 0x70020bc7 Scalar_BYTE 0 VBU0513_CM_int8_cnt -128.0 127.0 /end CHARACTERISTIC
/begin CHARACTERISTIC CcBCV_BatteryOverCurrentFaultPIC_n "" VALUE 0x70020bc8 Scalar_BYTE 0 VBU0513_CM_int8_cnt -128.0 127.0 /end CHARACTERISTIC
/begin CHARACTERISTIC CcBCV_BatteryOverCurrentWarningFaultFIC_n "" VALUE 0x70020bc9 Scalar_BYTE 0 VBU0513_CM_int8_cnt -128.0 127.0 /end CHARACTERISTIC
/begin CHARACTERISTIC CcBCV_BatteryOverCurrentWarningFaultPIC_n "" VALUE 0x70020bca Scalar_BYTE 0 VBU0513_CM_int8_cnt -128.0 127.0 /end CHARACTERISTIC
/begin CHARACTERISTIC CcBCV_BatteryOverVoltageEVMFaultFIC_n "" VALUE 0x70020bcb Scalar_BYTE 0 VBU0513_CM_int8_cnt -128.0 127.0 /end CHARACTERISTIC
/begin CHARACTERISTIC CcBCV_BatteryOverVoltageEVMFaultPIC_n "" VALUE 0x70020bcc Scalar_BYTE 0 VBU0513_CM_int8_cnt -128.0 127.0 /end CHARACTERISTIC
/begin CHARACTERISTIC CcBCV_BatteryOverVoltageFaultFIC_n "" VALUE 0x70020bcd Scalar_BYTE 0 VBU0513_CM_int8_cnt -128.0 127.0 /end CHARACTERISTIC
/begin CHARACTERISTIC CcBCV_BatteryOverVoltageFaultPIC_n "" VALUE 0x70020bce Scalar_BYTE 0 VBU0513_CM_int8_cnt -128.0 127.0 /end CHARACTERISTIC
/begin CHARACTERISTIC CcBCV_BatteryOverVoltageWarningFaultFIC_n "" VALUE 0x70020bcf Scalar_BYTE 0 VBU0513_CM_int8_cnt -128.0 127.0 /end CHARACTERISTIC
/begin CHARACTERISTIC CcBCV_BatteryOverVoltageWarningFaultPIC_n "" VALUE 0x70020bd0 Scalar_BYTE 0 VBU0513_CM_int8_cnt -128.0 127.0 /end CHARACTERISTIC
/begin CHARACTERISTIC CcBCV_BatteryUnderVoltageEVMFaultFIC_n "" VALUE 0x70020bd1 Scalar_BYTE 0 VBU0513_CM_int8_cnt -128.0 127.0 /end CHARACTERISTIC
/begin CHARACTERISTIC CcBCV_BatteryUnderVoltageEVMFaultPIC_n "" VALUE 0x70020bd2 Scalar_BYTE 0 VBU0513_CM_int8_cnt -128.0 127.0 /end CHARACTERISTIC
/begin CHARACTERISTIC CcBCV_BatteryUnderVoltageFaultFIC_n "" VALUE 0x70020bd3 Scalar_BYTE 0 VBU0513_CM_int8_cnt -128.0 127.0 /end CHARACTERISTIC
/begin CHARACTERISTIC CcBCV_BatteryUnderVoltageFaultPIC_n "" VALUE 0x70020bd4 Scalar_BYTE 0 VBU0513_CM_int8_cnt -128.0 127.0 /end CHARACTERISTIC
/begin CHARACTERISTIC CcBCV_BatteryVoltageOoRFaultFIC_n "" VALUE 0x70020bd5 Scalar_BYTE 0 VBU0513_CM_int8_cnt -128.0 127.0 /end CHARACTERISTIC
/begin CHARACTERISTIC CcBCV_BatteryVoltageOoRFaultPIC_n "" VALUE 0x70020bd6 Scalar_BYTE 0 VBU0513_CM_int8_cnt -128.0 127.0 /end CHARACTERISTIC
/begin CHARACTERISTIC CcCBL_CellBalanceRespMismatchReqtFIC_n "" VALUE 0x70020be5 Scalar_BYTE 0 VBU0513_CM_int8_cnt -128.0 127.0 /end CHARACTERISTIC
/begin CHARACTERISTIC CcCBL_CellBalanceRespMismatchReqtPIC_n "" VALUE 0x70020be6 Scalar_BYTE 0 VBU0513_CM_int8_cnt -128.0 127.0 /end CHARACTERISTIC
/begin CHARACTERISTIC CcCTD_MNCWeldTestEnablePEURVoltageRatio_pct "" VALUE 0x70020be7 Scalar_BYTE 0 VBU0513_CM_int8_cnt -128.0 127.0 /end CHARACTERISTIC
/begin CHARACTERISTIC CcCTD_MnNegContactorWeldFaultFIC_n "" VALUE 0x70020bed Scalar_BYTE 0 VBU0513_CM_int8_cnt -128.0 127.0 /end CHARACTERISTIC
/begin CHARACTERISTIC CcCTD_MnNegContactorWeldFaultPIC_n "" VALUE 0x70020bee Scalar_BYTE 0 VBU0513_CM_int8_cnt -128.0 127.0 /end CHARACTERISTIC
/begin CHARACTERISTIC CcCTD_MnPosContactorWeldFaultFIC_n "" VALUE 0x70020bf1 Scalar_BYTE 0 VBU0513_CM_int8_cnt -128.0 127.0 /end CHARACTERISTIC
/begin CHARACTERISTIC CcCTD_MnPosContactorWeldFaultPIC_n "" VALUE 0x70020bf2 Scalar_BYTE 0 VBU0513_CM_int8_cnt -128.0 127.0 /end CHARACTERISTIC
/begin CHARACTERISTIC CcCTD_PrechargeRelayStuckOpenFaultFIC_n "" VALUE 0x70020bf5 Scalar_BYTE 0 VBU0513_CM_int8_cnt -128.0 127.0 /end CHARACTERISTIC
/begin CHARACTERISTIC CcCTD_PrechargeRelayStuckOpenFaultPIC_n "" VALUE 0x70020bf6 Scalar_BYTE 0 VBU0513_CM_int8_cnt -128.0 127.0 /end CHARACTERISTIC
/begin CHARACTERISTIC CcCTD_PrechargeTimeoutFaultFIC_n "" VALUE 0x70020bf9 Scalar_BYTE 0 VBU0513_CM_int8_cnt -128.0 127.0 /end CHARACTERISTIC
/begin CHARACTERISTIC CcCTD_PrechargeTimeoutFaultPIC_n "" VALUE 0x70020bfa Scalar_BYTE 0 VBU0513_CM_int8_cnt -128.0 127.0 /end CHARACTERISTIC
/begin CHARACTERISTIC CcCTM_CellThermalRunawayFaultFIC_n "" VALUE 0x70020c0d Scalar_BYTE 0 VBU0513_CM_int8_cnt -128.0 127.0 /end CHARACTERISTIC
/begin CHARACTERISTIC CcCTM_CellThermalRunawayFaultPIC_n "" VALUE 0x70020c0e Scalar_BYTE 0 VBU0513_CM_int8_cnt -128.0 127.0 /end CHARACTERISTIC
/begin CHARACTERISTIC CcCTM_ThermalRunawayFaultFIC_n "" VALUE 0x70020c11 Scalar_BYTE 0 VBU0513_CM_int8_cnt -128.0 127.0 /end CHARACTERISTIC
/begin CHARACTERISTIC CcCTM_ThermalRunawayFaultPIC_n "" VALUE 0x70020c12 Scalar_BYTE 0 VBU0513_CM_int8_cnt -128.0 127.0 /end CHARACTERISTIC
/begin CHARACTERISTIC CcCVT_BdmCellOverVoltageFaultFIC_n "" VALUE 0x70020c1b Scalar_BYTE 0 VBU0513_CM_int8_n -128.0 127.0 /end CHARACTERISTIC
/begin CHARACTERISTIC CcCVT_BdmCellOverVoltageFaultPIC_n "" VALUE 0x70020c1c Scalar_BYTE 0 VBU0513_CM_int8_n -128.0 127.0 /end CHARACTERISTIC
/begin CHARACTERISTIC CcCVT_BdmCellUnderVoltageFaultFIC_n "" VALUE 0x70020c1d Scalar_BYTE 0 VBU0513_CM_int8_n -128.0 127.0 /end CHARACTERISTIC
/begin CHARACTERISTIC CcCVT_BdmCellUnderVoltageFaultPIC_n "" VALUE 0x70020c1e Scalar_BYTE 0 VBU0513_CM_int8_n -128.0 127.0 /end CHARACTERISTIC
/begin CHARACTERISTIC CcCVT_BdmCellVoltageOverDeviationFaultFIC_n "" VALUE 0x70020c1f Scalar_BYTE 0 VBU0513_CM_int8_n -128.0 127.0 /end CHARACTERISTIC
/begin CHARACTERISTIC CcCVT_BdmCellVoltageOverDeviationFaultPIC_n "" VALUE 0x70020c20 Scalar_BYTE 0 VBU0513_CM_int8_n -128.0 127.0 /end CHARACTERISTIC
/begin CHARACTERISTIC CcFDC_MaxCount_n "" VALUE 0x70020c32 Scalar_BYTE 0 VBU0513_CM_int8_cnt -128.0 127.0 /end CHARACTERISTIC
/begin CHARACTERISTIC CcFDC_MinCount_n "" VALUE 0x70020c33 Scalar_BYTE 0 VBU0513_CM_int8_cnt -128.0 127.0 /end CHARACTERISTIC
/begin CHARACTERISTIC BCV_BATTERY_BUS_VOLTAGE_MISMATCH_FAULT "" VALUE 0x70020a24 Scalar_UBYTE 0 VBU0513_CM_uint8_cnt 0.0 255.0 /end CHARACTERISTIC
/begin CHARACTERISTIC BCV_BATTERY_OVER_CURRENT_WARNING_FAULT "" VALUE 0x70020a25 Scalar_UBYTE 0 VBU0513_CM_uint8_cnt 0.0 255.0 /end CHARACTERISTIC
/begin CHARACTERISTIC BCV_BATTERY_UNDER_VOLTAGEEVM_FAULT "" VALUE 0x70020a26 Scalar_UBYTE 0 VBU0513_CM_uint8_cnt 0.0 255.0 /end CHARACTERISTIC
/begin CHARACTERISTIC BCV_BATTERY_UNDER_VOLTAGE_FAULT "" VALUE 0x70020a27 Scalar_UBYTE 0 VBU0513_CM_uint8_cnt 0.0 255.0 /end CHARACTERISTIC
/begin CHARACTERISTIC BCV_BATTERY_VOLTAGE_SENSE_OOR_FAULT "" VALUE 0x70020a28 Scalar_UBYTE 0 VBU0513_CM_uint8_cnt 0.0 255.0 /end CHARACTERISTIC
/begin CHARACTERISTIC BCV_LEM_CURRENT_SENSE_OOR_FAULT "" VALUE 0x70020a29 Scalar_UBYTE 0 VBU0513_CM_uint8_cnt 0.0 255.0 /end CHARACTERISTIC
/begin CHARACTERISTIC BMM_STATE_POWER_SWAP "" VALUE 0x70020a32 Scalar_UBYTE 0 VBU0513_CM_uint8_cnt 0.0 255.0 /end CHARACTERISTIC
/begin CHARACTERISTIC BPD_stBrkPedPrsNoActv_C "" VALUE 0x70020a41 Scalar_UBYTE 0 VBU0513_CM_uint8_cnt 0.0 15.0 /end CHARACTERISTIC
/begin CHARACTERISTIC BPD_stBrkSwtOverrideVal_C "" VALUE 0x70020a44 Scalar_UBYTE 0 VBU0513_CM_uint8_cnt 0.0 15.0 /end CHARACTERISTIC
/begin CHARACTERISTIC CTD_PRECHARGE_STATUS_CHARGING "" VALUE 0x70020a8b Scalar_UBYTE 0 VBU0513_CM_uint8_cnt 0.0 255.0 /end CHARACTERISTIC
/begin CHARACTERISTIC CaFCC_CurrentLimitRemainChargeTimeSocTempMapDimension_n "" VAL_BLK 0x70020f30 Scalar_UBYTE 0 VBU0513_CM_uint8_cnt 0.0 255.0 NUMBER 2 /end CHARACTERISTIC
/begin CHARACTERISTIC CaFCC_IdealRemainChargeTimeSocTempMapDimension_n "" VAL_BLK 0x70020f3a Scalar_UBYTE 0 VBU0513_CM_uint8_cnt 0.0 255.0 NUMBER 2 /end CHARACTERISTIC
/begin CHARACTERISTIC CaOCV_QuasiOCVCurrentDimension_n "" VAL_BLK 0x70020f3e Scalar_UBYTE 0 VBU0513_CM_uint8_cnt 0.0 255.0 NUMBER 2 /end CHARACTERISTIC
/begin CHARACTERISTIC CbCTM_CellThermalRunawayEnable_flg "" VALUE 0x70020aeb Scalar_UBYTE 0 VBU0513_CM_uint8_cnt 0.0 255.0 /end CHARACTERISTIC
/begin CHARACTERISTIC CbCTM_ThermalRunawayTestFailORF_flg "" VALUE 0x70020aed Scalar_UBYTE 0 VBU0513_CM_uint8_cnt 0.0 255.0 /end CHARACTERISTIC
/begin CHARACTERISTIC CbCTM_ThermalRunawayTestFailORV_flg "" VALUE 0x70020aee Scalar_UBYTE 0 VBU0513_CM_uint8_cnt 0.0 255.0 /end CHARACTERISTIC
/begin CHARACTERISTIC CbCTS_CellDataInvalidSerialCheckEnable_flg "" VALUE 0x70020aef Scalar_UBYTE 0 VBU0513_CM_uint8_cnt 0.0 255.0 /end CHARACTERISTIC
/begin CHARACTERISTIC CbCTS_ContactorComandBypassBMUModeEnable_flg "" VALUE 0x70020af0 Scalar_UBYTE 0 VBU0513_CM_uint8_cnt 0.0 255.0 /end CHARACTERISTIC
/begin CHARACTERISTIC CbCTS_EnergyProtectEnable_flg "" VALUE 0x70020af1 Scalar_UBYTE 0 VBU0513_CM_uint8_cnt 0.0 255.0 /end CHARACTERISTIC
/begin CHARACTERISTIC CbCTS_SocInitialInhibitEnable_flg "" VALUE 0x70020af3 Scalar_UBYTE 0 VBU0513_CM_uint8_cnt 0.0 255.0 /end CHARACTERISTIC
/begin CHARACTERISTIC CcCTD_MnCntcStuckOpenVhclSpdThreshold_kmh "" VALUE 0x70020bea Scalar_UBYTE 0 VBU0513_CM_uint8_cnt 0.0 255.0 /end CHARACTERISTIC
/begin CHARACTERISTIC CcCTS_BatteryDisplaySocLimit_pct "" VALUE 0x70020c13 Scalar_UBYTE 0 VBU0513_CM_uint8_cnt 0.0 255.0 /end CHARACTERISTIC
/begin CHARACTERISTIC CcCTS_SocMinLimit_pct "" VALUE 0x70020c1a Scalar_UBYTE 0 VBU0513_CM_uint8_cnt 0.0 255.0 /end CHARACTERISTIC
/begin CHARACTERISTIC CcSYS_NoOfInvalidCellVoltages_n "" VALUE 0x70020c56 Scalar_UBYTE 0 VBU0513_CM_uint8_cnt 0.0 255.0 /end CHARACTERISTIC
/begin CHARACTERISTIC CmDSM_MILFaultCat_enum "" VALUE 0x70020ca1 Scalar_UBYTE 0 VBU0513_CM_uint8_cnt 0.0 255.0 /end CHARACTERISTIC
/begin CHARACTERISTIC CmFCC_NoChargeCellTempHigh_enum "" VALUE 0x70020ca2 Scalar_UBYTE 0 VBU0513_CM_uint8_cnt 0.0 255.0 /end CHARACTERISTIC
/begin CHARACTERISTIC CmFCC_NoChargeCellTempLow_enum "" VALUE 0x70020ca3 Scalar_UBYTE 0 VBU0513_CM_uint8_cnt 0.0 255.0 /end CHARACTERISTIC
/begin CHARACTERISTIC CmFCC_NoChargeFaultCat_enum "" VALUE 0x70020ca4 Scalar_UBYTE 0 VBU0513_CM_uint8_cnt 0.0 255.0 /end CHARACTERISTIC
/begin CHARACTERISTIC CmFCC_NoChargeFault_enum "" VALUE 0x70020ca5 Scalar_UBYTE 0 VBU0513_CM_uint8_cnt 0.0 255.0 /end CHARACTERISTIC
/begin CHARACTERISTIC CmFCC_NoChargeVoltageHigh_enum "" VALUE 0x70020ca6 Scalar_UBYTE 0 VBU0513_CM_uint8_cnt 0.0 255.0 /end CHARACTERISTIC
/begin CHARACTERISTIC CmSYS_BatteryPowerOffFaultCat_enum "" VALUE 0x70020ca7 Scalar_UBYTE 0 VBU0513_CM_uint8_cnt 0.0 255.0 /end CHARACTERISTIC
/begin CHARACTERISTIC DIAGNOSTIC_ON_GOING "" VALUE 0x70020d99 Scalar_UBYTE 0 VBU0513_CM_uint8_cnt 0.0 255.0 /end CHARACTERISTIC
/begin CHARACTERISTIC DIAGS_stNRCFail_SY "" VALUE 0x70020d9a Scalar_UBYTE 0 VBU0513_CM_uint8_cnt 0.0 255.0 /end CHARACTERISTIC
/begin CHARACTERISTIC DIAGS_stPsvRespIn_SY "" VALUE 0x70020d9c Scalar_UBYTE 0 VBU0513_CM_uint8_cnt 0.0 255.0 /end CHARACTERISTIC
/begin CHARACTERISTIC DIAGS_stPsvRespNok_SY "" VALUE 0x70020d9d Scalar_UBYTE 0 VBU0513_CM_uint8_cnt 0.0 255.0 /end CHARACTERISTIC
/begin CHARACTERISTIC DIAGS_stPsvRespOk_SY "" VALUE 0x70020d9e Scalar_UBYTE 0 VBU0513_CM_uint8_cnt 0.0 255.0 /end CHARACTERISTIC
/begin CHARACTERISTIC FAULT_CAT_NONE "" VALUE 0x70020dc5 Scalar_UBYTE 0 VBU0513_CM_uint8_cnt 0.0 255.0 /end CHARACTERISTIC
/begin CHARACTERISTIC PMM_stDiaPEUActvDisCh_SY "" VALUE 0x70020ea1 Scalar_UBYTE 0 VBU0513_CM_uint8_cnt 0.0 255.0 /end CHARACTERISTIC
/begin CHARACTERISTIC PMM_stDiaPreChRlyClsd_SY "" VALUE 0x70020ea2 Scalar_UBYTE 0 VBU0513_CM_uint8_cnt 0.0 255.0 /end CHARACTERISTIC
/begin CHARACTERISTIC PMM_stDiaRlyOpn_SY "" VALUE 0x70020ea3 Scalar_UBYTE 0 VBU0513_CM_uint8_cnt 0.0 255.0 /end CHARACTERISTIC
/begin CHARACTERISTIC PMM_stDrvMode_SY "" VALUE 0x70020ea4 Scalar_UBYTE 0 VBU0513_CM_uint8_cnt 0.0 255.0 /end CHARACTERISTIC
/begin CHARACTERISTIC PMM_stHVRlyReqOvrdVal_C "" VALUE 0x70020eae Scalar_UBYTE 0 VBU0513_CM_uint8_cnt 0.0 15.0 /end CHARACTERISTIC
/begin CHARACTERISTIC PMM_stImmoPass_SY "" VALUE 0x70020eaf Scalar_UBYTE 0 VBU0513_CM_uint8_cnt 0.0 255.0 /end CHARACTERISTIC
/begin CHARACTERISTIC PMM_stNoReqMode_SY "" VALUE 0x70020eb3 Scalar_UBYTE 0 VBU0513_CM_uint8_cnt 0.0 255.0 /end CHARACTERISTIC
/begin CHARACTERISTIC PMM_stPEUInvrOff_SY "" VALUE 0x70020eb4 Scalar_UBYTE 0 VBU0513_CM_uint8_cnt 0.0 255.0 /end CHARACTERISTIC
/begin CHARACTERISTIC PMM_stPEUOpStandbyMod_SY "" VALUE 0x70020eb5 Scalar_UBYTE 0 VBU0513_CM_uint8_cnt 0.0 255.0 /end CHARACTERISTIC
/begin CHARACTERISTIC PMM_stPEUOpTorMod_SY "" VALUE 0x70020eb6 Scalar_UBYTE 0 VBU0513_CM_uint8_cnt 0.0 255.0 /end CHARACTERISTIC
/begin CHARACTERISTIC PMM_stPEUROpModOvrdSwt_C "" VALUE 0x70020eb7 Scalar_UBYTE 0 VBU0513_CM_uint8_cnt 0.0 15.0 /end CHARACTERISTIC
/begin CHARACTERISTIC PMM_stPEUROpModOvrdVal_C "" VALUE 0x70020eb8 Scalar_UBYTE 0 VBU0513_CM_uint8_cnt 0.0 15.0 /end CHARACTERISTIC
/begin CHARACTERISTIC PMM_stWkupModOvrdVal_C "" VALUE 0x70020ebb Scalar_UBYTE 0 VBU0513_CM_uint8_cnt 0.0 15.0 /end CHARACTERISTIC
/begin CHARACTERISTIC PMM_trqMaxPEUStandBy_C "" VALUE 0x70020ebc Scalar_UBYTE 0 VBU0513_CM_uint8_cnt 0.0 255.0 /end CHARACTERISTIC
/begin CHARACTERISTIC SYS_stMCUDisChMalFunc_SY "" VALUE 0x70020ed8 Scalar_UBYTE 0 VBU0513_CM_uint8_cnt 0.0 255.0 /end CHARACTERISTIC
/begin CHARACTERISTIC TQC_stCurrentGearD_C "" VALUE 0x70020ef5 Scalar_UBYTE 0 VBU0513_CM_uint8_cnt 0.0 15.0 /end CHARACTERISTIC
/begin CHARACTERISTIC TQC_stDGear_C "" VALUE 0x70020ef6 Scalar_UBYTE 0 VBU0513_CM_uint8_cnt 0.0 15.0 /end CHARACTERISTIC
/begin CHARACTERISTIC VM_stVehLimExtSpd_C "" VALUE 0x70020f16 Scalar_UBYTE 0 VBU0513_CM_uint8_cnt 0.0 15.0 /end CHARACTERISTIC
/begin CHARACTERISTIC VM_stVehLimMaxSpdD_C "" VALUE 0x70020f17 Scalar_UBYTE 0 VBU0513_CM_uint8_cnt 0.0 15.0 /end CHARACTERISTIC
/begin CHARACTERISTIC VM_stVehLimMaxSpdR_C "" VALUE 0x70020f18 Scalar_UBYTE 0 VBU0513_CM_uint8_cnt 0.0 15.0 /end CHARACTERISTIC
/begin CHARACTERISTIC VM_stVehLimServerGearD_C "" VALUE 0x70020f19 Scalar_UBYTE 0 VBU0513_CM_uint8_cnt 0.0 15.0 /end CHARACTERISTIC
/begin CHARACTERISTIC VM_stVehLimServerGearR_C "" VALUE 0x70020f1a Scalar_UBYTE 0 VBU0513_CM_uint8_cnt 0.0 15.0 /end CHARACTERISTIC
/begin MEASUREMENT CTD_tisPrechargeLockoutTime "" ULONG VBU0513_CM_uint32 0 0 0 4294967295 ECU_ADDRESS 0x90002282 /end MEASUREMENT
/begin MEASUREMENT CTD_tiLastPrechargeStartTime "" ULONG VBU0513_CM_uint32 0 0 0 4294967295 ECU_ADDRESS 0x9000227e /end MEASUREMENT
/begin MEASUREMENT EcBCV_nbrFuseProtectCounter3r "" ULONG VBU0513_CM_uint32 0 0 0 4294967295 ECU_ADDRESS 0x9000240a /end MEASUREMENT
/begin MEASUREMENT THM_tCoolTar "" FLOAT32_IEEE VBU0513_CM_single 0 0 -3.4E+38 3.4E+38 ECU_ADDRESS 0x90002016 /end MEASUREMENT
/begin MEASUREMENT THM_tHeatTar "" FLOAT32_IEEE VBU0513_CM_single 0 0 -3.4E+38 3.4E+38 ECU_ADDRESS 0x9000201a /end MEASUREMENT
/begin MEASUREMENT THM_pctRearPumpReq "" FLOAT32_IEEE VBU0513_CM_single 0 0 -3.4E+38 3.4E+38 ECU_ADDRESS 0x90002012 /end MEASUREMENT
/begin MEASUREMENT THM_pctRearPmpCmdRaw "" FLOAT32_IEEE VBU0513_CM_single 0 0 -3.4E+38 3.4E+38 ECU_ADDRESS 0x9000200e /end MEASUREMENT
/begin MEASUREMENT THM_nACSpdSet "" FLOAT32_IEEE VBU0513_CM_single 0 0 -3.4E+38 3.4E+38 ECU_ADDRESS 0x900024fe /end MEASUREMENT
/begin MEASUREMENT THM_pctESSPumpReq "" FLOAT32_IEEE VBU0513_CM_single 0 0 -3.4E+38 3.4E+38 ECU_ADDRESS 0x90002002 /end MEASUREMENT
/begin MEASUREMENT THM_pctESSPmpCmdRaw "" FLOAT32_IEEE VBU0513_CM_single 0 0 -3.4E+38 3.4E+38 ECU_ADDRESS 0x90001ffe /end MEASUREMENT
/begin MEASUREMENT SPD_vVehSpdSlp "" FLOAT32_IEEE VBU0513_CM_single 0 0 -3.4E+38 3.4E+38 ECU_ADDRESS 0x90001ffa /end MEASUREMENT
/begin MEASUREMENT SPD_nFA "" FLOAT32_IEEE VBU0513_CM_single 0 0 -3.4E+38 3.4E+38 ECU_ADDRESS 0x90001fd6 /end MEASUREMENT
/begin MEASUREMENT SPD_nRA "" FLOAT32_IEEE VBU0513_CM_single 0 0 -3.4E+38 3.4E+38 ECU_ADDRESS 0x90001fde /end MEASUREMENT
/begin MEASUREMENT SPD_nFARADelta "" FLOAT32_IEEE VBU0513_CM_single 0 0 -3.4E+38 3.4E+38 ECU_ADDRESS 0x90001fda /end MEASUREMENT
/begin MEASUREMENT SPD_nDSpdTarFR "" FLOAT32_IEEE VBU0513_CM_single 0 0 -3.4E+38 3.4E+38 ECU_ADDRESS 0x90001fce /end MEASUREMENT
/begin MEASUREMENT SPD_nDeltaRALR "" FLOAT32_IEEE VBU0513_CM_single 0 0 -3.4E+38 3.4E+38 ECU_ADDRESS 0x90001fd2 /end MEASUREMENT
/begin MEASUREMENT TQC_trqLIM "" FLOAT32_IEEE VBU0513_CM_single 0 0 -10000.0 10000.0 ECU_ADDRESS 0x900021ae /end MEASUREMENT
/begin MEASUREMENT MTQL_trqRMotrMaxLim "" FLOAT32_IEEE VBU0513_CM_single 0 0 -10000.0 10000.0 ECU_ADDRESS 0x90002192 /end MEASUREMENT
/begin MEASUREMENT MTQL_trqRMotrMinLim "" FLOAT32_IEEE VBU0513_CM_single 0 0 -10000.0 10000.0 ECU_ADDRESS 0x90002196 /end MEASUREMENT
/begin MEASUREMENT MTQL_trqMtrDrvLimRaw "" FLOAT32_IEEE VBU0513_CM_single 0 0 -3.4E+38 3.4E+38 ECU_ADDRESS 0x90002456 /end MEASUREMENT
/begin MEASUREMENT MTQL_trqMtrRgnLimRaw "" FLOAT32_IEEE VBU0513_CM_single 0 0 -3.4E+38 3.4E+38 ECU_ADDRESS 0x9000245a /end MEASUREMENT
/begin MEASUREMENT MTQL_trqMtrDrvLim "" FLOAT32_IEEE VBU0513_CM_single 0 0 -3.4E+38 3.4E+38 ECU_ADDRESS 0x90001f02 /end MEASUREMENT
/begin MEASUREMENT MTQL_trqMtrRgnLim "" FLOAT32_IEEE VBU0513_CM_single 0 0 -3.4E+38 3.4E+38 ECU_ADDRESS 0x90001f06 /end MEASUREMENT
/begin MEASUREMENT MTQL_trqMtrTrqDrvLT "" FLOAT32_IEEE VBU0513_CM_single 0 0 -3.4E+38 3.4E+38 ECU_ADDRESS 0x90001f0a /end MEASUREMENT
/begin MEASUREMENT TQD_pctAccPedPosFlt "" FLOAT32_IEEE VBU0513_CM_single 0 0 0.0 100.0 ECU_ADDRESS 0x900021c2 /end MEASUREMENT
/begin MEASUREMENT TQD_trqRoad "" FLOAT32_IEEE VBU0513_CM_single 0 0 -10000.0 10000.0 ECU_ADDRESS 0x900021ea /end MEASUREMENT
/begin MEASUREMENT TQD_trqDesWeighted "" FLOAT32_IEEE VBU0513_CM_single 0 0 -10000.0 10000.0 ECU_ADDRESS 0x900021de /end MEASUREMENT
/begin MEASUREMENT TQD_trqDesDecel "" FLOAT32_IEEE VBU0513_CM_single 0 0 -10000.0 10000.0 ECU_ADDRESS 0x900021d6 /end MEASUREMENT
/begin MEASUREMENT TQD_trqDemRegen "" FLOAT32_IEEE VBU0513_CM_single 0 0 -10000.0 10000.0 ECU_ADDRESS 0x900021d2 /end MEASUREMENT
/begin MEASUREMENT TQD_trqNrmDes "" FLOAT32_IEEE VBU0513_CM_single 0 0 -10000.0 10000.0 ECU_ADDRESS 0x900021e6 /end MEASUREMENT
/begin MEASUREMENT TQD_facDesTrqGr "" FLOAT32_IEEE VBU0513_CM_single 0 0 0.0 1.0 ECU_ADDRESS 0x900021ba /end MEASUREMENT
/begin MEASUREMENT TQD_trqDesRaw "" FLOAT32_IEEE VBU0513_CM_single 0 0 -10000.0 10000.0 ECU_ADDRESS 0x900021da /end MEASUREMENT
/begin MEASUREMENT TQD_trqZrPed "" FLOAT32_IEEE VBU0513_CM_single 0 0 -3.4E+38 3.4E+38 ECU_ADDRESS 0x900020be /end MEASUREMENT
/begin MEASUREMENT TQD_trqNrmLead "" FLOAT32_IEEE VBU0513_CM_single 0 0 -3.4E+38 3.4E+38 ECU_ADDRESS 0x900020ba /end MEASUREMENT
/begin MEASUREMENT SPD_aXSlope "" FLOAT32_IEEE VBU0513_CM_single 0 0 -3.4E+38 3.4E+38 ECU_ADDRESS 0x90001fca /end MEASUREMENT
/begin MEASUREMENT EDIS_pwrAcsyAct "" FLOAT32_IEEE VBU0513_CM_single 0 0 0.0 1000.0 ECU_ADDRESS 0x9000210e /end MEASUREMENT
/begin MEASUREMENT CBL_tCTMBoardTempMaxORV "" FLOAT32_IEEE VBU0513_CM_single 0 0 -3.4E+38 3.4E+38 ECU_ADDRESS 0x900023ee /end MEASUREMENT
/begin MEASUREMENT LcSOH_AhMinSocCellCapacity "" FLOAT32_IEEE VBU0513_CM_single 0 0 -3.4E+38 3.4E+38 ECU_ADDRESS 0x900022ee /end MEASUREMENT
/begin MEASUREMENT CBL_pctBalanceTargeSoc "" FLOAT32_IEEE VBU0513_CM_single 0 0 -3.4E+38 3.4E+38 ECU_ADDRESS 0x9000223a /end MEASUREMENT
/begin MEASUREMENT SOC_iAModuleCurrent "" FLOAT32_IEEE VBU0513_CM_single 0 0 -3.4E+38 3.4E+38 ECU_ADDRESS 0x9000246e /end MEASUREMENT
/begin MEASUREMENT LaSOC_pctCellSocCurrentIntegral "" FLOAT32_IEEE VBU0513_CM_single 0 0 0.0 100.0 ARRAY_SIZE 198 ECU_ADDRESS 0x6003b6ae /end MEASUREMENT
/begin MEASUREMENT FCC_iABaseChargeCurrentRequest "" FLOAT32_IEEE VBU0513_CM_single 0 0 -3.4E+38 3.4E+38 ECU_ADDRESS 0x9000240e /end MEASUREMENT
/begin MEASUREMENT FCC_uBaseChargeVoltageRequest "" FLOAT32_IEEE VBU0513_CM_single 0 0 -3.4E+38 3.4E+38 ECU_ADDRESS 0x9000243e /end MEASUREMENT
/begin MEASUREMENT FCC_kwBaseChargePowerRequest "" FLOAT32_IEEE VBU0513_CM_single 0 0 0.0 10000.0 ECU_ADDRESS 0x90001ee2 /end MEASUREMENT
/begin MEASUREMENT FCC_iAChargeRequestCurrentLimit "" FLOAT32_IEEE VBU0513_CM_single 0 0 -3.4E+38 3.4E+38 ECU_ADDRESS 0x9000241a /end MEASUREMENT
/begin MEASUREMENT FCC_iAChargeCurrentRequestFnl "" FLOAT32_IEEE VBU0513_CM_single 0 0 -3.4E+38 3.4E+38 ECU_ADDRESS 0x90002416 /end MEASUREMENT
/begin MEASUREMENT FCC_timinFastChargeBaseRemainTime "" FLOAT32_IEEE VBU0513_CM_single 0 0 -3.4E+38 3.4E+38 ECU_ADDRESS 0x9000243a /end MEASUREMENT
/begin MEASUREMENT LcFCC_timinEstimatePercTime "" FLOAT32_IEEE VBU0513_CM_single 0 0 -3.4E+38 3.4E+38 ECU_ADDRESS 0x90001efa /end MEASUREMENT
/begin MEASUREMENT CTD_pctBusOfBatteryVoltage "" FLOAT32_IEEE VBU0513_CM_single 0 0 -3.4E+38 3.4E+38 ECU_ADDRESS 0x9000226a /end MEASUREMENT
/begin MEASUREMENT LcSOC_AhLifeTimeCoulomb "" FLOAT32_IEEE VBU0513_CM_single 0 0 -3.4E+38 3.4E+38 ECU_ADDRESS 0x900022ea /end MEASUREMENT
/begin MEASUREMENT BCV_AhLifeTimeCharge "" FLOAT32_IEEE VBU0513_CM_single 0 0 -3.4E+38 3.4E+38 ECU_ADDRESS 0x900020f2 /end MEASUREMENT
/begin MEASUREMENT BCV_AhLifeTimeDischarge "" FLOAT32_IEEE VBU0513_CM_single 0 0 -3.4E+38 3.4E+38 ECU_ADDRESS 0x900020f6 /end MEASUREMENT
/begin MEASUREMENT BCV_AhLifeTimeFastcharge "" FLOAT32_IEEE VBU0513_CM_single 0 0 -3.4E+38 3.4E+38 ECU_ADDRESS 0x900020fa /end MEASUREMENT
/begin MEASUREMENT BCV_uVx2Voltage "" FLOAT32_IEEE VBU0513_CM_single 0 0 -3.4E+38 3.4E+38 ECU_ADDRESS 0x90002262 /end MEASUREMENT
/begin MEASUREMENT BCV_uPrechargeVoltage "" FLOAT32_IEEE VBU0513_CM_single 0 0 -3.4E+38 3.4E+38 ECU_ADDRESS 0x9000225e /end MEASUREMENT
/begin MEASUREMENT BCV_uFuseVoltage "" FLOAT32_IEEE VBU0513_CM_single 0 0 -3.4E+38 3.4E+38 ECU_ADDRESS 0x9000225a /end MEASUREMENT
/begin MEASUREMENT BCV_uBusVoltage "" FLOAT32_IEEE VBU0513_CM_single 0 0 -3.4E+38 3.4E+38 ECU_ADDRESS 0x90002256 /end MEASUREMENT
/begin MEASUREMENT BCV_uBusNegativeVoltage "" FLOAT32_IEEE VBU0513_CM_single 0 0 -3.4E+38 3.4E+38 ECU_ADDRESS 0x90002252 /end MEASUREMENT
/begin MEASUREMENT BCV_uBatteryVoltage "" FLOAT32_IEEE VBU0513_CM_single 0 0 -3.4E+38 3.4E+38 ECU_ADDRESS 0x90001e3a /end MEASUREMENT
/begin MEASUREMENT BCV_iAUpdateBatteryCurrent "" FLOAT32_IEEE VBU0513_CM_single 0 0 -3.4E+38 3.4E+38 ECU_ADDRESS 0x900023da /end MEASUREMENT
/begin MEASUREMENT BCV_iABatteryCurrent "" FLOAT32_IEEE VBU0513_CM_single 0 0 -3.4E+38 3.4E+38 ECU_ADDRESS 0x9000224e /end MEASUREMENT
/begin MEASUREMENT CBL_mvBalanceTargetVoltage "" UWORD VBU0513_CM_uint16 0 0 0 65535 ECU_ADDRESS 0x90003770 /end MEASUREMENT
/begin MEASUREMENT CTD_stPrechargeRelayStuckOpenFault "" UWORD VBU0513_CM_uint16 0 0 0 65535 ECU_ADDRESS 0x900039b4 /end MEASUREMENT
/begin MEASUREMENT CTD_stPrechargeTimeoutFault "" UWORD VBU0513_CM_uint16 0 0 0 65535 ECU_ADDRESS 0x900039b6 /end MEASUREMENT
/begin MEASUREMENT CTD_timsPrechargeTimer "" UWORD VBU0513_CM_uint16 0 0 0 65535 ECU_ADDRESS 0x900037a2 /end MEASUREMENT
/begin MEASUREMENT CTD_stMnPosContactorWeldFault "" UWORD VBU0513_CM_uint16 0 0 0 65535 ECU_ADDRESS 0x9000379e /end MEASUREMENT
/begin MEASUREMENT BCV_stBatteryOverVoltageFault "" UWORD VBU0513_CM_uint16 0 0 0 65535 ECU_ADDRESS 0x900039c4 /end MEASUREMENT
/begin MEASUREMENT BCV_stBatteryUnderVoltageFault "" UWORD VBU0513_CM_uint16 0 0 0 65535 ECU_ADDRESS 0x900039ca /end MEASUREMENT
/begin MEASUREMENT BCV_stBatteryOverCurrentFault "" UWORD VBU0513_CM_uint16 0 0 0 65535 ECU_ADDRESS 0x900039be /end MEASUREMENT
/begin MEASUREMENT BCV_stBatteryOverVoltageEVMFault "" UWORD VBU0513_CM_uint16 0 0 0 65535 ECU_ADDRESS 0x900039c2 /end MEASUREMENT
/begin MEASUREMENT BCV_stBatteryUnderVoltageEVMFault "" UWORD VBU0513_CM_uint16 0 0 0 65535 ECU_ADDRESS 0x900039c8 /end MEASUREMENT
/begin MEASUREMENT BCV_stBatteryOverVoltageWarningFault "" UWORD VBU0513_CM_uint16 0 0 0 65535 ECU_ADDRESS 0x900039c6 /end MEASUREMENT
/begin MEASUREMENT BCV_stBatteryOverCurrentWarningFault "" UWORD VBU0513_CM_uint16 0 0 0 65535 ECU_ADDRESS 0x900039c0 /end MEASUREMENT
/begin MEASUREMENT BCV_stBatteryBusVoltageMismatchFault "" UWORD VBU0513_CM_uint16 0 0 0 65535 ECU_ADDRESS 0x900039bc /end MEASUREMENT
/begin MEASUREMENT BCV_stBatteryCurrentOoRFault "" UWORD VBU0513_CM_uint16 0 0 0 65535 ECU_ADDRESS 0x900039aa /end MEASUREMENT
/begin MEASUREMENT BCV_stBatteryVoltageOoRFault "" UWORD VBU0513_CM_uint16 0 0 0 65535 ECU_ADDRESS 0x900039cc /end MEASUREMENT
/begin MEASUREMENT THM_stOperateMode "" UBYTE VBU0513_CM_uint8 0 0 0 255 ECU_ADDRESS 0x90004082 /end MEASUREMENT
/begin MEASUREMENT THM_stOperateCycle "" UBYTE VBU0513_CM_uint8 0 0 0 255 ECU_ADDRESS 0x90004081 /end MEASUREMENT
/begin MEASUREMENT FPV_st4WayVlvPosFdbk "" UBYTE VBU0513_CM_uint8 0 0 0 255 ECU_ADDRESS 0x900042a5 /end MEASUREMENT
/begin MEASUREMENT TQD_stVehCreepMode "" UBYTE VBU0513_CM_uint8 0 0 0.0 15.0 ECU_ADDRESS 0x900040b7 /end MEASUREMENT
/begin MEASUREMENT SPD_stAX "" UBYTE VBU0513_CM_uint8 0 0 0.0 15.0 ECU_ADDRESS 0x9000407a /end MEASUREMENT
/begin MEASUREMENT PMM_stHVRlyReq "" UBYTE VBU0513_CM_uint8 0 0 0 255 ECU_ADDRESS 0x90004285 /end MEASUREMENT
/begin MEASUREMENT PMM_stSelfDiagResp "" UBYTE VBU0513_CM_uint8 0 0 0 255 ECU_ADDRESS 0x90004289 /end MEASUREMENT
/begin MEASUREMENT PMM_stWkupMod "" UBYTE VBU0513_CM_uint8 0 0 0.0 255.0 ECU_ADDRESS 0x9000428a /end MEASUREMENT
/begin MEASUREMENT PMM_stPEUROpMod "" UBYTE VBU0513_CM_uint8 0 0 0 255 ECU_ADDRESS 0x90004287 /end MEASUREMENT
/begin MEASUREMENT CBL_numCellBalanceNumber "" UBYTE VBU0513_CM_uint8 0 0 0 255 ECU_ADDRESS 0x9000425d /end MEASUREMENT
/begin MEASUREMENT FCC_stNoChargeCause "" UBYTE VBU0513_CM_uint8 0 0 0 255 ECU_ADDRESS 0x900042a4 /end MEASUREMENT
/begin MEASUREMENT DSM_stFaultCat "" UBYTE VBU0513_CM_uint8 0 0 0 255 ECU_ADDRESS 0x90004028 /end MEASUREMENT
/begin MEASUREMENT CTD_stPrechargeStatus "" UBYTE VBU0513_CM_uint8 0 0 0 255 ECU_ADDRESS 0x9000410f /end MEASUREMENT
/begin MEASUREMENT CTD_stPrechargeRelayBlownDiagnosticStatus "" UBYTE VBU0513_CM_uint8 0 0 0 255 ECU_ADDRESS 0x9000410d /end MEASUREMENT
/begin MEASUREMENT CTD_stMainFuseBlownDiagnosticStatus "" UBYTE VBU0513_CM_uint8 0 0 0 255 ECU_ADDRESS 0x9000410a /end MEASUREMENT
/begin MEASUREMENT THM_flgEXVEna "" UBYTE VBU0513_CM_boolean 0 0 0.0 1.0 ECU_ADDRESS 0x9000407e /end MEASUREMENT
/begin MEASUREMENT Veh_flgVacPumpReq "" UBYTE VBU0513_CM_boolean 0 0 0 1 ECU_ADDRESS 0x900042c1 /end MEASUREMENT
/begin MEASUREMENT BPD_flgBrkSwt "" UBYTE VBU0513_CM_boolean 0 0 0.0 1.0 ECU_ADDRESS 0x90004091 /end MEASUREMENT
/begin MEASUREMENT TQD_flgSlideRst "" UBYTE VBU0513_CM_boolean 0 0 0.0 1.0 ECU_ADDRESS 0x9000408b /end MEASUREMENT
/begin MEASUREMENT TQD_flgVirtualNeutral "" UBYTE VBU0513_CM_boolean 0 0 0.0 1.0 ECU_ADDRESS 0x900040b6 /end MEASUREMENT
/begin MEASUREMENT PMM_flgPEURActvDisChEnaOvrd "" UBYTE VBU0513_CM_boolean 0 0 0 1 ECU_ADDRESS 0x9000427c /end MEASUREMENT
/begin MEASUREMENT PMM_flgSelfDiagEnaOvrd "" UBYTE VBU0513_CM_boolean 0 0 0 1 ECU_ADDRESS 0x9000427f /end MEASUREMENT
/begin MEASUREMENT PMM_flgHVPwrUpEnaOvrd "" UBYTE VBU0513_CM_boolean 0 0 0 1 ECU_ADDRESS 0x90004276 /end MEASUREMENT
/begin MEASUREMENT PMM_flgHVPwrUpEna "" UBYTE VBU0513_CM_boolean 0 0 0 1 ECU_ADDRESS 0x90004275 /end MEASUREMENT
/begin MEASUREMENT PMM_flgHVPwrDwnEnaOvrd "" UBYTE VBU0513_CM_boolean 0 0 0 1 ECU_ADDRESS 0x90004274 /end MEASUREMENT
/begin MEASUREMENT PMM_flgHVPwrDwnEna "" UBYTE VBU0513_CM_boolean 0 0 0 1 ECU_ADDRESS 0x90004273 /end MEASUREMENT
/begin MEASUREMENT PMM_flgRMCUActvDisChReq "" UBYTE VBU0513_CM_boolean 0 0 0 1 ECU_ADDRESS 0x9000427e /end MEASUREMENT
/begin MEASUREMENT PMM_flgAccDisbl "" UBYTE VBU0513_CM_boolean 0 0 0.0 1.0 ECU_ADDRESS 0x90004063 /end MEASUREMENT
/begin MEASUREMENT PMM_flgSetPEURRdy "" UBYTE VBU0513_CM_boolean 0 0 0 1 ECU_ADDRESS 0x90004280 /end MEASUREMENT
/begin MEASUREMENT PMM_flgPEURShtDwn "" UBYTE VBU0513_CM_boolean 0 0 0 1 ECU_ADDRESS 0x9000427d /end MEASUREMENT
/begin MEASUREMENT PMM_flgVehRdy "" UBYTE VBU0513_CM_boolean 0 0 0 1 ECU_ADDRESS 0x90004283 /end MEASUREMENT
/begin MEASUREMENT PMM_flgHVRdy "" UBYTE VBU0513_CM_boolean 0 0 0.0 1.0 ECU_ADDRESS 0x90004064 /end MEASUREMENT
/begin MEASUREMENT LbCBL_flgBalanceEnableCondition "" UBYTE VBU0513_CM_boolean 0 0 0 1 ECU_ADDRESS 0x90004171 /end MEASUREMENT
/begin MEASUREMENT CBL_flgVoltageBalanceEnable "" UBYTE VBU0513_CM_boolean 0 0 0 1 ECU_ADDRESS 0x90004296 /end MEASUREMENT
/begin MEASUREMENT CBL_flgSocBalanceEnable "" UBYTE VBU0513_CM_boolean 0 0 0 1 ECU_ADDRESS 0x90004295 /end MEASUREMENT
/begin MEASUREMENT CBL_flgCTMBoardTempValidORV "" UBYTE VBU0513_CM_boolean 0 0 0 1 ECU_ADDRESS 0x90004294 /end MEASUREMENT
/begin MEASUREMENT CBL_flgBalanceStatus "" UBYTE VBU0513_CM_boolean 0 0 0 1 ECU_ADDRESS 0x9000425c /end MEASUREMENT
/begin MEASUREMENT SOC_flgRelaxationST "" UBYTE VBU0513_CM_boolean 0 0 0.0 1.0 ECU_ADDRESS 0x9000406c /end MEASUREMENT
/begin MEASUREMENT OCV_flgOcvCriteriaMet "" UBYTE VBU0513_CM_boolean 0 0 0.0 1.0 ECU_ADDRESS 0x9000405c /end MEASUREMENT
/begin MEASUREMENT OCV_flgQuasiOcvCriteria "" UBYTE VBU0513_CM_boolean 0 0 0.0 1.0 ECU_ADDRESS 0x9000405e /end MEASUREMENT
/begin MEASUREMENT FCC_flgChargeProtection "" UBYTE VBU0513_CM_boolean 0 0 0.0 1.0 ECU_ADDRESS 0x90004030 /end MEASUREMENT
/begin MEASUREMENT FCC_flgChargeNoFault "" UBYTE VBU0513_CM_boolean 0 0 0.0 1.0 ECU_ADDRESS 0x90004266 /end MEASUREMENT
/begin MEASUREMENT FCC_flgChargeAvailable "" UBYTE VBU0513_CM_boolean 0 0 0.0 1.0 ECU_ADDRESS 0x9000402e /end MEASUREMENT
/begin MEASUREMENT FCC_flgInvalidEstimatedChargeTime "" UBYTE VBU0513_CM_boolean 0 0 0.0 1.0 ECU_ADDRESS 0x9000403a /end MEASUREMENT
/begin MEASUREMENT LbFCC_flgInvalidEstimatedChargeTimeCFT "" UBYTE VBU0513_CM_boolean 0 0 0 1 ECU_ADDRESS 0x9000426a /end MEASUREMENT
/begin MEASUREMENT FCC_flgPackCurrentUpdatePercTime "" UBYTE VBU0513_CM_boolean 0 0 0 1 ECU_ADDRESS 0x900042a3 /end MEASUREMENT
/begin MEASUREMENT DSM_flgMILRequest "" UBYTE VBU0513_CM_boolean 0 0 0.0 1.0 ECU_ADDRESS 0x90004026 /end MEASUREMENT
/begin MEASUREMENT CTS_CellDataInvalidInhibitPrecharge_flg "" UBYTE VBU0513_CM_boolean 0 0 0 1 ECU_ADDRESS 0x90004110 /end MEASUREMENT
/begin MEASUREMENT CTS_flgEnergyProtectInhibitPrecharge "" UBYTE VBU0513_CM_boolean 0 0 0 1 ECU_ADDRESS 0x9000429d /end MEASUREMENT
/begin MEASUREMENT LbCTS_FaultInhibitPrecharge_flg "" UBYTE VBU0513_CM_boolean 0 0 0 1 ECU_ADDRESS 0x90004175 /end MEASUREMENT
/begin MEASUREMENT LbCTS_FaultAbortPrecharge_flg "" UBYTE VBU0513_CM_boolean 0 0 0 1 ECU_ADDRESS 0x90004269 /end MEASUREMENT
/begin MEASUREMENT CTS_flgHVDataInvalidInhibitPrecharge "" UBYTE VBU0513_CM_boolean 0 0 0 1 ECU_ADDRESS 0x90004115 /end MEASUREMENT
/begin MEASUREMENT LbCTS_HVSafetyStatusInhibitPrecharge_flg "" UBYTE VBU0513_CM_boolean 0 0 0 1 ECU_ADDRESS 0x90004176 /end MEASUREMENT
/begin MEASUREMENT CTS_SocInitialInhibitPrecharge_flg "" UBYTE VBU0513_CM_boolean 0 0 0 1 ECU_ADDRESS 0x90004111 /end MEASUREMENT
/begin MEASUREMENT CTD_flgDisablePrechargeDiagInAbnormalPowerOff "" UBYTE VBU0513_CM_boolean 0 0 0 1 ECU_ADDRESS 0x90004102 /end MEASUREMENT
/begin MEASUREMENT CTD_MnPosContactorWeldTestEnable_flg "" UBYTE VBU0513_CM_boolean 0 0 0 1 ECU_ADDRESS 0x9000429a /end MEASUREMENT
/begin MEASUREMENT LbCTD_MnNegContactorWeldTestFail_flg "" UBYTE VBU0513_CM_boolean 0 0 0 1 ECU_ADDRESS 0x900042ac /end MEASUREMENT
/begin MEASUREMENT BMM_flgWakeupLine "" UBYTE VBU0513_CM_boolean 0 0 0 1 ECU_ADDRESS 0x900040f2 /end MEASUREMENT
/begin MEASUREMENT BCV_flgFuseHealthWarning "" UBYTE VBU0513_CM_boolean 0 0 0 1 ECU_ADDRESS 0x9000425a /end MEASUREMENT
/begin MEASUREMENT SPD_tiStAx "" FLOAT32_IEEE VBU0513_CM_single 0 0 -3.4E+38 3.4E+38 ECU_ADDRESS 0x90001fe6 /end MEASUREMENT
/begin COMPU_METHOD VBU0513_CM_single_C "Q = V" RAT_FUNC "%8.6" "C" COEFFS 0 1 0 0 0 1 /end COMPU_METHOD
/begin COMPU_METHOD VBU0513_CM_single_cnt "Q = V" RAT_FUNC "%8.6" "cnt" COEFFS 0 1 0 0 0 1 /end COMPU_METHOD
/begin COMPU_METHOD VBU0513_CM_single_Nm "Q = V" RAT_FUNC "%8.6" "Nm" COEFFS 0 1 0 0 0 1 /end COMPU_METHOD
/begin COMPU_METHOD VBU0513_CM_single_kph "Q = V" RAT_FUNC "%8.6" "kph" COEFFS 0 1 0 0 0 1 /end COMPU_METHOD
/begin COMPU_METHOD VBU0513_CM_uint16_cnt "Q = V" RAT_FUNC "%5.0" "cnt" COEFFS 0 1 0 0 0 1 /end COMPU_METHOD
/begin COMPU_METHOD VBU0513_CM_single_pct "Q = V" RAT_FUNC "%8.6" "pct" COEFFS 0 1 0 0 0 1 /end COMPU_METHOD
/begin COMPU_METHOD VBU0513_CM_single_A "Q = V" RAT_FUNC "%8.6" "A" COEFFS 0 1 0 0 0 1 /end COMPU_METHOD
/begin COMPU_METHOD VBU0513_CM_uint8 "Q = V" RAT_FUNC "%3.0" "" COEFFS 0 1 0 0 0 1 /end COMPU_METHOD
/begin COMPU_METHOD VBU0513_CM_uint16 "Q = V" RAT_FUNC "%5.0" "" COEFFS 0 1 0 0 0 1 /end COMPU_METHOD
/begin COMPU_METHOD VBU0513_CM_single "Q = V" RAT_FUNC "%8.6" "" COEFFS 0 1 0 0 0 1 /end COMPU_METHOD
/begin COMPU_METHOD VBU0513_CM_single_kg "Q = V" RAT_FUNC "%8.6" "kg" COEFFS 0 1 0 0 0 1 /end COMPU_METHOD
/begin COMPU_METHOD VBU0513_CM_single_m "Q = V" RAT_FUNC "%8.6" "m" COEFFS 0 1 0 0 0 1 /end COMPU_METHOD
/begin COMPU_METHOD VBU0513_CM_uint32_cnt "Q = V" RAT_FUNC "%10.0" "cnt" COEFFS 0 1 0 0 0 1 /end COMPU_METHOD
/begin COMPU_METHOD VBU0513_CM_uint32 "Q = V" RAT_FUNC "%10.0" "" COEFFS 0 1 0 0 0 1 /end COMPU_METHOD
/begin COMPU_METHOD VBU0513_CM_uint16_ms "Q = V" RAT_FUNC "%5.0" "ms" COEFFS 0 1 0 0 0 1 /end COMPU_METHOD
/begin COMPU_METHOD VBU0513_CM_uint16_mV "Q = V" RAT_FUNC "%5.0" "mV" COEFFS 0 1 0 0 0 1 /end COMPU_METHOD
/begin COMPU_METHOD VBU0513_CM_boolean_flg "Q = V" RAT_FUNC "%1.0" "flg" COEFFS 0 1 0 0 0 1 /end COMPU_METHOD
/begin COMPU_METHOD VBU0513_CM_boolean_cnt "Q = V" RAT_FUNC "%1.0" "cnt" COEFFS 0 1 0 0 0 1 /end COMPU_METHOD
/begin COMPU_METHOD VBU0513_CM_boolean "Q = V" RAT_FUNC "%1.0" "" COEFFS 0 1 0 0 0 1 /end COMPU_METHOD
/begin COMPU_METHOD VBU0513_CM_int8_cnt "Q = V" RAT_FUNC "%3.0" "cnt" COEFFS 0 1 0 0 0 1 /end COMPU_METHOD
/begin COMPU_METHOD VBU0513_CM_int8_n "Q = V" RAT_FUNC "%3.0" "n" COEFFS 0 1 0 0 0 1 /end COMPU_METHOD
/begin COMPU_METHOD VBU0513_CM_uint8_cnt "Q = V" RAT_FUNC "%3.0" "cnt" COEFFS 0 1 0 0 0 1 /end COMPU_METHOD
/begin GROUP S3504_Regen_Mode_Power_Calculate "VBU0513/VBUSystem/VCU /EDIS/EDIS_Ctrl/BatDis_Power_Lim_Calc/Regen_Mode_Power_Calculate" /begin REF_CHARACTERISTIC EDIS_pwrChDynSpare_CUR_v /end REF_CHARACTERISTIC /end GROUP
/begin GROUP S3505_charge_power_calculate "VBU0513/VBUSystem/VCU /EDIS/EDIS_Ctrl/battery_power_calculate/charge_power_calculate" /begin SUB_GROUP S3527_BatDis_Regen_Power_PI_Filter S3527_ChPowSetPoint /end SUB_GROUP /end GROUP
/begin GROUP S3505_discharge_power_calculate "VBU0513/VBUSystem/VCU /EDIS/EDIS_Ctrl/battery_power_calculate/discharge_power_calculate" /begin SUB_GROUP S3528_DchPowSetpiont S3528_discharge_pid /end SUB_GROUP /end GROUP
/begin GROUP S3506_accessory_load_power "VBU0513/VBUSystem/VCU /EDIS/EDIS_Ctrl/drive_power_calculate/accessory_load_power" /begin REF_CHARACTERISTIC PTC_PwrMax_C /end REF_CHARACTERISTIC /begin REF_MEASUREMENT EDIS_pwrAcsyAct /end REF_MEASUREMENT /end GROUP
/begin GROUP S3587_DSM_DisableFault "VBU0513/VBUSystem/VCU /LVC/LVC/LVC_DIAG/DSM_DisableFault"
 /begin REF_CHARACTERISTIC LVC_stDiaDCDCStsWrk_SY LVC_tiDcDcPTNodeAbsent_C LVC_tiDiaDCDCActnDly_C LVC_tiSample_SY /end REF_CHARACTERISTIC
/end GROUP
/begin GROUP S3587_DSM_EnableFault "VBU0513/VBUSystem/VCU /LVC/LVC/LVC_DIAG/DSM_EnableFault"
 /begin REF_CHARACTERISTIC LVC_stDiaDCDCStsWrk_SY LVC_tiDiaDCDCActnDly_C LVC_tiDiaDCDCSmpl_SY /end REF_CHARACTERISTIC
/end GROUP
/begin GROUP S3587_DSM_OutputCurrent "VBU0513/VBUSystem/VCU /LVC/LVC/LVC_DIAG/DSM_OutputCurrent"
 /begin REF_CHARACTERISTIC LVC_iDCDCOutCrnt_C LVC_stDiaDCDCStsWrk_SY LVC_tiDCDCOutCurnt_C LVC_tiSample_SY LVC_uDCDCCrntDeltaLe_C LVC_uDCDCCrntDeltaRe_C LVC_uDCDCOutCrntLe_C LVC_uDCDCOutCrntRe_C /end REF_CHARACTERISTIC
/end GROUP
/begin GROUP S3587_DSM_OutputOverVol "VBU0513/VBUSystem/VCU /LVC/LVC/LVC_DIAG/DSM_OutputOverVol"
 /begin REF_CHARACTERISTIC LVC_stDiaDCDCStsWrk_SY LVC_tiDCDCOutVltg_C LVC_tiSample_SY LVC_uDiaDCDCOutOvrVltgThres_C /end REF_CHARACTERISTIC
/end GROUP
/begin GROUP S3587_DSM_OutputUnderVol "VBU0513/VBUSystem/VCU /LVC/LVC/LVC_DIAG/DSM_OutputUnderVol"
 /begin REF_CHARACTERISTIC LVC_iDiaUndrVltgPwrEnough_C LVC_iDiaUndrVltgPwrLack_C LVC_pwrDiaUndrVolHi_C LVC_pwrDiaUndrVolLo_C LVC_stDiaDCDCStsWrk_SY LVC_tiDCDCOutVltg_C LVC_tiSample_SY LVC_uDiaDCDCOutUndrVltgThres_C /end REF_CHARACTERISTIC
/end GROUP
/begin GROUP S3588_LVC_DcdcSpCtl "VBU0513/VBUSystem/VCU /LVC/LVC/LowVoltageBalanceControl/LVC_DcdcSpCtl"
 /begin REF_CHARACTERISTIC LVC_flgIbsSocLowHvRlyOpen_C LVC_tiHvRlyClReq_C LVC_tiIBSStatusErrAndParked_C LVC_tiLvBattVolLow_C LVC_tiSample_SY LVC_uVolLowOnPark_C /end REF_CHARACTERISTIC
/end GROUP
/begin GROUP S3588_LVC_DcdcStCtl "VBU0513/VBUSystem/VCU /LVC/LVC/LowVoltageBalanceControl/LVC_DcdcStCtl" /begin SUB_GROUP S3610_DCDC_Enable S3610_RoutineControl /end SUB_GROUP /end GROUP
/begin GROUP S3632_DVM_PEUShtDwn "VBU0513/VBUSystem/VCU /PMM/PMM_Ctrl/DrvMod_Ctrl/DVM_PEUShtDwn" /begin SUB_GROUP S3636_Turn_On_Delay_Time2 /end SUB_GROUP
 /begin REF_CHARACTERISTIC PMM_flgPEURShtDwnOvrdSwt_C PMM_flgPEURShtDwnOvrdVal_C PMM_stPEUInvrOff_SY PMM_stPEUOpStandbyMod_SY PMM_tiDlyACTst_C PMM_tiDlyPEUShtDwn_C /end REF_CHARACTERISTIC
 /begin REF_MEASUREMENT PMM_flgPEURShtDwn /end REF_MEASUREMENT
/end GROUP
/begin GROUP S3632_DVM_SetRdy "VBU0513/VBUSystem/VCU /PMM/PMM_Ctrl/DrvMod_Ctrl/DVM_SetRdy"
 /begin REF_CHARACTERISTIC PMM_flgHVRdyOvrdSwt_C PMM_flgHVRdyOvrdVal_C PMM_flgVehRdyOvrdSwt_C PMM_stImmoPass_SY SYS_stShftPosDrv_SY SYS_stShftPosRev_SY /end REF_CHARACTERISTIC
 /begin REF_MEASUREMENT PMM_flgHVRdy PMM_flgSetPEURRdy PMM_flgVehRdy /end REF_MEASUREMENT
/end GROUP
/begin GROUP S3632_DVM_VehRdy "VBU0513/VBUSystem/VCU /PMM/PMM_Ctrl/DrvMod_Ctrl/DVM_VehRdy"
 /begin REF_CHARACTERISTIC PMM_flgRMCUZrTrqReqOvrdSwt_C PMM_flgRMCUZrTrqReqOvrdVal_C PMM_stPEUOpStandbyMod_SY PMM_stPEUOpTorMod_SY PMM_stPEUROpModOvrdSwt_C PMM_stPEUROpModOvrdVal_C PMM_tiDlyPEUStandBy_C PMM_trqMaxPEUStandBy_C /end REF_CHARACTERISTIC
 /begin REF_MEASUREMENT PMM_stPEUROpMod /end REF_MEASUREMENT
/end GROUP
/begin GROUP S3633_LvWakeUp_Mode_Calc "VBU0513/VBUSystem/VCU /PMM/PMM_Ctrl/LvWakeUp_Ctrl/LvWakeUp_Mode_Calc"
 /begin REF_CHARACTERISTIC PMM_flgWkupModOvrdSwt_C PMM_stDrvMode_SY PMM_stNoReqMode_SY PMM_stWkupModOvrdVal_C PMM_tiDlySWReset_C /end REF_CHARACTERISTIC
 /begin REF_MEASUREMENT PMM_stWkupMod /end REF_MEASUREMENT
/end GROUP
/begin GROUP S3633_LvWakeUp_State_Calc "VBU0513/VBUSystem/VCU /PMM/PMM_Ctrl/LvWakeUp_Ctrl/LvWakeUp_State_Calc" /begin SUB_GROUP S3647_LVWSrc S3647_Wakeup /end SUB_GROUP /end GROUP
/begin GROUP S3634_ActiveDisChFault "VBU0513/VBUSystem/VCU /PMM/PMM_Ctrl/PMM_DIAG/ActiveDisChFault"
 /begin REF_CHARACTERISTIC PMM_stDiaPEUActvDisCh_SY PMM_tiDiaActvDisChDur_C PMM_uDiaActvDisCh_C /end REF_CHARACTERISTIC
/end GROUP
/begin GROUP S3634_PreChargeCheck "VBU0513/VBUSystem/VCU /PMM/PMM_Ctrl/PMM_DIAG/PreChargeCheck"
 /begin REF_CHARACTERISTIC PMM_stDiaPreChRlyClsd_SY PMM_stDiaRlyOpn_SY PMM_tiDiaPreChDur_C PMM_tiDiaPreChFail_C PMM_tiDlyDiaRlyOp_C PMM_tiMonDlyDiaPreCh_C /end REF_CHARACTERISTIC
/end GROUP
/begin GROUP S3634_UnintendAction "VBU0513/VBUSystem/VCU /PMM/PMM_Ctrl/PMM_DIAG/UnintendAction"
 /begin REF_CHARACTERISTIC PMM_stDiaPreChRlyClsd_SY PMM_stDiaRlyOpn_SY PMM_tiDiaHVRlyActnDly_C PMM_tiDiaUnIntdPreRlyClsdMntn_C /end REF_CHARACTERISTIC
/end GROUP
/begin GROUP S3635_AcTvDisCh "VBU0513/VBUSystem/VCU /PMM/PMM_Ctrl/PwrMod_Ctrl/AcTvDisCh"
 /begin REF_CHARACTERISTIC PMM_flgAccDisblOvrdSwt_C PMM_flgAccDisblOvrdVal_C PMM_flgActvDisWihtHVRlyCldSwt_C PMM_flgActvDisWihtHVRlyCldVal_C SYS_stMCUDisChMalFunc_SY /end REF_CHARACTERISTIC
 /begin REF_MEASUREMENT PMM_flgAccDisbl PMM_flgRMCUActvDisChReq /end REF_MEASUREMENT
/end GROUP
/begin GROUP S3635_HVRlyCtrl "VBU0513/VBUSystem/VCU /PMM/PMM_Ctrl/PwrMod_Ctrl/HVRlyCtrl" /begin REF_CHARACTERISTIC PMM_flgHVRlyReqOvrdSwt_C PMM_stHVRlyReqOvrdVal_C /end REF_CHARACTERISTIC /begin REF_MEASUREMENT PMM_stHVRlyReq /end REF_MEASUREMENT /end GROUP
/begin GROUP S3635_PwrMod_PowerUp "VBU0513/VBUSystem/VCU /PMM/PMM_Ctrl/PwrMod_Ctrl/PwrMod_PowerUp"
 /begin SUB_GROUP S3696_CtrlSht S3696_EmgcySht S3696_HVClReqSrc S3696_OllLoad S3696_VehStsJudgement S3696_stateflowcondition /end SUB_GROUP
/end GROUP
/begin GROUP S3635_Routine "VBU0513/VBUSystem/VCU /PMM/PMM_Ctrl/PwrMod_Ctrl/Routine"
 /begin SUB_GROUP S3698_PwrUpRoutine S3698_Routine_PwrDwn S3698_Rouutine_RActiveDis /end SUB_GROUP
/end GROUP
/begin GROUP S3635_RoutineOvrd "VBU0513/VBUSystem/VCU /PMM/PMM_Ctrl/PwrMod_Ctrl/RoutineOvrd"
 /begin REF_CHARACTERISTIC PMM_flgHVPwrDwnEnaOvrdSwt_C PMM_flgHVPwrDwnEnaOvrdVal_C PMM_flgHVPwrUpEnaOvrdSwt_C PMM_flgHVPwrUpEnaOvrdVal_C PMM_flgPEURActvDisChEnaOvrdSwt_C PMM_flgPEURActvDisChEnaOvrdVal_C PMM_flgSelfDiagEnaOvrdSwt_C PMM_flgSelfDiagEnaOvrdVal_C /end REF_CHARACTERISTIC
 /begin REF_MEASUREMENT PMM_flgHVPwrDwnEnaOvrd PMM_flgHVPwrUpEnaOvrd PMM_flgPEURActvDisChEnaOvrd PMM_flgSelfDiagEnaOvrd /end REF_MEASUREMENT
/end GROUP
/begin GROUP S3635_SelfRoutine "VBU0513/VBUSystem/VCU /PMM/PMM_Ctrl/PwrMod_Ctrl/SelfRoutine"
 /begin REF_CHARACTERISTIC DIAGS_stNRCFail_SY DIAGS_stPsvRespIn_SY DIAGS_stPsvRespNok_SY DIAGS_stPsvRespOk_SY PMM_tiDlySelfDiag_C /end REF_CHARACTERISTIC
 /begin REF_MEASUREMENT PMM_flgHVPwrDwnEna PMM_flgHVPwrUpEna PMM_stSelfDiagResp /end REF_MEASUREMENT
/end GROUP
/begin GROUP S3746_AxleSpeedDiff "VBU0513/VBUSystem/VCU /SPD/SPD/SignalProcessing_10ms/AxleSpeedDiff" /begin REF_CHARACTERISTIC SYS_facRPM2KPH_SY SYS_lFWhlRadius_SY SYS_lWheelBase_SY /end REF_CHARACTERISTIC
 /begin REF_MEASUREMENT SPD_nDSpdTarFR SPD_nDeltaRALR SPD_nFA SPD_nFARADelta SPD_nRA /end REF_MEASUREMENT
/end GROUP
/begin GROUP S3746_Bench "VBU0513/VBUSystem/VCU /SPD/SPD/SignalProcessing_10ms/Bench" /begin SUB_GROUP S3748_BenchArb /end SUB_GROUP /end GROUP
/begin GROUP S3746_SlopeCal1 "VBU0513/VBUSystem/VCU /SPD/SPD/SignalProcessing_10ms/SlopeCal1" /begin SUB_GROUP S3749_SlopeCal S3749_VehSt /end SUB_GROUP /begin REF_CHARACTERISTIC SPD_tiAxUpdate2_C SPD_tiAxUpdate_C /end REF_CHARACTERISTIC /begin REF_MEASUREMENT SPD_aXSlope SPD_stAX SPD_tiStAx /end REF_MEASUREMENT /end GROUP
/begin GROUP S3746_Subsystem1 "VBU0513/VBUSystem/VCU /SPD/SPD/SignalProcessing_10ms/Subsystem1" /begin SUB_GROUP S3750_vWhlProcess S3750_v_Axle /end SUB_GROUP /end GROUP
/begin GROUP S3746_VehDir "VBU0513/VBUSystem/VCU /SPD/SPD/SignalProcessing_10ms/VehDir" /begin SUB_GROUP S3751_RearWhl /end SUB_GROUP /begin REF_MEASUREMENT SPD_vVehSpdSlp /end REF_MEASUREMENT /end GROUP
/begin GROUP S3746_VehSpdNorm "VBU0513/VBUSystem/VCU /SPD/SPD/SignalProcessing_10ms/VehSpdNorm" /begin SUB_GROUP S3752_Normal_VehSpdCal S3752_nMotr2vVeh /end SUB_GROUP /end GROUP
/begin GROUP S3792_GradientLimiter "VBU0513/VBUSystem/VCU /THM/THM/Compre/GradientLimiter" /begin REF_MEASUREMENT THM_nACSpdSet /end REF_MEASUREMENT /end GROUP
/begin GROUP S3793_Turn_Off_Delay_Time "VBU0513/VBUSystem/VCU /THM/THM/EVXRaw/Turn_Off_Delay_Time" /begin REF_MEASUREMENT THM_flgEXVEna /end REF_MEASUREMENT /end GROUP
/begin GROUP S3797_ESSPmpCmdRaw "VBU0513/VBUSystem/VCU /THM/THM/PumpRaw/ESSPmpCmdRaw"
 /begin REF_CHARACTERISTIC THM_facDeltaCellTempESSPump_v THM_ptcActvThemalMaxESSPump_C /end REF_CHARACTERISTIC
 /begin REF_MEASUREMENT THM_pctESSPmpCmdRaw /end REF_MEASUREMENT
/end GROUP
/begin GROUP S3797_PumpCmd "VBU0513/VBUSystem/VCU /THM/THM/PumpRaw/PumpCmd"
 /begin REF_CHARACTERISTIC THM_facVheSpdRearPump_v THM_pctDCDCRearPump_v THM_pctESSPumpCool_v THM_pctESSPumpDftCmd_C THM_pctESSPumpHeat_v THM_pctPEUPhUVWRearPump_v THM_pctPEUStrRearPump_v THM_vVehSpdHysBand_C /end REF_CHARACTERISTIC
 /begin REF_MEASUREMENT THM_pctESSPumpReq THM_pctRearPumpReq /end REF_MEASUREMENT
/end GROUP
/begin GROUP S3797_RearPmpCmdRaw "VBU0513/VBUSystem/VCU /THM/THM/PumpRaw/RearPmpCmdRaw" /begin REF_MEASUREMENT THM_pctRearPmpCmdRaw /end REF_MEASUREMENT /end GROUP
/begin GROUP S3798_OperateCycle "VBU0513/VBUSystem/VCU /THM/THM/ThermalMode/OperateCycle" /begin SUB_GROUP S3808_Cool S3808_Heat /end SUB_GROUP /begin REF_MEASUREMENT THM_stOperateCycle /end REF_MEASUREMENT /end GROUP
/begin GROUP S3798_OperateMode "VBU0513/VBUSystem/VCU /THM/THM/ThermalMode/OperateMode"
 /begin REF_CHARACTERISTIC THM_tCoolDeltaMaxTemp_C THM_tCoolDeltaMinTemp_C THM_tCoolFrstDeltaMaxTemp_C THM_tHeatDeltaMaxTemp_C THM_tHeatDeltaMinTemp_C /end REF_CHARACTERISTIC
 /begin REF_MEASUREMENT THM_stOperateMode /end REF_MEASUREMENT
/end GROUP
/begin GROUP S3798_TempTar "VBU0513/VBUSystem/VCU /THM/THM/ThermalMode/TempTar"
 /begin REF_CHARACTERISTIC THM_tDCChCoolTar_C THM_tDCChHeatTar_C THM_tDrvCoolTar_C THM_tDrvHeatTar_C /end REF_CHARACTERISTIC
 /begin REF_MEASUREMENT THM_tCoolTar THM_tHeatTar /end REF_MEASUREMENT
/end GROUP
/begin GROUP S3828_Subsystem "VBU0513/VBUSystem/VCU /TQC/TQC/TQC_VehSpdLimit/Subsystem"
 /begin REF_CHARACTERISTIC TQC_aAcc2TrqPrpHigh_SY TQC_aSlopeLimitInit_C TQC_aThresLe_C TQC_aThresRi_C TQC_facDecDrag_C TQC_facDragFastFilter_C TQC_facDragNormalFilter_C TQC_facMinDrag_C TQC_facNormalDrag_C TQC_facSlopeLimitIntegral_C TQC_facSlopeLimitProportion_C TQC_flgSlopeLimitEn_C TQC_numSlopeSample_C TQC_tiDragDelayTime_C TQC_tiSampleTime_C TQC_trqDefaultLimit_C TQC_trqDefaultSlope_C TQC_trqSlopeLimitInit_C TQC_trqSlopeLimitMax_C TQC_trqSlopeLimitMin_C TQC_trqVehMax_C TQC_trqVehMin_C /end REF_CHARACTERISTIC
 /begin REF_MEASUREMENT TQC_trqLIM /end REF_MEASUREMENT
/end GROUP
/begin GROUP S3828_VLIMCal "VBU0513/VBUSystem/VCU /TQC/TQC/TQC_VehSpdLimit/VLIMCal"
 /begin REF_CHARACTERISTIC VM_aMSLimD_CUR_v VM_aMSLimHomeD_CUR_v VM_aMSLimHomeR_CUR_v VM_aMSLimR_CUR_v VM_aVehLimDifNeg_C VM_aVehLimDifPos_C VM_aVehLimMax_C VM_stVehLimMaxSpdR_C VM_stVehLimServerGearD_C VM_stVehLimServerGearR_C VM_vVehLimThresD_C VM_vVehLimThresR_C VM_vVehLimpHomeThresD_C VM_vVehLimpHomeThresR_C /end REF_CHARACTERISTIC
/end GROUP
/begin GROUP S3828_VMax "VBU0513/VBUSystem/VCU /TQC/TQC/TQC_VehSpdLimit/VMax"
 /begin REF_CHARACTERISTIC TQC_stCurrentGearD_C VM_flgVehLimFixEnable_C VM_stVehLimMaxSpdD_C VM_stVehLimMaxSpdR_C VM_vVehLimFix_C VM_vVehLimMaxRThresHi_C VM_vVehLimMaxRThresLo_C VM_vVehLimMaxR_C VM_vVehLimMaxThresHi_C VM_vVehLimMaxThresLo_C VM_vVehLimMax_C /end REF_CHARACTERISTIC
/end GROUP
/begin GROUP S3828_VMaxExt "VBU0513/VBUSystem/VCU /TQC/TQC/TQC_VehSpdLimit/VMaxExt" /begin REF_CHARACTERISTIC VM_stVehLimExtSpd_C VM_vVehLimExtDefault_C /end REF_CHARACTERISTIC /end GROUP
/begin GROUP S3828_VMaxServer "VBU0513/VBUSystem/VCU /TQC/TQC/TQC_VehSpdLimit/VMaxServer"
 /begin REF_CHARACTERISTIC TQC_stCurrentGearD_C VM_stVehLimServerGearD_C VM_stVehLimServerGearR_C VM_vVehLimMax_C VM_vVehLimServerGearD_C VM_vVehLimServerGearR_C VM_vVehSpdLimHiServerGearD_C VM_vVehSpdLimHiServerGearR_C VM_vVehSpdLimREDSServerGearDMax_C VM_vVehSpdLimREDSServerGearDMin_C VM_vVehSpdLimREDSServerGearR_C VM_vVehSpdLimServerGearD_C VM_vVehSpdLimServerGearR_C /end REF_CHARACTERISTIC
/end GROUP
/begin GROUP S3829_TQC_VehInfoAnalysis "VBU0513/VBUSystem/VCU /TQC/TQC/VehInfo1/TQC_VehInfoAnalysis"
 /begin REF_CHARACTERISTIC TQC_aXFltGradDec_C TQC_aXFltGradInc_C TQC_facDelayShiftFilter_C TQC_facDragShiftFilter_C TQC_facVehSpdFilter_C TQC_flgDragCalEn_C TQC_flgVehAccCalcEnable_C TQC_numFltAccAverage_C TQC_rRatioReducer_C TQC_stDGear_C TQC_tiDelayDragTime_C TQC_tiSampleTime_C TQC_vDragSpeedLe_C TQC_vDragSpeedRi_C /end REF_CHARACTERISTIC
/end GROUP
/begin GROUP S3829_Veh_Drag "VBU0513/VBUSystem/VCU /TQC/TQC/VehInfo1/Veh_Drag"
 /begin REF_CHARACTERISTIC CrCtl_facDragSpeed_MAP_v TQC_aDragLearnMax_C TQC_aDragLearnMin_C TQC_facDragCalGradDec_C TQC_facDragCalGradInc_C TQC_facDragCalGradMax_C TQC_facDragCalGradMin_C TQC_facDragWheelFilter_C TQC_facTrqWheelFilter_C TQC_flgDragTrqMovingOn_C TQC_numDragCalAverageAccStepDown_C TQC_numDragCalAverageAccStepUp_C TQC_numDragCalAverageAcc_C TQC_numDragCalAverageBrk_C TQC_numDragFastLearn_C TQC_numDragLearnMin_C TQC_numDragLearnStepDown_C TQC_numDragLearnStepMax_C TQC_numDragLearnStepUp_C TQC_numDragLearnStep_C TQC_pctDragCalPedLe_C TQC_pctDragCalPedRi_C TQC_rRatioReducer_C TQC_trqDragCalGradDec_C TQC_trqDragCalGradInc_C TQC_trqDragMax_C TQC_vDragSpeedLearnLe_C TQC_vDragSpeedLearnRi_C /end REF_CHARACTERISTIC
/end GROUP
/begin GROUP S3829_Veh_a2Trq "VBU0513/VBUSystem/VCU /TQC/TQC/VehInfo1/Veh_a2Trq" /begin REF_CHARACTERISTIC TQC_mInrt_C TQC_mVeh_C TQC_rTire19Wheel_C /end REF_CHARACTERISTIC /end GROUP
/begin GROUP S3876_TrqDem_DrvTrq_Cal "VBU0513/VBUSystem/VCU /TQD/TrqDem/TrqDem_DrvTrq_Cal/TrqDem_DrvTrq_Cal"
 /begin REF_CHARACTERISTIC TQD_facTrqDesGrR_CUR_v TQD_trqTrqSetECO_MAP_v TQD_trqTrqSetNormal_MAP_v /end REF_CHARACTERISTIC
 /begin REF_MEASUREMENT TQD_facDesTrqGr TQD_trqDesRaw TQD_trqNrmLead TQD_trqZrPed /end REF_MEASUREMENT
/end GROUP
/begin GROUP S3876_TrqDem_MinTrq_Cal "VBU0513/VBUSystem/VCU /TQD/TrqDem/TrqDem_DrvTrq_Cal/TrqDem_MinTrq_Cal"
 /begin SUB_GROUP S3879_BrakeCrpModify S3879_CrpEnaArb S3879_CrpRgnTrqArb S3879_CrpRgnTrqCal S3879_CrpRgnTrqLim /end SUB_GROUP
/end GROUP
/begin GROUP S3876_TrqDem_TrqDes_Cal "VBU0513/VBUSystem/VCU /TQD/TrqDem/TrqDem_DrvTrq_Cal/TrqDem_TrqDes_Cal" /begin REF_CHARACTERISTIC TQD_pctCrpOff_CUR_v TQD_trqRoad_CUR_v /end REF_CHARACTERISTIC
 /begin REF_MEASUREMENT TQD_trqDemRegen TQD_trqDesDecel TQD_trqDesWeighted TQD_trqNrmDes TQD_trqRoad /end REF_MEASUREMENT
/end GROUP
/begin GROUP S3877_BrakePressureFilter "VBU0513/VBUSystem/VCU /TQD/TrqDem/TrqDem_InputTransfer/BrakePressureFilter" /begin SUB_GROUP S3891_First_Order_Low_Pass_Filter /end SUB_GROUP /begin REF_CHARACTERISTIC TQD_facBrkPressFilt_C /end REF_CHARACTERISTIC /end GROUP
/begin GROUP S3877_TrqDem_AccPdl_Filter "VBU0513/VBUSystem/VCU /TQD/TrqDem/TrqDem_InputTransfer/TrqDem_AccPdl_Filter" /begin REF_CHARACTERISTIC TQD_flgAPDFltByp_C /end REF_CHARACTERISTIC /begin REF_MEASUREMENT TQD_pctAccPedPosFlt /end REF_MEASUREMENT /end GROUP
/begin GROUP S3877_TrqDem_GearDet "VBU0513/VBUSystem/VCU /TQD/TrqDem/TrqDem_InputTransfer/TrqDem_GearDet" /begin REF_CHARACTERISTIC TQD_flgVirtualNeutralEnable_C TQD_pctAccPedalDeadband_C /end REF_CHARACTERISTIC /begin REF_MEASUREMENT TQD_flgVirtualNeutral TQD_stVehCreepMode /end REF_MEASUREMENT /end GROUP
/begin GROUP S3877_TrqDem_VehSpeed_Filter "VBU0513/VBUSystem/VCU /TQD/TrqDem/TrqDem_InputTransfer/TrqDem_VehSpeed_Filter" /begin SUB_GROUP S3894_DejitterFIL S3894_SR_Flip_Flop /end SUB_GROUP
 /begin REF_CHARACTERISTIC TQD_facVehSpdFlt_C TQD_facVehSpdHys_C TQD_flgVectorSpdUsed_C TQD_pctVehSlideRes_C TQD_vVehSlideEna_C TQD_vVehSlideRes_C /end REF_CHARACTERISTIC
 /begin REF_MEASUREMENT TQD_flgSlideRst /end REF_MEASUREMENT
/end GROUP
/begin GROUP S3901_STC "VBU0513/VBUSystem/VCU /TQO/TQOAll/STC/STC" /begin SUB_GROUP S3909_ABSRgnCancel S3909_DisableRgnTorque /end SUB_GROUP /end GROUP
/begin GROUP S3903_TQARB "VBU0513/VBUSystem/VCU /TQO/TQOAll/TQARB/TQARB" /begin SUB_GROUP S3913_Limitation S3913_TrqArb /end SUB_GROUP /end GROUP
/begin GROUP S3904_TQCMP "VBU0513/VBUSystem/VCU /TQO/TQOAll/TQCMP/TQCMP" /begin SUB_GROUP S3919_TrqPulse /end SUB_GROUP /begin REF_CHARACTERISTIC TQCMP_trqLowSpdRA /end REF_CHARACTERISTIC /end GROUP
/begin GROUP S3905_TQDIS "VBU0513/VBUSystem/VCU /TQO/TQOAll/TQDIS/TQDIS" /begin SUB_GROUP S3927_AxleArb S3927_Dmp S3927_TrqFilter S3927_TrqLim /end SUB_GROUP /end GROUP
/begin GROUP S3906_TQDMP "VBU0513/VBUSystem/VCU /TQO/TQOAll/TQDMP/TQDMP" /begin SUB_GROUP S3963_CMB S3963_Dibl S3963_RAROTC /end SUB_GROUP /end GROUP
/begin GROUP S3907_TQO "VBU0513/VBUSystem/VCU /TQO/TQOAll/TQO/TQO" /begin SUB_GROUP S4006_MotorTorque S4006_Subsystem S4006_Trq /end SUB_GROUP /end GROUP
/begin GROUP S4019_TorqueRamp "VBU0513/VBUSystem/VCU /VTQA/Subsystem/MTrqLim/TorqueRamp" /begin REF_CHARACTERISTIC MTQL_trqDecLim_C MTQL_trqIncLim_C /end REF_CHARACTERISTIC /end GROUP
/begin GROUP S4019_TrqCapacityArb "VBU0513/VBUSystem/VCU /VTQA/Subsystem/MTrqLim/TrqCapacityArb"
 /begin REF_CHARACTERISTIC MTQL_trqMtrDrvLimOvrdVal_C MTQL_trqMtrDrvLimOvrd_C MTQL_trqMtrRgnLimOvrdVal_C MTQL_trqMtrRgnLimOvrd_C MTQL_trqPEURDrvLowLim_C MTQL_trqPEURDrvUpLim_C MTQL_trqPEURRgnLowLim_C MTQL_trqPEURRgnUpLim_C /end REF_CHARACTERISTIC
 /begin REF_MEASUREMENT MTQL_trqMtrDrvLim MTQL_trqMtrDrvLimRaw MTQL_trqMtrRgnLim MTQL_trqMtrRgnLimRaw /end REF_MEASUREMENT
/end GROUP
/begin GROUP S4019_TrqCapacityCal "VBU0513/VBUSystem/VCU /VTQA/Subsystem/MTrqLim/TrqCapacityCal" /begin REF_MEASUREMENT MTQL_trqRMotrMaxLim MTQL_trqRMotrMinLim /end REF_MEASUREMENT /end GROUP
/begin GROUP S4019_TrqCapacityLim "VBU0513/VBUSystem/VCU /VTQA/Subsystem/MTrqLim/TrqCapacityLim"
 /begin SUB_GROUP S4024_FIDTrqLim S4024_Motor_Inhibit S4024_VehicleSpeedLim S4024_dnLim /end SUB_GROUP
/end GROUP
/begin GROUP S4019_TrqCapacityOffline "VBU0513/VBUSystem/VCU /VTQA/Subsystem/MTrqLim/TrqCapacityOffline" /begin REF_CHARACTERISTIC MTQL_facVehSpd2MotSpd_C MTQL_trqMtrTrqDrvLT_CUR_v /end REF_CHARACTERISTIC /begin REF_MEASUREMENT MTQL_trqMtrTrqDrvLT /end REF_MEASUREMENT /end GROUP
/begin GROUP S4020_BattLim_Transfer "VBU0513/VBUSystem/VCU /VTQA/Subsystem/VehTrqArb/BattLim_Transfer" /begin SUB_GROUP S4035_AxleTrq_Limit_Calc S4035_Motor_PwrLoss_Calc /end SUB_GROUP /end GROUP
/begin GROUP S4020_Trq_Arb "VBU0513/VBUSystem/VCU /VTQA/Subsystem/VehTrqArb/Trq_Arb" /begin SUB_GROUP S4036_AlxeMax S4036_AlxeMin S4036_Arb /end SUB_GROUP /end GROUP
/begin GROUP S4053_APD "VBU0513/VBUSystem/VCU /VehINP/VehINP_Logic/APD/APD"
 /begin SUB_GROUP S4064_APD1_Norm S4064_APD2_Norm S4064_APD_Dejitter1 S4064_APD_Dejitter2 S4064_APD_Override S4064_Diag_Ratio S4064_Diag_Status S4064_Value_Selection /end SUB_GROUP
/end GROUP
/begin GROUP S4054_Charge_Port_Temp "VBU0513/VBUSystem/VCU /VehINP/VehINP_Logic/DCPortTemp/Charge_Port_Temp"
 /begin SUB_GROUP S4096_Veh_DCPortTempPlausibility S4096_Veh_DCPortTempStatus /end SUB_GROUP
/end GROUP
/begin GROUP S4055_IF_Then_Else1 "VBU0513/VBUSystem/VCU /VehINP/VehINP_Logic/FPV/IF_Then_Else1" /begin REF_MEASUREMENT FPV_st4WayVlvPosFdbk /end REF_MEASUREMENT /end GROUP
/begin GROUP S4056_Gear1 "VBU0513/VBUSystem/VCU /VehINP/VehINP_Logic/GearShift/Gear1"
 /begin SUB_GROUP S4105_Digital_Gear_D_R S4105_Gear4DriveIntend S4105_Gear_BrakeCondition S4105_Gear_DriverShiftPReq S4105_Gear_EPBStatus S4105_Gear_ExternalReq S4105_Gear_P S4105_Gear_ProtectCondition S4105_Gear_Status S4105_Gear_VehSpeed S4105_Gear_VehicleStatus /end SUB_GROUP
/end GROUP
/begin GROUP S4057_VehMode "VBU0513/VBUSystem/VCU /VehINP/VehINP_Logic/Mode/VehMode"
 /begin SUB_GROUP S4222_Veh_AccrMode S4222_Veh_CreepMode S4222_Veh_DrvMode S4222_Veh_RgnMode /end SUB_GROUP
/end GROUP
/begin GROUP S4061_Hysteresis_LLC_RHC "VBU0513/VBUSystem/VCU /VehINP/VehINP_Logic/VacuumPump Control/Hysteresis_LLC_RHC" /begin REF_MEASUREMENT Veh_flgVacPumpReq /end REF_MEASUREMENT /end GROUP
/begin GROUP S4062_BPD_BrakePercent "VBU0513/VBUSystem/VCU /VehINP/VehINP_Logic/VehINP_BPD/BPD_BrakePercent" /begin SUB_GROUP S4265_BPD_BrakePercentStatus S4265_BPD_PressBrake /end SUB_GROUP /end GROUP
/begin GROUP S4062_BPD_BrakeSwitch "VBU0513/VBUSystem/VCU /VehINP/VehINP_Logic/VehINP_BPD/BPD_BrakeSwitch" /begin SUB_GROUP S4266_BPD_BrakeSwitchHW S4266_BPD_BrakeSwitchSelect /end SUB_GROUP /end GROUP
/begin GROUP S4062_BPD_BrkSwtPosPlausibilityCheck "VBU0513/VBUSystem/VCU /VehINP/VehINP_Logic/VehINP_BPD/BPD_BrkSwtPosPlausibilityCheck" /begin SUB_GROUP S4267_DiagBrkPosDft /end SUB_GROUP /end GROUP
/begin GROUP S4062_VehINP_BrkPedOverride "VBU0513/VBUSystem/VCU /VehINP/VehINP_Logic/VehINP_BPD/VehINP_BrkPedOverride" /begin SUB_GROUP S4268_override_signal1 S4268_override_signal4 /end SUB_GROUP
 /begin REF_CHARACTERISTIC BPD_flgBrkPosOverride_C BPD_flgBrkPosVldOverrideVal_C BPD_flgBrkPosVldOverride_C BPD_flgBrkSwtOverride_C BPD_pctBrkPosOverrideVal_C BPD_stBrkPedPrsNoActv_C BPD_stBrkSwtOverrideVal_C /end REF_CHARACTERISTIC
 /begin REF_MEASUREMENT BPD_flgBrkSwt /end REF_MEASUREMENT
/end GROUP
/begin GROUP S4063_VehHVIL "VBU0513/VBUSystem/VCU /VehINP/VehINP_Logic/Veh_Status/VehHVIL" /begin SUB_GROUP S4285_HVIL /end SUB_GROUP /end GROUP
/begin GROUP S36_Check_BatteryCurrent_Valid "VBU0513/VBUSystem/BMS/BCV/BCV/Subsystem/Calculate_BatteryCurrent/Check_BatteryCurrent_Valid" /begin REF_CHARACTERISTIC CcBCV_ABatteryCurrentOoR_C /end REF_CHARACTERISTIC /end GROUP
/begin GROUP S36_Correct_BatteryCurrent "VBU0513/VBUSystem/BMS/BCV/BCV/Subsystem/Calculate_BatteryCurrent/Correct_BatteryCurrent"
 /begin SUB_GROUP S54_Calculate_BatteryCurrent_ZeroDrift S54_Delay_RisingEdge /end SUB_GROUP
 /begin REF_CHARACTERISTIC CbBCV_BatteryCurrentZeroDriftEnable_flg CcBCV_BatteryCurrentDelay_ms /end REF_CHARACTERISTIC
 /begin REF_MEASUREMENT BCV_iABatteryCurrent /end REF_MEASUREMENT
/end GROUP
/begin GROUP S36_UpdateBatteryCurrent "VBU0513/VBUSystem/BMS/BCV/BCV/Subsystem/Calculate_BatteryCurrent/UpdateBatteryCurrent" /begin REF_MEASUREMENT BCV_iAUpdateBatteryCurrent /end REF_MEASUREMENT /end GROUP
/begin GROUP S37_Check_BatteryVoltage_Valid "VBU0513/VBUSystem/BMS/BCV/BCV/Subsystem/Calculate_BatteryVoltage/Check_BatteryVoltage_Valid" /begin SUB_GROUP S68_Delay_FallingEdge /end SUB_GROUP
 /begin REF_CHARACTERISTIC CcBCV_BatteryVoltageOoRHigh_V CcBCV_BatteryVoltageOoRLow_V CcBCV_HighVoltageDelay_ms /end REF_CHARACTERISTIC
/end GROUP
/begin GROUP S37_Check_BusNegativeVoltage_Valid "VBU0513/VBUSystem/BMS/BCV/BCV/Subsystem/Calculate_BatteryVoltage/Check_BusNegativeVoltage_Valid" /begin SUB_GROUP S69_Delay_FallingEdge /end SUB_GROUP /begin REF_CHARACTERISTIC CcBCV_HighVoltageDelay_ms /end REF_CHARACTERISTIC /end GROUP
/begin GROUP S37_Check_BusVoltage_Valid "VBU0513/VBUSystem/BMS/BCV/BCV/Subsystem/Calculate_BatteryVoltage/Check_BusVoltage_Valid" /begin SUB_GROUP S70_Delay_FallingEdge /end SUB_GROUP /begin REF_CHARACTERISTIC CcBCV_HighVoltageDelay_ms /end REF_CHARACTERISTIC /end GROUP
/begin GROUP S37_Check_FuseVoltage_Valid "VBU0513/VBUSystem/BMS/BCV/BCV/Subsystem/Calculate_BatteryVoltage/Check_FuseVoltage_Valid" /begin SUB_GROUP S71_Delay_FallingEdge /end SUB_GROUP /begin REF_CHARACTERISTIC CcBCV_HighVoltageDelay_ms /end REF_CHARACTERISTIC /end GROUP
/begin GROUP S37_Check_PrechargeVoltage_Valid "VBU0513/VBUSystem/BMS/BCV/BCV/Subsystem/Calculate_BatteryVoltage/Check_PrechargeVoltage_Valid" /begin SUB_GROUP S72_Delay_FallingEdge /end SUB_GROUP /begin REF_CHARACTERISTIC CcBCV_HighVoltageDelay_ms /end REF_CHARACTERISTIC /end GROUP
/begin GROUP S37_Check_Vx1Voltage_Valid "VBU0513/VBUSystem/BMS/BCV/BCV/Subsystem/Calculate_BatteryVoltage/Check_Vx1Voltage_Valid" /begin SUB_GROUP S73_Delay_FallingEdge /end SUB_GROUP
 /begin REF_CHARACTERISTIC CcBCV_BatteryVoltageOoRHigh_V CcBCV_BatteryVoltageOoRLow_V CcBCV_HighVoltageDelay_ms /end REF_CHARACTERISTIC
/end GROUP
/begin GROUP S37_Check_Vx2Voltage_Valid "VBU0513/VBUSystem/BMS/BCV/BCV/Subsystem/Calculate_BatteryVoltage/Check_Vx2Voltage_Valid" /begin SUB_GROUP S74_Delay_FallingEdge /end SUB_GROUP /begin REF_CHARACTERISTIC CcBCV_HighVoltageDelay_ms /end REF_CHARACTERISTIC /end GROUP
/begin GROUP S37_Update_BatteryVoltage "VBU0513/VBUSystem/BMS/BCV/BCV/Subsystem/Calculate_BatteryVoltage/Update_BatteryVoltage" /begin REF_MEASUREMENT BCV_uBatteryVoltage /end REF_MEASUREMENT /end GROUP
/begin GROUP S37_Update_BusNegativeVoltage "VBU0513/VBUSystem/BMS/BCV/BCV/Subsystem/Calculate_BatteryVoltage/Update_BusNegativeVoltage" /begin REF_MEASUREMENT BCV_uBusNegativeVoltage /end REF_MEASUREMENT /end GROUP
/begin GROUP S37_Update_BusVoltage "VBU0513/VBUSystem/BMS/BCV/BCV/Subsystem/Calculate_BatteryVoltage/Update_BusVoltage" /begin REF_MEASUREMENT BCV_uBusVoltage /end REF_MEASUREMENT /end GROUP
/begin GROUP S37_Update_FuseVoltage "VBU0513/VBUSystem/BMS/BCV/BCV/Subsystem/Calculate_BatteryVoltage/Update_FuseVoltage" /begin REF_MEASUREMENT BCV_uFuseVoltage /end REF_MEASUREMENT /end GROUP
/begin GROUP S37_Update_PrechargeVoltage "VBU0513/VBUSystem/BMS/BCV/BCV/Subsystem/Calculate_BatteryVoltage/Update_PrechargeVoltage" /begin REF_MEASUREMENT BCV_uPrechargeVoltage /end REF_MEASUREMENT /end GROUP
/begin GROUP S37_Update_Vx2Voltage "VBU0513/VBUSystem/BMS/BCV/BCV/Subsystem/Calculate_BatteryVoltage/Update_Vx2Voltage" /begin REF_MEASUREMENT BCV_uVx2Voltage /end REF_MEASUREMENT /end GROUP
/begin GROUP S38_Calculate_FuseProtect_Counter "VBU0513/VBUSystem/BMS/BCV/BCV/Subsystem/Calculate_Lifetime_Data/Calculate_FuseProtect_Counter"
 /begin REF_CHARACTERISTIC CcBCV_FuseCurrentFactor1_n CcBCV_FuseCurrentFactor2_n CcBCV_FuseCurrentFactor3_n CcBCV_FuseCurrentHigh1_A CcBCV_FuseCurrentHigh2_A CcBCV_FuseCurrentHigh3_A CcBCV_FuseCurrentHigh4_A CcBCV_FuseCurrentLow1_A CcBCV_FuseCurrentLow2_A CcBCV_FuseCurrentLow3_A CcBCV_FuseCurrentLow4_A CcBCV_FuseHealthThreshold_n CcBCV_FuseProtectDelay1_ms CcBCV_FuseProtectDelay2_ms CcBCV_FuseProtectDelay3_ms CcBCV_FuseProtectDelay4_ms EcBCV_nbrFuseProtectCounter3W /end REF_CHARACTERISTIC
 /begin REF_MEASUREMENT BCV_flgFuseHealthWarning EcBCV_nbrFuseProtectCounter3r /end REF_MEASUREMENT
/end GROUP
/begin GROUP S38_Calculate_LifeTimeCharge "VBU0513/VBUSystem/BMS/BCV/BCV/Subsystem/Calculate_Lifetime_Data/Calculate_LifeTimeCharge" /begin REF_MEASUREMENT BCV_AhLifeTimeCharge /end REF_MEASUREMENT /end GROUP
/begin GROUP S38_Calculate_LifeTimeCoulomb "VBU0513/VBUSystem/BMS/BCV/BCV/Subsystem/Calculate_Lifetime_Data/Calculate_LifeTimeCoulomb" /begin REF_CHARACTERISTIC SECONDS_PER_HOUR /end REF_CHARACTERISTIC /begin REF_MEASUREMENT LcSOC_AhLifeTimeCoulomb /end REF_MEASUREMENT /end GROUP
/begin GROUP S38_Calculate_LifeTimeDischarge "VBU0513/VBUSystem/BMS/BCV/BCV/Subsystem/Calculate_Lifetime_Data/Calculate_LifeTimeDischarge" /begin REF_MEASUREMENT BCV_AhLifeTimeDischarge /end REF_MEASUREMENT /end GROUP
/begin GROUP S38_Calculate_LifeTimeFastcharge "VBU0513/VBUSystem/BMS/BCV/BCV/Subsystem/Calculate_Lifetime_Data/Calculate_LifeTimeFastcharge" /begin SUB_GROUP S107_Accumulate_Carry S107_Equal_FASTCHARGE /end SUB_GROUP /begin REF_MEASUREMENT BCV_AhLifeTimeFastcharge /end REF_MEASUREMENT /end GROUP
/begin GROUP S39_DIagnose_OutOfRange_Fault "VBU0513/VBUSystem/BMS/BCV/BCV/Subsystem/Diagnose_BCV_Communication_Fault/DIagnose_OutOfRange_Fault"
 /begin REF_CHARACTERISTIC BCV_BATTERY_VOLTAGE_SENSE_OOR_FAULT BCV_LEM_CURRENT_SENSE_OOR_FAULT CbBCV_BatteryCurrentOoR_flg CbBCV_BatteryVoltageOoR_flg CcBCV_BatteryCurrentOoRFaultFIC_n CcBCV_BatteryCurrentOoRFaultPIC_n CcBCV_BatteryCurrentOoR_A CcBCV_BatteryVoltageOoRFaultFIC_n CcBCV_BatteryVoltageOoRFaultPIC_n CcBCV_BatteryVoltageOoRHigh_V CcBCV_BatteryVoltageOoRLow_V /end REF_CHARACTERISTIC
 /begin REF_MEASUREMENT BCV_stBatteryCurrentOoRFault BCV_stBatteryVoltageOoRFault /end REF_MEASUREMENT
/end GROUP
/begin GROUP S40_Diagnose_BatteryBusVoltageMismatch_Fault "VBU0513/VBUSystem/BMS/BCV/BCV/Subsystem/Diagnose_BCV_Data_Fault/Diagnose_BatteryBusVoltageMismatch_Fault"
 /begin REF_CHARACTERISTIC BCV_BATTERY_BUS_VOLTAGE_MISMATCH_FAULT CbBCV_BatteryBusVoltageMismatch_flg CcBCV_BatteryBusVoltageMismatchFaultDelta_V CcBCV_BatteryBusVoltageMismatchFaultFIC_n CcBCV_BatteryBusVoltageMismatchFaultPIC_n CcBCV_BatteryBusVoltageMismatchFault_V /end REF_CHARACTERISTIC
 /begin REF_MEASUREMENT BCV_stBatteryBusVoltageMismatchFault /end REF_MEASUREMENT
/end GROUP
/begin GROUP S40_Diagnose_VoltageCurrent_Fault "VBU0513/VBUSystem/BMS/BCV/BCV/Subsystem/Diagnose_BCV_Data_Fault/Diagnose_VoltageCurrent_Fault"
 /begin SUB_GROUP S136_EVM_FDC_Handler S136_EVM_FDC_Handler1 S136_EVM_FDC_Handler2 /end SUB_GROUP
 /begin REF_CHARACTERISTIC BCV_BATTERY_OVER_CURRENT_WARNING_FAULT BCV_BATTERY_UNDER_VOLTAGEEVM_FAULT BCV_BATTERY_UNDER_VOLTAGE_FAULT CbBCV_BatteryOverCurrentWarning_flg CbBCV_BatteryOverCurrent_flg CbBCV_BatteryOverVoltageEVMFaultEnable_flg CbBCV_BatteryOverVoltageWarning_flg CbBCV_BatteryOverVoltage_flg CbBCV_BatteryUnderVoltageEVMFaultEnable_flg CbBCV_BatteryUnderVoltage_flg CcBCV_BatteryOverCurrentFaultFIC_n CcBCV_BatteryOverCurrentFaultPIC_n CcBCV_BatteryOverCurrentWarningFaultDelay_ms CcBCV_BatteryOverCurrentWarningFaultFIC_n CcBCV_BatteryOverCurrentWarningFaultPIC_n CcBCV_BatteryOverCurrentWarning_A CcBCV_BatteryOverCurrent_A CcBCV_BatteryOverVoltageEVMFaultFIC_n CcBCV_BatteryOverVoltageEVMFaultPIC_n CcBCV_BatteryOverVoltageEVM_V CcBCV_BatteryOverVoltageFaultFIC_n CcBCV_BatteryOverVoltageFaultPIC_n CcBCV_BatteryOverVoltageWarningFaultDelay_ms CcBCV_BatteryOverVoltageWarningFaultFIC_n CcBCV_BatteryOverVoltageWarningFaultPIC_n CcBCV_BatteryOverVoltageWarning_V CcBCV_BatteryOverVoltage_V CcBCV_BatteryUnderVoltage1_V CcBCV_BatteryUnderVoltage2_V CcBCV_BatteryUnderVoltageEVM1_V CcBCV_BatteryUnderVoltageEVM2_V CcBCV_BatteryUnderVoltageEVMFaultFIC_n CcBCV_BatteryUnderVoltageEVMFaultPIC_n CcBCV_BatteryUnderVoltageFaultFIC_n CcBCV_BatteryUnderVoltageFaultPIC_n CcBCV_BatteryUnderVoltageTemp_C /end REF_CHARACTERISTIC
 /begin REF_MEASUREMENT BCV_stBatteryOverCurrentFault BCV_stBatteryOverCurrentWarningFault BCV_stBatteryOverVoltageEVMFault BCV_stBatteryOverVoltageFault BCV_stBatteryOverVoltageWarningFault BCV_stBatteryUnderVoltageEVMFault BCV_stBatteryUnderVoltageFault /end REF_MEASUREMENT
/end GROUP
/begin GROUP S51_Diagnose_BDM_BCV_Communication_Fault "VBU0513/VBUSystem/BMS/BCV/BCV/Subsystem/Monitor_BCV_Performance/Diagnose_BDM_BCV_Communication_Fault" /begin SUB_GROUP S186_Diagnose_BdmOutOfRange_Fault /end SUB_GROUP /end GROUP
/begin GROUP S51_Diagnose_BDM_BCV_Data_Fault "VBU0513/VBUSystem/BMS/BCV/BCV/Subsystem/Monitor_BCV_Performance/Diagnose_BDM_BCV_Data_Fault"
 /begin SUB_GROUP S187_Diagnose_BdmBatteryBusVoltageMismatch_Fault S187_Diagnose_BdmVoltageCurrent_Fault /end SUB_GROUP
/end GROUP
/begin GROUP S51_Diagnose_BDM_FastChargeContactorOverCurrentAlarm "VBU0513/VBUSystem/BMS/BCV/BCV/Subsystem/Monitor_BCV_Performance/Diagnose_BDM_FastChargeContactorOverCurrentAlarm" /begin SUB_GROUP S188_Equal_FASTCHARGE /end SUB_GROUP /begin REF_CHARACTERISTIC CcBCV_DCContactorOverCurrent_A /end REF_CHARACTERISTIC /end GROUP
/begin GROUP S280_Delay_FallingEdge "VBU0513/VBUSystem/BMS/BMM/BMM/Determine_Wakeup_Mode/Determine_Wakeup_Bywire/Delay_FallingEdge" /begin REF_MEASUREMENT BMM_flgWakeupLine /end REF_MEASUREMENT /end GROUP
/begin GROUP S288_DetermineBalance_EnableCondition "VBU0513/VBUSystem/BMS/CBL/Subsystem8/Subsystem/Balance_EnableCondition/DetermineBalance_EnableCondition"
 /begin REF_CHARACTERISTIC CbCBL_CellBalanceEnable_flg CbCBL_CellTempCheckEnable_flg CbCBL_IsolationResistanceEnable_flg CcCBL_BalanceStartCellSoc_pct CcCBL_BalanceStartCellTempMaxHysteresis_C CcCBL_BalanceStartCellTempMax_C CcCBL_BalanceStartCellVoltageMinHysteresis_mV CcCBL_BalanceStartCellVoltageMin_mV CcCBL_BalanceStartIsoResistance_Kohm CcCBL_SystemVoltageMaxHysteresis_V CcCBL_SystemVoltageMax_V CcCBL_SystemVoltageMinHysteresis_V CcCBL_SystemVoltageMin_V /end REF_CHARACTERISTIC
 /begin REF_MEASUREMENT LbCBL_flgBalanceEnableCondition /end REF_MEASUREMENT
/end GROUP
/begin GROUP S288_DetermineSOCBalance_EnableCondition "VBU0513/VBUSystem/BMS/CBL/Subsystem8/Subsystem/Balance_EnableCondition/DetermineSOCBalance_EnableCondition"
 /begin REF_CHARACTERISTIC CcCBL_SocBalanceChargeCurrentHysteresis_A CcCBL_SocBalanceChargeCurrent_A CcCBL_SocBalanceCurrentCheckTime_s CcCBL_SocBalanceDischargeCurrentHysteresis_A CcCBL_SocBalanceDischargeCurrent_A /end REF_CHARACTERISTIC
 /begin REF_MEASUREMENT CBL_flgSocBalanceEnable /end REF_MEASUREMENT
/end GROUP
/begin GROUP S288_DetermineVoltaageBalance_EnableCondition "VBU0513/VBUSystem/BMS/CBL/Subsystem8/Subsystem/Balance_EnableCondition/DetermineVoltaageBalance_EnableCondition"
 /begin REF_CHARACTERISTIC CbCBL_CellBalanceOCVCheckEnable_flg CcCBL_CellBalanceChargeCurrentHysteresis_A CcCBL_CellBalanceChargeCurrent_A CcCBL_CellBalanceCurrentCheckTime_s CcCBL_CellBalanceDischargeCurrentHysteresis_A CcCBL_CellBalanceDischargeCurrent_A /end REF_CHARACTERISTIC
 /begin REF_MEASUREMENT CBL_flgVoltageBalanceEnable /end REF_MEASUREMENT
/end GROUP
/begin GROUP S290_Determin_MinSocCellCapacity "VBU0513/VBUSystem/BMS/CBL/Subsystem8/Subsystem/Determine_CSCCellBalanceRequest/Determin_MinSocCellCapacity" /begin REF_MEASUREMENT LcSOH_AhMinSocCellCapacity /end REF_MEASUREMENT /end GROUP
/begin GROUP S290_Determine_CellBalanceNumber "VBU0513/VBUSystem/BMS/CBL/Subsystem8/Subsystem/Determine_CSCCellBalanceRequest/Determine_CellBalanceNumber" /begin REF_MEASUREMENT CBL_numCellBalanceNumber /end REF_MEASUREMENT /end GROUP
/begin GROUP S290_Determine_CellBalanceRequest "VBU0513/VBUSystem/BMS/CBL/Subsystem8/Subsystem/Determine_CSCCellBalanceRequest/Determine_CellBalanceRequest" /begin SUB_GROUP S317_Cell0 /end SUB_GROUP
 /begin REF_CHARACTERISTIC CcCBL_BalanceStartDeltaSoc_pct CcCBL_BalanceStartDeltaVoltage_mV /end REF_CHARACTERISTIC
 /begin REF_MEASUREMENT CBL_mvBalanceTargetVoltage CBL_pctBalanceTargeSoc /end REF_MEASUREMENT
/end GROUP
/begin GROUP S290_Determine_TotalCellBalanceState "VBU0513/VBUSystem/BMS/CBL/Subsystem8/Subsystem/Determine_CSCCellBalanceRequest/Determine_TotalCellBalanceState" /begin REF_MEASUREMENT CBL_flgBalanceStatus /end REF_MEASUREMENT /end GROUP
/begin GROUP S290_Subsystem "VBU0513/VBUSystem/BMS/CBL/Subsystem8/Subsystem/Determine_CSCCellBalanceRequest/Subsystem" /begin SUB_GROUP S322_Balance_Fault_Diagnostic1 /end SUB_GROUP
 /begin REF_CHARACTERISTIC CBL_BALANCE_RESPOND_MISNATCH_REQUEST_FAULT CbCBL_CellBalanceRespMismatchReqtFault_flg CcCBL_CellBalanceRespMismatchReqtFIC_n CcCBL_CellBalanceRespMismatchReqtPIC_n /end REF_CHARACTERISTIC
/end GROUP
/begin GROUP S291_LOW_HIGH1 "VBU0513/VBUSystem/BMS/CBL/Subsystem8/Subsystem/Override/LOW_HIGH1" /begin REF_MEASUREMENT CBL_tCTMBoardTempMaxORV /end REF_MEASUREMENT /end GROUP
/begin GROUP S291_LOW_HIGH2 "VBU0513/VBUSystem/BMS/CBL/Subsystem8/Subsystem/Override/LOW_HIGH2" /begin REF_MEASUREMENT CBL_flgCTMBoardTempValidORV /end REF_MEASUREMENT /end GROUP
/begin GROUP S375_DetermineRatioPEUtoBat "VBU0513/VBUSystem/BMS/CTD/Subsystem/Subsystem4/DiagnoseRelayWeld/DetermineRatioPEUtoBat"
 /begin REF_CHARACTERISTIC CcCTD_PEUMessageDataValidDelay_ms CcCTD_PEURVtoBatVThresholdLower_pct CcCTD_PEURVtoBatVThresholdUpper_pct /end REF_CHARACTERISTIC
/end GROUP
/begin GROUP S375_MNC_Weld_Check "VBU0513/VBUSystem/BMS/CTD/Subsystem/Subsystem4/DiagnoseRelayWeld/MNC_Weld_Check"
 /begin SUB_GROUP S387_CONTACTOR_STATUS_OPENED1 S387_Determine_Diagnostic_Status S387_Equal_to_LOW1 /end SUB_GROUP
 /begin REF_CHARACTERISTIC CbCTD_MnNegContactorWeldFaultEnable_flg CcCTD_MNCWeldTestEnablePEURVoltageRatio_pct CcCTD_MnNegContactorCloseDeltaVoltage_V CcCTD_MnNegContactorWeldFaultFIC_n CcCTD_MnNegContactorWeldFaultPIC_n /end REF_CHARACTERISTIC
 /begin REF_MEASUREMENT LbCTD_MnNegContactorWeldTestFail_flg /end REF_MEASUREMENT
/end GROUP
/begin GROUP S375_MPC_Weld_Check "VBU0513/VBUSystem/BMS/CTD/Subsystem/Subsystem4/DiagnoseRelayWeld/MPC_Weld_Check"
 /begin SUB_GROUP S388_CONTACTOR_STATUS_OPENED S388_CONTACTOR_STATUS_OPENED1 S388_Determine_Diagnostic_Status S388_Equal_to_LOW1 S388_Equal_to_LOW2 /end SUB_GROUP
 /begin REF_CHARACTERISTIC CbCTD_MnPosContactorWeldFaultEnable_flg CcCTD_MnPosContactorCloseDeltaVoltage_V CcCTD_MnPosContactorWeldFaultFIC_n CcCTD_MnPosContactorWeldFaultPIC_n /end REF_CHARACTERISTIC
 /begin REF_MEASUREMENT CTD_MnPosContactorWeldTestEnable_flg CTD_stMnPosContactorWeldFault /end REF_MEASUREMENT
/end GROUP
/begin GROUP S377_Determine_Fail_Lockout "VBU0513/VBUSystem/BMS/CTD/Subsystem/Subsystem4/Lockout_Precharge_Process/Determine_Fail_Lockout"
 /begin REF_CHARACTERISTIC CTD_PRECHARGE_STATUS_CHARGING CcCTD_PrechargeFailLockoutInterval_s /end REF_CHARACTERISTIC
/end GROUP
/begin GROUP S377_Determine_Lockout_Time "VBU0513/VBUSystem/BMS/CTD/Subsystem/Subsystem4/Lockout_Precharge_Process/Determine_Lockout_Time" /begin REF_MEASUREMENT CTD_tisPrechargeLockoutTime /end REF_MEASUREMENT /end GROUP
/begin GROUP S377_Determine_Overload_Lockout "VBU0513/VBUSystem/BMS/CTD/Subsystem/Subsystem4/Lockout_Precharge_Process/Determine_Overload_Lockout"
 /begin REF_CHARACTERISTIC CbCTD_PrechargeOverEnergyLockoutEnable_flg CcCTD_PrechargeOverEnergyLockoutInterval_s /end REF_CHARACTERISTIC
/end GROUP
/begin GROUP S377_HeatProtection_Lockout "VBU0513/VBUSystem/BMS/CTD/Subsystem/Subsystem4/Lockout_Precharge_Process/HeatProtection_Lockout"
 /begin SUB_GROUP S428_Determine_Heat_LockTime S428_Determine_LockPoint_AvaliableHeat /end SUB_GROUP
/end GROUP
/begin GROUP S378_Determine_Diagnostic_Status "VBU0513/VBUSystem/BMS/CTD/Subsystem/Subsystem4/MainFuseDiagnostic/Determine_Diagnostic_Status" /begin REF_CHARACTERISTIC CcFDC_MaxCount_n CcFDC_MinCount_n DIAGNOSTIC_ON_GOING /end REF_CHARACTERISTIC /begin REF_MEASUREMENT CTD_stMainFuseBlownDiagnosticStatus /end REF_MEASUREMENT /end GROUP
/begin GROUP S379_Determine_Diagnostic_Status "VBU0513/VBUSystem/BMS/CTD/Subsystem/Subsystem4/Precharge_Resistance_Diagnostic/Determine_Diagnostic_Status" /begin REF_CHARACTERISTIC CcFDC_MaxCount_n CcFDC_MinCount_n DIAGNOSTIC_ON_GOING /end REF_CHARACTERISTIC /begin REF_MEASUREMENT CTD_stPrechargeRelayBlownDiagnosticStatus /end REF_MEASUREMENT /end GROUP
/begin GROUP S380_Determine_PrechargeDiag_Disable "VBU0513/VBUSystem/BMS/CTD/Subsystem/Subsystem4/PrechrgProcessMonitoring/Determine_PrechargeDiag_Disable" /begin REF_CHARACTERISTIC CcCTD_VehSpdPrechargeDiag_kmh /end REF_CHARACTERISTIC /begin REF_MEASUREMENT CTD_flgDisablePrechargeDiagInAbnormalPowerOff /end REF_MEASUREMENT /end GROUP
/begin GROUP S380_Determine_Precharge_Timer "VBU0513/VBUSystem/BMS/CTD/Subsystem/Subsystem4/PrechrgProcessMonitoring/Determine_Precharge_Timer" /begin REF_MEASUREMENT CTD_tiLastPrechargeStartTime CTD_timsPrechargeTimer /end REF_MEASUREMENT /end GROUP
/begin GROUP S380_Determine_Ratio_BusVBatV "VBU0513/VBUSystem/BMS/CTD/Subsystem/Subsystem4/PrechrgProcessMonitoring/Determine_Ratio_BusVBatV" /begin REF_MEASUREMENT CTD_pctBusOfBatteryVoltage /end REF_MEASUREMENT /end GROUP
/begin GROUP S380_Precharge_Thermal_Management "VBU0513/VBUSystem/BMS/CTD/Subsystem/Subsystem4/PrechrgProcessMonitoring/Precharge_Thermal_Management"
 /begin SUB_GROUP S454_Determine_Precharge_JouleHeat S454_Perform_OverEnergy_Diagnostic /end SUB_GROUP
/end GROUP
/begin GROUP S380_Precharge_Timeout_Diagnostic "VBU0513/VBUSystem/BMS/CTD/Subsystem/Subsystem4/PrechrgProcessMonitoring/Precharge_Timeout_Diagnostic"
 /begin REF_CHARACTERISTIC CbCTD_PrechargeTimeoutFaultEnable_flg CcCTD_PrechargeTimeoutFaultFIC_n CcCTD_PrechargeTimeoutFaultPIC_n /end REF_CHARACTERISTIC
 /begin REF_MEASUREMENT CTD_stPrechargeTimeoutFault /end REF_MEASUREMENT
/end GROUP
/begin GROUP S380_Precharging_Process_Monitoring "VBU0513/VBUSystem/BMS/CTD/Subsystem/Subsystem4/PrechrgProcessMonitoring/Precharging_Process_Monitoring"
 /begin SUB_GROUP S456_Status_Charging S456_Status_Fail S456_Status_Idle S456_Status_Success /end SUB_GROUP
 /begin REF_CHARACTERISTIC CcCTD_PrechargeSuccessMax_pct CcCTD_PrechargeSuccessMin_pct CcCTD_PrechargeTimeMax_ms /end REF_CHARACTERISTIC
 /begin REF_MEASUREMENT CTD_stPrechargeStatus /end REF_MEASUREMENT
/end GROUP
/begin GROUP S381_MNC_Stuck_Open "VBU0513/VBUSystem/BMS/CTD/Subsystem/Subsystem4/Stuck_Open_Diagnostic/MNC_Stuck_Open"
 /begin SUB_GROUP S476_MNC_Stuck_Open_With_VehicleSpeed S476_MNC_Stuck_Open_Without_VehicleSpeed /end SUB_GROUP
/end GROUP
/begin GROUP S381_MPC_Stuck_Open "VBU0513/VBUSystem/BMS/CTD/Subsystem/Subsystem4/Stuck_Open_Diagnostic/MPC_Stuck_Open"
 /begin SUB_GROUP S477_MPC_Stuck_Open_Within_VehicleSpeed S477_MPC_Stuck_Open_Without_VehicleSpeed /end SUB_GROUP
/end GROUP
/begin GROUP S381_MPR_Stuck_Open "VBU0513/VBUSystem/BMS/CTD/Subsystem/Subsystem4/Stuck_Open_Diagnostic/MPR_Stuck_Open"
 /begin SUB_GROUP S478_CONTACTOR_STATUS_CLOSED1 S478_Determine_Diagnostic_Status S478_Equal_to_HIGH /end SUB_GROUP
 /begin REF_CHARACTERISTIC CbCTD_PrechargeRelayStuckOpenFaultEnable_flg CcCTD_PrechargeRelayStuckOpenDeltaVoltage_V CcCTD_PrechargeRelayStuckOpenFaultFIC_n CcCTD_PrechargeRelayStuckOpenFaultPIC_n /end REF_CHARACTERISTIC
 /begin REF_MEASUREMENT CTD_stPrechargeRelayStuckOpenFault /end REF_MEASUREMENT
/end GROUP
/begin GROUP S381_StuckOpenAssistantConditons "VBU0513/VBUSystem/BMS/CTD/Subsystem/Subsystem4/Stuck_Open_Diagnostic/StuckOpenAssistantConditons"
 /begin REF_CHARACTERISTIC CcCTD_MessageDataValidDelay_ms CcCTD_MnCntcStuckOpenVhclSpdThreshold_kmh CcCTD_PEURDCVoltageThreshold_V /end REF_CHARACTERISTIC
/end GROUP
/begin GROUP S547_EVM_FDC_Handler1 "VBU0513/VBUSystem/BMS/CTM/CTM/Subsystem/Determine_CellTemp_OverDeviationFaults/EVM_FDC_Handler1" /begin SUB_GROUP S559_DetermineFault S559_DetermineFaultCounter /end SUB_GROUP /end GROUP
/begin GROUP S548_EVM_FDC_Handler "VBU0513/VBUSystem/BMS/CTM/CTM/Subsystem/Determine_CellTemp_OverUnderFaults/EVM_FDC_Handler" /begin SUB_GROUP S569_DetermineFault S569_DetermineFaultCounter /end SUB_GROUP /end GROUP
/begin GROUP S550_CellThermalRunaway_FaultArrayCheck "VBU0513/VBUSystem/BMS/CTM/CTM/Subsystem/Determine_Thermal_Runaway/CellThermalRunaway_FaultArrayCheck"
 /begin REF_CHARACTERISTIC CTM_CELL_THERMAL_RUNAWAY_FAULT CbCTM_CellThermalRunawayEnable_flg CbCTM_ThermalRunawayTestFailORF_flg CbCTM_ThermalRunawayTestFailORV_flg CcCTM_ThermalRunawayFaultFIC_n CcCTM_ThermalRunawayFaultPIC_n CcCTM_ThermalRunawayValidDelayTime_ms /end REF_CHARACTERISTIC
/end GROUP
/begin GROUP S550_DetermineCellTempOver "VBU0513/VBUSystem/BMS/CTM/CTM/Subsystem/Determine_Thermal_Runaway/DetermineCellTempOver"
 /begin REF_CHARACTERISTIC CcCTM_ThermalRunawayOverTemp_C CcCTM_ThermalRunawayResetTemp_C CcCTM_ThermalRunawayTempRiseDelayTime_ms /end REF_CHARACTERISTIC
/end GROUP
/begin GROUP S550_DetermineTempRiseRate "VBU0513/VBUSystem/BMS/CTM/CTM/Subsystem/Determine_Thermal_Runaway/DetermineTempRiseRate" /begin SUB_GROUP S593_CellTemp_ChangeRate_Calculate /end SUB_GROUP
 /begin REF_CHARACTERISTIC CcCTM_CellThermalRunawayFaultFIC_n CcCTM_CellThermalRunawayFaultPIC_n /end REF_CHARACTERISTIC
/end GROUP
/begin GROUP S550_TriggerCycle "VBU0513/VBUSystem/BMS/CTM/CTM/Subsystem/Determine_Thermal_Runaway/TriggerCycle" /begin REF_CHARACTERISTIC CcCTM_ThermalRunawayTriggerTime_ms /end REF_CHARACTERISTIC /end GROUP
/begin GROUP S621_Cell_DataValid_Check "VBU0513/VBUSystem/BMS/CTS/CTS/Subsystem/DeterminePrechargeConditions/Cell_DataValid_Check"
 /begin REF_CHARACTERISTIC CbCTS_CellDataInvalidSerialCheckEnable_flg CcSYS_NoOfInvalidCellVoltages_n /end REF_CHARACTERISTIC
 /begin REF_MEASUREMENT CTS_CellDataInvalidInhibitPrecharge_flg /end REF_MEASUREMENT
/end GROUP
/begin GROUP S621_Energy_Protection_Check "VBU0513/VBUSystem/BMS/CTS/CTS/Subsystem/DeterminePrechargeConditions/Energy_Protection_Check"
 /begin REF_CHARACTERISTIC CbCTS_EnergyProtectEnable_flg CcCTS_BatteryDisplaySocLimit_pct CcCTS_BatteryVoltageMinLimit_V CcCTS_CellVoltageMinLimitDelta_mV CcCTS_CellVoltageMinLimit_mV CcCTS_SocMinLimit_pct /end REF_CHARACTERISTIC
 /begin REF_MEASUREMENT CTS_flgEnergyProtectInhibitPrecharge /end REF_MEASUREMENT
/end GROUP
/begin GROUP S621_Fault_Check "VBU0513/VBUSystem/BMS/CTS/CTS/Subsystem/DeterminePrechargeConditions/Fault_Check" /begin REF_CHARACTERISTIC CmSYS_BatteryPowerOffFaultCat_enum /end REF_CHARACTERISTIC
 /begin REF_MEASUREMENT LbCTS_FaultAbortPrecharge_flg LbCTS_FaultInhibitPrecharge_flg /end REF_MEASUREMENT
/end GROUP
/begin GROUP S621_HV_DataValid_Check "VBU0513/VBUSystem/BMS/CTS/CTS/Subsystem/DeterminePrechargeConditions/HV_DataValid_Check" /begin REF_MEASUREMENT CTS_flgHVDataInvalidInhibitPrecharge /end REF_MEASUREMENT /end GROUP
/begin GROUP S621_HV_Safety_Check "VBU0513/VBUSystem/BMS/CTS/CTS/Subsystem/DeterminePrechargeConditions/HV_Safety_Check" /begin REF_MEASUREMENT LbCTS_HVSafetyStatusInhibitPrecharge_flg /end REF_MEASUREMENT /end GROUP
/begin GROUP S621_Precharge_Inhibit_Abort "VBU0513/VBUSystem/BMS/CTS/CTS/Subsystem/DeterminePrechargeConditions/Precharge_Inhibit_Abort" /begin SUB_GROUP S631_Combine_Precharge_Conditions /end SUB_GROUP /end GROUP
/begin GROUP S621_SoC_Initialization_Check "VBU0513/VBUSystem/BMS/CTS/CTS/Subsystem/DeterminePrechargeConditions/SoC_Initialization_Check"
 /begin REF_CHARACTERISTIC CbCTS_SocInitialInhibitEnable_flg CcCTS_SocInitialDelayTime_s /end REF_CHARACTERISTIC
 /begin REF_MEASUREMENT CTS_SocInitialInhibitPrecharge_flg /end REF_MEASUREMENT
/end GROUP
/begin GROUP S622_Close_Comamnd "VBU0513/VBUSystem/BMS/CTS/CTS/Subsystem/Determine_Contactor_Request/Close_Comamnd"
 /begin REF_CHARACTERISTIC BMM_STATE_POWER_SWAP CbCTS_ContactorComandBypassBMUModeEnable_flg CcCTS_ContactorRequestCloseDelay_ms /end REF_CHARACTERISTIC
/end GROUP
/begin GROUP S652_EVM_FDC_Handler "VBU0513/VBUSystem/BMS/CVT/CVT/Subsystem/Determine_CellVoltage_OverUnderFaults/EVM_FDC_Handler" /begin SUB_GROUP S659_DetermineFault S659_DetermineFaultCounter /end SUB_GROUP /end GROUP
/begin GROUP S652_EVM_FDC_Handler1 "VBU0513/VBUSystem/BMS/CVT/CVT/Subsystem/Determine_CellVoltage_OverUnderFaults/EVM_FDC_Handler1" /begin SUB_GROUP S660_DetermineFault S660_DetermineFaultCounter /end SUB_GROUP /end GROUP
/begin GROUP S652_EVM_FDC_Handler2 "VBU0513/VBUSystem/BMS/CVT/CVT/Subsystem/Determine_CellVoltage_OverUnderFaults/EVM_FDC_Handler2" /begin SUB_GROUP S661_DetermineFault S661_DetermineFaultCounter /end SUB_GROUP /end GROUP
/begin GROUP S654_Determine_CSCCellVoltage_DeviationDynamicBDM "VBU0513/VBUSystem/BMS/CVT/CVT/Subsystem/Monitor_CVT_DeviationDynamic/Determine_CSCCellVoltage_DeviationDynamicBDM" /begin REF_CHARACTERISTIC CcCVT_BdmDelayTime_ms CcCVT_BdmVoltageDeviationDynamic_mV /end REF_CHARACTERISTIC /end GROUP
/begin GROUP S655_Determine_CellVoltage_OverDeviationBDM "VBU0513/VBUSystem/BMS/CVT/CVT/Subsystem/Monitor_CVT_Performance/Determine_CellVoltage_OverDeviationBDM" /begin SUB_GROUP S690_BigDataMonitor_Handler1 /end SUB_GROUP
 /begin REF_CHARACTERISTIC CbCVT_BdmCellVoltageOverDeviationFaultEnable_flg CcCVT_BdmCellVoltageOverDeviationDisableCrrnt_A CcCVT_BdmCellVoltageOverDeviationFaultFIC_n CcCVT_BdmCellVoltageOverDeviationFaultPIC_n CcCVT_BdmCellVoltageOverDeviationFault_mV CcCVT_BdmDelayTime_ms /end REF_CHARACTERISTIC
/end GROUP
/begin GROUP S655_Determine_CellVoltage_OverUnderBDM "VBU0513/VBUSystem/BMS/CVT/CVT/Subsystem/Monitor_CVT_Performance/Determine_CellVoltage_OverUnderBDM" /begin SUB_GROUP S691_BigDataMonitor_Handler S691_BigDataMonitor_Handler2 /end SUB_GROUP
 /begin REF_CHARACTERISTIC CbCVT_BdmCellOverVoltageFaultEnable_flg CbCVT_BdmCellUnderVoltageFaultEnable_flg CcCVT_BdmCellOverVoltageFaultFIC_n CcCVT_BdmCellOverVoltageFaultPIC_n CcCVT_BdmCellOverVoltageFault_mV CcCVT_BdmCellUnderVoltageFaultFIC_n CcCVT_BdmCellUnderVoltageFaultPIC_n CcCVT_BdmCellUnderVoltageFault_mV CcCVT_BdmDelayTime_ms /end REF_CHARACTERISTIC
/end GROUP
/begin GROUP S711_For_Iterator_Subsystem "VBU0513/VBUSystem/BMS/DSM/Subsystem10/Subsystem/Determine_Abnormal_In_PeriodicalUpload/For_Iterator_Subsystem" /begin REF_CHARACTERISTIC CaDSM_CycleUploadAbnormalEvent_flg /end REF_CHARACTERISTIC /end GROUP
/begin GROUP S712_For_Iterator_Subsystem "VBU0513/VBUSystem/BMS/DSM/Subsystem10/Subsystem/Determine_CSC_Inhibit/For_Iterator_Subsystem" /begin REF_CHARACTERISTIC CaDSM_CscValueUncertainFault_flg /end REF_CHARACTERISTIC /end GROUP
/begin GROUP S714_Clear_Fault_Category "VBU0513/VBUSystem/BMS/DSM/Subsystem10/Subsystem/Determine_Fault_Category/Clear_Fault_Category" /begin REF_CHARACTERISTIC FAULT_CAT_NONE /end REF_CHARACTERISTIC /begin REF_MEASUREMENT DSM_stFaultCat /end REF_MEASUREMENT /end GROUP
/begin GROUP S716_Clear_MIL_Request "VBU0513/VBUSystem/BMS/DSM/Subsystem10/Subsystem/Determine_MIL_Request/Clear_MIL_Request" /begin REF_MEASUREMENT DSM_flgMILRequest /end REF_MEASUREMENT /end GROUP
/begin GROUP S716_Determine_Local_MILRequest "VBU0513/VBUSystem/BMS/DSM/Subsystem10/Subsystem/Determine_MIL_Request/Determine_Local_MILRequest" /begin REF_CHARACTERISTIC CmDSM_MILFaultCat_enum FAULT_CAT_NONE /end REF_CHARACTERISTIC /end GROUP
/begin GROUP S717_For_Iterator_Subsystem "VBU0513/VBUSystem/BMS/DSM/Subsystem10/Subsystem/Determine_No_Charge/For_Iterator_Subsystem" /begin REF_CHARACTERISTIC CaDSM_NoChargeFault_flg /end REF_CHARACTERISTIC /end GROUP
/begin GROUP S742_Calculate_FastChargeBaseRemainTime "VBU0513/VBUSystem/BMS/FCC /FCC/Subsystem/Calculate_Fastcharge_Time/Calculate_FastChargeBaseRemainTime"
 /begin REF_CHARACTERISTIC CaFCC_CurrentLimitRemainChargeTimeSocTempMapDimension_n CaFCC_CurrentLimitRemainChargeTimeSocTempMapZ_min CaFCC_IdealRemainChargeTimeSocTempMapDimension_n CaFCC_IdealRemainChargeTimeSocTempMapZ_min CcFCC_BatteryCapacityCycle1_n CcFCC_BatteryCapacityCycle2_n CcFCC_CustomSetSOCEnable_pct CcFCC_FullChargeSoc1_pct CcFCC_FullChargeSoc2_pct CcFCC_FullChargeSoc3_pct MINUTES_PER_HOUR /end REF_CHARACTERISTIC
 /begin REF_MEASUREMENT FCC_timinFastChargeBaseRemainTime /end REF_MEASUREMENT
/end GROUP
/begin GROUP S742_EightyPercentCustomSOC_CaculateChargeTime "VBU0513/VBUSystem/BMS/FCC /FCC/Subsystem/Calculate_Fastcharge_Time/EightyPercentCustomSOC_CaculateChargeTime"
 /begin REF_CHARACTERISTIC CaFCC_CurrentLimitRemainChargeTimeSocTempMapDimension_n CaFCC_CurrentLimitRemainChargeTimeSocTempMapZ_min CaFCC_IdealRemainChargeTimeSocTempMapDimension_n CaFCC_IdealRemainChargeTimeSocTempMapZ_min MINUTES_PER_HOUR /end REF_CHARACTERISTIC
 /begin REF_MEASUREMENT LcFCC_timinEstimatePercTime /end REF_MEASUREMENT
/end GROUP
/begin GROUP S742_EightyPercentCustomSOC_EnableInvalidChargeTimeFlag "VBU0513/VBUSystem/BMS/FCC /FCC/Subsystem/Calculate_Fastcharge_Time/EightyPercentCustomSOC_EnableInvalidChargeTimeFlag" /begin REF_CHARACTERISTIC CcFCC_CurrentValueCrossZeroFlagDelay_ms /end REF_CHARACTERISTIC /begin REF_MEASUREMENT LbFCC_flgInvalidEstimatedChargeTimeCFT /end REF_MEASUREMENT /end GROUP
/begin GROUP S742_EightyPercentCustomSOC_UpdateChargeTimeFlag "VBU0513/VBUSystem/BMS/FCC /FCC/Subsystem/Calculate_Fastcharge_Time/EightyPercentCustomSOC_UpdateChargeTimeFlag"
 /begin REF_CHARACTERISTIC CaFCC_EstimateChargingTimeDeltaMapY_min CcFCC_EstimateChargeTimeCurrent_A CcFCC_EstimateChargeTimeRefresh_s /end REF_CHARACTERISTIC
 /begin REF_MEASUREMENT FCC_flgPackCurrentUpdatePercTime /end REF_MEASUREMENT
/end GROUP
/begin GROUP S742_EstimateChargeTime_CellVoltageMax_Coefficient "VBU0513/VBUSystem/BMS/FCC /FCC/Subsystem/Calculate_Fastcharge_Time/EstimateChargeTime_CellVoltageMax_Coefficient"
 /begin REF_CHARACTERISTIC CcFCC_CellVoltageMaxCorrectEndDelta_mV CcFCC_CellVoltageMaxCorrectMiddleDelta_mV CcFCC_CellVoltageMaxCorrectStartDelta_mV CcFCC_CellVoltageMaxFactorEnd_nbr CcFCC_CellVoltageMaxFactorMiddle_nbr CcFCC_CellVoltageMaxFactorStart_nbr /end REF_CHARACTERISTIC
/end GROUP
/begin GROUP S742_EstimateChargeTime_CellVoltageMax_Slop "VBU0513/VBUSystem/BMS/FCC /FCC/Subsystem/Calculate_Fastcharge_Time/EstimateChargeTime_CellVoltageMax_Slop"
 /begin REF_CHARACTERISTIC CcFCC_CellVoltageMaxCorrectSlopMax_nbr CcFCC_CellVoltageMaxCorrectSlopMin_nbr /end REF_CHARACTERISTIC
/end GROUP
/begin GROUP S742_SOC_Mapping "VBU0513/VBUSystem/BMS/FCC /FCC/Subsystem/Calculate_Fastcharge_Time/SOC_Mapping"
 /begin SUB_GROUP S754_EqualPorportionMapping3 S754_EqualPorportionMapping4 S754_EqualPorportionMapping5 /end SUB_GROUP
/end GROUP
/begin GROUP S742_SendInvalidTime_flg "VBU0513/VBUSystem/BMS/FCC /FCC/Subsystem/Calculate_Fastcharge_Time/SendInvalidTime_flg" /begin REF_CHARACTERISTIC CcFCC_CurrentValueCrossZeroFlagDelay_ms /end REF_CHARACTERISTIC /begin REF_MEASUREMENT FCC_flgInvalidEstimatedChargeTime /end REF_MEASUREMENT /end GROUP
/begin GROUP S742_UpdateTimeTrigger "VBU0513/VBUSystem/BMS/FCC /FCC/Subsystem/Calculate_Fastcharge_Time/UpdateTimeTrigger"
 /begin REF_CHARACTERISTIC CaFCC_EstimateChargingTimeDeltaMapY_min CcFCC_EstimateChargeTimeCurrent_A CcFCC_EstimateChargeTimeRefresh_s /end REF_CHARACTERISTIC
/end GROUP
/begin GROUP S742_Update_CustomSOC100RemainTime "VBU0513/VBUSystem/BMS/FCC /FCC/Subsystem/Calculate_Fastcharge_Time/Update_CustomSOC100RemainTime" /begin REF_CHARACTERISTIC CcFCC_MaxValidChargeTime_min /end REF_CHARACTERISTIC /end GROUP
/begin GROUP S742_Update_CustomSOC80RemainTime "VBU0513/VBUSystem/BMS/FCC /FCC/Subsystem/Calculate_Fastcharge_Time/Update_CustomSOC80RemainTime" /begin REF_CHARACTERISTIC CcFCC_MaxValidChargeTime_min /end REF_CHARACTERISTIC /end GROUP
/begin GROUP S743_Charge_Request_Protection "VBU0513/VBUSystem/BMS/FCC /FCC/Subsystem/Determine_Fastcharge_Request/Charge_Request_Protection"
 /begin SUB_GROUP S798_Decrease_ChargeCurrentRequest S798_Override_Block1 S798_Override_Voltage_Request S798_Rate_Limiter /end SUB_GROUP
 /begin REF_CHARACTERISTIC CcFCC_ChargePowerDecRate_Kw CcFCC_ChargePowerIncRate_Kw CcFCC_ComputeResistanceCurrentDecRate_A CcFCC_ComputeResistanceCurrentIncRate_A CcFCC_NoChargeHighTemp_C CcFCC_NoChargeLowTemp_C /end REF_CHARACTERISTIC
 /begin REF_MEASUREMENT FCC_iAChargeCurrentRequestFnl /end REF_MEASUREMENT
/end GROUP
/begin GROUP S743_DetermineComputeResistancePulseCurrent "VBU0513/VBUSystem/BMS/FCC /FCC/Subsystem/Determine_Fastcharge_Request/DetermineComputeResistancePulseCurrent"
 /begin SUB_GROUP S799_Determine_ComputeResistanceCondition S799_Determine_ComputeResistancePulseRequest S799_Determine_FastChargeRequest /end SUB_GROUP
/end GROUP
/begin GROUP S743_Determine_Base_ChargeRequest "VBU0513/VBUSystem/BMS/FCC /FCC/Subsystem/Determine_Fastcharge_Request/Determine_Base_ChargeRequest" /begin SUB_GROUP S800_Request_At_Charging S800_Request_At_NoCharging /end SUB_GROUP
 /begin REF_MEASUREMENT FCC_iABaseChargeCurrentRequest FCC_kwBaseChargePowerRequest FCC_uBaseChargeVoltageRequest /end REF_MEASUREMENT
/end GROUP
/begin GROUP S743_Determine_DiagnosedAndLimitedChargeRequestCurrent "VBU0513/VBUSystem/BMS/FCC /FCC/Subsystem/Determine_Fastcharge_Request/Determine_DiagnosedAndLimitedChargeRequestCurrent"
 /begin REF_CHARACTERISTIC CcFCC_BatteryChargeCurrentFactor_n CcFCC_StandardPowerLimit_Kw CcFCC_TrickleChargeCurrent_A CcSYS_MappedCellCapacity_Ah /end REF_CHARACTERISTIC
 /begin REF_MEASUREMENT FCC_iAChargeRequestCurrentLimit /end REF_MEASUREMENT
/end GROUP
/begin GROUP S744_Condition_Categorize "VBU0513/VBUSystem/BMS/FCC /FCC/Subsystem/Fastcharge_Conditions_Check/Condition_Categorize"
 /begin SUB_GROUP S832_Cell_Temp_Protection S832_Full_Charge_Determination S832_Voltage_Protection /end SUB_GROUP
 /begin REF_CHARACTERISTIC CmFCC_NoChargeFaultCat_enum /end REF_CHARACTERISTIC
 /begin REF_MEASUREMENT FCC_flgChargeNoFault FCC_flgChargeProtection /end REF_MEASUREMENT
/end GROUP
/begin GROUP S744_Determine_NoCharge_Cause "VBU0513/VBUSystem/BMS/FCC /FCC/Subsystem/Fastcharge_Conditions_Check/Determine_NoCharge_Cause"
 /begin REF_CHARACTERISTIC CmFCC_NoChargeCellTempHigh_enum CmFCC_NoChargeCellTempLow_enum CmFCC_NoChargeFault_enum CmFCC_NoChargeVoltageHigh_enum /end REF_CHARACTERISTIC
 /begin REF_MEASUREMENT FCC_flgChargeAvailable FCC_stNoChargeCause /end REF_MEASUREMENT
/end GROUP
/begin GROUP S924_Determine_OCV_Criteria "VBU0513/VBUSystem/BMS/OCV/OCV/Subsystem/Determine_Criteria/Determine_OCV_Criteria" /begin REF_MEASUREMENT OCV_flgOcvCriteriaMet /end REF_MEASUREMENT /end GROUP
/begin GROUP S924_Determine_QOCV_Criteria "VBU0513/VBUSystem/BMS/OCV/OCV/Subsystem/Determine_Criteria/Determine_QOCV_Criteria" /begin REF_CHARACTERISTIC CaOCV_QuasiOCVCurrentDimension_n CaOCV_QuasiOCVCurrentZ_A /end REF_CHARACTERISTIC /begin REF_MEASUREMENT OCV_flgQuasiOcvCriteria /end REF_MEASUREMENT /end GROUP
/begin GROUP S961_Determine_AhIntegral_Capacity "VBU0513/VBUSystem/BMS/SOC/Subsystem5/Subsystem/Determine_AhIntegral_SoC/Determine_AhIntegral_Capacity" /begin SUB_GROUP S986_Determine_Cell_Balanced_Capacity /end SUB_GROUP
 /begin REF_CHARACTERISTIC CcSOC_MaxBalancedCapacity_As CcSOC_MaxCurrentIntegral_As CcSOC_MinBalancedCapacity_As CcSOC_MinCurrentIntegral_As /end REF_CHARACTERISTIC
/end GROUP
/begin GROUP S961_Determine_AhIntegral_SOC "VBU0513/VBUSystem/BMS/SOC/Subsystem5/Subsystem/Determine_AhIntegral_SoC/Determine_AhIntegral_SOC"
 /begin REF_CHARACTERISTIC CbSOC_CellCapacityOvrdFlg_flg CcSOC_CellCapacityOvrdVal_Ah SECONDS_PER_HOUR /end REF_CHARACTERISTIC
 /begin REF_MEASUREMENT LaSOC_pctCellSocCurrentIntegral /end REF_MEASUREMENT
/end GROUP
/begin GROUP S961_Determine_Module_Current "VBU0513/VBUSystem/BMS/SOC/Subsystem5/Subsystem/Determine_AhIntegral_SoC/Determine_Module_Current" /begin SUB_GROUP S988_CONTACTOR_STATUS_OPENED1 /end SUB_GROUP /begin REF_MEASUREMENT SOC_iAModuleCurrent /end REF_MEASUREMENT /end GROUP
/begin GROUP S966_Determine_BatterySOC_ChangeRate "VBU0513/VBUSystem/BMS/SOC/Subsystem5/Subsystem/Determine_Display_SOC/Determine_BatterySOC_ChangeRate" /begin REF_CHARACTERISTIC SECONDS_PER_HOUR /end REF_CHARACTERISTIC /end GROUP
/begin GROUP S966_DisplaySOC_Driving_Calculation "VBU0513/VBUSystem/BMS/SOC/Subsystem5/Subsystem/Determine_Display_SOC/DisplaySOC_Driving_Calculation" /begin SUB_GROUP S1021_Determine_SOC_RateLimit /end SUB_GROUP /begin REF_CHARACTERISTIC CcSOC_ChargeStateDelay_ms /end REF_CHARACTERISTIC /end GROUP
/begin GROUP S966_DisplaySOC_Startup_Calculation "VBU0513/VBUSystem/BMS/SOC/Subsystem5/Subsystem/Determine_Display_SOC/DisplaySOC_Startup_Calculation"
 /begin REF_CHARACTERISTIC CcSOC_BatteryDisplaySocUpdateInterval_s CcSOC_InvalidLastShutdownTime_s /end REF_CHARACTERISTIC
 /begin REF_MEASUREMENT SOC_flgRelaxationST /end REF_MEASUREMENT
/end GROUP
/begin GROUP S966_NoJumpSOC_Startup_Calculation "VBU0513/VBUSystem/BMS/SOC/Subsystem5/Subsystem/Determine_Display_SOC/NoJumpSOC_Startup_Calculation"
 /begin REF_CHARACTERISTIC CcSOC_BatteryDisplaySocUpdateInterval_s CcSOC_InvalidLastShutdownTime_s /end REF_CHARACTERISTIC
/end GROUP
/begin GROUP S3647_Wakeup "VBU0513/VBUSystem/VCU /PMM/PMM_Ctrl/LvWakeUp_Ctrl/LvWakeUp_State_Calc/Wakeup" /begin REF_CHARACTERISTIC PMM_tiDlySWReset_C /end REF_CHARACTERISTIC /end GROUP
/begin GROUP S3698_PwrUpRoutine "VBU0513/VBUSystem/VCU /PMM/PMM_Ctrl/PwrMod_Ctrl/Routine/PwrUpRoutine"
 /begin REF_CHARACTERISTIC DIAGS_stNRCFail_SY DIAGS_stPsvRespIn_SY DIAGS_stPsvRespNok_SY DIAGS_stPsvRespOk_SY /end REF_CHARACTERISTIC
/end GROUP
/begin GROUP S3698_Routine_PwrDwn "VBU0513/VBUSystem/VCU /PMM/PMM_Ctrl/PwrMod_Ctrl/Routine/Routine_PwrDwn"
 /begin REF_CHARACTERISTIC DIAGS_stNRCFail_SY DIAGS_stPsvRespIn_SY DIAGS_stPsvRespNok_SY DIAGS_stPsvRespOk_SY /end REF_CHARACTERISTIC
/end GROUP
/begin GROUP S3698_Rouutine_RActiveDis "VBU0513/VBUSystem/VCU /PMM/PMM_Ctrl/PwrMod_Ctrl/Routine/Rouutine_RActiveDis"
 /begin REF_CHARACTERISTIC DIAGS_stNRCFail_SY DIAGS_stPsvRespIn_SY DIAGS_stPsvRespNok_SY DIAGS_stPsvRespOk_SY /end REF_CHARACTERISTIC
/end GROUP
/begin GROUP S3749_SlopeCal "VBU0513/VBUSystem/VCU /SPD/SPD/SignalProcessing_10ms/SlopeCal1/SlopeCal" /begin REF_CHARACTERISTIC SYS_stShftPosDrv_SY SYS_stShftPosRev_SY /end REF_CHARACTERISTIC /end GROUP
/begin GROUP S3751_RearWhl "VBU0513/VBUSystem/VCU /SPD/SPD/SignalProcessing_10ms/VehDir/RearWhl" /begin REF_CHARACTERISTIC SYS_stShftPosDrv_SY SYS_stShftPosRev_SY /end REF_CHARACTERISTIC /end GROUP
/begin GROUP S3752_Normal_VehSpdCal "VBU0513/VBUSystem/VCU /SPD/SPD/SignalProcessing_10ms/VehSpdNorm/Normal_VehSpdCal" /begin REF_CHARACTERISTIC SYS_facRPM2KPH_SY /end REF_CHARACTERISTIC /end GROUP
/begin GROUP S3752_nMotr2vVeh "VBU0513/VBUSystem/VCU /SPD/SPD/SignalProcessing_10ms/VehSpdNorm/nMotr2vVeh" /begin REF_CHARACTERISTIC SYS_facRPM2KPH_SY /end REF_CHARACTERISTIC /end GROUP
/begin GROUP S3879_CrpRgnTrqArb "VBU0513/VBUSystem/VCU /TQD/TrqDem/TrqDem_DrvTrq_Cal/TrqDem_MinTrq_Cal/CrpRgnTrqArb" /begin REF_CHARACTERISTIC SYS_stShftPosDrv_SY SYS_stShftPosRev_SY /end REF_CHARACTERISTIC /end GROUP
/begin GROUP S4024_FIDTrqLim "VBU0513/VBUSystem/VCU /VTQA/Subsystem/MTrqLim/TrqCapacityLim/FIDTrqLim" /begin REF_CHARACTERISTIC MTQL_trqPEURDrvUpLim_C /end REF_CHARACTERISTIC /end GROUP
/begin GROUP S4266_BPD_BrakeSwitchSelect "VBU0513/VBUSystem/VCU /VehINP/VehINP_Logic/VehINP_BPD/BPD_BrakeSwitch/BPD_BrakeSwitchSelect" /begin REF_CHARACTERISTIC BPD_stBrkPedPrsNoActv_C /end REF_CHARACTERISTIC /end GROUP
/begin GROUP S4267_DiagBrkPosDft "VBU0513/VBUSystem/VCU /VehINP/VehINP_Logic/VehINP_BPD/BPD_BrkSwtPosPlausibilityCheck/DiagBrkPosDft" /begin REF_CHARACTERISTIC BPD_stBrkPedPrsNoActv_C /end REF_CHARACTERISTIC /end GROUP
/begin GROUP S186_Diagnose_BdmOutOfRange_Fault "VBU0513/VBUSystem/BMS/BCV/BCV/Subsystem/Monitor_BCV_Performance/Diagnose_BDM_BCV_Communication_Fault/Diagnose_BdmOutOfRange_Fault"
 /begin REF_CHARACTERISTIC BCV_BATTERY_VOLTAGE_SENSE_OOR_FAULT BCV_LEM_CURRENT_SENSE_OOR_FAULT /end REF_CHARACTERISTIC
/end GROUP
/begin GROUP S187_Diagnose_BdmBatteryBusVoltageMismatch_Fault "VBU0513/VBUSystem/BMS/BCV/BCV/Subsystem/Monitor_BCV_Performance/Diagnose_BDM_BCV_Data_Fault/Diagnose_BdmBatteryBusVoltageMismatch_Fault" /begin REF_CHARACTERISTIC BCV_BATTERY_BUS_VOLTAGE_MISMATCH_FAULT /end REF_CHARACTERISTIC /end GROUP
/begin GROUP S187_Diagnose_BdmVoltageCurrent_Fault "VBU0513/VBUSystem/BMS/BCV/BCV/Subsystem/Monitor_BCV_Performance/Diagnose_BDM_BCV_Data_Fault/Diagnose_BdmVoltageCurrent_Fault" /begin REF_CHARACTERISTIC BCV_BATTERY_UNDER_VOLTAGE_FAULT /end REF_CHARACTERISTIC /end GROUP
/begin GROUP S387_Determine_Diagnostic_Status "VBU0513/VBUSystem/BMS/CTD/Subsystem/Subsystem4/DiagnoseRelayWeld/MNC_Weld_Check/Determine_Diagnostic_Status" /begin REF_CHARACTERISTIC CcFDC_MaxCount_n CcFDC_MinCount_n DIAGNOSTIC_ON_GOING /end REF_CHARACTERISTIC /end GROUP
/begin GROUP S388_Determine_Diagnostic_Status "VBU0513/VBUSystem/BMS/CTD/Subsystem/Subsystem4/DiagnoseRelayWeld/MPC_Weld_Check/Determine_Diagnostic_Status" /begin REF_CHARACTERISTIC CcFDC_MaxCount_n CcFDC_MinCount_n DIAGNOSTIC_ON_GOING /end REF_CHARACTERISTIC /end GROUP
/begin GROUP S456_Status_Charging "VBU0513/VBUSystem/BMS/CTD/Subsystem/Subsystem4/PrechrgProcessMonitoring/Precharging_Process_Monitoring/Status_Charging" /begin REF_CHARACTERISTIC CTD_PRECHARGE_STATUS_CHARGING /end REF_CHARACTERISTIC /end GROUP
/begin GROUP S478_Determine_Diagnostic_Status "VBU0513/VBUSystem/BMS/CTD/Subsystem/Subsystem4/Stuck_Open_Diagnostic/MPR_Stuck_Open/Determine_Diagnostic_Status" /begin REF_CHARACTERISTIC CcFDC_MaxCount_n CcFDC_MinCount_n DIAGNOSTIC_ON_GOING /end REF_CHARACTERISTIC /end GROUP
/begin GROUP S559_DetermineFault "VBU0513/VBUSystem/BMS/CTM/CTM/Subsystem/Determine_CellTemp_OverDeviationFaults/EVM_FDC_Handler1/DetermineFault" /begin REF_CHARACTERISTIC CcFDC_MaxCount_n CcFDC_MinCount_n /end REF_CHARACTERISTIC /end GROUP
/begin GROUP S559_DetermineFaultCounter "VBU0513/VBUSystem/BMS/CTM/CTM/Subsystem/Determine_CellTemp_OverDeviationFaults/EVM_FDC_Handler1/DetermineFaultCounter" /begin REF_CHARACTERISTIC CcFDC_MaxCount_n CcFDC_MinCount_n /end REF_CHARACTERISTIC /end GROUP
/begin GROUP S569_DetermineFault "VBU0513/VBUSystem/BMS/CTM/CTM/Subsystem/Determine_CellTemp_OverUnderFaults/EVM_FDC_Handler/DetermineFault" /begin REF_CHARACTERISTIC CcFDC_MaxCount_n CcFDC_MinCount_n /end REF_CHARACTERISTIC /end GROUP
/begin GROUP S569_DetermineFaultCounter "VBU0513/VBUSystem/BMS/CTM/CTM/Subsystem/Determine_CellTemp_OverUnderFaults/EVM_FDC_Handler/DetermineFaultCounter" /begin REF_CHARACTERISTIC CcFDC_MaxCount_n CcFDC_MinCount_n /end REF_CHARACTERISTIC /end GROUP
/begin GROUP S593_CellTemp_ChangeRate_Calculate "VBU0513/VBUSystem/BMS/CTM/CTM/Subsystem/Determine_Thermal_Runaway/DetermineTempRiseRate/CellTemp_ChangeRate_Calculate"
 /begin REF_CHARACTERISTIC CbCTM_CellThermalRunawayEnable_flg CcCTM_ThermalRunawayTriggerTime_ms /end REF_CHARACTERISTIC
/end GROUP
/begin GROUP S659_DetermineFault "VBU0513/VBUSystem/BMS/CVT/CVT/Subsystem/Determine_CellVoltage_OverUnderFaults/EVM_FDC_Handler/DetermineFault" /begin REF_CHARACTERISTIC CcFDC_MaxCount_n CcFDC_MinCount_n /end REF_CHARACTERISTIC /end GROUP
/begin GROUP S659_DetermineFaultCounter "VBU0513/VBUSystem/BMS/CVT/CVT/Subsystem/Determine_CellVoltage_OverUnderFaults/EVM_FDC_Handler/DetermineFaultCounter" /begin REF_CHARACTERISTIC CcFDC_MaxCount_n CcFDC_MinCount_n /end REF_CHARACTERISTIC /end GROUP
/begin GROUP S660_DetermineFault "VBU0513/VBUSystem/BMS/CVT/CVT/Subsystem/Determine_CellVoltage_OverUnderFaults/EVM_FDC_Handler1/DetermineFault" /begin REF_CHARACTERISTIC CcFDC_MaxCount_n CcFDC_MinCount_n /end REF_CHARACTERISTIC /end GROUP
/begin GROUP S660_DetermineFaultCounter "VBU0513/VBUSystem/BMS/CVT/CVT/Subsystem/Determine_CellVoltage_OverUnderFaults/EVM_FDC_Handler1/DetermineFaultCounter" /begin REF_CHARACTERISTIC CcFDC_MaxCount_n CcFDC_MinCount_n /end REF_CHARACTERISTIC /end GROUP
/begin GROUP S661_DetermineFault "VBU0513/VBUSystem/BMS/CVT/CVT/Subsystem/Determine_CellVoltage_OverUnderFaults/EVM_FDC_Handler2/DetermineFault" /begin REF_CHARACTERISTIC CcFDC_MaxCount_n CcFDC_MinCount_n /end REF_CHARACTERISTIC /end GROUP
/begin GROUP S661_DetermineFaultCounter "VBU0513/VBUSystem/BMS/CVT/CVT/Subsystem/Determine_CellVoltage_OverUnderFaults/EVM_FDC_Handler2/DetermineFaultCounter" /begin REF_CHARACTERISTIC CcFDC_MaxCount_n CcFDC_MinCount_n /end REF_CHARACTERISTIC /end GROUP
/begin GROUP S798_Decrease_ChargeCurrentRequest "VBU0513/VBUSystem/BMS/FCC /FCC/Subsystem/Determine_Fastcharge_Request/Charge_Request_Protection/Decrease_ChargeCurrentRequest"
 /begin REF_CHARACTERISTIC CcFCC_BatteryChargeCurrentFactor_n CcFCC_TrickleChargeCurrent_A CcSYS_MappedCellCapacity_Ah /end REF_CHARACTERISTIC
/end GROUP
/begin GROUP S799_Determine_ComputeResistancePulseRequest "VBU0513/VBUSystem/BMS/FCC /FCC/Subsystem/Determine_Fastcharge_Request/DetermineComputeResistancePulseCurrent/Determine_ComputeResistancePulseRequest"
 /begin REF_CHARACTERISTIC CcFCC_BatteryChargeCurrentFactor_n CcFCC_StandardPowerLimit_Kw CcFCC_TrickleChargeCurrent_A CcSYS_MappedCellCapacity_Ah /end REF_CHARACTERISTIC
/end GROUP
/begin GROUP S800_Request_At_Charging "VBU0513/VBUSystem/BMS/FCC /FCC/Subsystem/Determine_Fastcharge_Request/Determine_Base_ChargeRequest/Request_At_Charging"
 /begin REF_CHARACTERISTIC CcFCC_BatteryChargeCurrentFactor_n CcFCC_StandardPowerLimit_Kw CcFCC_TrickleChargeCurrent_A CcSYS_MappedCellCapacity_Ah /end REF_CHARACTERISTIC
/end GROUP
/begin GROUP S832_Cell_Temp_Protection "VBU0513/VBUSystem/BMS/FCC /FCC/Subsystem/Fastcharge_Conditions_Check/Condition_Categorize/Cell_Temp_Protection" /begin REF_CHARACTERISTIC CcFCC_NoChargeHighTemp_C CcFCC_NoChargeLowTemp_C /end REF_CHARACTERISTIC /end GROUP
/begin GROUP S1425_Determine_SlowCharge "VBU0513/VBUSystem/BMS/SOH/Subsystem4/Subsystem1/Calculate_Capacity/Determine_CalculateCellCapacity_Condition/Determine_SlowCharge" /begin REF_CHARACTERISTIC CcSYS_NoOfInvalidCellVoltages_n /end REF_CHARACTERISTIC /end GROUP
/begin GROUP S1425_Determine_SlowChargeEnd "VBU0513/VBUSystem/BMS/SOH/Subsystem4/Subsystem1/Calculate_Capacity/Determine_CalculateCellCapacity_Condition/Determine_SlowChargeEnd" /begin REF_CHARACTERISTIC CcSYS_NoOfInvalidCellVoltages_n /end REF_CHARACTERISTIC /end GROUP
/begin GROUP S1425_Determine_SlowChargeStart "VBU0513/VBUSystem/BMS/SOH/Subsystem4/Subsystem1/Calculate_Capacity/Determine_CalculateCellCapacity_Condition/Determine_SlowChargeStart" /begin REF_CHARACTERISTIC CcSYS_NoOfInvalidCellVoltages_n /end REF_CHARACTERISTIC /end GROUP
/begin GROUP S1491_ResistanceCalc_Check "VBU0513/VBUSystem/BMS/SOH/Subsystem4/Subsystem1/Calculate_Resistance/BasicCellResistance_Calculation_Check/ResistanceCalc_Check" /begin REF_CHARACTERISTIC CcSYS_NoOfInvalidCellVoltages_n /end REF_CHARACTERISTIC /end GROUP
/begin GROUP S3620_Disenable "VBU0513/VBUSystem/VCU /LVC/LVC/LowVoltageBalanceControl/LVC_DcdcStCtl/RoutineControl/Disenable"
 /begin REF_CHARACTERISTIC DIAGS_stNRCFail_SY DIAGS_stPsvRespIn_SY DIAGS_stPsvRespNok_SY DIAGS_stPsvRespOk_SY LVC_tiSample_SY /end REF_CHARACTERISTIC
/end GROUP
/begin GROUP S3620_Enable "VBU0513/VBUSystem/VCU /LVC/LVC/LowVoltageBalanceControl/LVC_DcdcStCtl/RoutineControl/Enable"
 /begin REF_CHARACTERISTIC DIAGS_stNRCFail_SY DIAGS_stPsvRespIn_SY DIAGS_stPsvRespNok_SY DIAGS_stPsvRespOk_SY LVC_tiSample_SY /end REF_CHARACTERISTIC
/end GROUP
/begin GROUP S3920_PulseTrig "VBU0513/VBUSystem/VCU /TQO/TQOAll/TQCMP/TQCMP/TrqPulse/PulseTrig" /begin REF_CHARACTERISTIC SYS_stShftPosDrv_SY SYS_stShftPosRev_SY /end REF_CHARACTERISTIC /end GROUP
/begin GROUP S4007_ShftChange "VBU0513/VBUSystem/VCU /TQO/TQOAll/TQO/TQO/MotorTorque/ShftChange" /begin REF_CHARACTERISTIC SYS_stShftPosDrv_SY SYS_stShftPosRev_SY /end REF_CHARACTERISTIC /end GROUP
/begin GROUP S4007_Subsystem "VBU0513/VBUSystem/VCU /TQO/TQOAll/TQO/TQO/MotorTorque/Subsystem" /begin REF_CHARACTERISTIC SYS_stShftPosDrv_SY SYS_stShftPosRev_SY /end REF_CHARACTERISTIC /end GROUP
/begin GROUP S143_DetermineFault "VBU0513/VBUSystem/BMS/BCV/BCV/Subsystem/Diagnose_BCV_Data_Fault/Diagnose_VoltageCurrent_Fault/EVM_FDC_Handler/DetermineFault" /begin REF_CHARACTERISTIC CcFDC_MaxCount_n CcFDC_MinCount_n /end REF_CHARACTERISTIC /end GROUP
/begin GROUP S143_DetermineFaultCounter "VBU0513/VBUSystem/BMS/BCV/BCV/Subsystem/Diagnose_BCV_Data_Fault/Diagnose_VoltageCurrent_Fault/EVM_FDC_Handler/DetermineFaultCounter" /begin REF_CHARACTERISTIC CcFDC_MaxCount_n CcFDC_MinCount_n /end REF_CHARACTERISTIC /end GROUP
/begin GROUP S144_DetermineFault "VBU0513/VBUSystem/BMS/BCV/BCV/Subsystem/Diagnose_BCV_Data_Fault/Diagnose_VoltageCurrent_Fault/EVM_FDC_Handler1/DetermineFault" /begin REF_CHARACTERISTIC CcFDC_MaxCount_n CcFDC_MinCount_n /end REF_CHARACTERISTIC /end GROUP
/begin GROUP S144_DetermineFaultCounter "VBU0513/VBUSystem/BMS/BCV/BCV/Subsystem/Diagnose_BCV_Data_Fault/Diagnose_VoltageCurrent_Fault/EVM_FDC_Handler1/DetermineFaultCounter" /begin REF_CHARACTERISTIC CcFDC_MaxCount_n CcFDC_MinCount_n /end REF_CHARACTERISTIC /end GROUP
/begin GROUP S145_DetermineFault "VBU0513/VBUSystem/BMS/BCV/BCV/Subsystem/Diagnose_BCV_Data_Fault/Diagnose_VoltageCurrent_Fault/EVM_FDC_Handler2/DetermineFault" /begin REF_CHARACTERISTIC CcFDC_MaxCount_n CcFDC_MinCount_n /end REF_CHARACTERISTIC /end GROUP
/begin GROUP S145_DetermineFaultCounter "VBU0513/VBUSystem/BMS/BCV/BCV/Subsystem/Diagnose_BCV_Data_Fault/Diagnose_VoltageCurrent_Fault/EVM_FDC_Handler2/DetermineFaultCounter" /begin REF_CHARACTERISTIC CcFDC_MaxCount_n CcFDC_MinCount_n /end REF_CHARACTERISTIC /end GROUP
/begin GROUP S324_Determine_CellBlanceTime "VBU0513/VBUSystem/BMS/CBL/Subsystem8/Subsystem/Determine_CSCCellBalanceRequest/Determine_CellBalanceRequest/Cell0/Determine_CellBlanceTime" /begin REF_CHARACTERISTIC MINUTES_PER_HOUR /end REF_CHARACTERISTIC /end GROUP
/begin GROUP S324_Determine_SocBalanceReq "VBU0513/VBUSystem/BMS/CBL/Subsystem8/Subsystem/Determine_CSCCellBalanceRequest/Determine_CellBalanceRequest/Cell0/Determine_SocBalanceReq" /begin REF_CHARACTERISTIC CcCBL_BalanceStartDeltaSoc_pct /end REF_CHARACTERISTIC /end GROUP
/begin GROUP S324_Determine_VoltageBalanceReq "VBU0513/VBUSystem/BMS/CBL/Subsystem8/Subsystem/Determine_CSCCellBalanceRequest/Determine_CellBalanceRequest/Cell0/Determine_VoltageBalanceReq" /begin REF_CHARACTERISTIC CcCBL_BalanceStartDeltaVoltage_mV /end REF_CHARACTERISTIC /end GROUP
/begin GROUP S480_Determine_Diagnostic_Status "VBU0513/VBUSystem/BMS/CTD/Subsystem/Subsystem4/Stuck_Open_Diagnostic/MNC_Stuck_Open/MNC_Stuck_Open_With_VehicleSpeed/Determine_Diagnostic_Status" /begin REF_CHARACTERISTIC CcFDC_MaxCount_n CcFDC_MinCount_n DIAGNOSTIC_ON_GOING /end REF_CHARACTERISTIC /end GROUP
/begin GROUP S504_Determine_Diagnostic_Status "VBU0513/VBUSystem/BMS/CTD/Subsystem/Subsystem4/Stuck_Open_Diagnostic/MPC_Stuck_Open/MPC_Stuck_Open_Without_VehicleSpeed/Determine_Diagnostic_Status" /begin REF_CHARACTERISTIC CcFDC_MaxCount_n CcFDC_MinCount_n DIAGNOSTIC_ON_GOING /end REF_CHARACTERISTIC /end GROUP
/begin GROUP S693_DetermineFault "VBU0513/VBUSystem/BMS/CVT/CVT/Subsystem/Monitor_CVT_Performance/Determine_CellVoltage_OverDeviationBDM/BigDataMonitor_Handler1/DetermineFault" /begin REF_CHARACTERISTIC CcFDC_MaxCount_n CcFDC_MinCount_n /end REF_CHARACTERISTIC /end GROUP
/begin GROUP S693_DetermineFaultCounter "VBU0513/VBUSystem/BMS/CVT/CVT/Subsystem/Monitor_CVT_Performance/Determine_CellVoltage_OverDeviationBDM/BigDataMonitor_Handler1/DetermineFaultCounter" /begin REF_CHARACTERISTIC CcFDC_MaxCount_n CcFDC_MinCount_n /end REF_CHARACTERISTIC /end GROUP
/begin GROUP S698_DetermineFault "VBU0513/VBUSystem/BMS/CVT/CVT/Subsystem/Monitor_CVT_Performance/Determine_CellVoltage_OverUnderBDM/BigDataMonitor_Handler/DetermineFault" /begin REF_CHARACTERISTIC CcFDC_MaxCount_n CcFDC_MinCount_n /end REF_CHARACTERISTIC /end GROUP
/begin GROUP S698_DetermineFaultCounter "VBU0513/VBUSystem/BMS/CVT/CVT/Subsystem/Monitor_CVT_Performance/Determine_CellVoltage_OverUnderBDM/BigDataMonitor_Handler/DetermineFaultCounter" /begin REF_CHARACTERISTIC CcFDC_MaxCount_n CcFDC_MinCount_n /end REF_CHARACTERISTIC /end GROUP
/begin GROUP S699_DetermineFault "VBU0513/VBUSystem/BMS/CVT/CVT/Subsystem/Monitor_CVT_Performance/Determine_CellVoltage_OverUnderBDM/BigDataMonitor_Handler2/DetermineFault" /begin REF_CHARACTERISTIC CcFDC_MaxCount_n CcFDC_MinCount_n /end REF_CHARACTERISTIC /end GROUP
/begin GROUP S699_DetermineFaultCounter "VBU0513/VBUSystem/BMS/CVT/CVT/Subsystem/Monitor_CVT_Performance/Determine_CellVoltage_OverUnderBDM/BigDataMonitor_Handler2/DetermineFaultCounter" /begin REF_CHARACTERISTIC CcFDC_MaxCount_n CcFDC_MinCount_n /end REF_CHARACTERISTIC /end GROUP
/begin GROUP S841_FullCharge_criteria4 "VBU0513/VBUSystem/BMS/FCC /FCC/Subsystem/Fastcharge_Conditions_Check/Condition_Categorize/Full_Charge_Determination/FullCharge_criteria4"
 /begin REF_CHARACTERISTIC CcFCC_BatteryCapacityCycle1_n CcFCC_BatteryCapacityCycle2_n CcFCC_CustomSetSOCEnable_pct CcFCC_FullChargeSoc1_pct CcFCC_FullChargeSoc2_pct CcFCC_FullChargeSoc3_pct /end REF_CHARACTERISTIC
/end GROUP
/begin GROUP S1234_Enable_Voltage_Correction "VBU0513/VBUSystem/BMS/SOF/Subsystem6/Subsystem/Determine_Currentlimit_Target/Calculate_CurrentLimit_Target/CurrentLimit_Voltage_Correct/Enable_Voltage_Correction" /begin REF_CHARACTERISTIC CcSYS_NoOfInvalidCellVoltages_n /end REF_CHARACTERISTIC /end GROUP
/begin GROUP S1461_Determine_AhIntegral_Q "VBU0513/VBUSystem/BMS/SOH/Subsystem4/Subsystem1/Calculate_Capacity/Calculate_CellCapacity_SlowCharge/Determine_AhIntegral_DeltaQ/Determine_AhIntegral_Q" /begin REF_CHARACTERISTIC SECONDS_PER_HOUR /end REF_CHARACTERISTIC /end GROUP
/begin GROUP S3943_AccPdlIdl "VBU0513/VBUSystem/VCU /TQO/TQOAll/TQDIS/TQDIS/TrqFilter/DrvLim/AccPdlIdl" /begin REF_CHARACTERISTIC SYS_stShftPosDrv_SY SYS_stShftPosRev_SY /end REF_CHARACTERISTIC /end GROUP
/begin GROUP S3943_Creep "VBU0513/VBUSystem/VCU /TQO/TQOAll/TQDIS/TQDIS/TrqFilter/DrvLim/Creep" /begin REF_CHARACTERISTIC SYS_stShftPosDrv_SY SYS_stShftPosRev_SY /end REF_CHARACTERISTIC /end GROUP
/begin GROUP S3972_TipinEnaRA "VBU0513/VBUSystem/VCU /TQO/TQOAll/TQDMP/TQDMP/RAROTC/ROTCConidtion/TipinEnaRA" /begin REF_CHARACTERISTIC SYS_stShftPosDrv_SY SYS_stShftPosRev_SY /end REF_CHARACTERISTIC /end GROUP
/begin GROUP S3972_TipoutEnaRA "VBU0513/VBUSystem/VCU /TQO/TQOAll/TQDMP/TQDMP/RAROTC/ROTCConidtion/TipoutEnaRA" /begin REF_CHARACTERISTIC SYS_stShftPosDrv_SY SYS_stShftPosRev_SY /end REF_CHARACTERISTIC /end GROUP
/begin GROUP S3973_DeltaTrqArb "VBU0513/VBUSystem/VCU /TQO/TQOAll/TQDMP/TQDMP/RAROTC/TorqueCal/DeltaTrqArb" /begin REF_CHARACTERISTIC SYS_stShftPosDrv_SY SYS_stShftPosRev_SY /end REF_CHARACTERISTIC /end GROUP
/begin GROUP S193_DetermineFault "VBU0513/VBUSystem/BMS/BCV/BCV/Subsystem/Monitor_BCV_Performance/Diagnose_BDM_BCV_Communication_Fault/Diagnose_BdmOutOfRange_Fault/BigDataMonitor_Handler/DetermineFault" /begin REF_CHARACTERISTIC CcFDC_MaxCount_n CcFDC_MinCount_n /end REF_CHARACTERISTIC /end GROUP
/begin GROUP S193_DetermineFaultCounter "VBU0513/VBUSystem/BMS/BCV/BCV/Subsystem/Monitor_BCV_Performance/Diagnose_BDM_BCV_Communication_Fault/Diagnose_BdmOutOfRange_Fault/BigDataMonitor_Handler/DetermineFaultCounter" /begin REF_CHARACTERISTIC CcFDC_MaxCount_n CcFDC_MinCount_n /end REF_CHARACTERISTIC /end GROUP
/begin GROUP S194_DetermineFault "VBU0513/VBUSystem/BMS/BCV/BCV/Subsystem/Monitor_BCV_Performance/Diagnose_BDM_BCV_Communication_Fault/Diagnose_BdmOutOfRange_Fault/BigDataMonitor_Handler1/DetermineFault" /begin REF_CHARACTERISTIC CcFDC_MaxCount_n CcFDC_MinCount_n /end REF_CHARACTERISTIC /end GROUP
/begin GROUP S194_DetermineFaultCounter "VBU0513/VBUSystem/BMS/BCV/BCV/Subsystem/Monitor_BCV_Performance/Diagnose_BDM_BCV_Communication_Fault/Diagnose_BdmOutOfRange_Fault/BigDataMonitor_Handler1/DetermineFaultCounter" /begin REF_CHARACTERISTIC CcFDC_MaxCount_n CcFDC_MinCount_n /end REF_CHARACTERISTIC /end GROUP
/begin GROUP S205_DetermineFault "VBU0513/VBUSystem/BMS/BCV/BCV/Subsystem/Monitor_BCV_Performance/Diagnose_BDM_BCV_Data_Fault/Diagnose_BdmBatteryBusVoltageMismatch_Fault/BigDataMonitor_Handler1/DetermineFault" /begin REF_CHARACTERISTIC CcFDC_MaxCount_n CcFDC_MinCount_n /end REF_CHARACTERISTIC /end GROUP
/begin GROUP S205_DetermineFaultCounter "VBU0513/VBUSystem/BMS/BCV/BCV/Subsystem/Monitor_BCV_Performance/Diagnose_BDM_BCV_Data_Fault/Diagnose_BdmBatteryBusVoltageMismatch_Fault/BigDataMonitor_Handler1/DetermineFaultCounter" /begin REF_CHARACTERISTIC CcFDC_MaxCount_n CcFDC_MinCount_n /end REF_CHARACTERISTIC /end GROUP
/begin GROUP S211_DetermineFault "VBU0513/VBUSystem/BMS/BCV/BCV/Subsystem/Monitor_BCV_Performance/Diagnose_BDM_BCV_Data_Fault/Diagnose_BdmVoltageCurrent_Fault/BigDataMonitor_Handler/DetermineFault" /begin REF_CHARACTERISTIC CcFDC_MaxCount_n CcFDC_MinCount_n /end REF_CHARACTERISTIC /end GROUP
/begin GROUP S211_DetermineFaultCounter "VBU0513/VBUSystem/BMS/BCV/BCV/Subsystem/Monitor_BCV_Performance/Diagnose_BDM_BCV_Data_Fault/Diagnose_BdmVoltageCurrent_Fault/BigDataMonitor_Handler/DetermineFaultCounter" /begin REF_CHARACTERISTIC CcFDC_MaxCount_n CcFDC_MinCount_n /end REF_CHARACTERISTIC /end GROUP
/begin GROUP S212_DetermineFault "VBU0513/VBUSystem/BMS/BCV/BCV/Subsystem/Monitor_BCV_Performance/Diagnose_BDM_BCV_Data_Fault/Diagnose_BdmVoltageCurrent_Fault/BigDataMonitor_Handler1/DetermineFault" /begin REF_CHARACTERISTIC CcFDC_MaxCount_n CcFDC_MinCount_n /end REF_CHARACTERISTIC /end GROUP
/begin GROUP S212_DetermineFaultCounter "VBU0513/VBUSystem/BMS/BCV/BCV/Subsystem/Monitor_BCV_Performance/Diagnose_BDM_BCV_Data_Fault/Diagnose_BdmVoltageCurrent_Fault/BigDataMonitor_Handler1/DetermineFaultCounter" /begin REF_CHARACTERISTIC CcFDC_MaxCount_n CcFDC_MinCount_n /end REF_CHARACTERISTIC /end GROUP
/begin GROUP S213_DetermineFault "VBU0513/VBUSystem/BMS/BCV/BCV/Subsystem/Monitor_BCV_Performance/Diagnose_BDM_BCV_Data_Fault/Diagnose_BdmVoltageCurrent_Fault/BigDataMonitor_Handler2/DetermineFault" /begin REF_CHARACTERISTIC CcFDC_MaxCount_n CcFDC_MinCount_n /end REF_CHARACTERISTIC /end GROUP
/begin GROUP S213_DetermineFaultCounter "VBU0513/VBUSystem/BMS/BCV/BCV/Subsystem/Monitor_BCV_Performance/Diagnose_BDM_BCV_Data_Fault/Diagnose_BdmVoltageCurrent_Fault/BigDataMonitor_Handler2/DetermineFaultCounter" /begin REF_CHARACTERISTIC CcFDC_MaxCount_n CcFDC_MinCount_n /end REF_CHARACTERISTIC /end GROUP
/end MODULE
/end PROJECT
