/******************************************************************************
* ASAP2 file: VBU0428Test.a2l
* Code generation for model "VBU0428Test".
* Model version : 7.262
* Simulink Coder version : 9.4 (R2020b) 29-Jul-2020
* C source code generated on : Wed Apr 28 19:10:55 2021
* Target selection: ert.tlc
* Embedded hardware selection: Infineon->TriCore
* Code generation objectives: Unspecified
* Validation result: Not run
* (add additional file header information here)
******************************************************************************/
/* Version 1.31 */
ASAP2_VERSION 1 31
/begin PROJECT ProjectName "Project Comment Goes Here"
/begin HEADER "Header Comments go here" /end HEADER
/begin MODULE ModuleName "Module Comment Goes Here"
/begin MOD_PAR "MOD PAR Comment Goes Here" /end MOD_PAR
/begin MOD_COMMON "Mod Common Comment Here" BYTE_ORDER MSB_LAST /end MOD_COMMON
/begin RECORD_LAYOUT Scalar_BOOLEAN FNC_VALUES 1 UBYTE COLUMN_DIR DIRECT /end RECORD_LAYOUT
/begin RECORD_LAYOUT Scalar_UBYTE FNC_VALUES 1 UBYTE COLUMN_DIR DIRECT /end RECORD_LAYOUT
/begin RECORD_LAYOUT Scalar_BYTE FNC_VALUES 1 SBYTE COLUMN_DIR DIRECT /end RECORD_LAYOUT
/begin RECORD_LAYOUT Scalar_UWORD FNC_VALUES 1 UWORD COLUMN_DIR DIRECT /end RECORD_LAYOUT
/begin RECORD_LAYOUT Scalar_SWORD FNC_VALUES 1 SWORD COLUMN_DIR DIRECT /end RECORD_LAYOUT
/begin RECORD_LAYOUT Scalar_ULONG FNC_VALUES 1 ULONG COLUMN_DIR DIRECT /end RECORD_LAYOUT
/begin RECORD_LAYOUT Scalar_LONG FNC_VALUES 1 SLONG COLUMN_DIR DIRECT /end RECORD_LAYOUT
/begin RECORD_LAYOUT Scalar_FLOAT32_IEEE FNC_VALUES 1 FLOAT32_IEEE COLUMN_DIR DIRECT /end RECORD_LAYOUT
/begin RECORD_LAYOUT Lookup1D_BOOLEAN FNC_VALUES 1 UBYTE COLUMN_DIR DIRECT /end RECORD_LAYOUT
/begin RECORD_LAYOUT Lookup1D_X_BOOLEAN AXIS_PTS_X 1 UBYTE INDEX_INCR DIRECT /end RECORD_LAYOUT
/begin RECORD_LAYOUT Lookup1D_FLOAT32_IEEE FNC_VALUES 1 FLOAT32_IEEE COLUMN_DIR DIRECT /end RECORD_LAYOUT
/begin RECORD_LAYOUT Lookup1D_X_FLOAT32_IEEE AXIS_PTS_X 1 FLOAT32_IEEE INDEX_INCR DIRECT /end RECORD_LAYOUT
/begin CHARACTERISTIC INP_pVacPres_CUR_v "" CURVE 0x700121da Lookup1D_FLOAT32_IEEE 0 VBU0428Test_CM_single_Kpa 0.0 10000.0
 /begin AXIS_DESCR COM_AXIS NO_INPUT_QUANTITY VBU0428Test_CM_single_mV 6 0.0 5000.0 AXIS_PTS_REF INP_uVacPres_CUR_x /end AXIS_DESCR
/end CHARACTERISTIC
/begin AXIS_PTS INP_uVacPres_CUR_x "" 0x700121f2 NO_INPUT_QUANTITY Lookup1D_X_FLOAT32_IEEE 0 VBU0428Test_CM_single_mV 6 0.0 5000.0 /end AXIS_PTS
/begin CHARACTERISTIC INP_tDCChPortTemp_CUR_v "" CURVE 0x70013e16 Lookup1D_FLOAT32_IEEE 0 VBU0428Test_CM_single_C -100.0 200.0
 /begin AXIS_DESCR COM_AXIS NO_INPUT_QUANTITY VBU0428Test_CM_single_mV 17 0.0 5.0 AXIS_PTS_REF INP_uDCChPortTemp_CUR_x /end AXIS_DESCR
/end CHARACTERISTIC
/begin AXIS_PTS INP_uDCChPortTemp_CUR_x "" 0x70013ee2 NO_INPUT_QUANTITY Lookup1D_X_FLOAT32_IEEE 0 VBU0428Test_CM_single_mV 17 0.0 5.0 /end AXIS_PTS
/begin CHARACTERISTIC INP_tDCChPortTempNegative_CUR_v "" CURVE 0x70013dd2 Lookup1D_FLOAT32_IEEE 0 VBU0428Test_CM_single_C -100.0 200.0
 /begin AXIS_DESCR COM_AXIS NO_INPUT_QUANTITY VBU0428Test_CM_single_mV 17 0.0 5.0 AXIS_PTS_REF INP_uDCChPortTempNegative_CUR_x /end AXIS_DESCR
/end CHARACTERISTIC
/begin AXIS_PTS INP_uDCChPortTempNegative_CUR_x "" 0x70013e9e NO_INPUT_QUANTITY Lookup1D_X_FLOAT32_IEEE 0 VBU0428Test_CM_single_mV 17 0.0 5.0 /end AXIS_PTS
/begin CHARACTERISTIC INP_tEDSOutTemp_CUR_v "" CURVE 0x70013e5a Lookup1D_FLOAT32_IEEE 0 VBU0428Test_CM_single_C -100.0 200.0
 /begin AXIS_DESCR COM_AXIS NO_INPUT_QUANTITY VBU0428Test_CM_single_mV 17 0.0 5.0 AXIS_PTS_REF INP_uEDSOutTemp_CUR_x /end AXIS_DESCR
/end CHARACTERISTIC
/begin AXIS_PTS INP_uEDSOutTemp_CUR_x "" 0x70013f26 NO_INPUT_QUANTITY Lookup1D_X_FLOAT32_IEEE 0 VBU0428Test_CM_single_mV 17 0.0 5.0 /end AXIS_PTS
/begin CHARACTERISTIC APO_AxAccelerationOvrdVal_C "" VALUE 0x700101b4 Scalar_FLOAT32_IEEE 0 VBU0428Test_CM_single_cnt -3.4028234663852886E+38 3.4028234663852886E+38 /end CHARACTERISTIC
/begin CHARACTERISTIC APO_AyAccelerationOvrdVal_C "" VALUE 0x700101b8 Scalar_FLOAT32_IEEE 0 VBU0428Test_CM_single_cnt -3.4028234663852886E+38 3.4028234663852886E+38 /end CHARACTERISTIC
/begin CHARACTERISTIC APO_AzAccelerationOvrdVal_C "" VALUE 0x700101bc Scalar_FLOAT32_IEEE 0 VBU0428Test_CM_single_cnt -3.4028234663852886E+38 3.4028234663852886E+38 /end CHARACTERISTIC
/begin CHARACTERISTIC APO_HundredKmTripEnergyOvrdVal_C "" VALUE 0x700101dc Scalar_FLOAT32_IEEE 0 VBU0428Test_CM_single_cnt -3.4028234663852886E+38 3.4028234663852886E+38 /end CHARACTERISTIC
/begin CHARACTERISTIC APO_RemainingChargingTimeOvrdVal_C "" VALUE 0x700101f0 Scalar_FLOAT32_IEEE 0 VBU0428Test_CM_single_cnt -3.4028234663852886E+38 3.4028234663852886E+38 /end CHARACTERISTIC
/begin CHARACTERISTIC APO_RemainingDrivingRangeOvrdVal_C "" VALUE 0x700101f4 Scalar_FLOAT32_IEEE 0 VBU0428Test_CM_single_cnt -3.4028234663852886E+38 3.4028234663852886E+38 /end CHARACTERISTIC
/begin CHARACTERISTIC APO_SOCLowWarningOvrdVal_C "" VALUE 0x700101f8 Scalar_FLOAT32_IEEE 0 VBU0428Test_CM_single_cnt -3.4028234663852886E+38 3.4028234663852886E+38 /end CHARACTERISTIC
/begin CHARACTERISTIC APO_TenkmTripEnergyOvrdVal_C "" VALUE 0x700101fc Scalar_FLOAT32_IEEE 0 VBU0428Test_CM_single_cnt -3.4028234663852886E+38 3.4028234663852886E+38 /end CHARACTERISTIC
/begin CHARACTERISTIC APO_YawrateOvrdVal_C "" VALUE 0x70010210 Scalar_FLOAT32_IEEE 0 VBU0428Test_CM_single_cnt -3.4028234663852886E+38 3.4028234663852886E+38 /end CHARACTERISTIC
/begin CHARACTERISTIC APO_flgBMSThermalRunawayOvrdVal_C "" VALUE 0x7001022c Scalar_FLOAT32_IEEE 0 VBU0428Test_CM_single_cnt -3.4028234663852886E+38 3.4028234663852886E+38 /end CHARACTERISTIC
/begin CHARACTERISTIC APO_flgBrkSwtOvrdVal_C "" VALUE 0x70010230 Scalar_FLOAT32_IEEE 0 VBU0428Test_CM_single_cnt -3.4028234663852886E+38 3.4028234663852886E+38 /end CHARACTERISTIC
/begin CHARACTERISTIC APO_iBMSPackCurrentOvrdVal_C "" VALUE 0x70010234 Scalar_FLOAT32_IEEE 0 VBU0428Test_CM_single_cnt -3.4028234663852886E+38 3.4028234663852886E+38 /end CHARACTERISTIC
/begin CHARACTERISTIC APO_pBrkPressOvrdVal_C "" VALUE 0x70010238 Scalar_FLOAT32_IEEE 0 VBU0428Test_CM_single_cnt -3.4028234663852886E+38 3.4028234663852886E+38 /end CHARACTERISTIC
/begin CHARACTERISTIC APO_pctAccPedPosOvrdVal_C "" VALUE 0x70010240 Scalar_FLOAT32_IEEE 0 VBU0428Test_CM_single_cnt -3.4028234663852886E+38 3.4028234663852886E+38 /end CHARACTERISTIC
/begin CHARACTERISTIC APO_pctBMSDIsplaySOCOvrdVal_C "" VALUE 0x70010244 Scalar_FLOAT32_IEEE 0 VBU0428Test_CM_single_cnt -3.4028234663852886E+38 3.4028234663852886E+38 /end CHARACTERISTIC
/begin CHARACTERISTIC APO_pctBMSSOCOvrdVal_C "" VALUE 0x70010248 Scalar_FLOAT32_IEEE 0 VBU0428Test_CM_single_cnt -3.4028234663852886E+38 3.4028234663852886E+38 /end CHARACTERISTIC
/begin CHARACTERISTIC APO_pctEfcAccPdlOvrdVal_C "" VALUE 0x7001024c Scalar_FLOAT32_IEEE 0 VBU0428Test_CM_single_cnt -3.4028234663852886E+38 3.4028234663852886E+38 /end CHARACTERISTIC
/begin CHARACTERISTIC APO_tBMSInletTempOvrdVal_C "" VALUE 0x70010260 Scalar_FLOAT32_IEEE 0 VBU0428Test_CM_single_cnt -3.4028234663852886E+38 3.4028234663852886E+38 /end CHARACTERISTIC
/begin CHARACTERISTIC APO_tBMSOutletTempOvrdVal_C "" VALUE 0x70010264 Scalar_FLOAT32_IEEE 0 VBU0428Test_CM_single_cnt -3.4028234663852886E+38 3.4028234663852886E+38 /end CHARACTERISTIC
/begin CHARACTERISTIC APO_uLVBattOvrdVal_C "" VALUE 0x70010268 Scalar_FLOAT32_IEEE 0 VBU0428Test_CM_single_cnt -3.4028234663852886E+38 3.4028234663852886E+38 /end CHARACTERISTIC
/begin CHARACTERISTIC APO_vBMSPackVoltageOvrdVal_C "" VALUE 0x7001026c Scalar_FLOAT32_IEEE 0 VBU0428Test_CM_single_cnt -3.4028234663852886E+38 3.4028234663852886E+38 /end CHARACTERISTIC
/begin CHARACTERISTIC BCV_facHVADC "" VALUE 0x700103d0 Scalar_FLOAT32_IEEE 0 VBU0428Test_CM_single_cnt 0.0 1000.0 /end CHARACTERISTIC
/begin CHARACTERISTIC BCV_facPEURCurrent "" VALUE 0x90002384 Scalar_FLOAT32_IEEE 0 VBU0428Test_CM_single -3.4E+38 3.4E+38 /end CHARACTERISTIC
/begin CHARACTERISTIC CcBMM_CurrentStableThreshold_A "" VALUE 0x70010548 Scalar_FLOAT32_IEEE 0 VBU0428Test_CM_single_cnt -3.4028234663852886E+38 3.4028234663852886E+38 /end CHARACTERISTIC
/begin CHARACTERISTIC CcBMM_MaxInitializeTime_ms "" VALUE 0x70010550 Scalar_FLOAT32_IEEE 0 VBU0428Test_CM_single_cnt -3.4028234663852886E+38 3.4028234663852886E+38 /end CHARACTERISTIC
/begin CHARACTERISTIC CcISO_DrvISODecThr_kohm "" VALUE 0x70010768 Scalar_FLOAT32_IEEE 0 VBU0428Test_CM_single_kohm -3.4028234663852886E+38 3.4028234663852886E+38 /end CHARACTERISTIC
/begin CHARACTERISTIC CcISO_DrvISODecThr_pct "" VALUE 0x7001076c Scalar_FLOAT32_IEEE 0 VBU0428Test_CM_single_pct -3.4028234663852886E+38 3.4028234663852886E+38 /end CHARACTERISTIC
/begin CHARACTERISTIC CcISO_DrvISOLowThr40_kohm "" VALUE 0x70010770 Scalar_FLOAT32_IEEE 0 VBU0428Test_CM_single_kohm -3.4028234663852886E+38 3.4028234663852886E+38 /end CHARACTERISTIC
/begin CHARACTERISTIC CcISO_DrvISOLowThr_kohm "" VALUE 0x70010774 Scalar_FLOAT32_IEEE 0 VBU0428Test_CM_single_kohm -3.4028234663852886E+38 3.4028234663852886E+38 /end CHARACTERISTIC
/begin CHARACTERISTIC CcISO_FccISODecThr_kohm "" VALUE 0x70010778 Scalar_FLOAT32_IEEE 0 VBU0428Test_CM_single_kohm -3.4028234663852886E+38 3.4028234663852886E+38 /end CHARACTERISTIC
/begin CHARACTERISTIC CcISO_FccISODecThr_pct "" VALUE 0x7001077c Scalar_FLOAT32_IEEE 0 VBU0428Test_CM_single_pct -3.4028234663852886E+38 3.4028234663852886E+38 /end CHARACTERISTIC
/begin CHARACTERISTIC CcISO_FccISOLowThr40_kohm "" VALUE 0x70010780 Scalar_FLOAT32_IEEE 0 VBU0428Test_CM_single_kohm -3.4028234663852886E+38 3.4028234663852886E+38 /end CHARACTERISTIC
/begin CHARACTERISTIC CcISO_FccISOLowThr_kohm "" VALUE 0x70010784 Scalar_FLOAT32_IEEE 0 VBU0428Test_CM_single_kohm -3.4028234663852886E+38 3.4028234663852886E+38 /end CHARACTERISTIC
/begin CHARACTERISTIC CcISO_PackISODecThr_kohm "" VALUE 0x70010790 Scalar_FLOAT32_IEEE 0 VBU0428Test_CM_single_kohm -3.4028234663852886E+38 3.4028234663852886E+38 /end CHARACTERISTIC
/begin CHARACTERISTIC CcISO_PackISODecThr_pct "" VALUE 0x70010794 Scalar_FLOAT32_IEEE 0 VBU0428Test_CM_single_pct -3.4028234663852886E+38 3.4028234663852886E+38 /end CHARACTERISTIC
/begin CHARACTERISTIC CcISO_PackISOLowThr_kohm "" VALUE 0x70010798 Scalar_FLOAT32_IEEE 0 VBU0428Test_CM_single_kohm -3.4028234663852886E+38 3.4028234663852886E+38 /end CHARACTERISTIC
/begin CHARACTERISTIC CcRTC_FastWakeUpSOCLowerLimit_pct "" VALUE 0x700107a0 Scalar_FLOAT32_IEEE 0 VBU0428Test_CM_single_cnt -3.4028234663852886E+38 3.4028234663852886E+38 /end CHARACTERISTIC
/begin CHARACTERISTIC CcRTC_FastWakeUpSOCUpperLimit_pct "" VALUE 0x700107a4 Scalar_FLOAT32_IEEE 0 VBU0428Test_CM_single_cnt -3.4028234663852886E+38 3.4028234663852886E+38 /end CHARACTERISTIC
/begin CHARACTERISTIC CcRTC_FastWakeUpTempMiddleLimit_C "" VALUE 0x700107a8 Scalar_FLOAT32_IEEE 0 VBU0428Test_CM_single_cnt -3.4028234663852886E+38 3.4028234663852886E+38 /end CHARACTERISTIC
/begin CHARACTERISTIC CcRTC_FastWakeUpTempUpperLimit_C "" VALUE 0x700107ac Scalar_FLOAT32_IEEE 0 VBU0428Test_CM_single_cnt -3.4028234663852886E+38 3.4028234663852886E+38 /end CHARACTERISTIC
/begin CHARACTERISTIC CcSYS_NominalCellCapacity_Ah "" VALUE 0x70010aa4 Scalar_FLOAT32_IEEE 0 VBU0428Test_CM_single_cnt -3.4028234663852886E+38 3.4028234663852886E+38 /end CHARACTERISTIC
/begin CHARACTERISTIC EDIS_pwrDcdcPwrLim_C "" VALUE 0x70011114 Scalar_FLOAT32_IEEE 0 VBU0428Test_CM_single_cnt 0.0 1.0E+23 /end CHARACTERISTIC
/begin CHARACTERISTIC FCC_pctVCRVCUMaxChrgSOCSet "" VALUE 0x70011234 Scalar_FLOAT32_IEEE 0 VBU0428Test_CM_single -3.4E+38 3.4E+38 /end CHARACTERISTIC
/begin CHARACTERISTIC HALIn_facIgnOnThd_C "" VALUE 0x700112ac Scalar_FLOAT32_IEEE 0 VBU0428Test_CM_single_fac -1000.0 1000.0 /end CHARACTERISTIC
/begin CHARACTERISTIC HALIn_vBrkSwtThold_C "" VALUE 0x700112b0 Scalar_FLOAT32_IEEE 0 VBU0428Test_CM_single -3.4E+38 3.4E+38 /end CHARACTERISTIC
/begin CHARACTERISTIC INP_pVacPresCaliOvrdVal_C "" VALUE 0x700112d8 Scalar_FLOAT32_IEEE 0 VBU0428Test_CM_single_bar 0.0 200.0 /end CHARACTERISTIC
/begin CHARACTERISTIC INP_tDCChPortTempCaliOvrdVal_C "" VALUE 0x700112dc Scalar_FLOAT32_IEEE 0 VBU0428Test_CM_single_C -100.0 200.0 /end CHARACTERISTIC
/begin CHARACTERISTIC INP_tDCChPortTempNegativeCaliOvrdVal_C "" VALUE 0x700112e0 Scalar_FLOAT32_IEEE 0 VBU0428Test_CM_single_cnt -3.4E+38 3.4E+38 /end CHARACTERISTIC
/begin CHARACTERISTIC INP_tDCChPortTempNegativeSafetyVal_C "" VALUE 0x700112e4 Scalar_FLOAT32_IEEE 0 VBU0428Test_CM_single_cnt -3.4E+38 3.4E+38 /end CHARACTERISTIC
/begin CHARACTERISTIC INP_tDCChPortTempSafetyVal_C "" VALUE 0x700112e8 Scalar_FLOAT32_IEEE 0 VBU0428Test_CM_single_cnt -3.4E+38 3.4E+38 /end CHARACTERISTIC
/begin CHARACTERISTIC INP_tEDSOutTempCaliOvrdVal_C "" VALUE 0x700112ec Scalar_FLOAT32_IEEE 0 VBU0428Test_CM_single_cnt -3.4E+38 3.4E+38 /end CHARACTERISTIC
/begin CHARACTERISTIC INP_tEDSOutTempSafetyVal_C "" VALUE 0x700112f0 Scalar_FLOAT32_IEEE 0 VBU0428Test_CM_single_cnt -3.4E+38 3.4E+38 /end CHARACTERISTIC
/begin CHARACTERISTIC INP_uAccPed1CaliOvrdVal_C "" VALUE 0x700112f4 Scalar_FLOAT32_IEEE 0 VBU0428Test_CM_single_cnt 0.0 30.0 /end CHARACTERISTIC
/begin CHARACTERISTIC INP_uAccPed1RangeMax_C "" VALUE 0x700112f8 Scalar_FLOAT32_IEEE 0 VBU0428Test_CM_single_cnt 0.0 30.0 /end CHARACTERISTIC
/begin CHARACTERISTIC INP_uAccPed1RangeMin_C "" VALUE 0x700112fc Scalar_FLOAT32_IEEE 0 VBU0428Test_CM_single_cnt 0.0 30.0 /end CHARACTERISTIC
/begin CHARACTERISTIC INP_uAccPed1SafetyVal_C "" VALUE 0x70011300 Scalar_FLOAT32_IEEE 0 VBU0428Test_CM_single_cnt 0.0 30.0 /end CHARACTERISTIC
/begin CHARACTERISTIC INP_uAccPed2CaliOvrdVal_C "" VALUE 0x70011304 Scalar_FLOAT32_IEEE 0 VBU0428Test_CM_single_cnt 0.0 30.0 /end CHARACTERISTIC
/begin CHARACTERISTIC INP_uAccPed2RangeMax_C "" VALUE 0x70011308 Scalar_FLOAT32_IEEE 0 VBU0428Test_CM_single_cnt 0.0 30.0 /end CHARACTERISTIC
/begin CHARACTERISTIC INP_uAccPed2RangeMin_C "" VALUE 0x7001130c Scalar_FLOAT32_IEEE 0 VBU0428Test_CM_single_cnt 0.0 30.0 /end CHARACTERISTIC
/begin CHARACTERISTIC INP_uAccPed2SafetyVal_C "" VALUE 0x70011310 Scalar_FLOAT32_IEEE 0 VBU0428Test_CM_single_cnt 0.0 30.0 /end CHARACTERISTIC
/begin CHARACTERISTIC INP_uBrkPresCaliOvrdVal_C "" VALUE 0x70011314 Scalar_FLOAT32_IEEE 0 VBU0428Test_CM_single_cnt 0.0 30.0 /end CHARACTERISTIC
/begin CHARACTERISTIC INP_uBrkPresRangeMax_C "" VALUE 0x70011318 Scalar_FLOAT32_IEEE 0 VBU0428Test_CM_single_cnt 0.0 30.0 /end CHARACTERISTIC
/begin CHARACTERISTIC INP_uBrkPresRangeMin_C "" VALUE 0x7001131c Scalar_FLOAT32_IEEE 0 VBU0428Test_CM_single_cnt 0.0 30.0 /end CHARACTERISTIC
/begin CHARACTERISTIC INP_uBrkPresSafetyVal_C "" VALUE 0x70011320 Scalar_FLOAT32_IEEE 0 VBU0428Test_CM_single_cnt -3.4E+38 3.4E+38 /end CHARACTERISTIC
/begin CHARACTERISTIC INP_uDCChCC2CaliOvrdVal_C "" VALUE 0x70011324 Scalar_FLOAT32_IEEE 0 VBU0428Test_CM_single_cnt 0.0 30.0 /end CHARACTERISTIC
/begin CHARACTERISTIC INP_uDCChCC2RangeMax_C "" VALUE 0x70011328 Scalar_FLOAT32_IEEE 0 VBU0428Test_CM_single_cnt 0.0 30.0 /end CHARACTERISTIC
/begin CHARACTERISTIC INP_uDCChCC2RangeMin_C "" VALUE 0x7001132c Scalar_FLOAT32_IEEE 0 VBU0428Test_CM_single_cnt 0.0 30.0 /end CHARACTERISTIC
/begin CHARACTERISTIC INP_uDCChCC2SafetyVal_C "" VALUE 0x70011330 Scalar_FLOAT32_IEEE 0 VBU0428Test_CM_single_cnt 0.0 30.0 /end CHARACTERISTIC
/begin CHARACTERISTIC INP_uDCChPortTempNegativeRangeMax_C "" VALUE 0x70011334 Scalar_FLOAT32_IEEE 0 VBU0428Test_CM_single_cnt 0.0 30.0 /end CHARACTERISTIC
/begin CHARACTERISTIC INP_uDCChPortTempNegativeRangeMin_C "" VALUE 0x70011338 Scalar_FLOAT32_IEEE 0 VBU0428Test_CM_single_cnt 0.0 30.0 /end CHARACTERISTIC
/begin CHARACTERISTIC INP_uDCChPortTempRangeMax_C "" VALUE 0x7001133c Scalar_FLOAT32_IEEE 0 VBU0428Test_CM_single_cnt 0.0 30.0 /end CHARACTERISTIC
/begin CHARACTERISTIC INP_uDCChPortTempRangeMin_C "" VALUE 0x70011340 Scalar_FLOAT32_IEEE 0 VBU0428Test_CM_single_cnt 0.0 30.0 /end CHARACTERISTIC
/begin CHARACTERISTIC INP_uEDSOutTempRangeMax_C "" VALUE 0x70011344 Scalar_FLOAT32_IEEE 0 VBU0428Test_CM_single_cnt 0.0 30.0 /end CHARACTERISTIC
/begin CHARACTERISTIC INP_uEDSOutTempRangeMin_C "" VALUE 0x70011348 Scalar_FLOAT32_IEEE 0 VBU0428Test_CM_single_cnt 0.0 30.0 /end CHARACTERISTIC
/begin CHARACTERISTIC INP_uVacPresRangeMax_C "" VALUE 0x7001134c Scalar_FLOAT32_IEEE 0 VBU0428Test_CM_single_mV 0.0 30.0 /end CHARACTERISTIC
/begin CHARACTERISTIC INP_uVacPresRangeMin_C "" VALUE 0x70011350 Scalar_FLOAT32_IEEE 0 VBU0428Test_CM_single_mV 0.0 30.0 /end CHARACTERISTIC
/begin CHARACTERISTIC INP_uVacPresSafetyVal_C "" VALUE 0x70011354 Scalar_FLOAT32_IEEE 0 VBU0428Test_CM_single_mV -3.4E+38 3.4E+38 /end CHARACTERISTIC
/begin CHARACTERISTIC ONE_HUNDRED_PERCENT "" VALUE 0x700113f4 Scalar_FLOAT32_IEEE 0 VBU0428Test_CM_single_cnt 0.0 255.0 /end CHARACTERISTIC
/begin CHARACTERISTIC SOC_pctMaxSOCSet_C "" VALUE 0x700115d0 Scalar_FLOAT32_IEEE 0 VBU0428Test_CM_single_cnt 0.0 100.0 /end CHARACTERISTIC
/begin CHARACTERISTIC THM_fFANfrecuencyORV "" VALUE 0x90002388 Scalar_FLOAT32_IEEE 0 VBU0428Test_CM_single -3.4E+38 3.4E+38 /end CHARACTERISTIC
/begin CHARACTERISTIC THM_fPump1frecuencyORV "" VALUE 0x9000238c Scalar_FLOAT32_IEEE 0 VBU0428Test_CM_single -3.4E+38 3.4E+38 /end CHARACTERISTIC
/begin CHARACTERISTIC THM_fPump2frecuencyORV "" VALUE 0x90002390 Scalar_FLOAT32_IEEE 0 VBU0428Test_CM_single -3.4E+38 3.4E+38 /end CHARACTERISTIC
/begin CHARACTERISTIC THM_flgPump2frecuencyORF "" VALUE 0x90002394 Scalar_FLOAT32_IEEE 0 VBU0428Test_CM_single -3.4E+38 3.4E+38 /end CHARACTERISTIC
/begin CHARACTERISTIC THM_pctOverrideESSPmpCmd "" VALUE 0x70011678 Scalar_FLOAT32_IEEE 0 VBU0428Test_CM_single_pct 0.0 100.0 /end CHARACTERISTIC
/begin CHARACTERISTIC THM_pctOverrideRearPmpCmd "" VALUE 0x7001167c Scalar_FLOAT32_IEEE 0 VBU0428Test_CM_single_pct 0.0 100.0 /end CHARACTERISTIC
/begin CHARACTERISTIC THM_pctOverridevalueChillerPos "" VALUE 0x70011680 Scalar_FLOAT32_IEEE 0 VBU0428Test_CM_single_pct 0.0 100.0 /end CHARACTERISTIC
/begin CHARACTERISTIC THM_pctOverridevalueFAN "" VALUE 0x70011684 Scalar_FLOAT32_IEEE 0 VBU0428Test_CM_single_pct 0.0 100.0 /end CHARACTERISTIC
/begin CHARACTERISTIC THM_phiEXVPosReqORV "" VALUE 0x70011688 Scalar_FLOAT32_IEEE 0 VBU0428Test_CM_single -3.4E+38 3.4E+38 /end CHARACTERISTIC
/begin CHARACTERISTIC THM_rpmOverridevalueACCmpCmd "" VALUE 0x7001168c Scalar_FLOAT32_IEEE 0 VBU0428Test_CM_single_cnt 0.0 1.0E+23 /end CHARACTERISTIC
/begin CHARACTERISTIC CcBMM_AbnormalEventFlagLockTime_ms "" VALUE 0x70010544 Scalar_ULONG 0 VBU0428Test_CM_uint32_cnt 0.0 4.294967295E+9 /end CHARACTERISTIC
/begin CHARACTERISTIC CcISO_IsolationSeverseLimited_Kohm "" VALUE 0x70010788 Scalar_ULONG 0 VBU0428Test_CM_uint32_kohm 0.0 4.294967295E+9 /end CHARACTERISTIC
/begin CHARACTERISTIC CcISO_IsolationWarningLimited_Kohm "" VALUE 0x7001078c Scalar_ULONG 0 VBU0428Test_CM_uint32_kohm 0.0 4.294967295E+9 /end CHARACTERISTIC
/begin CHARACTERISTIC CcRTC_nbrRealtimeClockFIC "" VALUE 0x700107b0 Scalar_ULONG 0 VBU0428Test_CM_uint32_cnt 0.0 4.294967295E+9 /end CHARACTERISTIC
/begin CHARACTERISTIC CcRTC_nbrRealtimeClockPIC "" VALUE 0x700107b4 Scalar_ULONG 0 VBU0428Test_CM_uint32_cnt 0.0 4.294967295E+9 /end CHARACTERISTIC
/begin CHARACTERISTIC VTestR "" VALUE 0x700119d8 Scalar_ULONG 0 VBU0428Test_CM_uint32 0 4294967295 /end CHARACTERISTIC
/begin CHARACTERISTIC BCV_BATTERY_OVER_CURRENT_FAULT "" VALUE 0x70010000 Scalar_UWORD 0 VBU0428Test_CM_uint16_cnt 0.0 330.0 /end CHARACTERISTIC
/begin CHARACTERISTIC BCV_BATTERY_OVER_VOLTAGE_FAULT "" VALUE 0x70010002 Scalar_UWORD 0 VBU0428Test_CM_uint16_cnt 0.0 330.0 /end CHARACTERISTIC
/begin CHARACTERISTIC BCV_BATTERY_OVER_VOLTAGE_WARNING_FAULT "" VALUE 0x70010004 Scalar_UWORD 0 VBU0428Test_CM_uint16_cnt 0.0 330.0 /end CHARACTERISTIC
/begin CHARACTERISTIC CTD_MAIN_NEGATIVE_CONTACTOR_WELD_FAULT "" VALUE 0x70010008 Scalar_UWORD 0 VBU0428Test_CM_uint16_cnt 0.0 330.0 /end CHARACTERISTIC
/begin CHARACTERISTIC CTD_MAIN_POSITIVE_CONTACTOR_WELD_FAULT "" VALUE 0x7001000a Scalar_UWORD 0 VBU0428Test_CM_uint16_cnt 0.0 330.0 /end CHARACTERISTIC
/begin CHARACTERISTIC CTD_PARKING_MAIN_NEGATIVE_CONTACTOR_STUCK_OPEN_FAULT "" VALUE 0x7001000c Scalar_UWORD 0 VBU0428Test_CM_uint16_cnt 0.0 330.0 /end CHARACTERISTIC
/begin CHARACTERISTIC CTD_PARKING_MAIN_POSITIVE_CONTACTOR_STUCK_OPEN_FAULT "" VALUE 0x7001000e Scalar_UWORD 0 VBU0428Test_CM_uint16_cnt 0.0 330.0 /end CHARACTERISTIC
/begin CHARACTERISTIC CTD_PRECHARGE_ENERGY_HIGH_FAULT "" VALUE 0x70010010 Scalar_UWORD 0 VBU0428Test_CM_uint16_cnt 0.0 330.0 /end CHARACTERISTIC
/begin CHARACTERISTIC CTD_PRECHARGE_RELAY_STUCK_OPEN_FAULT "" VALUE 0x70010012 Scalar_UWORD 0 VBU0428Test_CM_uint16_cnt 0.0 330.0 /end CHARACTERISTIC
/begin CHARACTERISTIC CTD_PRECHARGE_RESISTANCE_BLOWN_FAULT "" VALUE 0x70010014 Scalar_UWORD 0 VBU0428Test_CM_uint16_cnt 0.0 330.0 /end CHARACTERISTIC
/begin CHARACTERISTIC CTD_PRECHARG_TIMEOUT_FAULT "" VALUE 0x70010016 Scalar_UWORD 0 VBU0428Test_CM_uint16_cnt 0.0 330.0 /end CHARACTERISTIC
/begin CHARACTERISTIC CTM_CELL_OVER_TEMP_FAULT "" VALUE 0x7001001a Scalar_UWORD 0 VBU0428Test_CM_uint16_cnt 0.0 330.0 /end CHARACTERISTIC
/begin CHARACTERISTIC CVT_CELL_OVER_VOLTAGE_FAULT "" VALUE 0x70010024 Scalar_UWORD 0 VBU0428Test_CM_uint16_cnt 0.0 330.0 /end CHARACTERISTIC
/begin CHARACTERISTIC CVT_CELL_UNDER_VOLTAGE_FAULT "" VALUE 0x70010026 Scalar_UWORD 0 VBU0428Test_CM_uint16_cnt 0.0 330.0 /end CHARACTERISTIC
/begin CHARACTERISTIC CcBMM_CurrentStableDelayTime_ms "" VALUE 0x7001003a Scalar_UWORD 0 VBU0428Test_CM_uint16_cnt 0.0 65535.0 /end CHARACTERISTIC
/begin CHARACTERISTIC CcBMM_DeepSleepUploadTime_s "" VALUE 0x7001003c Scalar_UWORD 0 VBU0428Test_CM_uint16_cnt 0.0 65535.0 /end CHARACTERISTIC
/begin CHARACTERISTIC CcBMM_PeriodicalUploadTime_s "" VALUE 0x70010040 Scalar_UWORD 0 VBU0428Test_CM_uint16_cnt 0.0 65535.0 /end CHARACTERISTIC
/begin CHARACTERISTIC CcISO_BDMOutputDelayTime_ms "" VALUE 0x700100ae Scalar_UWORD 0 VBU0428Test_CM_uint16_ms 0.0 65535.0 /end CHARACTERISTIC
/begin CHARACTERISTIC CcISO_FaultReverseConfirmTime_ms "" VALUE 0x700100b2 Scalar_UWORD 0 VBU0428Test_CM_uint16_ms 0.0 65535.0 /end CHARACTERISTIC
/begin CHARACTERISTIC CcRTC_FastWakeUpCycle_min "" VALUE 0x700100b8 Scalar_UWORD 0 VBU0428Test_CM_uint16_cnt 0.0 65535.0 /end CHARACTERISTIC
/begin CHARACTERISTIC CcRTC_RTCWakeupLVBattDelay_min "" VALUE 0x0000 Scalar_UWORD 0 VBU0428Test_CM_uint16_cnt 0.0 65535.0 /end CHARACTERISTIC
/begin CHARACTERISTIC CcRTC_SlowWakeUpCycle_min "" VALUE 0x700100ba Scalar_UWORD 0 VBU0428Test_CM_uint16_cnt 0.0 65535.0 /end CHARACTERISTIC
/begin CHARACTERISTIC CcWRT_BatteryCapacityCycleORV_n "" VALUE 0x7001011e Scalar_UWORD 0 VBU0428Test_CM_uint16_cnt 0.0 65535.0 /end CHARACTERISTIC
/begin CHARACTERISTIC FCC_CHARGE_CURRENT_OVER_FAULT "" VALUE 0x70010124 Scalar_UWORD 0 VBU0428Test_CM_uint16_cnt 0.0 330.0 /end CHARACTERISTIC
/begin CHARACTERISTIC MILISECONDS_PER_SECOND "" VALUE 0x7001012e Scalar_UWORD 0 VBU0428Test_CM_uint16_cnt 0.0 65535.0 /end CHARACTERISTIC
/begin CHARACTERISTIC SAMPLE_TIME_TASK_A "" VALUE 0x70010134 Scalar_UWORD 0 VBU0428Test_CM_uint16_cnt 0.0 65535.0 /end CHARACTERISTIC
/begin CHARACTERISTIC SAMPLE_TIME_TASK_B "" VALUE 0x70010136 Scalar_UWORD 0 VBU0428Test_CM_uint16_cnt 0.0 65535.0 /end CHARACTERISTIC
/begin CHARACTERISTIC SOF_CHARGE_OVER_POWER_FAULT "" VALUE 0x70010142 Scalar_UWORD 0 VBU0428Test_CM_uint16_cnt 0.0 330.0 /end CHARACTERISTIC
/begin CHARACTERISTIC APO_AyAccelerationOvrd_C "" VALUE 0x70021f0d Scalar_BOOLEAN 0 VBU0428Test_CM_boolean_cnt 0.0 1.0 /end CHARACTERISTIC
/begin CHARACTERISTIC APO_AzAccelerationOvrd_C "" VALUE 0x70021f0e Scalar_BOOLEAN 0 VBU0428Test_CM_boolean_cnt 0.0 1.0 /end CHARACTERISTIC
/begin CHARACTERISTIC APO_HundredKmTripEnergyOvrd_C "" VALUE 0x70021f16 Scalar_BOOLEAN 0 VBU0428Test_CM_boolean_cnt 0.0 1.0 /end CHARACTERISTIC
/begin CHARACTERISTIC APO_RemainingChargingTimeOvrd_C "" VALUE 0x70021f1b Scalar_BOOLEAN 0 VBU0428Test_CM_boolean_cnt 0.0 1.0 /end CHARACTERISTIC
/begin CHARACTERISTIC APO_RemainingDrivingRangeOvrd_C "" VALUE 0x70021f1c Scalar_BOOLEAN 0 VBU0428Test_CM_boolean_cnt 0.0 1.0 /end CHARACTERISTIC
/begin CHARACTERISTIC APO_SOCLowWarningOvrd_C "" VALUE 0x70021f1d Scalar_BOOLEAN 0 VBU0428Test_CM_boolean_cnt 0.0 1.0 /end CHARACTERISTIC
/begin CHARACTERISTIC APO_TenkmTripEnergyOvrd_C "" VALUE 0x70021f1e Scalar_BOOLEAN 0 VBU0428Test_CM_boolean_cnt 0.0 1.0 /end CHARACTERISTIC
/begin CHARACTERISTIC APO_YawrateOvrd_C "" VALUE 0x70021f23 Scalar_BOOLEAN 0 VBU0428Test_CM_boolean_cnt 0.0 1.0 /end CHARACTERISTIC
/begin CHARACTERISTIC APO_flgAccPedPosOvrd_C "" VALUE 0x70021f2a Scalar_BOOLEAN 0 VBU0428Test_CM_boolean_cnt 0.0 1.0 /end CHARACTERISTIC
/begin CHARACTERISTIC APO_flgAxAccelerationOvrd_C "" VALUE 0x70021f2b Scalar_BOOLEAN 0 VBU0428Test_CM_boolean_cnt 0.0 1.0 /end CHARACTERISTIC
/begin CHARACTERISTIC APO_flgBMSCellTempHighAlarmOvrd_C "" VALUE 0x70021f2c Scalar_BOOLEAN 0 VBU0428Test_CM_boolean_cnt 0.0 1.0 /end CHARACTERISTIC
/begin CHARACTERISTIC APO_flgBMSCellTempLowAlarmOvrd_C "" VALUE 0x70021f2d Scalar_BOOLEAN 0 VBU0428Test_CM_boolean_cnt 0.0 1.0 /end CHARACTERISTIC
/begin CHARACTERISTIC APO_flgBMSDIsplaySOCOvrd_C "" VALUE 0x70021f2f Scalar_BOOLEAN 0 VBU0428Test_CM_boolean_cnt 0.0 1.0 /end CHARACTERISTIC
/begin CHARACTERISTIC APO_flgBMSFaultLevelOvrd_C "" VALUE 0x70021f30 Scalar_BOOLEAN 0 VBU0428Test_CM_boolean_cnt 0.0 1.0 /end CHARACTERISTIC
/begin CHARACTERISTIC APO_flgBMSInletTempOvrd_C "" VALUE 0x70021f31 Scalar_BOOLEAN 0 VBU0428Test_CM_boolean_cnt 0.0 1.0 /end CHARACTERISTIC
/begin CHARACTERISTIC APO_flgBMSMainRelayStatusOvrd_C "" VALUE 0x70021f32 Scalar_BOOLEAN 0 VBU0428Test_CM_boolean_cnt 0.0 1.0 /end CHARACTERISTIC
/begin CHARACTERISTIC APO_flgBMSOutletTempOvrd_C "" VALUE 0x70021f33 Scalar_BOOLEAN 0 VBU0428Test_CM_boolean_cnt 0.0 1.0 /end CHARACTERISTIC
/begin CHARACTERISTIC APO_flgBMSPackCurrentOvrd_C "" VALUE 0x70021f34 Scalar_BOOLEAN 0 VBU0428Test_CM_boolean_cnt 0.0 1.0 /end CHARACTERISTIC
/begin CHARACTERISTIC APO_flgBMSPackVoltageOvrd_C "" VALUE 0x70021f35 Scalar_BOOLEAN 0 VBU0428Test_CM_boolean_cnt 0.0 1.0 /end CHARACTERISTIC
/begin CHARACTERISTIC APO_flgBMSSOCOvrd_C "" VALUE 0x70021f36 Scalar_BOOLEAN 0 VBU0428Test_CM_boolean_cnt 0.0 1.0 /end CHARACTERISTIC
/begin CHARACTERISTIC APO_flgBMSThermalRunawayOvrd_C "" VALUE 0x70021f37 Scalar_BOOLEAN 0 VBU0428Test_CM_boolean_cnt 0.0 1.0 /end CHARACTERISTIC
/begin CHARACTERISTIC APO_flgBrkPressOvrd_C "" VALUE 0x70021f39 Scalar_BOOLEAN 0 VBU0428Test_CM_boolean_cnt 0.0 1.0 /end CHARACTERISTIC
/begin CHARACTERISTIC APO_flgBrkSwtOvrd_C "" VALUE 0x70021f3a Scalar_BOOLEAN 0 VBU0428Test_CM_boolean_cnt 0.0 1.0 /end CHARACTERISTIC
/begin CHARACTERISTIC APO_flgCellTempHighAlarmOvrdVal_C "" VALUE 0x70021f3b Scalar_BOOLEAN 0 VBU0428Test_CM_boolean_cnt 0.0 1.0 /end CHARACTERISTIC
/begin CHARACTERISTIC APO_flgCellTempLowAlarmOvrdVal_C "" VALUE 0x70021f3c Scalar_BOOLEAN 0 VBU0428Test_CM_boolean_cnt 0.0 1.0 /end CHARACTERISTIC
/begin CHARACTERISTIC APO_flgEfcAccPdlOvrd_C "" VALUE 0x70021f41 Scalar_BOOLEAN 0 VBU0428Test_CM_boolean_cnt 0.0 1.0 /end CHARACTERISTIC
/begin CHARACTERISTIC APO_flgLVBattOvrd_C "" VALUE 0x70021f47 Scalar_BOOLEAN 0 VBU0428Test_CM_boolean_cnt 0.0 1.0 /end CHARACTERISTIC
/begin CHARACTERISTIC CaCSC_CellBalanceRequestORF_flg "" VAL_BLK 0x700224a2 Scalar_BOOLEAN 0 VBU0428Test_CM_boolean_cnt 0.0 1.0 NUMBER 198 /end CHARACTERISTIC
/begin CHARACTERISTIC CaCSC_CellBalanceRequestORV_flg "" VAL_BLK 0x70022568 Scalar_BOOLEAN 0 VBU0428Test_CM_boolean_cnt 0.0 1.0 NUMBER 198 /end CHARACTERISTIC
/begin CHARACTERISTIC CbBMM_AbnormalEventDetectedORF_flg "" VALUE 0x70022015 Scalar_BOOLEAN 0 VBU0428Test_CM_boolean_cnt 0.0 1.0 /end CHARACTERISTIC
/begin CHARACTERISTIC CbBMM_AbnormalEventDetectedORV_flg "" VALUE 0x70022016 Scalar_BOOLEAN 0 VBU0428Test_CM_boolean_cnt 0.0 1.0 /end CHARACTERISTIC
/begin CHARACTERISTIC CbBMM_AbnormalPowerOffOverride_flg "" VALUE 0x70022017 Scalar_BOOLEAN 0 VBU0428Test_CM_boolean_cnt 0.0 1.0 /end CHARACTERISTIC
/begin CHARACTERISTIC CbBMM_AbnormalResetOverride_flg "" VALUE 0x70022018 Scalar_BOOLEAN 0 VBU0428Test_CM_boolean_cnt 0.0 1.0 /end CHARACTERISTIC
/begin CHARACTERISTIC CbBMM_flgNVMReadCheckEnable_C "" VALUE 0x7002201c Scalar_BOOLEAN 0 VBU0428Test_CM_boolean_cnt 0.0 1.0 /end CHARACTERISTIC
/begin CHARACTERISTIC CbISO_IsolationSevere_flg "" VALUE 0x7002205a Scalar_BOOLEAN 0 VBU0428Test_CM_boolean_flg 0.0 1.0 /end CHARACTERISTIC
/begin CHARACTERISTIC CbISO_IsolationWarning_flg "" VALUE 0x7002205b Scalar_BOOLEAN 0 VBU0428Test_CM_boolean_flg 0.0 1.0 /end CHARACTERISTIC
/begin CHARACTERISTIC CbNVM_DataReadFaultEnable_flg "" VALUE 0x7002205c Scalar_BOOLEAN 0 VBU0428Test_CM_boolean_cnt 0.0 1.0 /end CHARACTERISTIC
/begin CHARACTERISTIC CbNVM_DataWriteFaultEnable_flg "" VALUE 0x7002205d Scalar_BOOLEAN 0 VBU0428Test_CM_boolean_cnt 0.0 1.0 /end CHARACTERISTIC
/begin CHARACTERISTIC CbNVM_EepromCrcCheckFaultEnable_flg "" VALUE 0x7002205e Scalar_BOOLEAN 0 VBU0428Test_CM_boolean_cnt 0.0 1.0 /end CHARACTERISTIC
/begin CHARACTERISTIC CbRTC_ActualTimeInit_flg "" VALUE 0x70022060 Scalar_BOOLEAN 0 VBU0428Test_CM_boolean_cnt 0.0 1.0 /end CHARACTERISTIC
/begin CHARACTERISTIC CbRTC_flgRealtimeClockFaultEnable "" VALUE 0x70022062 Scalar_BOOLEAN 0 VBU0428Test_CM_boolean_cnt 0.0 1.0 /end CHARACTERISTIC
/begin CHARACTERISTIC CbSYS_flgAbnormalResetRecoverEnable "" VALUE 0x7002207a Scalar_BOOLEAN 0 VBU0428Test_CM_boolean_cnt 0.0 1.0 /end CHARACTERISTIC
/begin CHARACTERISTIC CbWRT_BatteryCapacityCycleORF_flg "" VALUE 0x7002210f Scalar_BOOLEAN 0 VBU0428Test_CM_boolean_cnt 0.0 1.0 /end CHARACTERISTIC
/begin CHARACTERISTIC HALOut_flgAccPed2VccEn_C "" VALUE 0x70022361 Scalar_BOOLEAN 0 VBU0428Test_CM_boolean_flg 0.0 1.0 /end CHARACTERISTIC
/begin CHARACTERISTIC HALOut_flgAccPedlVccEn_C "" VALUE 0x70022362 Scalar_BOOLEAN 0 VBU0428Test_CM_boolean_flg 0.0 1.0 /end CHARACTERISTIC
/begin CHARACTERISTIC HALOut_flgBekPressVccEn_C "" VALUE 0x70022363 Scalar_BOOLEAN 0 VBU0428Test_CM_boolean_flg 0.0 1.0 /end CHARACTERISTIC
/begin CHARACTERISTIC HALOut_flgVcuumPumpVccEn_C "" VALUE 0x70022364 Scalar_BOOLEAN 0 VBU0428Test_CM_boolean_flg 0.0 1.0 /end CHARACTERISTIC
/begin CHARACTERISTIC INP_flgAccPed1CaliOvrd_C "" VALUE 0x70022369 Scalar_BOOLEAN 0 VBU0428Test_CM_boolean_cnt 0.0 1.0 /end CHARACTERISTIC
/begin CHARACTERISTIC INP_flgAccPed1SafetyEnable_C "" VALUE 0x7002236a Scalar_BOOLEAN 0 VBU0428Test_CM_boolean_cnt 0.0 1.0 /end CHARACTERISTIC
/begin CHARACTERISTIC INP_flgAccPed2CaliOvrd_C "" VALUE 0x7002236b Scalar_BOOLEAN 0 VBU0428Test_CM_boolean_cnt 0.0 1.0 /end CHARACTERISTIC
/begin CHARACTERISTIC INP_flgAccPed2SafetyEnable_C "" VALUE 0x7002236c Scalar_BOOLEAN 0 VBU0428Test_CM_boolean_cnt 0.0 1.0 /end CHARACTERISTIC
/begin CHARACTERISTIC INP_flgBrkPresCaliOvrd_C "" VALUE 0x7002236d Scalar_BOOLEAN 0 VBU0428Test_CM_boolean_cnt 0.0 1.0 /end CHARACTERISTIC
/begin CHARACTERISTIC INP_flgBrkPresSafetyEnable_C "" VALUE 0x7002236e Scalar_BOOLEAN 0 VBU0428Test_CM_boolean_cnt 0.0 1.0 /end CHARACTERISTIC
/begin CHARACTERISTIC INP_flgDCChCC2CaliOvrd_C "" VALUE 0x7002236f Scalar_BOOLEAN 0 VBU0428Test_CM_boolean_cnt 0.0 1.0 /end CHARACTERISTIC
/begin CHARACTERISTIC INP_flgDCChCC2SafetyEnable_C "" VALUE 0x70022370 Scalar_BOOLEAN 0 VBU0428Test_CM_boolean_cnt 0.0 1.0 /end CHARACTERISTIC
/begin CHARACTERISTIC INP_flgDCChPortTempCaliOvrd_C "" VALUE 0x70022371 Scalar_BOOLEAN 0 VBU0428Test_CM_boolean_C 0.0 1.0 /end CHARACTERISTIC
/begin CHARACTERISTIC INP_flgDCChPortTempNegativeCaliOvrd_C "" VALUE 0x70022372 Scalar_BOOLEAN 0 VBU0428Test_CM_boolean_cnt 0.0 1.0 /end CHARACTERISTIC
/begin CHARACTERISTIC INP_flgDCChPortTempNegativeSafetyEnable_C "" VALUE 0x70022373 Scalar_BOOLEAN 0 VBU0428Test_CM_boolean_cnt 0.0 1.0 /end CHARACTERISTIC
/begin CHARACTERISTIC INP_flgDCChPortTempSafetyEnable_C "" VALUE 0x70022374 Scalar_BOOLEAN 0 VBU0428Test_CM_boolean_cnt 0.0 1.0 /end CHARACTERISTIC
/begin CHARACTERISTIC INP_flgEDSOutTempCaliOvrd_C "" VALUE 0x70022375 Scalar_BOOLEAN 0 VBU0428Test_CM_boolean_cnt 0.0 1.0 /end CHARACTERISTIC
/begin CHARACTERISTIC INP_flgEDSOutTempSafetyEnable_C "" VALUE 0x70022376 Scalar_BOOLEAN 0 VBU0428Test_CM_boolean_cnt 0.0 1.0 /end CHARACTERISTIC
/begin CHARACTERISTIC INP_flgVacPresCaliOvrd_C "" VALUE 0x70022377 Scalar_BOOLEAN 0 VBU0428Test_CM_boolean_cnt 0.0 1.0 /end CHARACTERISTIC
/begin CHARACTERISTIC INP_flgVacPresSafetyEnable_C "" VALUE 0x70022378 Scalar_BOOLEAN 0 VBU0428Test_CM_boolean_cnt 0.0 1.0 /end CHARACTERISTIC
/begin CHARACTERISTIC THM_flgEXVInitORF "" VALUE 0x7002242f Scalar_BOOLEAN 0 VBU0428Test_CM_boolean 0 1 /end CHARACTERISTIC
/begin CHARACTERISTIC THM_flgEXVInitORV "" VALUE 0x70022430 Scalar_BOOLEAN 0 VBU0428Test_CM_boolean 0 1 /end CHARACTERISTIC
/begin CHARACTERISTIC THM_flgEXVPosReqEnableORF "" VALUE 0x70022431 Scalar_BOOLEAN 0 VBU0428Test_CM_boolean 0 1 /end CHARACTERISTIC
/begin CHARACTERISTIC THM_flgEXVPosReqEnableORV "" VALUE 0x70022432 Scalar_BOOLEAN 0 VBU0428Test_CM_boolean 0 1 /end CHARACTERISTIC
/begin CHARACTERISTIC THM_flgEXVPosReqORF "" VALUE 0x70022433 Scalar_BOOLEAN 0 VBU0428Test_CM_boolean 0 1 /end CHARACTERISTIC
/begin CHARACTERISTIC THM_flgFANfrecuencyORF "" VALUE 0x90002818 Scalar_BOOLEAN 0 VBU0428Test_CM_boolean 0 1 /end CHARACTERISTIC
/begin CHARACTERISTIC THM_flgFPVEnableORF "" VALUE 0x70022434 Scalar_BOOLEAN 0 VBU0428Test_CM_boolean 0 1 /end CHARACTERISTIC
/begin CHARACTERISTIC THM_flgFPVEnableORV "" VALUE 0x70022435 Scalar_BOOLEAN 0 VBU0428Test_CM_boolean 0 1 /end CHARACTERISTIC
/begin CHARACTERISTIC THM_flgFPVPosReqORF "" VALUE 0x70022436 Scalar_BOOLEAN 0 VBU0428Test_CM_boolean 0 1 /end CHARACTERISTIC
/begin CHARACTERISTIC THM_flgOverrideACCmpCmd "" VALUE 0x70022437 Scalar_BOOLEAN 0 VBU0428Test_CM_boolean_flg 0.0 1.0 /end CHARACTERISTIC
/begin CHARACTERISTIC THM_flgOverrideACCmpValid "" VALUE 0x70022438 Scalar_BOOLEAN 0 VBU0428Test_CM_boolean_flg 0.0 1.0 /end CHARACTERISTIC
/begin CHARACTERISTIC THM_flgOverrideACCmpVlv "" VALUE 0x70022439 Scalar_BOOLEAN 0 VBU0428Test_CM_boolean_flg 0.0 1.0 /end CHARACTERISTIC
/begin CHARACTERISTIC THM_flgOverrideBattPTCCmd "" VALUE 0x7002243a Scalar_BOOLEAN 0 VBU0428Test_CM_boolean_flg 0.0 1.0 /end CHARACTERISTIC
/begin CHARACTERISTIC THM_flgOverrideChillerPos "" VALUE 0x7002243b Scalar_BOOLEAN 0 VBU0428Test_CM_boolean_flg 0.0 1.0 /end CHARACTERISTIC
/begin CHARACTERISTIC THM_flgOverrideESSPmpCmd "" VALUE 0x7002243c Scalar_BOOLEAN 0 VBU0428Test_CM_boolean_flg 0.0 1.0 /end CHARACTERISTIC
/begin CHARACTERISTIC THM_flgOverrideFAN "" VALUE 0x7002243d Scalar_BOOLEAN 0 VBU0428Test_CM_boolean_flg 0.0 1.0 /end CHARACTERISTIC
/begin CHARACTERISTIC THM_flgOverrideRearPmpCmd "" VALUE 0x7002243e Scalar_BOOLEAN 0 VBU0428Test_CM_boolean_flg 0.0 1.0 /end CHARACTERISTIC
/begin CHARACTERISTIC THM_flgOverridevalueACCmpValid "" VALUE 0x7002243f Scalar_BOOLEAN 0 VBU0428Test_CM_boolean_flg 0.0 1.0 /end CHARACTERISTIC
/begin CHARACTERISTIC THM_flgOverridevalueBattPTCCmd "" VALUE 0x70022440 Scalar_BOOLEAN 0 VBU0428Test_CM_boolean_flg 0.0 1.0 /end CHARACTERISTIC
/begin CHARACTERISTIC THM_flgPump1frecuencyORF "" VALUE 0x90002819 Scalar_BOOLEAN 0 VBU0428Test_CM_boolean 0 1 /end CHARACTERISTIC
/begin CHARACTERISTIC CcISO_IsolationSevereFaultFIC_n "" VALUE 0x70022182 Scalar_BYTE 0 VBU0428Test_CM_int8_n -128.0 127.0 /end CHARACTERISTIC
/begin CHARACTERISTIC CcISO_IsolationSevereFaultPIC_n "" VALUE 0x70022183 Scalar_BYTE 0 VBU0428Test_CM_int8_n -128.0 127.0 /end CHARACTERISTIC
/begin CHARACTERISTIC CcISO_IsolationWarningFaultFIC_n "" VALUE 0x70022184 Scalar_BYTE 0 VBU0428Test_CM_int8_n -128.0 127.0 /end CHARACTERISTIC
/begin CHARACTERISTIC CcISO_IsolationWarningFaultPIC_n "" VALUE 0x70022185 Scalar_BYTE 0 VBU0428Test_CM_int8_n -128.0 127.0 /end CHARACTERISTIC
/begin CHARACTERISTIC CcNVM_DataReadFIC_n "" VALUE 0x70022186 Scalar_BYTE 0 VBU0428Test_CM_int8_cnt -128.0 127.0 /end CHARACTERISTIC
/begin CHARACTERISTIC CcNVM_DataReadPIC_n "" VALUE 0x70022187 Scalar_BYTE 0 VBU0428Test_CM_int8_cnt -128.0 127.0 /end CHARACTERISTIC
/begin CHARACTERISTIC CcNVM_DataWriteFIC_n "" VALUE 0x0000 Scalar_BYTE 0 VBU0428Test_CM_int8_cnt -128.0 127.0 /end CHARACTERISTIC
/begin CHARACTERISTIC CcNVM_DataWritePIC_n "" VALUE 0x70022188 Scalar_BYTE 0 VBU0428Test_CM_int8_cnt -128.0 127.0 /end CHARACTERISTIC
/begin CHARACTERISTIC CcNVM_EepromCrcCheckFIC_n "" VALUE 0x70022189 Scalar_BYTE 0 VBU0428Test_CM_int8_cnt -128.0 127.0 /end CHARACTERISTIC
/begin CHARACTERISTIC CcNVM_EepromCrcCheckPIC_n "" VALUE 0x7002218a Scalar_BYTE 0 VBU0428Test_CM_int8_cnt -128.0 127.0 /end CHARACTERISTIC
/begin CHARACTERISTIC APO_stBMSFaultLevelOvrdVal_C "" VALUE 0x70021f54 Scalar_UBYTE 0 VBU0428Test_CM_uint8_cnt 0.0 255.0 /end CHARACTERISTIC
/begin CHARACTERISTIC APO_stBMSMainRelayStatusOvrdVal_C "" VALUE 0x70021f55 Scalar_UBYTE 0 VBU0428Test_CM_uint8_cnt 0.0 255.0 /end CHARACTERISTIC
/begin CHARACTERISTIC BMM_BMU_POWEROFF_NORMAL "" VALUE 0x70021f76 Scalar_UBYTE 0 VBU0428Test_CM_uint8_cnt 0.0 255.0 /end CHARACTERISTIC
/begin CHARACTERISTIC BMM_BMU_RESET_NONE "" VALUE 0x70021f77 Scalar_UBYTE 0 VBU0428Test_CM_uint8_cnt 0.0 255.0 /end CHARACTERISTIC
/begin CHARACTERISTIC BMM_STATE_AFTER_RUN "" VALUE 0x70021f78 Scalar_UBYTE 0 VBU0428Test_CM_uint8_cnt 0.0 255.0 /end CHARACTERISTIC
/begin CHARACTERISTIC BMM_STATE_DRIVE_MODE "" VALUE 0x70021f79 Scalar_UBYTE 0 VBU0428Test_CM_uint8_cnt 0.0 255.0 /end CHARACTERISTIC
/begin CHARACTERISTIC BMM_STATE_FAST_CHARGE "" VALUE 0x70021f7a Scalar_UBYTE 0 VBU0428Test_CM_uint8_cnt 0.0 255.0 /end CHARACTERISTIC
/begin CHARACTERISTIC BMM_STATE_IDLE "" VALUE 0x70021f7b Scalar_UBYTE 0 VBU0428Test_CM_uint8_cnt 0.0 255.0 /end CHARACTERISTIC
/begin CHARACTERISTIC BMM_STATE_INITIALIZATION "" VALUE 0x70021f7c Scalar_UBYTE 0 VBU0428Test_CM_uint8_cnt 0.0 255.0 /end CHARACTERISTIC
/begin CHARACTERISTIC BMM_STATE_ONBOARD_CHARGE "" VALUE 0x70021f7d Scalar_UBYTE 0 VBU0428Test_CM_uint8_cnt 0.0 255.0 /end CHARACTERISTIC
/begin CHARACTERISTIC BMM_STATE_RTC "" VALUE 0x70021f7f Scalar_UBYTE 0 VBU0428Test_CM_uint8_cnt 0.0 255.0 /end CHARACTERISTIC
/begin CHARACTERISTIC BMM_STATE_SHUT_DOWN "" VALUE 0x70021f80 Scalar_UBYTE 0 VBU0428Test_CM_uint8_cnt 0.0 255.0 /end CHARACTERISTIC
/begin CHARACTERISTIC CTD_MAIN_CONTACTOR_STATUS_CLOSED "" VALUE 0x70021fd0 Scalar_UBYTE 0 VBU0428Test_CM_uint8_cnt 0.0 255.0 /end CHARACTERISTIC
/begin CHARACTERISTIC CTD_MAIN_CONTACTOR_STATUS_OPENED "" VALUE 0x70021fd1 Scalar_UBYTE 0 VBU0428Test_CM_uint8_cnt 0.0 255.0 /end CHARACTERISTIC
/begin CHARACTERISTIC CYCLE_WAKEUP_STATE_PERIODICAL_UPLOAD "" VALUE 0x70021ff3 Scalar_UBYTE 0 VBU0428Test_CM_uint8_cnt 0.0 255.0 /end CHARACTERISTIC
/begin CHARACTERISTIC CcISO_AllowableIsolationWarningTimes_n "" VALUE 0x70022181 Scalar_UBYTE 0 VBU0428Test_CM_uint8_n 0.0 255.0 /end CHARACTERISTIC
/begin CHARACTERISTIC DSM_FDCFaultStatus_C "" VAL_BLK 0x70022b56 Scalar_UBYTE 0 VBU0428Test_CM_uint8_cnt 0.0 1.0 NUMBER 330 /end CHARACTERISTIC
/begin CHARACTERISTIC INP_numAccPed1CounterLim_C "" VALUE 0x70022379 Scalar_UBYTE 0 VBU0428Test_CM_uint8_cnt 0.0 100.0 /end CHARACTERISTIC
/begin CHARACTERISTIC INP_numAccPed1DecCounter_C "" VALUE 0x7002237a Scalar_UBYTE 0 VBU0428Test_CM_uint8_cnt 0.0 100.0 /end CHARACTERISTIC
/begin CHARACTERISTIC INP_numAccPed1IncCounter_C "" VALUE 0x7002237b Scalar_UBYTE 0 VBU0428Test_CM_uint8_cnt 0.0 100.0 /end CHARACTERISTIC
/begin CHARACTERISTIC INP_numAccPed2CounterLim_C "" VALUE 0x7002237c Scalar_UBYTE 0 VBU0428Test_CM_uint8_cnt 0.0 100.0 /end CHARACTERISTIC
/begin CHARACTERISTIC INP_numAccPed2DecCounter_C "" VALUE 0x7002237d Scalar_UBYTE 0 VBU0428Test_CM_uint8_cnt 0.0 100.0 /end CHARACTERISTIC
/begin CHARACTERISTIC INP_numAccPed2IncCounter_C "" VALUE 0x7002237e Scalar_UBYTE 0 VBU0428Test_CM_uint8_cnt 0.0 100.0 /end CHARACTERISTIC
/begin CHARACTERISTIC INP_numBrkPresCounterLim_C "" VALUE 0x7002237f Scalar_UBYTE 0 VBU0428Test_CM_uint8_cnt 0.0 100.0 /end CHARACTERISTIC
/begin CHARACTERISTIC INP_numBrkPresDecCounter_C "" VALUE 0x70022380 Scalar_UBYTE 0 VBU0428Test_CM_uint8_cnt 0.0 100.0 /end CHARACTERISTIC
/begin CHARACTERISTIC INP_numBrkPresIncCounter_C "" VALUE 0x70022381 Scalar_UBYTE 0 VBU0428Test_CM_uint8_cnt 0.0 100.0 /end CHARACTERISTIC
/begin CHARACTERISTIC INP_numDCChCC2CounterLim_C "" VALUE 0x70022382 Scalar_UBYTE 0 VBU0428Test_CM_uint8_cnt 0.0 100.0 /end CHARACTERISTIC
/begin CHARACTERISTIC INP_numDCChCC2DecCounter_C "" VALUE 0x70022383 Scalar_UBYTE 0 VBU0428Test_CM_uint8_cnt 0.0 100.0 /end CHARACTERISTIC
/begin CHARACTERISTIC INP_numDCChCC2IncCounter_C "" VALUE 0x70022384 Scalar_UBYTE 0 VBU0428Test_CM_uint8_cnt 0.0 100.0 /end CHARACTERISTIC
/begin CHARACTERISTIC INP_numDCChPortTempCounterLim_C "" VALUE 0x70022385 Scalar_UBYTE 0 VBU0428Test_CM_uint8_cnt 0.0 100.0 /end CHARACTERISTIC
/begin CHARACTERISTIC INP_numDCChPortTempDecCounter_C "" VALUE 0x70022386 Scalar_UBYTE 0 VBU0428Test_CM_uint8_cnt 0.0 100.0 /end CHARACTERISTIC
/begin CHARACTERISTIC INP_numDCChPortTempIncCounter_C "" VALUE 0x70022387 Scalar_UBYTE 0 VBU0428Test_CM_uint8_cnt 0.0 100.0 /end CHARACTERISTIC
/begin CHARACTERISTIC INP_numDCChPortTempNegativeCounterLim_C "" VALUE 0x70022388 Scalar_UBYTE 0 VBU0428Test_CM_uint8_cnt 0.0 100.0 /end CHARACTERISTIC
/begin CHARACTERISTIC INP_numDCChPortTempNegativeDecCounter_C "" VALUE 0x70022389 Scalar_UBYTE 0 VBU0428Test_CM_uint8_cnt 0.0 100.0 /end CHARACTERISTIC
/begin CHARACTERISTIC INP_numDCChPortTempNegativeIncCounter_C "" VALUE 0x7002238a Scalar_UBYTE 0 VBU0428Test_CM_uint8_cnt 0.0 100.0 /end CHARACTERISTIC
/begin CHARACTERISTIC INP_numEDSOutTempCounterLim_C "" VALUE 0x7002238b Scalar_UBYTE 0 VBU0428Test_CM_uint8_cnt 0.0 100.0 /end CHARACTERISTIC
/begin CHARACTERISTIC INP_numEDSOutTempDecCounter_C "" VALUE 0x7002238c Scalar_UBYTE 0 VBU0428Test_CM_uint8_cnt 0.0 100.0 /end CHARACTERISTIC
/begin CHARACTERISTIC INP_numEDSOutTempIncCounter_C "" VALUE 0x7002238d Scalar_UBYTE 0 VBU0428Test_CM_uint8_cnt 0.0 100.0 /end CHARACTERISTIC
/begin CHARACTERISTIC INP_numVacPresCounterLim_C "" VALUE 0x7002238e Scalar_UBYTE 0 VBU0428Test_CM_uint8_cnt 0.0 100.0 /end CHARACTERISTIC
/begin CHARACTERISTIC INP_numVacPresDecCounter_C "" VALUE 0x7002238f Scalar_UBYTE 0 VBU0428Test_CM_uint8_cnt 0.0 100.0 /end CHARACTERISTIC
/begin CHARACTERISTIC INP_numVacPresIncCounter_C "" VALUE 0x70022390 Scalar_UBYTE 0 VBU0428Test_CM_uint8_cnt 0.0 100.0 /end CHARACTERISTIC
/begin CHARACTERISTIC ISO_ISOLATION_SEVERE_FAULT "" VALUE 0x70022391 Scalar_UBYTE 0 VBU0428Test_CM_uint8_n 0.0 255.0 /end CHARACTERISTIC
/begin CHARACTERISTIC ISO_ISOLATION_WARNING_FAULT "" VALUE 0x70022392 Scalar_UBYTE 0 VBU0428Test_CM_uint8_n 0.0 255.0 /end CHARACTERISTIC
/begin CHARACTERISTIC NVM_DATA_READ_FAULT "" VALUE 0x700223b9 Scalar_UBYTE 0 VBU0428Test_CM_uint8_cnt 0.0 255.0 /end CHARACTERISTIC
/begin CHARACTERISTIC NVM_DATA_WRITE_FAULT "" VALUE 0x700223ba Scalar_UBYTE 0 VBU0428Test_CM_uint8_cnt 0.0 255.0 /end CHARACTERISTIC
/begin CHARACTERISTIC NVM_EEPROM_CRC_CHECK_FAULT "" VALUE 0x700223bb Scalar_UBYTE 0 VBU0428Test_CM_uint8_cnt 0.0 255.0 /end CHARACTERISTIC
/begin CHARACTERISTIC NVM_READ_CRC_FAIL "" VALUE 0x700223bc Scalar_UBYTE 0 VBU0428Test_CM_uint8_cnt 0.0 255.0 /end CHARACTERISTIC
/begin CHARACTERISTIC NVM_READ_HARDWARE_FAIL "" VALUE 0x700223bd Scalar_UBYTE 0 VBU0428Test_CM_uint8_cnt 0.0 255.0 /end CHARACTERISTIC
/begin CHARACTERISTIC PMM_stDCChMode_SY "" VALUE 0x700223e9 Scalar_UBYTE 0 VBU0428Test_CM_uint8_cnt 0.0 255.0 /end CHARACTERISTIC
/begin CHARACTERISTIC RTC_REALTIME_CLOCK_FAULT "" VALUE 0x7002240d Scalar_UBYTE 0 VBU0428Test_CM_uint8_cnt 0.0 255.0 /end CHARACTERISTIC
/begin CHARACTERISTIC THM_stFPVPosORV "" VALUE 0x70022441 Scalar_UBYTE 0 VBU0428Test_CM_uint8 0 255 /end CHARACTERISTIC
/begin CHARACTERISTIC THM_stOverridevalueACVlvOnoff "" VALUE 0x70022442 Scalar_UBYTE 0 VBU0428Test_CM_uint8_cnt 0.0 255.0 /end CHARACTERISTIC
/begin MEASUREMENT THM_flgBattPTCCmd "" FLOAT64_IEEE VBU0428Test_CM_double 0 0 -1.7E+308 1.7E+308 ECU_ADDRESS 0x90000204 /end MEASUREMENT
/begin MEASUREMENT VTestW "" ULONG VBU0428Test_CM_uint32 0 0 0 4294967295 ECU_ADDRESS 0x90000234 /end MEASUREMENT
/begin MEASUREMENT W3_Test "" ULONG VBU0428Test_CM_uint32 0 0 0 4294967295 ECU_ADDRESS 0x90000238 /end MEASUREMENT
/begin MEASUREMENT R3_test "" ULONG VBU0428Test_CM_uint32 0 0 0 4294967295 ECU_ADDRESS 0x90000170 /end MEASUREMENT
/begin MEASUREMENT WRT_numOpenContactorWithLoadTimes1 "" ULONG VBU0428Test_CM_uint32 0 0 0 4294967295 ECU_ADDRESS 0x6003bef6 /end MEASUREMENT
/begin MEASUREMENT WRT_numOpenContactorWithLoadTimes2 "" ULONG VBU0428Test_CM_uint32 0 0 0 4294967295 ECU_ADDRESS 0x6003befa /end MEASUREMENT
/begin MEASUREMENT INP_uLVBatt "" FLOAT32_IEEE VBU0428Test_CM_single 0 0 0.0 28.0 ECU_ADDRESS 0x6003bb8e /end MEASUREMENT
/begin MEASUREMENT THM_nACSpdSet "" FLOAT32_IEEE VBU0428Test_CM_single 0 0 -3.4E+38 3.4E+38 ECU_ADDRESS 0x90000208 /end MEASUREMENT
/begin MEASUREMENT THM_rpmACCompCmd "" FLOAT32_IEEE VBU0428Test_CM_single 0 0 -3.4E+38 3.4E+38 ECU_ADDRESS 0x90000210 /end MEASUREMENT
/begin MEASUREMENT TQC_TrqDes "" FLOAT32_IEEE VBU0428Test_CM_single 0 0 -9000.0 9000.0 ECU_ADDRESS 0x6003bcca /end MEASUREMENT
/begin MEASUREMENT THM_flgACVlvOnOff "" FLOAT32_IEEE VBU0428Test_CM_single 0 0 -3.4E+38 3.4E+38 ECU_ADDRESS 0x90000200 /end MEASUREMENT
/begin MEASUREMENT THM_pctChillerPos "" FLOAT32_IEEE VBU0428Test_CM_single 0 0 -3.4E+38 3.4E+38 ECU_ADDRESS 0x9000020c /end MEASUREMENT
/begin MEASUREMENT WRT_numBatteryCapacityCycle "" FLOAT32_IEEE VBU0428Test_CM_single 0 0 -3.4E+38 3.4E+38 ECU_ADDRESS 0x6003bef2 /end MEASUREMENT
/begin MEASUREMENT WRT_AhOverallDischarged "" FLOAT32_IEEE VBU0428Test_CM_single 0 0 -3.4E+38 3.4E+38 ECU_ADDRESS 0x6003beea /end MEASUREMENT
/begin MEASUREMENT WRT_AhOverallFastcharged "" FLOAT32_IEEE VBU0428Test_CM_single 0 0 -3.4E+38 3.4E+38 ECU_ADDRESS 0x6003beee /end MEASUREMENT
/begin MEASUREMENT CellTemp1 "" FLOAT32_IEEE VBU0428Test_CM_single 0 0 -3.4E+38 3.4E+38 ECU_ADDRESS 0x90000100 /end MEASUREMENT
/begin MEASUREMENT BCV_uHALBatteryVoltageRaw "" FLOAT32_IEEE VBU0428Test_CM_single 0 0 -3.4E+38 3.4E+38 ECU_ADDRESS 0x900000e4 /end MEASUREMENT
/begin MEASUREMENT BCV_uHALVx2VoltageRaw "" FLOAT32_IEEE VBU0428Test_CM_single 0 0 -3.4E+38 3.4E+38 ECU_ADDRESS 0x900000f0 /end MEASUREMENT
/begin MEASUREMENT BCV_uHALBusNegativeVoltageRaw "" FLOAT32_IEEE VBU0428Test_CM_single 0 0 -3.4E+38 3.4E+38 ECU_ADDRESS 0x900000e8 /end MEASUREMENT
/begin MEASUREMENT BCV_uHALFuseVoltageRaw "" FLOAT32_IEEE VBU0428Test_CM_single 0 0 -3.4E+38 3.4E+38 ECU_ADDRESS 0x900000ec /end MEASUREMENT
/begin MEASUREMENT THM_phiEXVPosReq "" UWORD VBU0428Test_CM_uint16 0 0 0 65535 ECU_ADDRESS 0x900016fa /end MEASUREMENT
/begin MEASUREMENT BSWIN_BatteryPre_f "" UWORD VBU0428Test_CM_uint16 0 0 0 65535 ECU_ADDRESS 0x900016da /end MEASUREMENT
/begin MEASUREMENT BSWIN_BatteryPre_du "" UWORD VBU0428Test_CM_uint16 0 0 0 65535 ECU_ADDRESS 0x900016d8 /end MEASUREMENT
/begin MEASUREMENT BSWIN_HVIL_f "" UWORD VBU0428Test_CM_uint16 0 0 0 65535 ECU_ADDRESS 0x900014a4 /end MEASUREMENT
/begin MEASUREMENT BSWIN_HVIL_du "" UWORD VBU0428Test_CM_uint16 0 0 0 65535 ECU_ADDRESS 0x900014a2 /end MEASUREMENT
/begin MEASUREMENT BSWIN_DCChAPlusWkup "" UWORD VBU0428Test_CM_uint16 0 0 0 65535 ECU_ADDRESS 0x900016dc /end MEASUREMENT
/begin MEASUREMENT uflgIgnOnRaw "" UWORD VBU0428Test_CM_uint16 0 0 0 65535 ECU_ADDRESS 0x90001700 /end MEASUREMENT
/begin MEASUREMENT uLVBattRaw "" UWORD VBU0428Test_CM_uint16 0 0 0 65535 ECU_ADDRESS 0x900016fe /end MEASUREMENT
/begin MEASUREMENT uDCChCC2 "" UWORD VBU0428Test_CM_uint16 0 0 0 65535 ECU_ADDRESS 0x900016ae /end MEASUREMENT
/begin MEASUREMENT BSWIN_EDSInletCoolTemp "" UWORD VBU0428Test_CM_uint16 0 0 0 65535 ECU_ADDRESS 0x900016de /end MEASUREMENT
/begin MEASUREMENT uDCChPortTempNegativeRaw "" UWORD VBU0428Test_CM_uint16 0 0 0 65535 ECU_ADDRESS 0x900016b0 /end MEASUREMENT
/begin MEASUREMENT uDCChPortPosTempRaw "" UWORD VBU0428Test_CM_uint16 0 0 0 65535 ECU_ADDRESS 0x900016fc /end MEASUREMENT
/begin MEASUREMENT uAccPed2Raw "" UWORD VBU0428Test_CM_uint16 0 0 0 65535 ECU_ADDRESS 0x900016aa /end MEASUREMENT
/begin MEASUREMENT uAccPed1Raw "" UWORD VBU0428Test_CM_uint16 0 0 0 65535 ECU_ADDRESS 0x900016a8 /end MEASUREMENT
/begin MEASUREMENT BSWIN_uVacuumPre "" UWORD VBU0428Test_CM_uint16 0 0 0 65535 ECU_ADDRESS 0x900016e0 /end MEASUREMENT
/begin MEASUREMENT uBrkPresRaw "" UWORD VBU0428Test_CM_uint16 0 0 0 65535 ECU_ADDRESS 0x900016ac /end MEASUREMENT
/begin MEASUREMENT THM_pctFAN "" UWORD VBU0428Test_CM_uint16 0 0 0 65535 ECU_ADDRESS 0x900016f6 /end MEASUREMENT
/begin MEASUREMENT THM_pctESSPmpCmd "" UWORD VBU0428Test_CM_uint16 0 0 0 65535 ECU_ADDRESS 0x900016f4 /end MEASUREMENT
/begin MEASUREMENT THM_pctRearPmpCmd "" UWORD VBU0428Test_CM_uint16 0 0 0 65535 ECU_ADDRESS 0x900016f8 /end MEASUREMENT
/begin MEASUREMENT THM_stEXVInitial "" UBYTE VBU0428Test_CM_uint8 0 0 0 255 ECU_ADDRESS 0x90001f8e /end MEASUREMENT
/begin MEASUREMENT THM_stFPVPosition_Req "" UBYTE VBU0428Test_CM_uint8 0 0 0 255 ECU_ADDRESS 0x90001f8f /end MEASUREMENT
/begin MEASUREMENT BSWIN_ACPreSw "" UBYTE VBU0428Test_CM_boolean 0 0 0 1 ECU_ADDRESS 0x90001f61 /end MEASUREMENT
/begin MEASUREMENT MsgRxFlg_MCU_305 "" UBYTE VBU0428Test_CM_boolean 0 0 0 1 ECU_ADDRESS 0x90001e86 /end MEASUREMENT
/begin MEASUREMENT BSWIN_Crank "" UBYTE VBU0428Test_CM_boolean 0 0 0 1 ECU_ADDRESS 0x90001f63 /end MEASUREMENT
/begin MEASUREMENT BSWIN_ACSwicth "" UBYTE VBU0428Test_CM_boolean 0 0 0 1 ECU_ADDRESS 0x90001f62 /end MEASUREMENT
/begin MEASUREMENT BSWIN_flgGearH3 "" UBYTE VBU0428Test_CM_boolean 0 0 0 1 ECU_ADDRESS 0x90001dc6 /end MEASUREMENT
/begin MEASUREMENT BSWIN_flgGearH2 "" UBYTE VBU0428Test_CM_boolean 0 0 0 1 ECU_ADDRESS 0x90001dc5 /end MEASUREMENT
/begin MEASUREMENT BSWIN_flgGearH1 "" UBYTE VBU0428Test_CM_boolean 0 0 0 1 ECU_ADDRESS 0x90001dc4 /end MEASUREMENT
/begin MEASUREMENT INP_flgBrkSwt "" UBYTE VBU0428Test_CM_boolean 0 0 0.0 1.0 ECU_ADDRESS 0x90001d22 /end MEASUREMENT
/begin MEASUREMENT BSWIN_BrkLmpSwtRaw "" UBYTE VBU0428Test_CM_boolean 0 0 0 1 ECU_ADDRESS 0x90001dc3 /end MEASUREMENT
/begin MEASUREMENT INP_flgDCChAPlusWkup "" UBYTE VBU0428Test_CM_boolean 0 0 0.0 1.0 ECU_ADDRESS 0x90001d23 /end MEASUREMENT
/begin MEASUREMENT INP_flgIgnOn "" UBYTE VBU0428Test_CM_boolean 0 0 0.0 1.0 ECU_ADDRESS 0x90001d28 /end MEASUREMENT
/begin MEASUREMENT THM_flgEXVPosReqEnable "" UBYTE VBU0428Test_CM_boolean 0 0 0 1 ECU_ADDRESS 0x90001f8c /end MEASUREMENT
/begin MEASUREMENT THM_flgACEnable "" UBYTE VBU0428Test_CM_boolean 0 0 0 1 ECU_ADDRESS 0x90001f8b /end MEASUREMENT
/begin MEASUREMENT THM_flgACCompCmd "" UBYTE VBU0428Test_CM_boolean 0 0 0 1 ECU_ADDRESS 0x90001f8a /end MEASUREMENT
/begin MEASUREMENT NVM_flgNVMValid "" UBYTE VBU0428Test_CM_boolean 0 0 0 1 ECU_ADDRESS 0x90001d32 /end MEASUREMENT
/begin MEASUREMENT BMM_flgDefaultState "" UBYTE VBU0428Test_CM_boolean 0 0 0.0 1.0 ECU_ADDRESS 0x90001cb6 /end MEASUREMENT
/begin MEASUREMENT BMM_flgBatteryAbnormalAlarm2 "" UBYTE VBU0428Test_CM_boolean 0 0 0 1 ECU_ADDRESS 0x90001dbf /end MEASUREMENT
/begin MEASUREMENT BMM_flgBatteryAbnormalAlarm3 "" UBYTE VBU0428Test_CM_boolean 0 0 0 1 ECU_ADDRESS 0x90001dc0 /end MEASUREMENT
/begin MEASUREMENT BMM_flgBatteryAbnormalAlarm1 "" UBYTE VBU0428Test_CM_boolean 0 0 0 1 ECU_ADDRESS 0x90001dbe /end MEASUREMENT
/begin MEASUREMENT BMM_flgBMUAbnormalReset "" UBYTE VBU0428Test_CM_boolean 0 0 0 1 ECU_ADDRESS 0x90001cb5 /end MEASUREMENT
/begin MEASUREMENT BMM_flgBMUAbnormalPowerOff "" UBYTE VBU0428Test_CM_boolean 0 0 0.0 1.0 ECU_ADDRESS 0x90001cb4 /end MEASUREMENT
/begin MEASUREMENT BMM_flg12VBatteryVoltageAbnormal "" UBYTE VBU0428Test_CM_boolean 0 0 0 1 ECU_ADDRESS 0x90001dbd /end MEASUREMENT
/begin MEASUREMENT EcBCV_iABatteryCurrentZeroDrift "" FLOAT32_IEEE VBU0428Test_CM_single 0 0 -3.4E+38 3.4E+38 ECU_ADDRESS 0x6003bf56 /end MEASUREMENT
/begin MEASUREMENT EaSOC_CellSoc_pct "" FLOAT32_IEEE VBU0428Test_CM_single 0 0 -3.4E+38 3.4E+38 ARRAY_SIZE 198 ECU_ADDRESS 0x6003a61e /end MEASUREMENT
/begin MEASUREMENT EaSOH_AhCellCapacityBase1 "" FLOAT32_IEEE VBU0428Test_CM_single 0 0 -3.4E+38 3.4E+38 ARRAY_SIZE 198 ECU_ADDRESS 0x6003ac4e /end MEASUREMENT
/begin MEASUREMENT EaSOH_AhCellCapacity "" FLOAT32_IEEE VBU0428Test_CM_single 0 0 -3.4E+38 3.4E+38 ARRAY_SIZE 198 ECU_ADDRESS 0x6003a936 /end MEASUREMENT
/begin MEASUREMENT EcSOC_BatteryDisplaySoc_pct "" FLOAT32_IEEE VBU0428Test_CM_single 0 0 -3.4E+38 3.4E+38 ECU_ADDRESS 0x6003bf5a /end MEASUREMENT
/begin MEASUREMENT EcSOC_BatterySoc_pct "" FLOAT32_IEEE VBU0428Test_CM_single 0 0 -3.4E+38 3.4E+38 ECU_ADDRESS 0x6003bf5e /end MEASUREMENT
/begin MEASUREMENT EcSOH_pctCellResistanceIncRatio "" FLOAT32_IEEE VBU0428Test_CM_single 0 0 -3.4E+38 3.4E+38 ECU_ADDRESS 0x6003bf7a /end MEASUREMENT
/begin MEASUREMENT EcSOH_AhChargeStart "" FLOAT32_IEEE VBU0428Test_CM_single 0 0 -3.4E+38 3.4E+38 ECU_ADDRESS 0x6003bb6e /end MEASUREMENT
/begin MEASUREMENT EcSOH_AhDischargeStart "" FLOAT32_IEEE VBU0428Test_CM_single 0 0 -3.4E+38 3.4E+38 ECU_ADDRESS 0x6003bb72 /end MEASUREMENT
/begin MEASUREMENT EcSOH_tisLifeTimeOperateTime "" FLOAT32_IEEE VBU0428Test_CM_single 0 0 -3.4E+38 3.4E+38 ECU_ADDRESS 0x6003bb76 /end MEASUREMENT
/begin MEASUREMENT TaskTimer "" FLOAT32_IEEE VBU0428Test_CM_single 0 0 -3.4E+38 3.4E+38 ECU_ADDRESS 0x6003bda2 /end MEASUREMENT
/begin MEASUREMENT LcBMM_timsInitializeTimer "" FLOAT32_IEEE VBU0428Test_CM_single 0 0 -3.4E+38 3.4E+38 ECU_ADDRESS 0x6003bf9e /end MEASUREMENT
/begin MEASUREMENT LcBMM_timsShutdownTimer "" FLOAT32_IEEE VBU0428Test_CM_single 0 0 -3.4E+38 3.4E+38 ECU_ADDRESS 0x6003bfa2 /end MEASUREMENT
/begin MEASUREMENT EcSOC_LoadDefaultSOCCnt_n "" ULONG VBU0428Test_CM_uint32 0 0 0 4294967295 ECU_ADDRESS 0x6003bf72 /end MEASUREMENT
/begin MEASUREMENT EcSOC_CellSocMaxOverrunCounter_n "" ULONG VBU0428Test_CM_uint32 0 0 0 4294967295 ECU_ADDRESS 0x6003bf62 /end MEASUREMENT
/begin MEASUREMENT EcSOC_CellSocMinOverrunCounter_n "" ULONG VBU0428Test_CM_uint32 0 0 0 4294967295 ECU_ADDRESS 0x6003bf66 /end MEASUREMENT
/begin MEASUREMENT EcSOC_LastCorrectionTime_s "" ULONG VBU0428Test_CM_uint32 0 0 0 4294967295 ECU_ADDRESS 0x6003bf6a /end MEASUREMENT
/begin MEASUREMENT EcSOC_ShortTimeLastCorrectionTime_s "" ULONG VBU0428Test_CM_uint32 0 0 0 4294967295 ECU_ADDRESS 0x6003bf76 /end MEASUREMENT
/begin MEASUREMENT EcSOC_LastShutdownTime_s "" ULONG VBU0428Test_CM_uint32 0 0 0 4294967295 ECU_ADDRESS 0x6003bf6e /end MEASUREMENT
/begin MEASUREMENT LINTx_ESV06 "" UBYTE VBU0428Test_CM_uint8 0 0 0 255 ARRAY_SIZE 8 ECU_ADDRESS 0x90001c45 /end MEASUREMENT
/begin MEASUREMENT LINTx_VBU "" UBYTE VBU0428Test_CM_uint8 0 0 0 255 ARRAY_SIZE 8 ECU_ADDRESS 0x90001c55 /end MEASUREMENT
/begin COMPU_METHOD VBU0428Test_CM_single_Kpa "Q = V" RAT_FUNC "%8.6" "Kpa" COEFFS 0 1 0 0 0 1 /end COMPU_METHOD
/begin COMPU_METHOD VBU0428Test_CM_single_mV "Q = V" RAT_FUNC "%8.6" "mV" COEFFS 0 1 0 0 0 1 /end COMPU_METHOD
/begin COMPU_METHOD VBU0428Test_CM_single_C "Q = V" RAT_FUNC "%8.6" "C" COEFFS 0 1 0 0 0 1 /end COMPU_METHOD
/begin COMPU_METHOD VBU0428Test_CM_single_cnt "Q = V" RAT_FUNC "%8.6" "cnt" COEFFS 0 1 0 0 0 1 /end COMPU_METHOD
/begin COMPU_METHOD VBU0428Test_CM_uint16_cnt "Q = V" RAT_FUNC "%5.0" "cnt" COEFFS 0 1 0 0 0 1 /end COMPU_METHOD
/begin COMPU_METHOD VBU0428Test_CM_single_pct "Q = V" RAT_FUNC "%8.6" "pct" COEFFS 0 1 0 0 0 1 /end COMPU_METHOD
/begin COMPU_METHOD VBU0428Test_CM_single_fac "Q = V" RAT_FUNC "%8.6" "fac" COEFFS 0 1 0 0 0 1 /end COMPU_METHOD
/begin COMPU_METHOD VBU0428Test_CM_uint8 "Q = V" RAT_FUNC "%3.0" "" COEFFS 0 1 0 0 0 1 /end COMPU_METHOD
/begin COMPU_METHOD VBU0428Test_CM_uint16 "Q = V" RAT_FUNC "%5.0" "" COEFFS 0 1 0 0 0 1 /end COMPU_METHOD
/begin COMPU_METHOD VBU0428Test_CM_double "Q = V" RAT_FUNC "%15.10" "" COEFFS 0 1 0 0 0 1 /end COMPU_METHOD
/begin COMPU_METHOD VBU0428Test_CM_single "Q = V" RAT_FUNC "%8.6" "" COEFFS 0 1 0 0 0 1 /end COMPU_METHOD
/begin COMPU_METHOD VBU0428Test_CM_single_kohm "Q = V" RAT_FUNC "%8.6" "kohm" COEFFS 0 1 0 0 0 1 /end COMPU_METHOD
/begin COMPU_METHOD VBU0428Test_CM_single_bar "Q = V" RAT_FUNC "%8.6" "bar" COEFFS 0 1 0 0 0 1 /end COMPU_METHOD
/begin COMPU_METHOD VBU0428Test_CM_uint32_cnt "Q = V" RAT_FUNC "%10.0" "cnt" COEFFS 0 1 0 0 0 1 /end COMPU_METHOD
/begin COMPU_METHOD VBU0428Test_CM_uint32_kohm "Q = V" RAT_FUNC "%10.0" "kohm" COEFFS 0 1 0 0 0 1 /end COMPU_METHOD
/begin COMPU_METHOD VBU0428Test_CM_uint32 "Q = V" RAT_FUNC "%10.0" "" COEFFS 0 1 0 0 0 1 /end COMPU_METHOD
/begin COMPU_METHOD VBU0428Test_CM_uint16_ms "Q = V" RAT_FUNC "%5.0" "ms" COEFFS 0 1 0 0 0 1 /end COMPU_METHOD
/begin COMPU_METHOD VBU0428Test_CM_boolean_flg "Q = V" RAT_FUNC "%1.0" "flg" COEFFS 0 1 0 0 0 1 /end COMPU_METHOD
/begin COMPU_METHOD VBU0428Test_CM_boolean_cnt "Q = V" RAT_FUNC "%1.0" "cnt" COEFFS 0 1 0 0 0 1 /end COMPU_METHOD
/begin COMPU_METHOD VBU0428Test_CM_boolean "Q = V" RAT_FUNC "%1.0" "" COEFFS 0 1 0 0 0 1 /end COMPU_METHOD
/begin COMPU_METHOD VBU0428Test_CM_boolean_C "Q = V" RAT_FUNC "%1.0" "C" COEFFS 0 1 0 0 0 1 /end COMPU_METHOD
/begin COMPU_METHOD VBU0428Test_CM_int8_cnt "Q = V" RAT_FUNC "%3.0" "cnt" COEFFS 0 1 0 0 0 1 /end COMPU_METHOD
/begin COMPU_METHOD VBU0428Test_CM_int8_n "Q = V" RAT_FUNC "%3.0" "n" COEFFS 0 1 0 0 0 1 /end COMPU_METHOD
/begin COMPU_METHOD VBU0428Test_CM_uint8_cnt "Q = V" RAT_FUNC "%3.0" "cnt" COEFFS 0 1 0 0 0 1 /end COMPU_METHOD
/begin COMPU_METHOD VBU0428Test_CM_uint8_n "Q = V" RAT_FUNC "%3.0" "n" COEFFS 0 1 0 0 0 1 /end COMPU_METHOD
/begin GROUP VBU0428Test "VBU0428Test" /* Root */ ROOT /begin SUB_GROUP Root_VBUSystem /end SUB_GROUP /begin REF_MEASUREMENT EcBCV_iABatteryCurrentZeroDrift /end REF_MEASUREMENT /end GROUP
/begin GROUP Root_VBUSystem "VBU0428Test/VBUSystem" /begin SUB_GROUP S1_BMS S1_GetEE S1_HALIn S1_HALOut S1_VCU_ /end SUB_GROUP
 /begin REF_MEASUREMENT EaSOC_CellSoc_pct EaSOH_AhCellCapacity EaSOH_AhCellCapacityBase1 EcSOC_BatteryDisplaySoc_pct EcSOC_BatterySoc_pct EcSOC_CellSocMaxOverrunCounter_n EcSOC_CellSocMinOverrunCounter_n EcSOC_LastCorrectionTime_s EcSOC_LastShutdownTime_s EcSOC_LoadDefaultSOCCnt_n EcSOC_ShortTimeLastCorrectionTime_s EcSOH_AhChargeStart EcSOH_AhDischargeStart EcSOH_pctCellResistanceIncRatio EcSOH_tisLifeTimeOperateTime VTestW /end REF_MEASUREMENT
/end GROUP
/begin GROUP S1_BMS "VBU0428Test/VBUSystem/BMS"
 /begin SUB_GROUP S2_BCV S2_BMM S2_CBL S2_CSC S2_CSD_ S2_CTC S2_CTD S2_CTM S2_CTS S2_CVT S2_DSM S2_FCC_ S2_ISO S2_NVM_ S2_OCV S2_RTC S2_SOC S2_SOE S2_SOF S2_SOH S2_Subsystem S2_THM S2_VCT S2_WRT /end SUB_GROUP
 /begin REF_MEASUREMENT TaskTimer /end REF_MEASUREMENT
/end GROUP
/begin GROUP S1_GetEE "VBU0428Test/VBUSystem/GetEE" /begin REF_MEASUREMENT R3_test /end REF_MEASUREMENT /end GROUP
/begin GROUP S1_HALIn "VBU0428Test/VBUSystem/HALIn" /begin SUB_GROUP S4_HW S4_PTCAN S4_PrivateCAN /end SUB_GROUP /end GROUP
/begin GROUP S1_HALOut "VBU0428Test/VBUSystem/HALOut" /begin SUB_GROUP S5_HWOut S5_LIN S5_PT_PrivateCAN /end SUB_GROUP /end GROUP
/begin GROUP S1_VCU_ "VBU0428Test/VBUSystem/VCU "
 /begin SUB_GROUP S8_APO2HAL S8_DCH S8_DSPL_ S8_EDIS S8_LVC S8_PMM S8_SPD S8_THM S8_TQC S8_TQD S8_TQO S8_VTQA S8_VehINP /end SUB_GROUP
/end GROUP
/begin GROUP S2_BCV "VBU0428Test/VBUSystem/BMS/BCV" /begin SUB_GROUP S9_BCV /end SUB_GROUP /begin REF_CHARACTERISTIC BCV_facPEURCurrent /end REF_CHARACTERISTIC /end GROUP
/begin GROUP S2_BMM "VBU0428Test/VBUSystem/BMS/BMM" /begin SUB_GROUP S10_BMM /end SUB_GROUP /end GROUP
/begin GROUP S2_CBL "VBU0428Test/VBUSystem/BMS/CBL" /begin SUB_GROUP S11_Subsystem8 /end SUB_GROUP /end GROUP
/begin GROUP S2_CSC "VBU0428Test/VBUSystem/BMS/CSC" /begin SUB_GROUP S12_Subsystem7 /end SUB_GROUP /end GROUP
/begin GROUP S2_CSD_ "VBU0428Test/VBUSystem/BMS/CSD " /begin SUB_GROUP S13_Subsystem /end SUB_GROUP /end GROUP
/begin GROUP S2_CTC "VBU0428Test/VBUSystem/BMS/CTC" /begin SUB_GROUP S14_Subsystem1 /end SUB_GROUP /end GROUP
/begin GROUP S2_CTD "VBU0428Test/VBUSystem/BMS/CTD" /begin SUB_GROUP S15_Subsystem /end SUB_GROUP /end GROUP
/begin GROUP S2_CTM "VBU0428Test/VBUSystem/BMS/CTM" /begin SUB_GROUP S16_CTM /end SUB_GROUP /end GROUP
/begin GROUP S2_CTS "VBU0428Test/VBUSystem/BMS/CTS" /begin SUB_GROUP S17_CTS /end SUB_GROUP /end GROUP
/begin GROUP S2_CVT "VBU0428Test/VBUSystem/BMS/CVT" /begin SUB_GROUP S18_CVT /end SUB_GROUP /end GROUP
/begin GROUP S2_DSM "VBU0428Test/VBUSystem/BMS/DSM" /begin SUB_GROUP S20_Subsystem10 /end SUB_GROUP /end GROUP
/begin GROUP S2_FCC_ "VBU0428Test/VBUSystem/BMS/FCC " /begin SUB_GROUP S21_FCC /end SUB_GROUP /end GROUP
/begin GROUP S2_ISO "VBU0428Test/VBUSystem/BMS/ISO"
 /begin SUB_GROUP S22_Determine_FaultDetection_Check S22_Determine_IsoLowItems S22_ISOSourceDiag /end SUB_GROUP
 /begin REF_CHARACTERISTIC BMM_STATE_FAST_CHARGE BMM_STATE_ONBOARD_CHARGE CTD_MAIN_CONTACTOR_STATUS_CLOSED CTD_MAIN_CONTACTOR_STATUS_OPENED /end REF_CHARACTERISTIC
/end GROUP
/begin GROUP S2_NVM_ "VBU0428Test/VBUSystem/BMS/NVM " /begin SUB_GROUP S23_Subsystem3 /end SUB_GROUP /end GROUP
/begin GROUP S2_OCV "VBU0428Test/VBUSystem/BMS/OCV" /begin SUB_GROUP S24_OCV /end SUB_GROUP /end GROUP
/begin GROUP S2_RTC "VBU0428Test/VBUSystem/BMS/RTC" /begin SUB_GROUP S25_RTC /end SUB_GROUP /end GROUP
/begin GROUP S2_SOC "VBU0428Test/VBUSystem/BMS/SOC" /begin SUB_GROUP S26_Subsystem5 /end SUB_GROUP /end GROUP
/begin GROUP S2_SOE "VBU0428Test/VBUSystem/BMS/SOE" /begin SUB_GROUP S27_Subsystem2 /end SUB_GROUP /end GROUP
/begin GROUP S2_SOF "VBU0428Test/VBUSystem/BMS/SOF" /begin SUB_GROUP S28_Subsystem6 /end SUB_GROUP /end GROUP
/begin GROUP S2_SOH "VBU0428Test/VBUSystem/BMS/SOH" /begin SUB_GROUP S29_Subsystem4 /end SUB_GROUP /end GROUP
/begin GROUP S2_Subsystem "VBU0428Test/VBUSystem/BMS/Subsystem" /begin SUB_GROUP S30_FaultDealTemp /end SUB_GROUP /end GROUP
/begin GROUP S2_THM "VBU0428Test/VBUSystem/BMS/THM" /begin SUB_GROUP S31_Subsystem /end SUB_GROUP /end GROUP
/begin GROUP S2_VCT "VBU0428Test/VBUSystem/BMS/VCT" /begin SUB_GROUP S32_Subsystem /end SUB_GROUP /end GROUP
/begin GROUP S2_WRT "VBU0428Test/VBUSystem/BMS/WRT" /begin SUB_GROUP S33_Subsystem9 /end SUB_GROUP /end GROUP
/begin GROUP S4_HW "VBU0428Test/VBUSystem/HALIn/HW" /begin SUB_GROUP S1807_Subsystem S1807_Subsystem1 S1807_Subsystem2 /end SUB_GROUP /end GROUP
/begin GROUP S4_PTCAN "VBU0428Test/VBUSystem/HALIn/PTCAN" /begin SUB_GROUP S1809_Subsystem /end SUB_GROUP /end GROUP
/begin GROUP S4_PrivateCAN "VBU0428Test/VBUSystem/HALIn/PrivateCAN" /begin SUB_GROUP S1810_CanMsgUnpack1 /end SUB_GROUP /end GROUP
/begin GROUP S5_HWOut "VBU0428Test/VBUSystem/HALOut/HWOut" /begin SUB_GROUP S2932_SetEE /end SUB_GROUP
 /begin REF_CHARACTERISTIC HALOut_flgAccPed2VccEn_C HALOut_flgAccPedlVccEn_C HALOut_flgBekPressVccEn_C HALOut_flgVcuumPumpVccEn_C /end REF_CHARACTERISTIC
/end GROUP
/begin GROUP S5_LIN "VBU0428Test/VBUSystem/HALOut/LIN" /begin REF_MEASUREMENT LINTx_ESV06 LINTx_VBU /end REF_MEASUREMENT /end GROUP
/begin GROUP S5_PT_PrivateCAN "VBU0428Test/VBUSystem/HALOut/PT_PrivateCAN" /begin REF_CHARACTERISTIC SAMPLE_TIME_TASK_B /end REF_CHARACTERISTIC /end GROUP
/begin GROUP S8_APO2HAL "VBU0428Test/VBUSystem/VCU /APO2HAL" /begin SUB_GROUP S3003_PTCAN1Transmit S3003_Subsystem1 S3003_Subsystem2 /end SUB_GROUP /end GROUP
/begin GROUP S8_DCH "VBU0428Test/VBUSystem/VCU /DCH" /begin SUB_GROUP S3006_DCH_Overall /end SUB_GROUP /end GROUP
/begin GROUP S8_DSPL_ "VBU0428Test/VBUSystem/VCU /DSPL " /begin SUB_GROUP S3007_DSPL /end SUB_GROUP /end GROUP
/begin GROUP S8_EDIS "VBU0428Test/VBUSystem/VCU /EDIS" /begin SUB_GROUP S3008_EDIS_Ctrl /end SUB_GROUP /end GROUP
/begin GROUP S8_LVC "VBU0428Test/VBUSystem/VCU /LVC" /begin SUB_GROUP S3009_LVC /end SUB_GROUP /end GROUP
/begin GROUP S8_PMM "VBU0428Test/VBUSystem/VCU /PMM" /begin SUB_GROUP S3010_PMM_Ctrl /end SUB_GROUP /end GROUP
/begin GROUP S8_SPD "VBU0428Test/VBUSystem/VCU /SPD" /begin SUB_GROUP S3011_SPD /end SUB_GROUP /end GROUP
/begin GROUP S8_THM "VBU0428Test/VBUSystem/VCU /THM" /begin SUB_GROUP S3012_Subsystem S3012_THM /end SUB_GROUP /end GROUP
/begin GROUP S8_TQC "VBU0428Test/VBUSystem/VCU /TQC" /begin SUB_GROUP S3013_TQC /end SUB_GROUP /end GROUP
/begin GROUP S8_TQD "VBU0428Test/VBUSystem/VCU /TQD" /begin SUB_GROUP S3014_TrqDem /end SUB_GROUP /end GROUP
/begin GROUP S8_TQO "VBU0428Test/VBUSystem/VCU /TQO" /begin SUB_GROUP S3015_TQOAll /end SUB_GROUP /end GROUP
/begin GROUP S8_VTQA "VBU0428Test/VBUSystem/VCU /VTQA" /begin SUB_GROUP S3017_Subsystem /end SUB_GROUP /end GROUP
/begin GROUP S8_VehINP "VBU0428Test/VBUSystem/VCU /VehINP" /begin SUB_GROUP S3018_VehINP_Logic /end SUB_GROUP /end GROUP
/begin GROUP S9_BCV "VBU0428Test/VBUSystem/BMS/BCV/BCV" /begin SUB_GROUP S34_Subsystem /end SUB_GROUP /end GROUP
/begin GROUP S10_BMM "VBU0428Test/VBUSystem/BMS/BMM/BMM"
 /begin SUB_GROUP S232_BMU_PowerOff_Check S232_BMU_Reset_Check S232_BMU_State_Management S232_DetermineAbnormalEventFlag S232_DetermineCycleUpload S232_Determine_Hold_Afterrun S232_Determine_Wakeup_Mode S232_Subsystem /end SUB_GROUP
 /begin REF_CHARACTERISTIC CbBMM_flgNVMReadCheckEnable_C /end REF_CHARACTERISTIC
/end GROUP
/begin GROUP S11_Subsystem8 "VBU0428Test/VBUSystem/BMS/CBL/Subsystem8" /begin SUB_GROUP S286_Subsystem /end SUB_GROUP /end GROUP
/begin GROUP S12_Subsystem7 "VBU0428Test/VBUSystem/BMS/CSC/Subsystem7" /begin SUB_GROUP S346_Determine_Cell_Balance /end SUB_GROUP /end GROUP
/begin GROUP S13_Subsystem "VBU0428Test/VBUSystem/BMS/CSD /Subsystem" /begin REF_MEASUREMENT CellTemp1 /end REF_MEASUREMENT /end GROUP
/begin GROUP S14_Subsystem1 "VBU0428Test/VBUSystem/BMS/CTC/Subsystem1" /begin SUB_GROUP S355_Subsystem /end SUB_GROUP /end GROUP
/begin GROUP S15_Subsystem "VBU0428Test/VBUSystem/BMS/CTD/Subsystem" /begin SUB_GROUP S372_Subsystem4 /end SUB_GROUP /end GROUP
/begin GROUP S16_CTM "VBU0428Test/VBUSystem/BMS/CTM/CTM" /begin SUB_GROUP S540_Subsystem /end SUB_GROUP /end GROUP
/begin GROUP S17_CTS "VBU0428Test/VBUSystem/BMS/CTS/CTS" /begin SUB_GROUP S618_Subsystem /end SUB_GROUP /end GROUP
/begin GROUP S18_CVT "VBU0428Test/VBUSystem/BMS/CVT/CVT" /begin SUB_GROUP S648_Subsystem /end SUB_GROUP /end GROUP
/begin GROUP S20_Subsystem10 "VBU0428Test/VBUSystem/BMS/DSM/Subsystem10" /begin SUB_GROUP S708_Subsystem /end SUB_GROUP /end GROUP
/begin GROUP S21_FCC "VBU0428Test/VBUSystem/BMS/FCC /FCC" /begin SUB_GROUP S740_Subsystem /end SUB_GROUP /end GROUP
/begin GROUP S22_Determine_FaultDetection_Check "VBU0428Test/VBUSystem/BMS/ISO/Determine_FaultDetection_Check"
 /begin SUB_GROUP S861_DetermineIsolationSevereTestFail S861_DetermineIsolationWarningTestFail S861_Status_Process /end SUB_GROUP
 /begin REF_CHARACTERISTIC CbISO_IsolationSevere_flg CbISO_IsolationWarning_flg CcISO_FaultReverseConfirmTime_ms CcISO_IsolationSevereFaultFIC_n CcISO_IsolationSevereFaultPIC_n CcISO_IsolationWarningFaultFIC_n CcISO_IsolationWarningFaultPIC_n ISO_ISOLATION_SEVERE_FAULT ISO_ISOLATION_WARNING_FAULT SAMPLE_TIME_TASK_B /end REF_CHARACTERISTIC
/end GROUP
/begin GROUP S22_Determine_IsoLowItems "VBU0428Test/VBUSystem/BMS/ISO/Determine_IsoLowItems"
 /begin SUB_GROUP S862_ISO_DCCharging_Dec S862_ISO_Normal_Dec S862_ISO_Pack_Dec /end SUB_GROUP
/end GROUP
/begin GROUP S22_ISOSourceDiag "VBU0428Test/VBUSystem/BMS/ISO/ISOSourceDiag" /begin REF_CHARACTERISTIC CcISO_BDMOutputDelayTime_ms SAMPLE_TIME_TASK_B /end REF_CHARACTERISTIC /end GROUP
/begin GROUP S23_Subsystem3 "VBU0428Test/VBUSystem/BMS/NVM /Subsystem3" /begin SUB_GROUP S902_Diagnose_NVM S902_Read_NVM_Data /end SUB_GROUP /end GROUP
/begin GROUP S24_OCV "VBU0428Test/VBUSystem/BMS/OCV/OCV" /begin SUB_GROUP S922_Subsystem /end SUB_GROUP /end GROUP
/begin GROUP S25_RTC "VBU0428Test/VBUSystem/BMS/RTC/RTC"
 /begin SUB_GROUP S931_Calculate_Actual_Time S931_Calculate_RelativeActual_Time S931_Determine_VCU_ActualTime S931_Diagnose_RTC S931_Reset_TimeInit_flg S931_Set_RTC_Wakeup /end SUB_GROUP
/end GROUP
/begin GROUP S26_Subsystem5 "VBU0428Test/VBUSystem/BMS/SOC/Subsystem5" /begin SUB_GROUP S958_Subsystem /end SUB_GROUP /end GROUP
/begin GROUP S27_Subsystem2 "VBU0428Test/VBUSystem/BMS/SOE/Subsystem2" /begin SUB_GROUP S1117_Subsystem /end SUB_GROUP /end GROUP
/begin GROUP S28_Subsystem6 "VBU0428Test/VBUSystem/BMS/SOF/Subsystem6" /begin SUB_GROUP S1169_Subsystem /end SUB_GROUP /end GROUP
/begin GROUP S29_Subsystem4 "VBU0428Test/VBUSystem/BMS/SOH/Subsystem4" /begin SUB_GROUP S1396_Subsystem1 /end SUB_GROUP /end GROUP
/begin GROUP S30_FaultDealTemp "VBU0428Test/VBUSystem/BMS/Subsystem/FaultDealTemp"
 /begin REF_CHARACTERISTIC BCV_BATTERY_OVER_CURRENT_FAULT BCV_BATTERY_OVER_VOLTAGE_FAULT BCV_BATTERY_OVER_VOLTAGE_WARNING_FAULT CTD_MAIN_NEGATIVE_CONTACTOR_WELD_FAULT CTD_MAIN_POSITIVE_CONTACTOR_WELD_FAULT CTD_PARKING_MAIN_NEGATIVE_CONTACTOR_STUCK_OPEN_FAULT CTD_PARKING_MAIN_POSITIVE_CONTACTOR_STUCK_OPEN_FAULT CTD_PRECHARGE_ENERGY_HIGH_FAULT CTD_PRECHARGE_RELAY_STUCK_OPEN_FAULT CTD_PRECHARGE_RESISTANCE_BLOWN_FAULT CTD_PRECHARG_TIMEOUT_FAULT CTM_CELL_OVER_TEMP_FAULT CVT_CELL_OVER_VOLTAGE_FAULT CVT_CELL_UNDER_VOLTAGE_FAULT FCC_CHARGE_CURRENT_OVER_FAULT SOF_CHARGE_OVER_POWER_FAULT /end REF_CHARACTERISTIC
/end GROUP
/begin GROUP S31_Subsystem "VBU0428Test/VBUSystem/BMS/THM/Subsystem" /begin SUB_GROUP S1527_Subsystem /end SUB_GROUP /end GROUP
/begin GROUP S32_Subsystem "VBU0428Test/VBUSystem/BMS/VCT/Subsystem" /begin SUB_GROUP S1601_Subsystem /end SUB_GROUP /end GROUP
/begin GROUP S33_Subsystem9 "VBU0428Test/VBUSystem/BMS/WRT/Subsystem9" /begin SUB_GROUP S1804_Subsystem /end SUB_GROUP /end GROUP
/begin GROUP S1807_Subsystem "VBU0428Test/VBUSystem/HALIn/HW/Subsystem"
 /begin SUB_GROUP S1841_Input_HW_Signal_Range_Check2 S1841_Input_HW_Signal_Range_Check3 S1841_Input_HW_Signal_Range_Check4 S1841_Input_HW_Signal_Range_Check6 S1841_Input_HW_Signal_Range_Check_Table1 S1841_Input_HW_Signal_Range_Check_Table2 S1841_Input_HW_Signal_Range_Check_Table4 S1841_Input_HW_Signal_Range_Check_Table5 /end SUB_GROUP
 /begin REF_CHARACTERISTIC HALIn_facIgnOnThd_C /end REF_CHARACTERISTIC
 /begin REF_MEASUREMENT BSWIN_DCChAPlusWkup BSWIN_EDSInletCoolTemp BSWIN_uVacuumPre INP_flgDCChAPlusWkup INP_flgIgnOn INP_uLVBatt uAccPed1Raw uAccPed2Raw uBrkPresRaw uDCChCC2 uDCChPortPosTempRaw uDCChPortTempNegativeRaw uLVBattRaw uflgIgnOnRaw /end REF_MEASUREMENT
/end GROUP
/begin GROUP S1807_Subsystem1 "VBU0428Test/VBUSystem/HALIn/HW/Subsystem1"
 /begin SUB_GROUP S1842_BrkLmpSwtConfirm S1842_INP_flgGearH1Confirm S1842_INP_flgGearH2Confirm S1842_INP_flgGearH3Confirm S1842_IN_ACMidPreConfirm S1842_IN_CrankConfirm S1842_IN_DriverACOnConfirm /end SUB_GROUP
 /begin REF_CHARACTERISTIC HALIn_vBrkSwtThold_C /end REF_CHARACTERISTIC
 /begin REF_MEASUREMENT BSWIN_ACPreSw BSWIN_ACSwicth BSWIN_BrkLmpSwtRaw BSWIN_Crank BSWIN_flgGearH1 BSWIN_flgGearH2 BSWIN_flgGearH3 INP_flgBrkSwt /end REF_MEASUREMENT
/end GROUP
/begin GROUP S1807_Subsystem2 "VBU0428Test/VBUSystem/HALIn/HW/Subsystem2"
 /begin SUB_GROUP S1843_Input_HW_Signal_Range_Check1 S1843_Input_HW_Signal_Range_Check2 S1843_Input_HW_Signal_Range_Check3 S1843_Input_HW_Signal_Range_Check7 /end SUB_GROUP
 /begin REF_MEASUREMENT BSWIN_BatteryPre_du BSWIN_BatteryPre_f BSWIN_HVIL_du BSWIN_HVIL_f /end REF_MEASUREMENT
/end GROUP
/begin GROUP S1809_Subsystem "VBU0428Test/VBUSystem/HALIn/PTCAN/Subsystem"
 /begin SUB_GROUP S1992_20ms S1992_50ms S1992_CanMsgReceive S1992_CanMsgUnpack S1992_Subsystem2 S1992_Subsystem3 S1992_Subsystem4 /end SUB_GROUP
/end GROUP
/begin GROUP S1810_CanMsgUnpack1 "VBU0428Test/VBUSystem/HALIn/PrivateCAN/CanMsgUnpack1"
 /begin SUB_GROUP S2697_MsgRxData_Unpack1 S2697_MsgRxData_Unpack10 S2697_MsgRxData_Unpack11 S2697_MsgRxData_Unpack12 S2697_MsgRxData_Unpack13 S2697_MsgRxData_Unpack14 S2697_MsgRxData_Unpack15 S2697_MsgRxData_Unpack16 S2697_MsgRxData_Unpack17 S2697_MsgRxData_Unpack18 S2697_MsgRxData_Unpack19 S2697_MsgRxData_Unpack2 S2697_MsgRxData_Unpack20 S2697_MsgRxData_Unpack21 S2697_MsgRxData_Unpack22 S2697_MsgRxData_Unpack23 S2697_MsgRxData_Unpack24 S2697_MsgRxData_Unpack25 S2697_MsgRxData_Unpack26 S2697_MsgRxData_Unpack27 S2697_MsgRxData_Unpack28 S2697_MsgRxData_Unpack29 S2697_MsgRxData_Unpack3 S2697_MsgRxData_Unpack30 S2697_MsgRxData_Unpack31 S2697_MsgRxData_Unpack32 S2697_MsgRxData_Unpack33 S2697_MsgRxData_Unpack34 S2697_MsgRxData_Unpack35 S2697_MsgRxData_Unpack36 S2697_MsgRxData_Unpack37 S2697_MsgRxData_Unpack38 S2697_MsgRxData_Unpack39 S2697_MsgRxData_Unpack4 S2697_MsgRxData_Unpack40 S2697_MsgRxData_Unpack41 S2697_MsgRxData_Unpack42 S2697_MsgRxData_Unpack43 S2697_MsgRxData_Unpack44 S2697_MsgRxData_Unpack45 S2697_MsgRxData_Unpack46 S2697_MsgRxData_Unpack47 S2697_MsgRxData_Unpack48 S2697_MsgRxData_Unpack49 S2697_MsgRxData_Unpack5 S2697_MsgRxData_Unpack50 S2697_MsgRxData_Unpack51 S2697_MsgRxData_Unpack52 S2697_MsgRxData_Unpack53 S2697_MsgRxData_Unpack54 S2697_MsgRxData_Unpack55 S2697_MsgRxData_Unpack56 S2697_MsgRxData_Unpack57 S2697_MsgRxData_Unpack58 S2697_MsgRxData_Unpack59 S2697_MsgRxData_Unpack6 S2697_MsgRxData_Unpack60 S2697_MsgRxData_Unpack61 S2697_MsgRxData_Unpack62 S2697_MsgRxData_Unpack63 S2697_MsgRxData_Unpack64 S2697_MsgRxData_Unpack65 S2697_MsgRxData_Unpack66 S2697_MsgRxData_Unpack67 S2697_MsgRxData_Unpack68 S2697_MsgRxData_Unpack69 S2697_MsgRxData_Unpack7 S2697_MsgRxData_Unpack70 S2697_MsgRxData_Unpack71 S2697_MsgRxData_Unpack72 S2697_MsgRxData_Unpack73 S2697_MsgRxData_Unpack74 S2697_MsgRxData_Unpack75 S2697_MsgRxData_Unpack76 S2697_MsgRxData_Unpack77 S2697_MsgRxData_Unpack78 S2697_MsgRxData_Unpack8 S2697_MsgRxData_Unpack9 /end SUB_GROUP
/end GROUP
/begin GROUP S2932_SetEE "VBU0428Test/VBUSystem/HALOut/HWOut/SetEE" /begin REF_CHARACTERISTIC VTestR /end REF_CHARACTERISTIC /begin REF_MEASUREMENT W3_Test /end REF_MEASUREMENT /end GROUP
/begin GROUP S3003_PTCAN1Transmit "VBU0428Test/VBUSystem/VCU /APO2HAL/PTCAN1Transmit"
 /begin SUB_GROUP S3020_VCU_151 S3020_VCU_153 S3020_VCU_201 S3020_VCU_501 S3020_VCU_502 S3020_VCU_AC_238 S3020_VCU_DCDC_250 S3020_VCU_EPB_155 S3020_VCU_IC_210 S3020_VCU_MCU_105 /end SUB_GROUP
/end GROUP
/begin GROUP S3003_Subsystem1 "VBU0428Test/VBUSystem/VCU /APO2HAL/Subsystem1"
 /begin SUB_GROUP S3021_BCL S3021_BCP S3021_BCS S3021_BEM S3021_BHM S3021_BRM S3021_BRO S3021_BSD S3021_BSM S3021_BST_ S3021_J1939TxEna /end SUB_GROUP
/end GROUP
/begin GROUP S3003_Subsystem2 "VBU0428Test/VBUSystem/VCU /APO2HAL/Subsystem2" /begin SUB_GROUP S3022_Subsystem /end SUB_GROUP /end GROUP
/begin GROUP S3006_DCH_Overall "VBU0428Test/VBUSystem/VCU /DCH/DCH_Overall"
 /begin SUB_GROUP S3208_DCH_DCChargeCtrlOverall S3208_DCH_J1939InputProcess S3208_DCH_J1939OutputSignalProcess /end SUB_GROUP
/end GROUP
/begin GROUP S3007_DSPL "VBU0428Test/VBUSystem/VCU /DSPL /DSPL" /begin SUB_GROUP S3333_DriveRange S3333_Other S3333_RegenLight /end SUB_GROUP /end GROUP
/begin GROUP S3008_EDIS_Ctrl "VBU0428Test/VBUSystem/VCU /EDIS/EDIS_Ctrl"
 /begin SUB_GROUP S3476_BatDis_Power_Lim_Calc S3476_battery_power_calculate S3476_drive_power_calculate /end SUB_GROUP
 /begin REF_CHARACTERISTIC PMM_stDCChMode_SY /end REF_CHARACTERISTIC
/end GROUP
/begin GROUP S3009_LVC "VBU0428Test/VBUSystem/VCU /LVC/LVC" /begin SUB_GROUP S3559_LVC_DIAG S3559_LowVoltageBalanceControl /end SUB_GROUP /begin REF_CHARACTERISTIC EDIS_pwrDcdcPwrLim_C /end REF_CHARACTERISTIC /end GROUP
/begin GROUP S3010_PMM_Ctrl "VBU0428Test/VBUSystem/VCU /PMM/PMM_Ctrl"
 /begin SUB_GROUP S3604_DrvMod_Ctrl S3604_LvWakeUp_Ctrl S3604_PMM_DIAG S3604_PwrMod_Ctrl /end SUB_GROUP
/end GROUP
/begin GROUP S3011_SPD "VBU0428Test/VBUSystem/VCU /SPD/SPD" /begin SUB_GROUP S3717_SignalProcessing_10ms /end SUB_GROUP /end GROUP
/begin GROUP S3012_Subsystem "VBU0428Test/VBUSystem/VCU /THM/Subsystem"
 /begin REF_CHARACTERISTIC THM_fFANfrecuencyORV THM_fPump1frecuencyORV THM_fPump2frecuencyORV THM_flgEXVInitORF THM_flgEXVInitORV THM_flgEXVPosReqEnableORF THM_flgEXVPosReqEnableORV THM_flgEXVPosReqORF THM_flgFANfrecuencyORF THM_flgFPVEnableORF THM_flgFPVEnableORV THM_flgFPVPosReqORF THM_flgOverrideACCmpCmd THM_flgOverrideACCmpValid THM_flgOverrideACCmpVlv THM_flgOverrideBattPTCCmd THM_flgOverrideChillerPos THM_flgOverrideESSPmpCmd THM_flgOverrideFAN THM_flgOverrideRearPmpCmd THM_flgOverridevalueACCmpValid THM_flgOverridevalueBattPTCCmd THM_flgPump1frecuencyORF THM_flgPump2frecuencyORF THM_pctOverrideESSPmpCmd THM_pctOverrideRearPmpCmd THM_pctOverridevalueChillerPos THM_pctOverridevalueFAN THM_phiEXVPosReqORV THM_rpmOverridevalueACCmpCmd THM_stFPVPosORV THM_stOverridevalueACVlvOnoff /end REF_CHARACTERISTIC
 /begin REF_MEASUREMENT THM_flgACCompCmd THM_flgACVlvOnOff THM_flgBattPTCCmd THM_flgEXVPosReqEnable THM_pctChillerPos THM_pctESSPmpCmd THM_pctFAN THM_pctRearPmpCmd THM_phiEXVPosReq THM_rpmACCompCmd THM_stEXVInitial THM_stFPVPosition_Req /end REF_MEASUREMENT
/end GROUP
/begin GROUP S3012_THM "VBU0428Test/VBUSystem/VCU /THM/THM" /begin SUB_GROUP S3753_EfanControl4PDU S3753_PumpControl /end SUB_GROUP /begin REF_MEASUREMENT THM_flgACEnable THM_nACSpdSet /end REF_MEASUREMENT /end GROUP
/begin GROUP S3013_TQC "VBU0428Test/VBUSystem/VCU /TQC/TQC" /begin SUB_GROUP S3777_TQC_VehSpdLimit S3777_VehInfo1 /end SUB_GROUP /begin REF_MEASUREMENT TQC_TrqDes /end REF_MEASUREMENT /end GROUP
/begin GROUP S3014_TrqDem "VBU0428Test/VBUSystem/VCU /TQD/TrqDem"
 /begin SUB_GROUP S3823_BrkRgn_Cal S3823_TrqDem_Arb S3823_TrqDem_DrvTrq_Cal S3823_TrqDem_InputTransfer /end SUB_GROUP
/end GROUP
/begin GROUP S3015_TQOAll "VBU0428Test/VBUSystem/VCU /TQO/TQOAll"
 /begin SUB_GROUP S3851_STC S3851_Schedule S3851_Subsystem S3851_TQARB S3851_TQCMP S3851_TQDIS S3851_TQO /end SUB_GROUP
/end GROUP
/begin GROUP S3017_Subsystem "VBU0428Test/VBUSystem/VCU /VTQA/Subsystem" /begin SUB_GROUP S4014_MTrqLim S4014_VehTrqArb /end SUB_GROUP /end GROUP
/begin GROUP S3018_VehINP_Logic "VBU0428Test/VBUSystem/VCU /VehINP/VehINP_Logic"
 /begin SUB_GROUP S4048_APD S4048_DCPortTemp S4048_FPV S4048_GearShift S4048_Mode S4048_PEU_InverterStatus S4048_SWReset S4048_TireType S4048_VacuumPump_Control S4048_VehINP_BPD S4048_Veh_Status /end SUB_GROUP
/end GROUP
/begin GROUP S34_Subsystem "VBU0428Test/VBUSystem/BMS/BCV/BCV/Subsystem"
 /begin SUB_GROUP S35_Calculate_BatteryCurrent S35_Calculate_BatteryVoltage S35_Calculate_Lifetime_Data S35_Diagnose_BCV_Communication_Fault S35_Diagnose_BCV_Data_Fault S35_Interface_Switch S35_Interface_Switch1 S35_Interface_Switch2 S35_Interface_Switch3 S35_Interface_Switch4 S35_Interface_Switch5 S35_Interface_Switch6 S35_Interface_Switch7 S35_Interface_Switch8 S35_Interface_Switch9 S35_Monitor_BCV_Performance S35_Unpackage_LEM_Msg /end SUB_GROUP
 /begin REF_CHARACTERISTIC BCV_facHVADC /end REF_CHARACTERISTIC
 /begin REF_MEASUREMENT BCV_uHALBatteryVoltageRaw BCV_uHALBusNegativeVoltageRaw BCV_uHALFuseVoltageRaw BCV_uHALVx2VoltageRaw /end REF_MEASUREMENT
/end GROUP
/begin GROUP S232_BMU_PowerOff_Check "VBU0428Test/VBUSystem/BMS/BMM/BMM/BMU_PowerOff_Check"
 /begin SUB_GROUP S233_BDM_KL30Voltage_Diagnostic S233_Monitor_BMM_Performance S233_Override1 /end SUB_GROUP
 /begin REF_CHARACTERISTIC BMM_BMU_POWEROFF_NORMAL CbBMM_AbnormalPowerOffOverride_flg /end REF_CHARACTERISTIC
 /begin REF_MEASUREMENT BMM_flg12VBatteryVoltageAbnormal BMM_flgBMUAbnormalPowerOff /end REF_MEASUREMENT
/end GROUP
/begin GROUP S232_BMU_Reset_Check "VBU0428Test/VBUSystem/BMS/BMM/BMM/BMU_Reset_Check" /begin REF_CHARACTERISTIC BMM_BMU_RESET_NONE CbBMM_AbnormalResetOverride_flg /end REF_CHARACTERISTIC /begin REF_MEASUREMENT BMM_flgBMUAbnormalReset /end REF_MEASUREMENT /end GROUP
/begin GROUP S232_BMU_State_Management "VBU0428Test/VBUSystem/BMS/BMM/BMM/BMU_State_Management"
 /begin REF_CHARACTERISTIC BMM_STATE_AFTER_RUN BMM_STATE_DRIVE_MODE BMM_STATE_FAST_CHARGE BMM_STATE_IDLE BMM_STATE_INITIALIZATION BMM_STATE_SHUT_DOWN CcBMM_MaxInitializeTime_ms SAMPLE_TIME_TASK_B /end REF_CHARACTERISTIC
 /begin REF_MEASUREMENT LcBMM_timsInitializeTimer LcBMM_timsShutdownTimer /end REF_MEASUREMENT
/end GROUP
/begin GROUP S232_DetermineAbnormalEventFlag "VBU0428Test/VBUSystem/BMS/BMM/BMM/DetermineAbnormalEventFlag" /begin SUB_GROUP S236_DetermineSOCJump /end SUB_GROUP
 /begin REF_CHARACTERISTIC BMM_STATE_SHUT_DOWN CbBMM_AbnormalEventDetectedORF_flg CbBMM_AbnormalEventDetectedORV_flg CcBMM_AbnormalEventFlagLockTime_ms CcBMM_CurrentStableDelayTime_ms CcBMM_CurrentStableThreshold_A SAMPLE_TIME_TASK_B /end REF_CHARACTERISTIC
 /begin REF_MEASUREMENT BMM_flgBatteryAbnormalAlarm1 BMM_flgBatteryAbnormalAlarm2 BMM_flgBatteryAbnormalAlarm3 /end REF_MEASUREMENT
/end GROUP
/begin GROUP S232_DetermineCycleUpload "VBU0428Test/VBUSystem/BMS/BMM/BMM/DetermineCycleUpload" /begin SUB_GROUP S237_CycleWakeupStateMachine S237_GetValueInNVM /end SUB_GROUP
 /begin REF_CHARACTERISTIC BMM_STATE_AFTER_RUN BMM_STATE_RTC CYCLE_WAKEUP_STATE_PERIODICAL_UPLOAD CcBMM_DeepSleepUploadTime_s CcBMM_PeriodicalUploadTime_s /end REF_CHARACTERISTIC
 /begin REF_MEASUREMENT BMM_flgDefaultState /end REF_MEASUREMENT
/end GROUP
/begin GROUP S232_Determine_Hold_Afterrun "VBU0428Test/VBUSystem/BMS/BMM/BMM/Determine_Hold_Afterrun" /begin SUB_GROUP S238_Determine_HoldAfterrun_Condition /end SUB_GROUP /begin REF_CHARACTERISTIC BMM_STATE_AFTER_RUN /end REF_CHARACTERISTIC /end GROUP
/begin GROUP S232_Determine_Wakeup_Mode "VBU0428Test/VBUSystem/BMS/BMM/BMM/Determine_Wakeup_Mode"
 /begin SUB_GROUP S239_Determine_Wakeup_Bywire S239_Wakeup_Fast_Charge S239_Wakeup_Ignition_On /end SUB_GROUP
/end GROUP
/begin GROUP S232_Subsystem "VBU0428Test/VBUSystem/BMS/BMM/BMM/Subsystem" /begin SUB_GROUP S240_EEPROM_BlockStoreEnable /end SUB_GROUP /end GROUP
/begin GROUP S286_Subsystem "VBU0428Test/VBUSystem/BMS/CBL/Subsystem8/Subsystem"
 /begin SUB_GROUP S287_Balance_EnableCondition S287_Determine_BoardTemAvailableCheck S287_Determine_CSCCellBalanceRequest S287_Override /end SUB_GROUP
/end GROUP
/begin GROUP S346_Determine_Cell_Balance "VBU0428Test/VBUSystem/BMS/CSC/Subsystem7/Determine_Cell_Balance" /begin SUB_GROUP S347_LOW_HIGH2 /end SUB_GROUP
 /begin REF_CHARACTERISTIC CaCSC_CellBalanceRequestORF_flg CaCSC_CellBalanceRequestORV_flg /end REF_CHARACTERISTIC
/end GROUP
/begin GROUP S355_Subsystem "VBU0428Test/VBUSystem/BMS/CTC/Subsystem1/Subsystem"
 /begin SUB_GROUP S356_ControlPrechargeRelay S356_ControlResetRelays S356_ControlmainNegativeRelay S356_ControlmainPositiveRelay S356_DetermineRelayCommandStatus S356_Determine_Openings_Number /end SUB_GROUP
/end GROUP
/begin GROUP S372_Subsystem4 "VBU0428Test/VBUSystem/BMS/CTD/Subsystem/Subsystem4"
 /begin SUB_GROUP S373_Determine_MainContactor_Status S373_DiagnoseRelayWeld S373_LV_Battery_Voltage S373_Lockout_Precharge_Process S373_MainFuseDiagnostic S373_Precharge_Resistance_Diagnostic S373_PrechrgProcessMonitoring S373_Stuck_Open_Diagnostic S373_Subsystem S373_Subsystem1 S373_Subsystem2 S373_Subsystem3 /end SUB_GROUP
/end GROUP
/begin GROUP S540_Subsystem "VBU0428Test/VBUSystem/BMS/CTM/CTM/Subsystem"
 /begin SUB_GROUP S541_BoardTemp_ValidCheck S541_CellTemp_ValidCheck S541_Determine_BoardTemp_OverUnderFaults S541_Determine_CellTemp S541_Determine_CellTemp_OverDeviationFaults S541_Determine_CellTemp_OverUnderFaults S541_Determine_Thermal_Runaway S541_PowerOnTempVoltageValid /end SUB_GROUP
/end GROUP
/begin GROUP S618_Subsystem "VBU0428Test/VBUSystem/BMS/CTS/CTS/Subsystem"
 /begin SUB_GROUP S619_Contactors_Timing_Control S619_DeterminePrechargeConditions S619_Determine_Contactor_Request S619_Determine_Emergency_Open S619_Determine_Precharge_Times /end SUB_GROUP
/end GROUP
/begin GROUP S648_Subsystem "VBU0428Test/VBUSystem/BMS/CVT/CVT/Subsystem"
 /begin SUB_GROUP S649_CellVoltage_ValidCheck S649_Determine_CellVoltage_ExtremeData S649_Determine_CellVoltage_OverUnderFaults S649_Monitor_CVT_DeviationDynamic S649_Monitor_CVT_Performance /end SUB_GROUP
/end GROUP
/begin GROUP S708_Subsystem "VBU0428Test/VBUSystem/BMS/DSM/Subsystem10/Subsystem"
 /begin SUB_GROUP S709_Clear_Fault_Data S709_Determine_Abnormal_In_PeriodicalUpload S709_Determine_CSC_Inhibit S709_Determine_Drive_Cycle S709_Determine_Fault_Category S709_Determine_MIL_Request S709_Determine_No_Charge S709_Determine_No_Restart /end SUB_GROUP
 /begin REF_CHARACTERISTIC DSM_FDCFaultStatus_C /end REF_CHARACTERISTIC
/end GROUP
/begin GROUP S740_Subsystem "VBU0428Test/VBUSystem/BMS/FCC /FCC/Subsystem"
 /begin SUB_GROUP S741_Calculate_Fastcharge_Time S741_Determine_Fastcharge_Request S741_Fastcharge_Conditions_Check S741_Fastcharge_State_Management S741_Fastcharge_Violation_Diagnostic S741_MapingSOC /end SUB_GROUP
 /begin REF_CHARACTERISTIC FCC_pctVCRVCUMaxChrgSOCSet /end REF_CHARACTERISTIC
/end GROUP
/begin GROUP S861_DetermineIsolationSevereTestFail "VBU0428Test/VBUSystem/BMS/ISO/Determine_FaultDetection_Check/DetermineIsolationSevereTestFail"
 /begin REF_CHARACTERISTIC CcISO_AllowableIsolationWarningTimes_n CcISO_IsolationSeverseLimited_Kohm /end REF_CHARACTERISTIC
/end GROUP
/begin GROUP S861_DetermineIsolationWarningTestFail "VBU0428Test/VBUSystem/BMS/ISO/Determine_FaultDetection_Check/DetermineIsolationWarningTestFail"
 /begin REF_CHARACTERISTIC CcISO_AllowableIsolationWarningTimes_n CcISO_IsolationWarningLimited_Kohm /end REF_CHARACTERISTIC
/end GROUP
/begin GROUP S861_Status_Process "VBU0428Test/VBUSystem/BMS/ISO/Determine_FaultDetection_Check/Status_Process" /begin SUB_GROUP S871_Determine_EVMandStatus S871_Determine_IsolationLevel /end SUB_GROUP /end GROUP
/begin GROUP S862_ISO_DCCharging_Dec "VBU0428Test/VBUSystem/BMS/ISO/Determine_IsoLowItems/ISO_DCCharging_Dec"
 /begin REF_CHARACTERISTIC CcISO_FccISODecThr_kohm CcISO_FccISODecThr_pct CcISO_FccISOLowThr40_kohm CcISO_FccISOLowThr_kohm ONE_HUNDRED_PERCENT /end REF_CHARACTERISTIC
/end GROUP
/begin GROUP S862_ISO_Normal_Dec "VBU0428Test/VBUSystem/BMS/ISO/Determine_IsoLowItems/ISO_Normal_Dec"
 /begin REF_CHARACTERISTIC CcISO_DrvISODecThr_kohm CcISO_DrvISODecThr_pct CcISO_DrvISOLowThr40_kohm CcISO_DrvISOLowThr_kohm ONE_HUNDRED_PERCENT /end REF_CHARACTERISTIC
/end GROUP
/begin GROUP S862_ISO_Pack_Dec "VBU0428Test/VBUSystem/BMS/ISO/Determine_IsoLowItems/ISO_Pack_Dec"
 /begin REF_CHARACTERISTIC CcISO_PackISODecThr_kohm CcISO_PackISODecThr_pct CcISO_PackISOLowThr_kohm ONE_HUNDRED_PERCENT /end REF_CHARACTERISTIC
/end GROUP
/begin GROUP S902_Diagnose_NVM "VBU0428Test/VBUSystem/BMS/NVM /Subsystem3/Diagnose_NVM"
 /begin REF_CHARACTERISTIC BMM_STATE_DRIVE_MODE CbNVM_DataReadFaultEnable_flg CbNVM_DataWriteFaultEnable_flg CbNVM_EepromCrcCheckFaultEnable_flg CcNVM_DataReadFIC_n CcNVM_DataReadPIC_n CcNVM_DataWriteFIC_n CcNVM_DataWritePIC_n CcNVM_EepromCrcCheckFIC_n CcNVM_EepromCrcCheckPIC_n NVM_DATA_READ_FAULT NVM_DATA_WRITE_FAULT NVM_EEPROM_CRC_CHECK_FAULT NVM_READ_CRC_FAIL NVM_READ_HARDWARE_FAIL /end REF_CHARACTERISTIC
/end GROUP
/begin GROUP S902_Read_NVM_Data "VBU0428Test/VBUSystem/BMS/NVM /Subsystem3/Read_NVM_Data" /begin SUB_GROUP S904_Check_First_Run S904_Check_NVM_Read /end SUB_GROUP /begin REF_MEASUREMENT NVM_flgNVMValid /end REF_MEASUREMENT /end GROUP
/begin GROUP S922_Subsystem "VBU0428Test/VBUSystem/BMS/OCV/OCV/Subsystem"
 /begin SUB_GROUP S923_Determine_Criteria S923_Determine_Relax_ElapsedTime S923_Determine_Relax_MinTime S923_OCV_Valid_Check /end SUB_GROUP
/end GROUP
/begin GROUP S931_Calculate_Actual_Time "VBU0428Test/VBUSystem/BMS/RTC/RTC/Calculate_Actual_Time" /begin SUB_GROUP S932_Initialize_Actual_Time /end SUB_GROUP /begin REF_CHARACTERISTIC CbSYS_flgAbnormalResetRecoverEnable /end REF_CHARACTERISTIC /end GROUP
/begin GROUP S931_Calculate_RelativeActual_Time "VBU0428Test/VBUSystem/BMS/RTC/RTC/Calculate_RelativeActual_Time" /begin REF_CHARACTERISTIC MILISECONDS_PER_SECOND SAMPLE_TIME_TASK_A /end REF_CHARACTERISTIC /end GROUP
/begin GROUP S931_Determine_VCU_ActualTime "VBU0428Test/VBUSystem/BMS/RTC/RTC/Determine_VCU_ActualTime" /begin SUB_GROUP S934_Calculate_Time_Deviation /end SUB_GROUP /begin REF_CHARACTERISTIC BMM_STATE_INITIALIZATION CbRTC_ActualTimeInit_flg /end REF_CHARACTERISTIC /end GROUP
/begin GROUP S931_Diagnose_RTC "VBU0428Test/VBUSystem/BMS/RTC/RTC/Diagnose_RTC"
 /begin REF_CHARACTERISTIC CbRTC_flgRealtimeClockFaultEnable CcRTC_nbrRealtimeClockFIC CcRTC_nbrRealtimeClockPIC RTC_REALTIME_CLOCK_FAULT /end REF_CHARACTERISTIC
/end GROUP
/begin GROUP S931_Reset_TimeInit_flg "VBU0428Test/VBUSystem/BMS/RTC/RTC/Reset_TimeInit_flg" /begin REF_CHARACTERISTIC CbRTC_ActualTimeInit_flg /end REF_CHARACTERISTIC /end GROUP
/begin GROUP S931_Set_RTC_Wakeup "VBU0428Test/VBUSystem/BMS/RTC/RTC/Set_RTC_Wakeup"
 /begin REF_CHARACTERISTIC CcRTC_FastWakeUpCycle_min CcRTC_FastWakeUpSOCLowerLimit_pct CcRTC_FastWakeUpSOCUpperLimit_pct CcRTC_FastWakeUpTempMiddleLimit_C CcRTC_FastWakeUpTempUpperLimit_C CcRTC_RTCWakeupLVBattDelay_min CcRTC_SlowWakeUpCycle_min /end REF_CHARACTERISTIC
/end GROUP
/begin GROUP S958_Subsystem "VBU0428Test/VBUSystem/BMS/SOC/Subsystem5/Subsystem"
 /begin SUB_GROUP S959_Battery_SoC_Diagnostic S959_Determine_AhIntegral_SoC S959_Determine_Battery_SOC S959_Determine_CellData_Validation S959_Determine_Cell_SOC S959_Determine_Correction_Condition S959_Determine_Display_SOC S959_Determine_FastChargeCorrection_Soc S959_Determine_Initial_SoC S959_Determine_Initialization_Condition S959_Determine_OcvSoc S959_Determine_ShortTimeCorrection_Condition S959_Ocv_ShortTimeCorrection S959_Soc_Data_Storage /end SUB_GROUP
 /begin REF_CHARACTERISTIC SOC_pctMaxSOCSet_C /end REF_CHARACTERISTIC
/end GROUP
/begin GROUP S1117_Subsystem "VBU0428Test/VBUSystem/BMS/SOE/Subsystem2/Subsystem"
 /begin SUB_GROUP S1118_Calculate_History_Average_Current S1118_Calculate_Pack_Remaining_Energy S1118_Calculate_Pack_Remaining_Energy_SOC S1118_Rate_Limit_and_Output S1118_Rate_Limit_and_Output_SOC /end SUB_GROUP
/end GROUP
/begin GROUP S1169_Subsystem "VBU0428Test/VBUSystem/BMS/SOF/Subsystem6/Subsystem"
 /begin SUB_GROUP S1170_Calculate_ActualPower S1170_Calculate_PowerLimit S1170_Count_LowTempOverCurrent S1170_Determine_Currentlimit_Target S1170_Rate_CurrentLimit S1170_Rate_PowerLimit S1170_SOF_Diagnostic /end SUB_GROUP
/end GROUP
/begin GROUP S1396_Subsystem1 "VBU0428Test/VBUSystem/BMS/SOH/Subsystem4/Subsystem1"
 /begin SUB_GROUP S1397_Calculate_Capacity S1397_Calculate_Resistance S1397_Monitor_SOH S1397_SOH_Diagnositic S1397_Subsystem /end SUB_GROUP
/end GROUP
/begin GROUP S1527_Subsystem "VBU0428Test/VBUSystem/BMS/THM/Subsystem/Subsystem"
 /begin SUB_GROUP S1528_Calculate_PipeTemperature S1528_Charge_Mode_Temp_Request S1528_Cooling_Request_Respond_Check S1528_Diagnose_InletCoolingHighTemperture_Fault S1528_Diagnose_InletCoolingLowTemperture_Fault S1528_Diagnose_InletOutletTempDelta_Fault S1528_Diagnose_OutletCoolingHighTemperture_Fault S1528_Diagnose_OutletCoolingLowTemperture_Fault S1528_Thermal_System_Damage_Judgement S1528_Valid_Condition_Determination /end SUB_GROUP
/end GROUP
/begin GROUP S1601_Subsystem "VBU0428Test/VBUSystem/BMS/VCT/Subsystem/Subsystem"
 /begin SUB_GROUP S1602_Determine_BMS_VCU_267 S1602_Determine_BMS_VCU_268 S1602_Determine_BMS_VCU_269 S1602_Determine_BMS_VCU_26A S1602_Determine_BMS_VCU_26F S1602_Determine_BMS_VCU_270 S1602_Determine_BMS_VCU_271 S1602_Determine_BMS_VCU_272 S1602_Determine_BMS_VCU_273 S1602_Determine_BMS_VCU_34 S1602_Determine_BMS_VCU_372 S1602_Determine_BMS_VCU_373 S1602_Determine_BMS_VCU_AC S1602_Determine_BMS_VCU_AD S1602_Determine_BMS_VCU_AE /end SUB_GROUP
/end GROUP
/begin GROUP S1804_Subsystem "VBU0428Test/VBUSystem/BMS/WRT/Subsystem9/Subsystem"
 /begin REF_CHARACTERISTIC CbWRT_BatteryCapacityCycleORF_flg CcSYS_NominalCellCapacity_Ah CcWRT_BatteryCapacityCycleORV_n /end REF_CHARACTERISTIC
 /begin REF_MEASUREMENT WRT_AhOverallDischarged WRT_AhOverallFastcharged WRT_numBatteryCapacityCycle WRT_numOpenContactorWithLoadTimes1 WRT_numOpenContactorWithLoadTimes2 /end REF_MEASUREMENT
/end GROUP
/begin GROUP S1841_Input_HW_Signal_Range_Check2 "VBU0428Test/VBUSystem/HALIn/HW/Subsystem/Input_HW_Signal_Range_Check2" /begin SUB_GROUP S1845_override_signal_Status /end SUB_GROUP
 /begin REF_CHARACTERISTIC INP_flgAccPed1CaliOvrd_C INP_flgAccPed1SafetyEnable_C INP_numAccPed1CounterLim_C INP_numAccPed1DecCounter_C INP_numAccPed1IncCounter_C INP_uAccPed1CaliOvrdVal_C INP_uAccPed1RangeMax_C INP_uAccPed1RangeMin_C INP_uAccPed1SafetyVal_C /end REF_CHARACTERISTIC
/end GROUP
/begin GROUP S1841_Input_HW_Signal_Range_Check3 "VBU0428Test/VBUSystem/HALIn/HW/Subsystem/Input_HW_Signal_Range_Check3" /begin SUB_GROUP S1846_override_signal_Status /end SUB_GROUP
 /begin REF_CHARACTERISTIC INP_flgBrkPresCaliOvrd_C INP_flgBrkPresSafetyEnable_C INP_numBrkPresCounterLim_C INP_numBrkPresDecCounter_C INP_numBrkPresIncCounter_C INP_uBrkPresCaliOvrdVal_C INP_uBrkPresRangeMax_C INP_uBrkPresRangeMin_C INP_uBrkPresSafetyVal_C /end REF_CHARACTERISTIC
/end GROUP
/begin GROUP S1841_Input_HW_Signal_Range_Check4 "VBU0428Test/VBUSystem/HALIn/HW/Subsystem/Input_HW_Signal_Range_Check4" /begin SUB_GROUP S1847_override_signal_Status /end SUB_GROUP
 /begin REF_CHARACTERISTIC INP_flgAccPed2CaliOvrd_C INP_flgAccPed2SafetyEnable_C INP_numAccPed2CounterLim_C INP_numAccPed2DecCounter_C INP_numAccPed2IncCounter_C INP_uAccPed2CaliOvrdVal_C INP_uAccPed2RangeMax_C INP_uAccPed2RangeMin_C INP_uAccPed2SafetyVal_C /end REF_CHARACTERISTIC
/end GROUP
/begin GROUP S1841_Input_HW_Signal_Range_Check6 "VBU0428Test/VBUSystem/HALIn/HW/Subsystem/Input_HW_Signal_Range_Check6" /begin SUB_GROUP S1848_override_signal_Status /end SUB_GROUP
 /begin REF_CHARACTERISTIC INP_flgDCChCC2CaliOvrd_C INP_flgDCChCC2SafetyEnable_C INP_numDCChCC2CounterLim_C INP_numDCChCC2DecCounter_C INP_numDCChCC2IncCounter_C INP_uDCChCC2CaliOvrdVal_C INP_uDCChCC2RangeMax_C INP_uDCChCC2RangeMin_C INP_uDCChCC2SafetyVal_C /end REF_CHARACTERISTIC
/end GROUP
/begin GROUP S1841_Input_HW_Signal_Range_Check_Table1 "VBU0428Test/VBUSystem/HALIn/HW/Subsystem/Input_HW_Signal_Range_Check_Table1" /begin SUB_GROUP S1849_override_signal_Status /end SUB_GROUP
 /begin REF_CHARACTERISTIC INP_flgVacPresCaliOvrd_C INP_flgVacPresSafetyEnable_C INP_numVacPresCounterLim_C INP_numVacPresDecCounter_C INP_numVacPresIncCounter_C INP_pVacPresCaliOvrdVal_C INP_pVacPres_CUR_v INP_uVacPresRangeMax_C INP_uVacPresRangeMin_C INP_uVacPresSafetyVal_C /end REF_CHARACTERISTIC
/end GROUP
/begin GROUP S1841_Input_HW_Signal_Range_Check_Table2 "VBU0428Test/VBUSystem/HALIn/HW/Subsystem/Input_HW_Signal_Range_Check_Table2" /begin SUB_GROUP S1850_override_signal_Status /end SUB_GROUP
 /begin REF_CHARACTERISTIC INP_flgDCChPortTempCaliOvrd_C INP_flgDCChPortTempSafetyEnable_C INP_numDCChPortTempCounterLim_C INP_numDCChPortTempDecCounter_C INP_numDCChPortTempIncCounter_C INP_tDCChPortTempCaliOvrdVal_C INP_tDCChPortTempSafetyVal_C INP_tDCChPortTemp_CUR_v INP_uDCChPortTempRangeMax_C INP_uDCChPortTempRangeMin_C /end REF_CHARACTERISTIC
/end GROUP
/begin GROUP S1841_Input_HW_Signal_Range_Check_Table4 "VBU0428Test/VBUSystem/HALIn/HW/Subsystem/Input_HW_Signal_Range_Check_Table4" /begin SUB_GROUP S1851_override_signal_Status /end SUB_GROUP
 /begin REF_CHARACTERISTIC INP_flgDCChPortTempNegativeCaliOvrd_C INP_flgDCChPortTempNegativeSafetyEnable_C INP_numDCChPortTempNegativeCounterLim_C INP_numDCChPortTempNegativeDecCounter_C INP_numDCChPortTempNegativeIncCounter_C INP_tDCChPortTempNegativeCaliOvrdVal_C INP_tDCChPortTempNegativeSafetyVal_C INP_tDCChPortTempNegative_CUR_v INP_uDCChPortTempNegativeRangeMax_C INP_uDCChPortTempNegativeRangeMin_C /end REF_CHARACTERISTIC
/end GROUP
/begin GROUP S1841_Input_HW_Signal_Range_Check_Table5 "VBU0428Test/VBUSystem/HALIn/HW/Subsystem/Input_HW_Signal_Range_Check_Table5" /begin SUB_GROUP S1852_override_signal_Status /end SUB_GROUP
 /begin REF_CHARACTERISTIC INP_flgEDSOutTempCaliOvrd_C INP_flgEDSOutTempSafetyEnable_C INP_numEDSOutTempCounterLim_C INP_numEDSOutTempDecCounter_C INP_numEDSOutTempIncCounter_C INP_tEDSOutTempCaliOvrdVal_C INP_tEDSOutTempSafetyVal_C INP_tEDSOutTemp_CUR_v INP_uEDSOutTempRangeMax_C INP_uEDSOutTempRangeMin_C /end REF_CHARACTERISTIC
/end GROUP
/begin GROUP S1842_BrkLmpSwtConfirm "VBU0428Test/VBUSystem/HALIn/HW/Subsystem1/BrkLmpSwtConfirm" /begin SUB_GROUP S1925_override_signal /end SUB_GROUP /end GROUP
/begin GROUP S1842_INP_flgGearH1Confirm "VBU0428Test/VBUSystem/HALIn/HW/Subsystem1/INP_flgGearH1Confirm" /begin SUB_GROUP S1926_override_signal /end SUB_GROUP /end GROUP
/begin GROUP S1842_INP_flgGearH2Confirm "VBU0428Test/VBUSystem/HALIn/HW/Subsystem1/INP_flgGearH2Confirm" /begin SUB_GROUP S1927_override_signal /end SUB_GROUP /end GROUP
/begin GROUP S1842_INP_flgGearH3Confirm "VBU0428Test/VBUSystem/HALIn/HW/Subsystem1/INP_flgGearH3Confirm" /begin SUB_GROUP S1928_override_signal /end SUB_GROUP /end GROUP
/begin GROUP S1842_IN_ACMidPreConfirm "VBU0428Test/VBUSystem/HALIn/HW/Subsystem1/IN_ACMidPreConfirm" /begin SUB_GROUP S1929_override_signal /end SUB_GROUP /end GROUP
/begin GROUP S1842_IN_CrankConfirm "VBU0428Test/VBUSystem/HALIn/HW/Subsystem1/IN_CrankConfirm" /begin SUB_GROUP S1930_override_signal /end SUB_GROUP /end GROUP
/begin GROUP S1842_IN_DriverACOnConfirm "VBU0428Test/VBUSystem/HALIn/HW/Subsystem1/IN_DriverACOnConfirm" /begin SUB_GROUP S1931_override_signal /end SUB_GROUP /end GROUP
/begin GROUP S1843_Input_HW_Signal_Range_Check1 "VBU0428Test/VBUSystem/HALIn/HW/Subsystem2/Input_HW_Signal_Range_Check1" /begin SUB_GROUP S1946_override_signal_Status /end SUB_GROUP /end GROUP
/begin GROUP S1843_Input_HW_Signal_Range_Check2 "VBU0428Test/VBUSystem/HALIn/HW/Subsystem2/Input_HW_Signal_Range_Check2" /begin SUB_GROUP S1947_override_signal_Status /end SUB_GROUP /end GROUP
/begin GROUP S1843_Input_HW_Signal_Range_Check3 "VBU0428Test/VBUSystem/HALIn/HW/Subsystem2/Input_HW_Signal_Range_Check3" /begin SUB_GROUP S1948_override_signal_Status /end SUB_GROUP /end GROUP
/begin GROUP S1843_Input_HW_Signal_Range_Check7 "VBU0428Test/VBUSystem/HALIn/HW/Subsystem2/Input_HW_Signal_Range_Check7" /begin SUB_GROUP S1949_override_signal_Status /end SUB_GROUP /end GROUP
/begin GROUP S1992_20ms "VBU0428Test/VBUSystem/HALIn/PTCAN/Subsystem/20ms"
 /begin SUB_GROUP S1993_ABS_0x068 S1993_ABS_0x115 S1993_ABS_0x75 S1993_ABS_0x79 S1993_EPB_0x80 S1993_EPS_0x70 S1993_MCU_205 /end SUB_GROUP
/end GROUP
/begin GROUP S1992_50ms "VBU0428Test/VBUSystem/HALIn/PTCAN/Subsystem/50ms" /begin SUB_GROUP S1994_BCM_0x18FE0121 S1994_MCU_305 /end SUB_GROUP /end GROUP
/begin GROUP S1992_CanMsgReceive "VBU0428Test/VBUSystem/HALIn/PTCAN/Subsystem/CanMsgReceive" /begin REF_MEASUREMENT MsgRxFlg_MCU_305 /end REF_MEASUREMENT /end GROUP
/begin GROUP S1992_CanMsgUnpack "VBU0428Test/VBUSystem/HALIn/PTCAN/Subsystem/CanMsgUnpack"
 /begin SUB_GROUP S1997_MsgRxData_Unpack1 S1997_MsgRxData_Unpack10 S1997_MsgRxData_Unpack11 S1997_MsgRxData_Unpack12 S1997_MsgRxData_Unpack13 S1997_MsgRxData_Unpack14 S1997_MsgRxData_Unpack15 S1997_MsgRxData_Unpack16 S1997_MsgRxData_Unpack17 S1997_MsgRxData_Unpack18 S1997_MsgRxData_Unpack19 S1997_MsgRxData_Unpack2 S1997_MsgRxData_Unpack20 S1997_MsgRxData_Unpack3 S1997_MsgRxData_Unpack4 S1997_MsgRxData_Unpack5 S1997_MsgRxData_Unpack6 S1997_MsgRxData_Unpack7 S1997_MsgRxData_Unpack8 S1997_MsgRxData_Unpack9 /end SUB_GROUP
/end GROUP
/begin GROUP S1992_Subsystem2 "VBU0428Test/VBUSystem/HALIn/PTCAN/Subsystem/Subsystem2" /begin SUB_GROUP S1999_AVAS_1801D0D3 S1999_IC_401 S1999_MCU_505 /end SUB_GROUP /end GROUP
/begin GROUP S1992_Subsystem3 "VBU0428Test/VBUSystem/HALIn/PTCAN/Subsystem/Subsystem3" /begin SUB_GROUP S2000_DCDC_509 /end SUB_GROUP /end GROUP
/begin GROUP S1992_Subsystem4 "VBU0428Test/VBUSystem/HALIn/PTCAN/Subsystem/Subsystem4" /begin SUB_GROUP S2001_AC_248 S2001_CDC_220 S2001_DCDC_303 S2001_MCU_405 /end SUB_GROUP /end GROUP
/begin GROUP S2697_MsgRxData_Unpack1 "VBU0428Test/VBUSystem/HALIn/PrivateCAN/CanMsgUnpack1/MsgRxData_Unpack1" /begin SUB_GROUP S2698_CanRxData_Unpack /end SUB_GROUP /end GROUP
/begin GROUP S2697_MsgRxData_Unpack10 "VBU0428Test/VBUSystem/HALIn/PrivateCAN/CanMsgUnpack1/MsgRxData_Unpack10" /begin SUB_GROUP S2699_CanRxData_Unpack /end SUB_GROUP /end GROUP
/begin GROUP S2697_MsgRxData_Unpack11 "VBU0428Test/VBUSystem/HALIn/PrivateCAN/CanMsgUnpack1/MsgRxData_Unpack11" /begin SUB_GROUP S2700_CanRxData_Unpack /end SUB_GROUP /end GROUP
/begin GROUP S2697_MsgRxData_Unpack12 "VBU0428Test/VBUSystem/HALIn/PrivateCAN/CanMsgUnpack1/MsgRxData_Unpack12" /begin SUB_GROUP S2701_CanRxData_Unpack /end SUB_GROUP /end GROUP
/begin GROUP S2697_MsgRxData_Unpack13 "VBU0428Test/VBUSystem/HALIn/PrivateCAN/CanMsgUnpack1/MsgRxData_Unpack13" /begin SUB_GROUP S2702_CanRxData_Unpack /end SUB_GROUP /end GROUP
/begin GROUP S2697_MsgRxData_Unpack14 "VBU0428Test/VBUSystem/HALIn/PrivateCAN/CanMsgUnpack1/MsgRxData_Unpack14" /begin SUB_GROUP S2703_CanRxData_Unpack /end SUB_GROUP /end GROUP
/begin GROUP S2697_MsgRxData_Unpack15 "VBU0428Test/VBUSystem/HALIn/PrivateCAN/CanMsgUnpack1/MsgRxData_Unpack15" /begin SUB_GROUP S2704_CanRxData_Unpack /end SUB_GROUP /end GROUP
/begin GROUP S2697_MsgRxData_Unpack16 "VBU0428Test/VBUSystem/HALIn/PrivateCAN/CanMsgUnpack1/MsgRxData_Unpack16" /begin SUB_GROUP S2705_CanRxData_Unpack /end SUB_GROUP /end GROUP
/begin GROUP S2697_MsgRxData_Unpack17 "VBU0428Test/VBUSystem/HALIn/PrivateCAN/CanMsgUnpack1/MsgRxData_Unpack17" /begin SUB_GROUP S2706_CanRxData_Unpack /end SUB_GROUP /end GROUP
/begin GROUP S2697_MsgRxData_Unpack18 "VBU0428Test/VBUSystem/HALIn/PrivateCAN/CanMsgUnpack1/MsgRxData_Unpack18" /begin SUB_GROUP S2707_CanRxData_Unpack /end SUB_GROUP /end GROUP
/begin GROUP S2697_MsgRxData_Unpack19 "VBU0428Test/VBUSystem/HALIn/PrivateCAN/CanMsgUnpack1/MsgRxData_Unpack19" /begin SUB_GROUP S2708_CanRxData_Unpack /end SUB_GROUP /end GROUP
/begin GROUP S2697_MsgRxData_Unpack2 "VBU0428Test/VBUSystem/HALIn/PrivateCAN/CanMsgUnpack1/MsgRxData_Unpack2" /begin SUB_GROUP S2709_CanRxData_Unpack /end SUB_GROUP /end GROUP
/begin GROUP S2697_MsgRxData_Unpack20 "VBU0428Test/VBUSystem/HALIn/PrivateCAN/CanMsgUnpack1/MsgRxData_Unpack20" /begin SUB_GROUP S2710_CanRxData_Unpack /end SUB_GROUP /end GROUP
/begin GROUP S2697_MsgRxData_Unpack21 "VBU0428Test/VBUSystem/HALIn/PrivateCAN/CanMsgUnpack1/MsgRxData_Unpack21" /begin SUB_GROUP S2711_CanRxData_Unpack /end SUB_GROUP /end GROUP
/begin GROUP S2697_MsgRxData_Unpack22 "VBU0428Test/VBUSystem/HALIn/PrivateCAN/CanMsgUnpack1/MsgRxData_Unpack22" /begin SUB_GROUP S2712_CanRxData_Unpack /end SUB_GROUP /end GROUP
/begin GROUP S2697_MsgRxData_Unpack23 "VBU0428Test/VBUSystem/HALIn/PrivateCAN/CanMsgUnpack1/MsgRxData_Unpack23" /begin SUB_GROUP S2713_CanRxData_Unpack /end SUB_GROUP /end GROUP
/begin GROUP S2697_MsgRxData_Unpack24 "VBU0428Test/VBUSystem/HALIn/PrivateCAN/CanMsgUnpack1/MsgRxData_Unpack24" /begin SUB_GROUP S2714_CanRxData_Unpack /end SUB_GROUP /end GROUP
/begin GROUP S2697_MsgRxData_Unpack25 "VBU0428Test/VBUSystem/HALIn/PrivateCAN/CanMsgUnpack1/MsgRxData_Unpack25" /begin SUB_GROUP S2715_CanRxData_Unpack /end SUB_GROUP /end GROUP
/begin GROUP S2697_MsgRxData_Unpack26 "VBU0428Test/VBUSystem/HALIn/PrivateCAN/CanMsgUnpack1/MsgRxData_Unpack26" /begin SUB_GROUP S2716_CanRxData_Unpack /end SUB_GROUP /end GROUP
/begin GROUP S2697_MsgRxData_Unpack27 "VBU0428Test/VBUSystem/HALIn/PrivateCAN/CanMsgUnpack1/MsgRxData_Unpack27" /begin SUB_GROUP S2717_CanRxData_Unpack /end SUB_GROUP /end GROUP
/begin GROUP S2697_MsgRxData_Unpack28 "VBU0428Test/VBUSystem/HALIn/PrivateCAN/CanMsgUnpack1/MsgRxData_Unpack28" /begin SUB_GROUP S2718_CanRxData_Unpack /end SUB_GROUP /end GROUP
/begin GROUP S2697_MsgRxData_Unpack29 "VBU0428Test/VBUSystem/HALIn/PrivateCAN/CanMsgUnpack1/MsgRxData_Unpack29" /begin SUB_GROUP S2719_CanRxData_Unpack /end SUB_GROUP /end GROUP
/begin GROUP S2697_MsgRxData_Unpack3 "VBU0428Test/VBUSystem/HALIn/PrivateCAN/CanMsgUnpack1/MsgRxData_Unpack3" /begin SUB_GROUP S2720_CanRxData_Unpack /end SUB_GROUP /end GROUP
/begin GROUP S2697_MsgRxData_Unpack30 "VBU0428Test/VBUSystem/HALIn/PrivateCAN/CanMsgUnpack1/MsgRxData_Unpack30" /begin SUB_GROUP S2721_CanRxData_Unpack /end SUB_GROUP /end GROUP
/begin GROUP S2697_MsgRxData_Unpack31 "VBU0428Test/VBUSystem/HALIn/PrivateCAN/CanMsgUnpack1/MsgRxData_Unpack31" /begin SUB_GROUP S2722_CanRxData_Unpack /end SUB_GROUP /end GROUP
/begin GROUP S2697_MsgRxData_Unpack32 "VBU0428Test/VBUSystem/HALIn/PrivateCAN/CanMsgUnpack1/MsgRxData_Unpack32" /begin SUB_GROUP S2723_CanRxData_Unpack /end SUB_GROUP /end GROUP
/begin GROUP S2697_MsgRxData_Unpack33 "VBU0428Test/VBUSystem/HALIn/PrivateCAN/CanMsgUnpack1/MsgRxData_Unpack33" /begin SUB_GROUP S2724_CanRxData_Unpack /end SUB_GROUP /end GROUP
/begin GROUP S2697_MsgRxData_Unpack34 "VBU0428Test/VBUSystem/HALIn/PrivateCAN/CanMsgUnpack1/MsgRxData_Unpack34" /begin SUB_GROUP S2725_CanRxData_Unpack /end SUB_GROUP /end GROUP
/begin GROUP S2697_MsgRxData_Unpack35 "VBU0428Test/VBUSystem/HALIn/PrivateCAN/CanMsgUnpack1/MsgRxData_Unpack35" /begin SUB_GROUP S2726_CanRxData_Unpack /end SUB_GROUP /end GROUP
/begin GROUP S2697_MsgRxData_Unpack36 "VBU0428Test/VBUSystem/HALIn/PrivateCAN/CanMsgUnpack1/MsgRxData_Unpack36" /begin SUB_GROUP S2727_CanRxData_Unpack /end SUB_GROUP /end GROUP
/begin GROUP S2697_MsgRxData_Unpack37 "VBU0428Test/VBUSystem/HALIn/PrivateCAN/CanMsgUnpack1/MsgRxData_Unpack37" /begin SUB_GROUP S2728_CanRxData_Unpack /end SUB_GROUP /end GROUP
/begin GROUP S2697_MsgRxData_Unpack38 "VBU0428Test/VBUSystem/HALIn/PrivateCAN/CanMsgUnpack1/MsgRxData_Unpack38" /begin SUB_GROUP S2729_CanRxData_Unpack /end SUB_GROUP /end GROUP
/begin GROUP S2697_MsgRxData_Unpack39 "VBU0428Test/VBUSystem/HALIn/PrivateCAN/CanMsgUnpack1/MsgRxData_Unpack39" /begin SUB_GROUP S2730_CanRxData_Unpack /end SUB_GROUP /end GROUP
/begin GROUP S2697_MsgRxData_Unpack4 "VBU0428Test/VBUSystem/HALIn/PrivateCAN/CanMsgUnpack1/MsgRxData_Unpack4" /begin SUB_GROUP S2731_CanRxData_Unpack /end SUB_GROUP /end GROUP
/begin GROUP S2697_MsgRxData_Unpack40 "VBU0428Test/VBUSystem/HALIn/PrivateCAN/CanMsgUnpack1/MsgRxData_Unpack40" /begin SUB_GROUP S2732_CanRxData_Unpack /end SUB_GROUP /end GROUP
/begin GROUP S2697_MsgRxData_Unpack41 "VBU0428Test/VBUSystem/HALIn/PrivateCAN/CanMsgUnpack1/MsgRxData_Unpack41" /begin SUB_GROUP S2733_CanRxData_Unpack /end SUB_GROUP /end GROUP
/begin GROUP S2697_MsgRxData_Unpack42 "VBU0428Test/VBUSystem/HALIn/PrivateCAN/CanMsgUnpack1/MsgRxData_Unpack42" /begin SUB_GROUP S2734_CanRxData_Unpack /end SUB_GROUP /end GROUP
/begin GROUP S2697_MsgRxData_Unpack43 "VBU0428Test/VBUSystem/HALIn/PrivateCAN/CanMsgUnpack1/MsgRxData_Unpack43" /begin SUB_GROUP S2735_CanRxData_Unpack /end SUB_GROUP /end GROUP
/begin GROUP S2697_MsgRxData_Unpack44 "VBU0428Test/VBUSystem/HALIn/PrivateCAN/CanMsgUnpack1/MsgRxData_Unpack44" /begin SUB_GROUP S2736_CanRxData_Unpack /end SUB_GROUP /end GROUP
/begin GROUP S2697_MsgRxData_Unpack45 "VBU0428Test/VBUSystem/HALIn/PrivateCAN/CanMsgUnpack1/MsgRxData_Unpack45" /begin SUB_GROUP S2737_CanRxData_Unpack /end SUB_GROUP /end GROUP
/begin GROUP S2697_MsgRxData_Unpack46 "VBU0428Test/VBUSystem/HALIn/PrivateCAN/CanMsgUnpack1/MsgRxData_Unpack46" /begin SUB_GROUP S2738_CanRxData_Unpack /end SUB_GROUP /end GROUP
/begin GROUP S2697_MsgRxData_Unpack47 "VBU0428Test/VBUSystem/HALIn/PrivateCAN/CanMsgUnpack1/MsgRxData_Unpack47" /begin SUB_GROUP S2739_CanRxData_Unpack /end SUB_GROUP /end GROUP
/begin GROUP S2697_MsgRxData_Unpack48 "VBU0428Test/VBUSystem/HALIn/PrivateCAN/CanMsgUnpack1/MsgRxData_Unpack48" /begin SUB_GROUP S2740_CanRxData_Unpack /end SUB_GROUP /end GROUP
/begin GROUP S2697_MsgRxData_Unpack49 "VBU0428Test/VBUSystem/HALIn/PrivateCAN/CanMsgUnpack1/MsgRxData_Unpack49" /begin SUB_GROUP S2741_CanRxData_Unpack /end SUB_GROUP /end GROUP
/begin GROUP S2697_MsgRxData_Unpack5 "VBU0428Test/VBUSystem/HALIn/PrivateCAN/CanMsgUnpack1/MsgRxData_Unpack5" /begin SUB_GROUP S2742_CanRxData_Unpack /end SUB_GROUP /end GROUP
/begin GROUP S2697_MsgRxData_Unpack50 "VBU0428Test/VBUSystem/HALIn/PrivateCAN/CanMsgUnpack1/MsgRxData_Unpack50" /begin SUB_GROUP S2743_CanRxData_Unpack /end SUB_GROUP /end GROUP
/begin GROUP S2697_MsgRxData_Unpack51 "VBU0428Test/VBUSystem/HALIn/PrivateCAN/CanMsgUnpack1/MsgRxData_Unpack51" /begin SUB_GROUP S2744_CanRxData_Unpack /end SUB_GROUP /end GROUP
/begin GROUP S2697_MsgRxData_Unpack52 "VBU0428Test/VBUSystem/HALIn/PrivateCAN/CanMsgUnpack1/MsgRxData_Unpack52" /begin SUB_GROUP S2745_CanRxData_Unpack /end SUB_GROUP /end GROUP
/begin GROUP S2697_MsgRxData_Unpack53 "VBU0428Test/VBUSystem/HALIn/PrivateCAN/CanMsgUnpack1/MsgRxData_Unpack53" /begin SUB_GROUP S2746_CanRxData_Unpack /end SUB_GROUP /end GROUP
/begin GROUP S2697_MsgRxData_Unpack54 "VBU0428Test/VBUSystem/HALIn/PrivateCAN/CanMsgUnpack1/MsgRxData_Unpack54" /begin SUB_GROUP S2747_CanRxData_Unpack /end SUB_GROUP /end GROUP
/begin GROUP S2697_MsgRxData_Unpack55 "VBU0428Test/VBUSystem/HALIn/PrivateCAN/CanMsgUnpack1/MsgRxData_Unpack55" /begin SUB_GROUP S2748_CanRxData_Unpack /end SUB_GROUP /end GROUP
/begin GROUP S2697_MsgRxData_Unpack56 "VBU0428Test/VBUSystem/HALIn/PrivateCAN/CanMsgUnpack1/MsgRxData_Unpack56" /begin SUB_GROUP S2749_CanRxData_Unpack /end SUB_GROUP /end GROUP
/begin GROUP S2697_MsgRxData_Unpack57 "VBU0428Test/VBUSystem/HALIn/PrivateCAN/CanMsgUnpack1/MsgRxData_Unpack57" /begin SUB_GROUP S2750_CanRxData_Unpack /end SUB_GROUP /end GROUP
/begin GROUP S2697_MsgRxData_Unpack58 "VBU0428Test/VBUSystem/HALIn/PrivateCAN/CanMsgUnpack1/MsgRxData_Unpack58" /begin SUB_GROUP S2751_CanRxData_Unpack /end SUB_GROUP /end GROUP
/begin GROUP S2697_MsgRxData_Unpack59 "VBU0428Test/VBUSystem/HALIn/PrivateCAN/CanMsgUnpack1/MsgRxData_Unpack59" /begin SUB_GROUP S2752_CanRxData_Unpack /end SUB_GROUP /end GROUP
/begin GROUP S2697_MsgRxData_Unpack6 "VBU0428Test/VBUSystem/HALIn/PrivateCAN/CanMsgUnpack1/MsgRxData_Unpack6" /begin SUB_GROUP S2753_CanRxData_Unpack /end SUB_GROUP /end GROUP
/begin GROUP S2697_MsgRxData_Unpack60 "VBU0428Test/VBUSystem/HALIn/PrivateCAN/CanMsgUnpack1/MsgRxData_Unpack60" /begin SUB_GROUP S2754_CanRxData_Unpack /end SUB_GROUP /end GROUP
/begin GROUP S2697_MsgRxData_Unpack61 "VBU0428Test/VBUSystem/HALIn/PrivateCAN/CanMsgUnpack1/MsgRxData_Unpack61" /begin SUB_GROUP S2755_CanRxData_Unpack /end SUB_GROUP /end GROUP
/begin GROUP S2697_MsgRxData_Unpack62 "VBU0428Test/VBUSystem/HALIn/PrivateCAN/CanMsgUnpack1/MsgRxData_Unpack62" /begin SUB_GROUP S2756_CanRxData_Unpack /end SUB_GROUP /end GROUP
/begin GROUP S2697_MsgRxData_Unpack63 "VBU0428Test/VBUSystem/HALIn/PrivateCAN/CanMsgUnpack1/MsgRxData_Unpack63" /begin SUB_GROUP S2757_CanRxData_Unpack /end SUB_GROUP /end GROUP
/begin GROUP S2697_MsgRxData_Unpack64 "VBU0428Test/VBUSystem/HALIn/PrivateCAN/CanMsgUnpack1/MsgRxData_Unpack64" /begin SUB_GROUP S2758_CanRxData_Unpack /end SUB_GROUP /end GROUP
/begin GROUP S2697_MsgRxData_Unpack65 "VBU0428Test/VBUSystem/HALIn/PrivateCAN/CanMsgUnpack1/MsgRxData_Unpack65" /begin SUB_GROUP S2759_CanRxData_Unpack /end SUB_GROUP /end GROUP
/begin GROUP S2697_MsgRxData_Unpack66 "VBU0428Test/VBUSystem/HALIn/PrivateCAN/CanMsgUnpack1/MsgRxData_Unpack66" /begin SUB_GROUP S2760_CanRxData_Unpack /end SUB_GROUP /end GROUP
/begin GROUP S2697_MsgRxData_Unpack67 "VBU0428Test/VBUSystem/HALIn/PrivateCAN/CanMsgUnpack1/MsgRxData_Unpack67" /begin SUB_GROUP S2761_CanRxData_Unpack /end SUB_GROUP /end GROUP
/begin GROUP S2697_MsgRxData_Unpack68 "VBU0428Test/VBUSystem/HALIn/PrivateCAN/CanMsgUnpack1/MsgRxData_Unpack68" /begin SUB_GROUP S2762_CanRxData_Unpack /end SUB_GROUP /end GROUP
/begin GROUP S2697_MsgRxData_Unpack69 "VBU0428Test/VBUSystem/HALIn/PrivateCAN/CanMsgUnpack1/MsgRxData_Unpack69" /begin SUB_GROUP S2763_CanRxData_Unpack /end SUB_GROUP /end GROUP
/begin GROUP S2697_MsgRxData_Unpack7 "VBU0428Test/VBUSystem/HALIn/PrivateCAN/CanMsgUnpack1/MsgRxData_Unpack7" /begin SUB_GROUP S2764_CanRxData_Unpack /end SUB_GROUP /end GROUP
/begin GROUP S2697_MsgRxData_Unpack70 "VBU0428Test/VBUSystem/HALIn/PrivateCAN/CanMsgUnpack1/MsgRxData_Unpack70" /begin SUB_GROUP S2765_CanRxData_Unpack /end SUB_GROUP /end GROUP
/begin GROUP S2697_MsgRxData_Unpack71 "VBU0428Test/VBUSystem/HALIn/PrivateCAN/CanMsgUnpack1/MsgRxData_Unpack71" /begin SUB_GROUP S2766_CanRxData_Unpack /end SUB_GROUP /end GROUP
/begin GROUP S2697_MsgRxData_Unpack72 "VBU0428Test/VBUSystem/HALIn/PrivateCAN/CanMsgUnpack1/MsgRxData_Unpack72" /begin SUB_GROUP S2767_CanRxData_Unpack /end SUB_GROUP /end GROUP
/begin GROUP S2697_MsgRxData_Unpack73 "VBU0428Test/VBUSystem/HALIn/PrivateCAN/CanMsgUnpack1/MsgRxData_Unpack73" /begin SUB_GROUP S2768_CanRxData_Unpack /end SUB_GROUP /end GROUP
/begin GROUP S2697_MsgRxData_Unpack74 "VBU0428Test/VBUSystem/HALIn/PrivateCAN/CanMsgUnpack1/MsgRxData_Unpack74" /begin SUB_GROUP S2769_CanRxData_Unpack /end SUB_GROUP /end GROUP
/begin GROUP S2697_MsgRxData_Unpack75 "VBU0428Test/VBUSystem/HALIn/PrivateCAN/CanMsgUnpack1/MsgRxData_Unpack75" /begin SUB_GROUP S2770_CanRxData_Unpack /end SUB_GROUP /end GROUP
/begin GROUP S2697_MsgRxData_Unpack76 "VBU0428Test/VBUSystem/HALIn/PrivateCAN/CanMsgUnpack1/MsgRxData_Unpack76" /begin SUB_GROUP S2771_CanRxData_Unpack /end SUB_GROUP /end GROUP
/begin GROUP S2697_MsgRxData_Unpack77 "VBU0428Test/VBUSystem/HALIn/PrivateCAN/CanMsgUnpack1/MsgRxData_Unpack77" /begin SUB_GROUP S2772_CanRxData_Unpack /end SUB_GROUP /end GROUP
/begin GROUP S2697_MsgRxData_Unpack78 "VBU0428Test/VBUSystem/HALIn/PrivateCAN/CanMsgUnpack1/MsgRxData_Unpack78" /begin SUB_GROUP S2773_CanRxData_Unpack /end SUB_GROUP /end GROUP
/begin GROUP S2697_MsgRxData_Unpack8 "VBU0428Test/VBUSystem/HALIn/PrivateCAN/CanMsgUnpack1/MsgRxData_Unpack8" /begin SUB_GROUP S2774_CanRxData_Unpack /end SUB_GROUP /end GROUP
/begin GROUP S2697_MsgRxData_Unpack9 "VBU0428Test/VBUSystem/HALIn/PrivateCAN/CanMsgUnpack1/MsgRxData_Unpack9" /begin SUB_GROUP S2775_CanRxData_Unpack /end SUB_GROUP /end GROUP
/begin GROUP S3020_VCU_151 "VBU0428Test/VBUSystem/VCU /APO2HAL/PTCAN1Transmit/VCU_151"
 /begin REF_CHARACTERISTIC APO_flgAccPedPosOvrd_C APO_flgBrkPressOvrd_C APO_flgBrkSwtOvrdVal_C APO_flgBrkSwtOvrd_C APO_flgEfcAccPdlOvrd_C APO_pBrkPressOvrdVal_C APO_pctAccPedPosOvrdVal_C APO_pctEfcAccPdlOvrdVal_C /end REF_CHARACTERISTIC
/end GROUP
/begin GROUP S3020_VCU_153 "VBU0428Test/VBUSystem/VCU /APO2HAL/PTCAN1Transmit/VCU_153"
 /begin REF_CHARACTERISTIC APO_flgBMSCellTempHighAlarmOvrd_C APO_flgBMSCellTempLowAlarmOvrd_C APO_flgBMSDIsplaySOCOvrd_C APO_flgBMSFaultLevelOvrd_C APO_flgBMSInletTempOvrd_C APO_flgBMSMainRelayStatusOvrd_C APO_flgBMSOutletTempOvrd_C APO_flgBMSPackCurrentOvrd_C APO_flgBMSPackVoltageOvrd_C APO_flgBMSSOCOvrd_C APO_flgBMSThermalRunawayOvrdVal_C APO_flgBMSThermalRunawayOvrd_C APO_flgCellTempHighAlarmOvrdVal_C APO_flgCellTempLowAlarmOvrdVal_C APO_iBMSPackCurrentOvrdVal_C APO_pctBMSDIsplaySOCOvrdVal_C APO_pctBMSSOCOvrdVal_C APO_stBMSFaultLevelOvrdVal_C APO_stBMSMainRelayStatusOvrdVal_C APO_tBMSInletTempOvrdVal_C APO_tBMSOutletTempOvrdVal_C APO_vBMSPackVoltageOvrdVal_C /end REF_CHARACTERISTIC
/end GROUP
/begin GROUP S3020_VCU_201 "VBU0428Test/VBUSystem/VCU /APO2HAL/PTCAN1Transmit/VCU_201"
 /begin REF_CHARACTERISTIC APO_AxAccelerationOvrdVal_C APO_AyAccelerationOvrdVal_C APO_AyAccelerationOvrd_C APO_AzAccelerationOvrdVal_C APO_AzAccelerationOvrd_C APO_YawrateOvrdVal_C APO_YawrateOvrd_C APO_flgAxAccelerationOvrd_C /end REF_CHARACTERISTIC
/end GROUP
/begin GROUP S3020_VCU_501 "VBU0428Test/VBUSystem/VCU /APO2HAL/PTCAN1Transmit/VCU_501"
 /begin REF_CHARACTERISTIC APO_HundredKmTripEnergyOvrdVal_C APO_HundredKmTripEnergyOvrd_C APO_RemainingChargingTimeOvrdVal_C APO_RemainingChargingTimeOvrd_C APO_RemainingDrivingRangeOvrdVal_C APO_RemainingDrivingRangeOvrd_C APO_SOCLowWarningOvrdVal_C APO_SOCLowWarningOvrd_C APO_TenkmTripEnergyOvrdVal_C APO_TenkmTripEnergyOvrd_C APO_flgLVBattOvrd_C APO_uLVBattOvrdVal_C /end REF_CHARACTERISTIC
/end GROUP
/begin GROUP S35_Monitor_BCV_Performance "VBU0428Test/VBUSystem/BMS/BCV/BCV/Subsystem/Monitor_BCV_Performance" /begin REF_CHARACTERISTIC SAMPLE_TIME_TASK_B /end REF_CHARACTERISTIC /end GROUP
/begin GROUP S233_Monitor_BMM_Performance "VBU0428Test/VBUSystem/BMS/BMM/BMM/BMU_PowerOff_Check/Monitor_BMM_Performance" /begin REF_CHARACTERISTIC SAMPLE_TIME_TASK_B /end REF_CHARACTERISTIC /end GROUP
/begin GROUP S236_DetermineSOCJump "VBU0428Test/VBUSystem/BMS/BMM/BMM/DetermineAbnormalEventFlag/DetermineSOCJump" /begin REF_CHARACTERISTIC SAMPLE_TIME_TASK_B /end REF_CHARACTERISTIC /end GROUP
/begin GROUP S237_CycleWakeupStateMachine "VBU0428Test/VBUSystem/BMS/BMM/BMM/DetermineCycleUpload/CycleWakeupStateMachine" /begin REF_CHARACTERISTIC CYCLE_WAKEUP_STATE_PERIODICAL_UPLOAD /end REF_CHARACTERISTIC /end GROUP
/begin GROUP S238_Determine_HoldAfterrun_Condition "VBU0428Test/VBUSystem/BMS/BMM/BMM/Determine_Hold_Afterrun/Determine_HoldAfterrun_Condition" /begin REF_CHARACTERISTIC BMM_STATE_INITIALIZATION BMM_STATE_RTC /end REF_CHARACTERISTIC /end GROUP
/begin GROUP S239_Determine_Wakeup_Bywire "VBU0428Test/VBUSystem/BMS/BMM/BMM/Determine_Wakeup_Mode/Determine_Wakeup_Bywire" /begin REF_CHARACTERISTIC SAMPLE_TIME_TASK_B /end REF_CHARACTERISTIC /end GROUP
/begin GROUP S356_ControlPrechargeRelay "VBU0428Test/VBUSystem/BMS/CTC/Subsystem1/Subsystem/ControlPrechargeRelay" /begin REF_CHARACTERISTIC CTD_MAIN_CONTACTOR_STATUS_CLOSED /end REF_CHARACTERISTIC /end GROUP
/begin GROUP S356_ControlResetRelays "VBU0428Test/VBUSystem/BMS/CTC/Subsystem1/Subsystem/ControlResetRelays"
 /begin REF_CHARACTERISTIC CTD_MAIN_CONTACTOR_STATUS_CLOSED CTD_MAIN_CONTACTOR_STATUS_OPENED /end REF_CHARACTERISTIC
/end GROUP
/begin GROUP S356_ControlmainNegativeRelay "VBU0428Test/VBUSystem/BMS/CTC/Subsystem1/Subsystem/ControlmainNegativeRelay" /begin REF_CHARACTERISTIC CTD_MAIN_CONTACTOR_STATUS_CLOSED /end REF_CHARACTERISTIC /end GROUP
/begin GROUP S356_ControlmainPositiveRelay "VBU0428Test/VBUSystem/BMS/CTC/Subsystem1/Subsystem/ControlmainPositiveRelay" /begin REF_CHARACTERISTIC CTD_MAIN_CONTACTOR_STATUS_CLOSED /end REF_CHARACTERISTIC /end GROUP
/begin GROUP S373_Determine_MainContactor_Status "VBU0428Test/VBUSystem/BMS/CTD/Subsystem/Subsystem4/Determine_MainContactor_Status"
 /begin REF_CHARACTERISTIC CTD_MAIN_CONTACTOR_STATUS_CLOSED CTD_MAIN_CONTACTOR_STATUS_OPENED /end REF_CHARACTERISTIC
/end GROUP
/begin GROUP S373_Precharge_Resistance_Diagnostic "VBU0428Test/VBUSystem/BMS/CTD/Subsystem/Subsystem4/Precharge_Resistance_Diagnostic" /begin REF_CHARACTERISTIC CTD_PRECHARGE_RESISTANCE_BLOWN_FAULT /end REF_CHARACTERISTIC /end GROUP
/begin GROUP S373_Subsystem "VBU0428Test/VBUSystem/BMS/CTD/Subsystem/Subsystem4/Subsystem"
 /begin REF_CHARACTERISTIC CTD_MAIN_CONTACTOR_STATUS_CLOSED CTD_MAIN_CONTACTOR_STATUS_OPENED /end REF_CHARACTERISTIC
/end GROUP
/begin GROUP S373_Subsystem1 "VBU0428Test/VBUSystem/BMS/CTD/Subsystem/Subsystem4/Subsystem1" /begin REF_CHARACTERISTIC CTD_MAIN_CONTACTOR_STATUS_CLOSED /end REF_CHARACTERISTIC /end GROUP
/begin GROUP S373_Subsystem2 "VBU0428Test/VBUSystem/BMS/CTD/Subsystem/Subsystem4/Subsystem2" /begin REF_CHARACTERISTIC CTD_MAIN_CONTACTOR_STATUS_CLOSED /end REF_CHARACTERISTIC /end GROUP
/begin GROUP S373_Subsystem3 "VBU0428Test/VBUSystem/BMS/CTD/Subsystem/Subsystem4/Subsystem3" /begin REF_CHARACTERISTIC CTD_MAIN_CONTACTOR_STATUS_CLOSED /end REF_CHARACTERISTIC /end GROUP
/begin GROUP S541_Determine_CellTemp_OverUnderFaults "VBU0428Test/VBUSystem/BMS/CTM/CTM/Subsystem/Determine_CellTemp_OverUnderFaults" /begin REF_CHARACTERISTIC CTM_CELL_OVER_TEMP_FAULT /end REF_CHARACTERISTIC /end GROUP
/begin GROUP S619_Contactors_Timing_Control "VBU0428Test/VBUSystem/BMS/CTS/CTS/Subsystem/Contactors_Timing_Control"
 /begin REF_CHARACTERISTIC CTD_MAIN_CONTACTOR_STATUS_CLOSED CTD_MAIN_CONTACTOR_STATUS_OPENED SAMPLE_TIME_TASK_B /end REF_CHARACTERISTIC
/end GROUP
/begin GROUP S619_Determine_Precharge_Times "VBU0428Test/VBUSystem/BMS/CTS/CTS/Subsystem/Determine_Precharge_Times" /begin REF_CHARACTERISTIC SAMPLE_TIME_TASK_B /end REF_CHARACTERISTIC /end GROUP
/begin GROUP S649_Determine_CellVoltage_OverUnderFaults "VBU0428Test/VBUSystem/BMS/CVT/CVT/Subsystem/Determine_CellVoltage_OverUnderFaults"
 /begin REF_CHARACTERISTIC BMM_STATE_INITIALIZATION BMM_STATE_ONBOARD_CHARGE CVT_CELL_OVER_VOLTAGE_FAULT CVT_CELL_UNDER_VOLTAGE_FAULT MILISECONDS_PER_SECOND /end REF_CHARACTERISTIC
/end GROUP
/begin GROUP S709_Determine_CSC_Inhibit "VBU0428Test/VBUSystem/BMS/DSM/Subsystem10/Subsystem/Determine_CSC_Inhibit" /begin REF_CHARACTERISTIC BMM_STATE_AFTER_RUN /end REF_CHARACTERISTIC /end GROUP
/begin GROUP S709_Determine_Drive_Cycle "VBU0428Test/VBUSystem/BMS/DSM/Subsystem10/Subsystem/Determine_Drive_Cycle"
 /begin REF_CHARACTERISTIC BMM_STATE_FAST_CHARGE BMM_STATE_ONBOARD_CHARGE SAMPLE_TIME_TASK_A /end REF_CHARACTERISTIC
/end GROUP
/begin GROUP S709_Determine_No_Restart "VBU0428Test/VBUSystem/BMS/DSM/Subsystem10/Subsystem/Determine_No_Restart" /begin REF_CHARACTERISTIC BMM_STATE_AFTER_RUN /end REF_CHARACTERISTIC /end GROUP
/begin GROUP S741_Fastcharge_State_Management "VBU0428Test/VBUSystem/BMS/FCC /FCC/Subsystem/Fastcharge_State_Management" /begin REF_CHARACTERISTIC BMM_STATE_FAST_CHARGE /end REF_CHARACTERISTIC /end GROUP
/begin GROUP S741_Fastcharge_Violation_Diagnostic "VBU0428Test/VBUSystem/BMS/FCC /FCC/Subsystem/Fastcharge_Violation_Diagnostic" /begin REF_CHARACTERISTIC BMM_STATE_FAST_CHARGE FCC_CHARGE_CURRENT_OVER_FAULT /end REF_CHARACTERISTIC /end GROUP
/begin GROUP S741_MapingSOC "VBU0428Test/VBUSystem/BMS/FCC /FCC/Subsystem/MapingSOC" /begin REF_CHARACTERISTIC ONE_HUNDRED_PERCENT /end REF_CHARACTERISTIC /end GROUP
/begin GROUP S871_Determine_IsolationLevel "VBU0428Test/VBUSystem/BMS/ISO/Determine_FaultDetection_Check/Status_Process/Determine_IsolationLevel" /begin REF_CHARACTERISTIC SAMPLE_TIME_TASK_B /end REF_CHARACTERISTIC /end GROUP
/begin GROUP S904_Check_NVM_Read "VBU0428Test/VBUSystem/BMS/NVM /Subsystem3/Read_NVM_Data/Check_NVM_Read" /begin REF_CHARACTERISTIC NVM_READ_CRC_FAIL NVM_READ_HARDWARE_FAIL /end REF_CHARACTERISTIC /end GROUP
/begin GROUP S959_Determine_Battery_SOC "VBU0428Test/VBUSystem/BMS/SOC/Subsystem5/Subsystem/Determine_Battery_SOC" /begin REF_CHARACTERISTIC ONE_HUNDRED_PERCENT /end REF_CHARACTERISTIC /end GROUP
/begin GROUP S959_Determine_Display_SOC "VBU0428Test/VBUSystem/BMS/SOC/Subsystem5/Subsystem/Determine_Display_SOC" /begin REF_CHARACTERISTIC ONE_HUNDRED_PERCENT /end REF_CHARACTERISTIC /end GROUP
/begin GROUP S1118_Calculate_Pack_Remaining_Energy_SOC "VBU0428Test/VBUSystem/BMS/SOE/Subsystem2/Subsystem/Calculate_Pack_Remaining_Energy_SOC" /begin REF_CHARACTERISTIC CcSYS_NominalCellCapacity_Ah ONE_HUNDRED_PERCENT /end REF_CHARACTERISTIC /end GROUP
/begin GROUP S1118_Rate_Limit_and_Output "VBU0428Test/VBUSystem/BMS/SOE/Subsystem2/Subsystem/Rate_Limit_and_Output" /begin REF_CHARACTERISTIC MILISECONDS_PER_SECOND /end REF_CHARACTERISTIC /end GROUP
/begin GROUP S1118_Rate_Limit_and_Output_SOC "VBU0428Test/VBUSystem/BMS/SOE/Subsystem2/Subsystem/Rate_Limit_and_Output_SOC" /begin REF_CHARACTERISTIC MILISECONDS_PER_SECOND /end REF_CHARACTERISTIC /end GROUP
/begin GROUP S1170_Count_LowTempOverCurrent "VBU0428Test/VBUSystem/BMS/SOF/Subsystem6/Subsystem/Count_LowTempOverCurrent" /begin REF_CHARACTERISTIC MILISECONDS_PER_SECOND /end REF_CHARACTERISTIC /end GROUP
/begin GROUP S1170_Rate_CurrentLimit "VBU0428Test/VBUSystem/BMS/SOF/Subsystem6/Subsystem/Rate_CurrentLimit" /begin REF_CHARACTERISTIC MILISECONDS_PER_SECOND /end REF_CHARACTERISTIC /end GROUP
/begin GROUP S1170_Rate_PowerLimit "VBU0428Test/VBUSystem/BMS/SOF/Subsystem6/Subsystem/Rate_PowerLimit" /begin REF_CHARACTERISTIC MILISECONDS_PER_SECOND /end REF_CHARACTERISTIC /end GROUP
/begin GROUP S1170_SOF_Diagnostic "VBU0428Test/VBUSystem/BMS/SOF/Subsystem6/Subsystem/SOF_Diagnostic" /begin REF_CHARACTERISTIC MILISECONDS_PER_SECOND SOF_CHARGE_OVER_POWER_FAULT /end REF_CHARACTERISTIC /end GROUP
/begin GROUP S1528_Charge_Mode_Temp_Request "VBU0428Test/VBUSystem/BMS/THM/Subsystem/Subsystem/Charge_Mode_Temp_Request" /begin REF_CHARACTERISTIC BMM_STATE_FAST_CHARGE BMM_STATE_ONBOARD_CHARGE /end REF_CHARACTERISTIC /end GROUP
/begin GROUP S1528_Cooling_Request_Respond_Check "VBU0428Test/VBUSystem/BMS/THM/Subsystem/Subsystem/Cooling_Request_Respond_Check" /begin REF_CHARACTERISTIC MILISECONDS_PER_SECOND /end REF_CHARACTERISTIC /end GROUP
/begin GROUP S1528_Thermal_System_Damage_Judgement "VBU0428Test/VBUSystem/BMS/THM/Subsystem/Subsystem/Thermal_System_Damage_Judgement" /begin REF_CHARACTERISTIC MILISECONDS_PER_SECOND /end REF_CHARACTERISTIC /end GROUP
/begin GROUP S1528_Valid_Condition_Determination "VBU0428Test/VBUSystem/BMS/THM/Subsystem/Subsystem/Valid_Condition_Determination" /begin REF_CHARACTERISTIC BMM_STATE_FAST_CHARGE BMM_STATE_ONBOARD_CHARGE /end REF_CHARACTERISTIC /end GROUP
/begin GROUP S1602_Determine_BMS_VCU_272 "VBU0428Test/VBUSystem/BMS/VCT/Subsystem/Subsystem/Determine_BMS_VCU_272" /begin REF_CHARACTERISTIC SAMPLE_TIME_TASK_B /end REF_CHARACTERISTIC /end GROUP
/begin GROUP S3606_LvWakeUp_Mode_Calc "VBU0428Test/VBUSystem/VCU /PMM/PMM_Ctrl/LvWakeUp_Ctrl/LvWakeUp_Mode_Calc" /begin REF_CHARACTERISTIC PMM_stDCChMode_SY /end REF_CHARACTERISTIC /end GROUP
/begin GROUP S36_Correct_BatteryCurrent "VBU0428Test/VBUSystem/BMS/BCV/BCV/Subsystem/Calculate_BatteryCurrent/Correct_BatteryCurrent" /begin REF_CHARACTERISTIC SAMPLE_TIME_TASK_B /end REF_CHARACTERISTIC /end GROUP
/begin GROUP S37_Check_BatteryVoltage_Valid "VBU0428Test/VBUSystem/BMS/BCV/BCV/Subsystem/Calculate_BatteryVoltage/Check_BatteryVoltage_Valid" /begin REF_CHARACTERISTIC SAMPLE_TIME_TASK_B /end REF_CHARACTERISTIC /end GROUP
/begin GROUP S37_Check_BusNegativeVoltage_Valid "VBU0428Test/VBUSystem/BMS/BCV/BCV/Subsystem/Calculate_BatteryVoltage/Check_BusNegativeVoltage_Valid" /begin REF_CHARACTERISTIC SAMPLE_TIME_TASK_B /end REF_CHARACTERISTIC /end GROUP
/begin GROUP S37_Check_BusVoltage_Valid "VBU0428Test/VBUSystem/BMS/BCV/BCV/Subsystem/Calculate_BatteryVoltage/Check_BusVoltage_Valid" /begin REF_CHARACTERISTIC SAMPLE_TIME_TASK_B /end REF_CHARACTERISTIC /end GROUP
/begin GROUP S37_Check_FuseVoltage_Valid "VBU0428Test/VBUSystem/BMS/BCV/BCV/Subsystem/Calculate_BatteryVoltage/Check_FuseVoltage_Valid" /begin REF_CHARACTERISTIC SAMPLE_TIME_TASK_B /end REF_CHARACTERISTIC /end GROUP
/begin GROUP S37_Check_PrechargeVoltage_Valid "VBU0428Test/VBUSystem/BMS/BCV/BCV/Subsystem/Calculate_BatteryVoltage/Check_PrechargeVoltage_Valid" /begin REF_CHARACTERISTIC SAMPLE_TIME_TASK_B /end REF_CHARACTERISTIC /end GROUP
/begin GROUP S37_Check_Vx1Voltage_Valid "VBU0428Test/VBUSystem/BMS/BCV/BCV/Subsystem/Calculate_BatteryVoltage/Check_Vx1Voltage_Valid" /begin REF_CHARACTERISTIC SAMPLE_TIME_TASK_B /end REF_CHARACTERISTIC /end GROUP
/begin GROUP S37_Check_Vx2Voltage_Valid "VBU0428Test/VBUSystem/BMS/BCV/BCV/Subsystem/Calculate_BatteryVoltage/Check_Vx2Voltage_Valid" /begin REF_CHARACTERISTIC SAMPLE_TIME_TASK_B /end REF_CHARACTERISTIC /end GROUP
/begin GROUP S38_Calculate_FuseProtect_Counter "VBU0428Test/VBUSystem/BMS/BCV/BCV/Subsystem/Calculate_Lifetime_Data/Calculate_FuseProtect_Counter" /begin REF_CHARACTERISTIC SAMPLE_TIME_TASK_B /end REF_CHARACTERISTIC /end GROUP
/begin GROUP S38_Calculate_LifeTimeCoulomb "VBU0428Test/VBUSystem/BMS/BCV/BCV/Subsystem/Calculate_Lifetime_Data/Calculate_LifeTimeCoulomb" /begin REF_CHARACTERISTIC MILISECONDS_PER_SECOND SAMPLE_TIME_TASK_B /end REF_CHARACTERISTIC /end GROUP
/begin GROUP S40_Diagnose_VoltageCurrent_Fault "VBU0428Test/VBUSystem/BMS/BCV/BCV/Subsystem/Diagnose_BCV_Data_Fault/Diagnose_VoltageCurrent_Fault"
 /begin REF_CHARACTERISTIC BCV_BATTERY_OVER_CURRENT_FAULT BCV_BATTERY_OVER_VOLTAGE_FAULT BCV_BATTERY_OVER_VOLTAGE_WARNING_FAULT SAMPLE_TIME_TASK_B /end REF_CHARACTERISTIC
/end GROUP
/begin GROUP S51_Diagnose_BDM_FastChargeContactorOverCurrentAlarm "VBU0428Test/VBUSystem/BMS/BCV/BCV/Subsystem/Monitor_BCV_Performance/Diagnose_BDM_FastChargeContactorOverCurrentAlarm" /begin REF_CHARACTERISTIC SAMPLE_TIME_TASK_B /end REF_CHARACTERISTIC /end GROUP
/begin GROUP S288_DetermineSOCBalance_EnableCondition "VBU0428Test/VBUSystem/BMS/CBL/Subsystem8/Subsystem/Balance_EnableCondition/DetermineSOCBalance_EnableCondition" /begin REF_CHARACTERISTIC MILISECONDS_PER_SECOND /end REF_CHARACTERISTIC /end GROUP
/begin GROUP S288_DetermineVoltaageBalance_EnableCondition "VBU0428Test/VBUSystem/BMS/CBL/Subsystem8/Subsystem/Balance_EnableCondition/DetermineVoltaageBalance_EnableCondition" /begin REF_CHARACTERISTIC MILISECONDS_PER_SECOND /end REF_CHARACTERISTIC /end GROUP
/begin GROUP S375_DetermineRatioPEUtoBat "VBU0428Test/VBUSystem/BMS/CTD/Subsystem/Subsystem4/DiagnoseRelayWeld/DetermineRatioPEUtoBat" /begin REF_CHARACTERISTIC ONE_HUNDRED_PERCENT SAMPLE_TIME_TASK_B /end REF_CHARACTERISTIC /end GROUP
/begin GROUP S375_MNC_Weld_Check "VBU0428Test/VBUSystem/BMS/CTD/Subsystem/Subsystem4/DiagnoseRelayWeld/MNC_Weld_Check" /begin REF_CHARACTERISTIC CTD_MAIN_NEGATIVE_CONTACTOR_WELD_FAULT ONE_HUNDRED_PERCENT /end REF_CHARACTERISTIC /end GROUP
/begin GROUP S375_MPC_Weld_Check "VBU0428Test/VBUSystem/BMS/CTD/Subsystem/Subsystem4/DiagnoseRelayWeld/MPC_Weld_Check" /begin REF_CHARACTERISTIC CTD_MAIN_POSITIVE_CONTACTOR_WELD_FAULT /end REF_CHARACTERISTIC /end GROUP
/begin GROUP S379_CONTACTOR_STATUS_CLOSED1 "VBU0428Test/VBUSystem/BMS/CTD/Subsystem/Subsystem4/Precharge_Resistance_Diagnostic/CONTACTOR_STATUS_CLOSED1" /begin REF_CHARACTERISTIC CTD_MAIN_CONTACTOR_STATUS_CLOSED /end REF_CHARACTERISTIC /end GROUP
/begin GROUP S379_CONTACTOR_STATUS_OPENED1 "VBU0428Test/VBUSystem/BMS/CTD/Subsystem/Subsystem4/Precharge_Resistance_Diagnostic/CONTACTOR_STATUS_OPENED1" /begin REF_CHARACTERISTIC CTD_MAIN_CONTACTOR_STATUS_OPENED /end REF_CHARACTERISTIC /end GROUP
/begin GROUP S380_Determine_Precharge_Timer "VBU0428Test/VBUSystem/BMS/CTD/Subsystem/Subsystem4/PrechrgProcessMonitoring/Determine_Precharge_Timer" /begin REF_CHARACTERISTIC SAMPLE_TIME_TASK_B /end REF_CHARACTERISTIC /end GROUP
/begin GROUP S380_Determine_Ratio_BusVBatV "VBU0428Test/VBUSystem/BMS/CTD/Subsystem/Subsystem4/PrechrgProcessMonitoring/Determine_Ratio_BusVBatV" /begin REF_CHARACTERISTIC ONE_HUNDRED_PERCENT /end REF_CHARACTERISTIC /end GROUP
/begin GROUP S380_Precharge_Timeout_Diagnostic "VBU0428Test/VBUSystem/BMS/CTD/Subsystem/Subsystem4/PrechrgProcessMonitoring/Precharge_Timeout_Diagnostic" /begin REF_CHARACTERISTIC CTD_PRECHARG_TIMEOUT_FAULT /end REF_CHARACTERISTIC /end GROUP
/begin GROUP S381_MPR_Stuck_Open "VBU0428Test/VBUSystem/BMS/CTD/Subsystem/Subsystem4/Stuck_Open_Diagnostic/MPR_Stuck_Open" /begin REF_CHARACTERISTIC CTD_PRECHARGE_RELAY_STUCK_OPEN_FAULT /end REF_CHARACTERISTIC /end GROUP
/begin GROUP S381_StuckOpenAssistantConditons "VBU0428Test/VBUSystem/BMS/CTD/Subsystem/Subsystem4/Stuck_Open_Diagnostic/StuckOpenAssistantConditons" /begin REF_CHARACTERISTIC SAMPLE_TIME_TASK_B /end REF_CHARACTERISTIC /end GROUP
/begin GROUP S621_Energy_Protection_Check "VBU0428Test/VBUSystem/BMS/CTS/CTS/Subsystem/DeterminePrechargeConditions/Energy_Protection_Check" /begin REF_CHARACTERISTIC BMM_STATE_DRIVE_MODE /end REF_CHARACTERISTIC /end GROUP
/begin GROUP S621_SoC_Initialization_Check "VBU0428Test/VBUSystem/BMS/CTS/CTS/Subsystem/DeterminePrechargeConditions/SoC_Initialization_Check" /begin REF_CHARACTERISTIC MILISECONDS_PER_SECOND SAMPLE_TIME_TASK_B /end REF_CHARACTERISTIC /end GROUP
/begin GROUP S622_Close_Comamnd "VBU0428Test/VBUSystem/BMS/CTS/CTS/Subsystem/Determine_Contactor_Request/Close_Comamnd"
 /begin REF_CHARACTERISTIC BMM_STATE_DRIVE_MODE BMM_STATE_FAST_CHARGE BMM_STATE_ONBOARD_CHARGE SAMPLE_TIME_TASK_B /end REF_CHARACTERISTIC
/end GROUP
/begin GROUP S622_Open_Comamnd "VBU0428Test/VBUSystem/BMS/CTS/CTS/Subsystem/Determine_Contactor_Request/Open_Comamnd" /begin REF_CHARACTERISTIC BMM_STATE_FAST_CHARGE /end REF_CHARACTERISTIC /end GROUP
/begin GROUP S655_Determine_CellVoltage_OverUnderBDM "VBU0428Test/VBUSystem/BMS/CVT/CVT/Subsystem/Monitor_CVT_Performance/Determine_CellVoltage_OverUnderBDM" /begin REF_CHARACTERISTIC BMM_STATE_INITIALIZATION /end REF_CHARACTERISTIC /end GROUP
/begin GROUP S742_Calculate_FastChargeBaseRemainTime "VBU0428Test/VBUSystem/BMS/FCC /FCC/Subsystem/Calculate_Fastcharge_Time/Calculate_FastChargeBaseRemainTime" /begin REF_CHARACTERISTIC ONE_HUNDRED_PERCENT /end REF_CHARACTERISTIC /end GROUP
/begin GROUP S742_EightyPercentCustomSOC_CaculateChargeTime "VBU0428Test/VBUSystem/BMS/FCC /FCC/Subsystem/Calculate_Fastcharge_Time/EightyPercentCustomSOC_CaculateChargeTime" /begin REF_CHARACTERISTIC ONE_HUNDRED_PERCENT /end REF_CHARACTERISTIC /end GROUP
/begin GROUP S742_EightyPercentCustomSOC_EnableInvalidChargeTimeFlag "VBU0428Test/VBUSystem/BMS/FCC /FCC/Subsystem/Calculate_Fastcharge_Time/EightyPercentCustomSOC_EnableInvalidChargeTimeFlag" /begin REF_CHARACTERISTIC BMM_STATE_FAST_CHARGE /end REF_CHARACTERISTIC /end GROUP
/begin GROUP S742_EightyPercentCustomSOC_UpdateChargeTimeFlag "VBU0428Test/VBUSystem/BMS/FCC /FCC/Subsystem/Calculate_Fastcharge_Time/EightyPercentCustomSOC_UpdateChargeTimeFlag" /begin REF_CHARACTERISTIC BMM_STATE_FAST_CHARGE MILISECONDS_PER_SECOND /end REF_CHARACTERISTIC /end GROUP
/begin GROUP S742_SendInvalidTime_flg "VBU0428Test/VBUSystem/BMS/FCC /FCC/Subsystem/Calculate_Fastcharge_Time/SendInvalidTime_flg" /begin REF_CHARACTERISTIC BMM_STATE_FAST_CHARGE /end REF_CHARACTERISTIC /end GROUP
/begin GROUP S742_UpdateTimeTrigger "VBU0428Test/VBUSystem/BMS/FCC /FCC/Subsystem/Calculate_Fastcharge_Time/UpdateTimeTrigger" /begin REF_CHARACTERISTIC BMM_STATE_FAST_CHARGE MILISECONDS_PER_SECOND /end REF_CHARACTERISTIC /end GROUP
/begin GROUP S743_Charge_Request_Protection "VBU0428Test/VBUSystem/BMS/FCC /FCC/Subsystem/Determine_Fastcharge_Request/Charge_Request_Protection" /begin REF_CHARACTERISTIC MILISECONDS_PER_SECOND /end REF_CHARACTERISTIC /end GROUP
/begin GROUP S924_Determine_OCV_Criteria "VBU0428Test/VBUSystem/BMS/OCV/OCV/Subsystem/Determine_Criteria/Determine_OCV_Criteria" /begin REF_CHARACTERISTIC CTD_MAIN_CONTACTOR_STATUS_OPENED /end REF_CHARACTERISTIC /end GROUP
/begin GROUP S924_Determine_QOCV_Criteria "VBU0428Test/VBUSystem/BMS/OCV/OCV/Subsystem/Determine_Criteria/Determine_QOCV_Criteria" /begin REF_CHARACTERISTIC CTD_MAIN_CONTACTOR_STATUS_CLOSED /end REF_CHARACTERISTIC /end GROUP
/begin GROUP S961_Determine_AhIntegral_Capacity "VBU0428Test/VBUSystem/BMS/SOC/Subsystem5/Subsystem/Determine_AhIntegral_SoC/Determine_AhIntegral_Capacity" /begin REF_CHARACTERISTIC MILISECONDS_PER_SECOND /end REF_CHARACTERISTIC /end GROUP
/begin GROUP S961_Determine_AhIntegral_SOC "VBU0428Test/VBUSystem/BMS/SOC/Subsystem5/Subsystem/Determine_AhIntegral_SoC/Determine_AhIntegral_SOC" /begin REF_CHARACTERISTIC ONE_HUNDRED_PERCENT /end REF_CHARACTERISTIC /end GROUP
/begin GROUP S966_Determine_BatterySOC_ChangeRate "VBU0428Test/VBUSystem/BMS/SOC/Subsystem5/Subsystem/Determine_Display_SOC/Determine_BatterySOC_ChangeRate" /begin REF_CHARACTERISTIC MILISECONDS_PER_SECOND ONE_HUNDRED_PERCENT /end REF_CHARACTERISTIC /end GROUP
/begin GROUP S966_DisplaySOC_Driving_Calculation "VBU0428Test/VBUSystem/BMS/SOC/Subsystem5/Subsystem/Determine_Display_SOC/DisplaySOC_Driving_Calculation" /begin REF_CHARACTERISTIC BMM_STATE_FAST_CHARGE /end REF_CHARACTERISTIC /end GROUP
/begin GROUP S967_Determine_InternalResistanceCausedDevCellVoltage "VBU0428Test/VBUSystem/BMS/SOC/Subsystem5/Subsystem/Determine_FastChargeCorrection_Soc/Determine_InternalResistanceCausedDevCellVoltage" /begin REF_CHARACTERISTIC BMM_STATE_FAST_CHARGE /end REF_CHARACTERISTIC /end GROUP
/begin GROUP S974_Data_Storage "VBU0428Test/VBUSystem/BMS/SOC/Subsystem5/Subsystem/Soc_Data_Storage/Data_Storage" /begin REF_CHARACTERISTIC NVM_EEPROM_CRC_CHECK_FAULT /end REF_CHARACTERISTIC /end GROUP
/begin GROUP S1119_Determine_History_Current_Data "VBU0428Test/VBUSystem/BMS/SOE/Subsystem2/Subsystem/Calculate_History_Average_Current/Determine_History_Current_Data" /begin REF_CHARACTERISTIC MILISECONDS_PER_SECOND /end REF_CHARACTERISTIC /end GROUP
/begin GROUP S1119_Time_Counter "VBU0428Test/VBUSystem/BMS/SOE/Subsystem2/Subsystem/Calculate_History_Average_Current/Time_Counter" /begin REF_CHARACTERISTIC MILISECONDS_PER_SECOND /end REF_CHARACTERISTIC /end GROUP
/begin GROUP S1120_Charge_and_Idle_Mode "VBU0428Test/VBUSystem/BMS/SOE/Subsystem2/Subsystem/Calculate_Pack_Remaining_Energy/Charge_and_Idle_Mode" /begin REF_CHARACTERISTIC CcSYS_NominalCellCapacity_Ah ONE_HUNDRED_PERCENT /end REF_CHARACTERISTIC /end GROUP
/begin GROUP S1120_Discharge_Mode "VBU0428Test/VBUSystem/BMS/SOE/Subsystem2/Subsystem/Calculate_Pack_Remaining_Energy/Discharge_Mode" /begin REF_CHARACTERISTIC ONE_HUNDRED_PERCENT /end REF_CHARACTERISTIC /end GROUP
/begin GROUP S1175_FCC_CHARGE_MODE1 "VBU0428Test/VBUSystem/BMS/SOF/Subsystem6/Subsystem/Rate_CurrentLimit/FCC_CHARGE_MODE1" /begin REF_CHARACTERISTIC BMM_STATE_FAST_CHARGE /end REF_CHARACTERISTIC /end GROUP
/begin GROUP S1398_Calculate_MinCellCapacity274_SlowCharge "VBU0428Test/VBUSystem/BMS/SOH/Subsystem4/Subsystem1/Calculate_Capacity/Calculate_MinCellCapacity274_SlowCharge" /begin REF_CHARACTERISTIC CcSYS_NominalCellCapacity_Ah ONE_HUNDRED_PERCENT /end REF_CHARACTERISTIC /end GROUP
/begin GROUP S1399_Compute_Resistance_Request "VBU0428Test/VBUSystem/BMS/SOH/Subsystem4/Subsystem1/Calculate_Resistance/Compute_Resistance_Request" /begin REF_CHARACTERISTIC CcSYS_NominalCellCapacity_Ah /end REF_CHARACTERISTIC /end GROUP
/begin GROUP S1603_FCC_CHARGE_MODE1 "VBU0428Test/VBUSystem/BMS/VCT/Subsystem/Subsystem/Determine_BMS_VCU_267/FCC_CHARGE_MODE1" /begin REF_CHARACTERISTIC BMM_STATE_FAST_CHARGE /end REF_CHARACTERISTIC /end GROUP
/begin GROUP S1612_CONTACTOR_STATUS_CLOSED1 "VBU0428Test/VBUSystem/BMS/VCT/Subsystem/Subsystem/Determine_BMS_VCU_34/CONTACTOR_STATUS_CLOSED1" /begin REF_CHARACTERISTIC CTD_MAIN_CONTACTOR_STATUS_CLOSED /end REF_CHARACTERISTIC /end GROUP
/begin GROUP S1612_CONTACTOR_STATUS_CLOSED2 "VBU0428Test/VBUSystem/BMS/VCT/Subsystem/Subsystem/Determine_BMS_VCU_34/CONTACTOR_STATUS_CLOSED2" /begin REF_CHARACTERISTIC CTD_MAIN_CONTACTOR_STATUS_CLOSED /end REF_CHARACTERISTIC /end GROUP
/begin GROUP S1612_CONTACTOR_STATUS_CLOSED3 "VBU0428Test/VBUSystem/BMS/VCT/Subsystem/Subsystem/Determine_BMS_VCU_34/CONTACTOR_STATUS_CLOSED3" /begin REF_CHARACTERISTIC CTD_MAIN_CONTACTOR_STATUS_CLOSED /end REF_CHARACTERISTIC /end GROUP
/begin GROUP S1612_CONTACTOR_STATUS_CLOSED4 "VBU0428Test/VBUSystem/BMS/VCT/Subsystem/Subsystem/Determine_BMS_VCU_34/CONTACTOR_STATUS_CLOSED4" /begin REF_CHARACTERISTIC CTD_MAIN_CONTACTOR_STATUS_CLOSED /end REF_CHARACTERISTIC /end GROUP
/begin GROUP S1612_CONTACTOR_STATUS_OPENED2 "VBU0428Test/VBUSystem/BMS/VCT/Subsystem/Subsystem/Determine_BMS_VCU_34/CONTACTOR_STATUS_OPENED2" /begin REF_CHARACTERISTIC CTD_MAIN_CONTACTOR_STATUS_OPENED /end REF_CHARACTERISTIC /end GROUP
/begin GROUP S1615_FCC_CHARGE_MODE1 "VBU0428Test/VBUSystem/BMS/VCT/Subsystem/Subsystem/Determine_BMS_VCU_AC/FCC_CHARGE_MODE1" /begin REF_CHARACTERISTIC BMM_STATE_FAST_CHARGE /end REF_CHARACTERISTIC /end GROUP
/begin GROUP S3338_ChargeConditon "VBU0428Test/VBUSystem/VCU /DSPL /DSPL/DriveRange/RemainingRange/ChargeConditon" /begin REF_CHARACTERISTIC PMM_stDCChMode_SY /end REF_CHARACTERISTIC /end GROUP
/begin GROUP S187_Diagnose_BdmVoltageCurrent_Fault "VBU0428Test/VBUSystem/BMS/BCV/BCV/Subsystem/Monitor_BCV_Performance/Diagnose_BDM_BCV_Data_Fault/Diagnose_BdmVoltageCurrent_Fault"
 /begin REF_CHARACTERISTIC BCV_BATTERY_OVER_CURRENT_FAULT BCV_BATTERY_OVER_VOLTAGE_FAULT /end REF_CHARACTERISTIC
/end GROUP
/begin GROUP S387_CONTACTOR_STATUS_OPENED1 "VBU0428Test/VBUSystem/BMS/CTD/Subsystem/Subsystem4/DiagnoseRelayWeld/MNC_Weld_Check/CONTACTOR_STATUS_OPENED1" /begin REF_CHARACTERISTIC CTD_MAIN_CONTACTOR_STATUS_OPENED /end REF_CHARACTERISTIC /end GROUP
/begin GROUP S388_CONTACTOR_STATUS_OPENED "VBU0428Test/VBUSystem/BMS/CTD/Subsystem/Subsystem4/DiagnoseRelayWeld/MPC_Weld_Check/CONTACTOR_STATUS_OPENED" /begin REF_CHARACTERISTIC CTD_MAIN_CONTACTOR_STATUS_OPENED /end REF_CHARACTERISTIC /end GROUP
/begin GROUP S388_CONTACTOR_STATUS_OPENED1 "VBU0428Test/VBUSystem/BMS/CTD/Subsystem/Subsystem4/DiagnoseRelayWeld/MPC_Weld_Check/CONTACTOR_STATUS_OPENED1" /begin REF_CHARACTERISTIC CTD_MAIN_CONTACTOR_STATUS_OPENED /end REF_CHARACTERISTIC /end GROUP
/begin GROUP S454_Determine_Precharge_JouleHeat "VBU0428Test/VBUSystem/BMS/CTD/Subsystem/Subsystem4/PrechrgProcessMonitoring/Precharge_Thermal_Management/Determine_Precharge_JouleHeat" /begin REF_CHARACTERISTIC MILISECONDS_PER_SECOND SAMPLE_TIME_TASK_B /end REF_CHARACTERISTIC /end GROUP
/begin GROUP S454_Perform_OverEnergy_Diagnostic "VBU0428Test/VBUSystem/BMS/CTD/Subsystem/Subsystem4/PrechrgProcessMonitoring/Precharge_Thermal_Management/Perform_OverEnergy_Diagnostic" /begin REF_CHARACTERISTIC CTD_PRECHARGE_ENERGY_HIGH_FAULT /end REF_CHARACTERISTIC /end GROUP
/begin GROUP S476_MNC_Stuck_Open_Without_VehicleSpeed "VBU0428Test/VBUSystem/BMS/CTD/Subsystem/Subsystem4/Stuck_Open_Diagnostic/MNC_Stuck_Open/MNC_Stuck_Open_Without_VehicleSpeed" /begin REF_CHARACTERISTIC CTD_PARKING_MAIN_NEGATIVE_CONTACTOR_STUCK_OPEN_FAULT /end REF_CHARACTERISTIC /end GROUP
/begin GROUP S477_MPC_Stuck_Open_Within_VehicleSpeed "VBU0428Test/VBUSystem/BMS/CTD/Subsystem/Subsystem4/Stuck_Open_Diagnostic/MPC_Stuck_Open/MPC_Stuck_Open_Within_VehicleSpeed" /begin REF_CHARACTERISTIC CTD_PARKING_MAIN_POSITIVE_CONTACTOR_STUCK_OPEN_FAULT /end REF_CHARACTERISTIC /end GROUP
/begin GROUP S478_CONTACTOR_STATUS_CLOSED1 "VBU0428Test/VBUSystem/BMS/CTD/Subsystem/Subsystem4/Stuck_Open_Diagnostic/MPR_Stuck_Open/CONTACTOR_STATUS_CLOSED1" /begin REF_CHARACTERISTIC CTD_MAIN_CONTACTOR_STATUS_CLOSED /end REF_CHARACTERISTIC /end GROUP
/begin GROUP S593_CellTemp_ChangeRate_Calculate "VBU0428Test/VBUSystem/BMS/CTM/CTM/Subsystem/Determine_Thermal_Runaway/DetermineTempRiseRate/CellTemp_ChangeRate_Calculate" /begin REF_CHARACTERISTIC MILISECONDS_PER_SECOND /end REF_CHARACTERISTIC /end GROUP
/begin GROUP S798_Decrease_ChargeCurrentRequest "VBU0428Test/VBUSystem/BMS/FCC /FCC/Subsystem/Determine_Fastcharge_Request/Charge_Request_Protection/Decrease_ChargeCurrentRequest" /begin REF_CHARACTERISTIC MILISECONDS_PER_SECOND /end REF_CHARACTERISTIC /end GROUP
/begin GROUP S832_Cell_Temp_Protection "VBU0428Test/VBUSystem/BMS/FCC /FCC/Subsystem/Fastcharge_Conditions_Check/Condition_Categorize/Cell_Temp_Protection" /begin REF_CHARACTERISTIC MILISECONDS_PER_SECOND /end REF_CHARACTERISTIC /end GROUP
/begin GROUP S832_Voltage_Protection "VBU0428Test/VBUSystem/BMS/FCC /FCC/Subsystem/Fastcharge_Conditions_Check/Condition_Categorize/Voltage_Protection" /begin REF_CHARACTERISTIC MILISECONDS_PER_SECOND /end REF_CHARACTERISTIC /end GROUP
/begin GROUP S986_Determine_Cell_Balanced_Capacity "VBU0428Test/VBUSystem/BMS/SOC/Subsystem5/Subsystem/Determine_AhIntegral_SoC/Determine_AhIntegral_Capacity/Determine_Cell_Balanced_Capacity" /begin REF_CHARACTERISTIC MILISECONDS_PER_SECOND ONE_HUNDRED_PERCENT /end REF_CHARACTERISTIC /end GROUP
/begin GROUP S988_CONTACTOR_STATUS_OPENED1 "VBU0428Test/VBUSystem/BMS/SOC/Subsystem5/Subsystem/Determine_AhIntegral_SoC/Determine_Module_Current/CONTACTOR_STATUS_OPENED1" /begin REF_CHARACTERISTIC CTD_MAIN_CONTACTOR_STATUS_OPENED /end REF_CHARACTERISTIC /end GROUP
/begin GROUP S1021_Determine_SOC_RateLimit "VBU0428Test/VBUSystem/BMS/SOC/Subsystem5/Subsystem/Determine_Display_SOC/DisplaySOC_Driving_Calculation/Determine_SOC_RateLimit" /begin REF_CHARACTERISTIC BMM_STATE_DRIVE_MODE /end REF_CHARACTERISTIC /end GROUP
/begin GROUP S1045_FastCharge_DynamicCorrection_Enable "VBU0428Test/VBUSystem/BMS/SOC/Subsystem5/Subsystem/Determine_FastChargeCorrection_Soc/FastCharge_DynamicCorrection/FastCharge_DynamicCorrection_Enable" /begin REF_CHARACTERISTIC CcSYS_NominalCellCapacity_Ah /end REF_CHARACTERISTIC /end GROUP
/begin GROUP S1065_Battery_SOC_Calculation "VBU0428Test/VBUSystem/BMS/SOC/Subsystem5/Subsystem/Determine_Initial_SoC/CellSOC_Startup_AbnormalReset/Battery_SOC_Calculation" /begin REF_CHARACTERISTIC ONE_HUNDRED_PERCENT /end REF_CHARACTERISTIC /end GROUP
/begin GROUP S1067_Battery_SOC_Calculation "VBU0428Test/VBUSystem/BMS/SOC/Subsystem5/Subsystem/Determine_Initial_SoC/CellSOC_Startup_Normal/Battery SOC Calculation" /begin REF_CHARACTERISTIC ONE_HUNDRED_PERCENT /end REF_CHARACTERISTIC /end GROUP
/begin GROUP S1131_Calculate_Energy_Retention_Factor "VBU0428Test/VBUSystem/BMS/SOE/Subsystem2/Subsystem/Calculate_Pack_Remaining_Energy/Discharge_Mode/Calculate_Energy_Retention_Factor" /begin REF_CHARACTERISTIC ONE_HUNDRED_PERCENT /end REF_CHARACTERISTIC /end GROUP
/begin GROUP S1131_Calculate_Remaining_Energy "VBU0428Test/VBUSystem/BMS/SOE/Subsystem2/Subsystem/Calculate_Pack_Remaining_Energy/Discharge_Mode/Calculate_Remaining_Energy" /begin REF_CHARACTERISTIC CcSYS_NominalCellCapacity_Ah ONE_HUNDRED_PERCENT /end REF_CHARACTERISTIC /end GROUP
/begin GROUP S1131_Predict_SOC_End "VBU0428Test/VBUSystem/BMS/SOE/Subsystem2/Subsystem/Calculate_Pack_Remaining_Energy/Discharge_Mode/Predict_SOC_End" /begin REF_CHARACTERISTIC ONE_HUNDRED_PERCENT /end REF_CHARACTERISTIC /end GROUP
/begin GROUP S1178_Calculate_Locked_SOC "VBU0428Test/VBUSystem/BMS/SOF/Subsystem6/Subsystem/Calculate_PowerLimit/Calculate_Pack_OCV/Calculate_Locked_SOC" /begin REF_CHARACTERISTIC ONE_HUNDRED_PERCENT /end REF_CHARACTERISTIC /end GROUP
/begin GROUP S1178_Rate_Limiter "VBU0428Test/VBUSystem/BMS/SOF/Subsystem6/Subsystem/Calculate_PowerLimit/Calculate_Pack_OCV/Rate_Limiter" /begin REF_CHARACTERISTIC MILISECONDS_PER_SECOND /end REF_CHARACTERISTIC /end GROUP
/begin GROUP S1180_Calculate_Locked_SOC "VBU0428Test/VBUSystem/BMS/SOF/Subsystem6/Subsystem/Calculate_PowerLimit/Determine_SOCP_PowerLimit/Calculate_Locked_SOC" /begin REF_CHARACTERISTIC ONE_HUNDRED_PERCENT /end REF_CHARACTERISTIC /end GROUP
/begin GROUP S1210_Calculate_CurrentLimit_Base "VBU0428Test/VBUSystem/BMS/SOF/Subsystem6/Subsystem/Determine_Currentlimit_Target/Calculate_CurrentLimit_Target/Calculate_CurrentLimit_Base" /begin REF_CHARACTERISTIC MILISECONDS_PER_SECOND /end REF_CHARACTERISTIC /end GROUP
/begin GROUP S1404_CellCapacity_Limit "VBU0428Test/VBUSystem/BMS/SOH/Subsystem4/Subsystem1/Calculate_Capacity/Calculate_CellCapacity/CellCapacity_Limit" /begin REF_CHARACTERISTIC CcSYS_NominalCellCapacity_Ah /end REF_CHARACTERISTIC /end GROUP
/begin GROUP S1404_Determine_PackSoh "VBU0428Test/VBUSystem/BMS/SOH/Subsystem4/Subsystem1/Calculate_Capacity/Calculate_CellCapacity/Determine_PackSoh" /begin REF_CHARACTERISTIC CcSYS_NominalCellCapacity_Ah ONE_HUNDRED_PERCENT /end REF_CHARACTERISTIC /end GROUP
/begin GROUP S1405_Caculate_CellCapacity "VBU0428Test/VBUSystem/BMS/SOH/Subsystem4/Subsystem1/Calculate_Capacity/Calculate_CellCapacity_SlowCharge/Caculate_CellCapacity" /begin REF_CHARACTERISTIC ONE_HUNDRED_PERCENT /end REF_CHARACTERISTIC /end GROUP
/begin GROUP S1475_CONTACTOR_STATUS_CLOSED "VBU0428Test/VBUSystem/BMS/SOH/Subsystem4/Subsystem1/Calculate_Resistance/Calculate_ModuleCurrent/CONTACTOR_STATUS_CLOSED" /begin REF_CHARACTERISTIC CTD_MAIN_CONTACTOR_STATUS_CLOSED /end REF_CHARACTERISTIC /end GROUP
/begin GROUP S1539_Determine_InletTemp_Validation "VBU0428Test/VBUSystem/BMS/THM/Subsystem/Subsystem/Calculate_PipeTemperature/Determine_CoolantSensorTemp_Validation/Determine_InletTemp_Validation" /begin REF_CHARACTERISTIC MILISECONDS_PER_SECOND /end REF_CHARACTERISTIC /end GROUP
/begin GROUP S1539_Determine_OutletTemp_Validation "VBU0428Test/VBUSystem/BMS/THM/Subsystem/Subsystem/Calculate_PipeTemperature/Determine_CoolantSensorTemp_Validation/Determine_OutletTemp_Validation" /begin REF_CHARACTERISTIC MILISECONDS_PER_SECOND /end REF_CHARACTERISTIC /end GROUP
/begin GROUP S56_Calculate_Current_ZeroDruft "VBU0428Test/VBUSystem/BMS/BCV/BCV/Subsystem/Calculate_BatteryCurrent/Correct_BatteryCurrent/Calculate_BatteryCurrent_ZeroDrift/Calculate_Current_ZeroDruft" /begin REF_CHARACTERISTIC SAMPLE_TIME_TASK_B /end REF_CHARACTERISTIC /end GROUP
/begin GROUP S324_Determine_CellBlanceTime "VBU0428Test/VBUSystem/BMS/CBL/Subsystem8/Subsystem/Determine_CSCCellBalanceRequest/Determine_CellBalanceRequest/Cell0/Determine_CellBlanceTime" /begin REF_CHARACTERISTIC ONE_HUNDRED_PERCENT /end REF_CHARACTERISTIC /end GROUP
/begin GROUP S480_CONTACTOR_STATUS_CLOSED1 "VBU0428Test/VBUSystem/BMS/CTD/Subsystem/Subsystem4/Stuck_Open_Diagnostic/MNC_Stuck_Open/MNC_Stuck_Open_With_VehicleSpeed/CONTACTOR_STATUS_CLOSED1" /begin REF_CHARACTERISTIC CTD_MAIN_CONTACTOR_STATUS_CLOSED /end REF_CHARACTERISTIC /end GROUP
/begin GROUP S481_CONTACTOR_STATUS_CLOSED1 "VBU0428Test/VBUSystem/BMS/CTD/Subsystem/Subsystem4/Stuck_Open_Diagnostic/MNC_Stuck_Open/MNC_Stuck_Open_Without_VehicleSpeed/CONTACTOR_STATUS_CLOSED1" /begin REF_CHARACTERISTIC CTD_MAIN_CONTACTOR_STATUS_CLOSED /end REF_CHARACTERISTIC /end GROUP
/begin GROUP S503_CONTACTOR_STATUS_CLOSED1 "VBU0428Test/VBUSystem/BMS/CTD/Subsystem/Subsystem4/Stuck_Open_Diagnostic/MPC_Stuck_Open/MPC_Stuck_Open_Within_VehicleSpeed/CONTACTOR_STATUS_CLOSED1" /begin REF_CHARACTERISTIC CTD_MAIN_CONTACTOR_STATUS_CLOSED /end REF_CHARACTERISTIC /end GROUP
/begin GROUP S504_CONTACTOR_STATUS_CLOSED1 "VBU0428Test/VBUSystem/BMS/CTD/Subsystem/Subsystem4/Stuck_Open_Diagnostic/MPC_Stuck_Open/MPC_Stuck_Open_Without_VehicleSpeed/CONTACTOR_STATUS_CLOSED1" /begin REF_CHARACTERISTIC CTD_MAIN_CONTACTOR_STATUS_CLOSED /end REF_CHARACTERISTIC /end GROUP
/begin GROUP S841_FullCharge_criteria1 "VBU0428Test/VBUSystem/BMS/FCC /FCC/Subsystem/Fastcharge_Conditions_Check/Condition_Categorize/Full_Charge_Determination/FullCharge_criteria1" /begin REF_CHARACTERISTIC MILISECONDS_PER_SECOND /end REF_CHARACTERISTIC /end GROUP
/begin GROUP S841_FullCharge_criteria2 "VBU0428Test/VBUSystem/BMS/FCC /FCC/Subsystem/Fastcharge_Conditions_Check/Condition_Categorize/Full_Charge_Determination/FullCharge_criteria2" /begin REF_CHARACTERISTIC MILISECONDS_PER_SECOND /end REF_CHARACTERISTIC /end GROUP
/begin GROUP S841_FullCharge_criteria4 "VBU0428Test/VBUSystem/BMS/FCC /FCC/Subsystem/Fastcharge_Conditions_Check/Condition_Categorize/Full_Charge_Determination/FullCharge_criteria4" /begin REF_CHARACTERISTIC MILISECONDS_PER_SECOND /end REF_CHARACTERISTIC /end GROUP
/begin GROUP S1053_Determine_CurrentStable_Condition "VBU0428Test/VBUSystem/BMS/SOC/Subsystem5/Subsystem/Determine_FastChargeCorrection_Soc/FastCharge_DynamicCorrection/FastCharge_DynamicCorrection_Enable/Determine_CurrentStable_Condition" /begin REF_CHARACTERISTIC ONE_HUNDRED_PERCENT /end REF_CHARACTERISTIC /end GROUP
/begin GROUP S1214_FastChrgOneThirdRateCurrentLimitCheck "VBU0428Test/VBUSystem/BMS/SOF/Subsystem6/Subsystem/Determine_Currentlimit_Target/Calculate_CurrentLimit_Target/CurrentLimit_FastCharge_Check/FastChrgOneThirdRateCurrentLimitCheck" /begin REF_CHARACTERISTIC MILISECONDS_PER_SECOND /end REF_CHARACTERISTIC /end GROUP
/begin GROUP S1215_Determine_StopCharge_Condition "VBU0428Test/VBUSystem/BMS/SOF/Subsystem6/Subsystem/Determine_Currentlimit_Target/Calculate_CurrentLimit_Target/CurrentLimit_Fault_Correct/Determine_StopCharge_Condition" /begin REF_CHARACTERISTIC MILISECONDS_PER_SECOND /end REF_CHARACTERISTIC /end GROUP
/begin GROUP S1409_Caculate_WeightingLifeTimeCharge "VBU0428Test/VBUSystem/BMS/SOH/Subsystem4/Subsystem1/Calculate_Capacity/Calculate_CellCapacity/Caculate_CellCapacity_LifeTimeQ/Caculate_WeightingLifeTimeCharge" /begin REF_CHARACTERISTIC ONE_HUNDRED_PERCENT /end REF_CHARACTERISTIC /end GROUP
/begin GROUP S1409_NVM_ReadWrite_Check "VBU0428Test/VBUSystem/BMS/SOH/Subsystem4/Subsystem1/Calculate_Capacity/Calculate_CellCapacity/Caculate_CellCapacity_LifeTimeQ/NVM_ReadWrite_Check" /begin REF_CHARACTERISTIC NVM_EEPROM_CRC_CHECK_FAULT /end REF_CHARACTERISTIC /end GROUP
/begin GROUP S1410_LimittedByNVMvalue "VBU0428Test/VBUSystem/BMS/SOH/Subsystem4/Subsystem1/Calculate_Capacity/Calculate_CellCapacity/CellCapacity_Limit/LimittedByNVMvalue" /begin REF_CHARACTERISTIC CcSYS_NominalCellCapacity_Ah ONE_HUNDRED_PERCENT /end REF_CHARACTERISTIC /end GROUP
/begin GROUP S1443_Determine_AhIntegral_Q "VBU0428Test/VBUSystem/BMS/SOH/Subsystem4/Subsystem1/Calculate_Capacity/Calculate_CellCapacity_SlowCharge/Determine_AhIntegral_DeltaQ/Determine_AhIntegral_Q" /begin REF_CHARACTERISTIC MILISECONDS_PER_SECOND /end REF_CHARACTERISTIC /end GROUP
/begin GROUP S1465_OBC_CHARGE_MODE1 "VBU0428Test/VBUSystem/BMS/SOH/Subsystem4/Subsystem1/Calculate_Capacity/Determine_CalculateCellCapacity_Condition/Determine_SlowCharge/OBC_CHARGE_MODE1" /begin REF_CHARACTERISTIC BMM_STATE_ONBOARD_CHARGE /end REF_CHARACTERISTIC /end GROUP
/begin GROUP S1483_NVM_ReadWrite_Check "VBU0428Test/VBUSystem/BMS/SOH/Subsystem4/Subsystem1/Calculate_Resistance/BasicCellResistance_Calculation_Check/ResistanceCalc_Check/NVM_ReadWrite_Check" /begin REF_CHARACTERISTIC NVM_EEPROM_CRC_CHECK_FAULT /end REF_CHARACTERISTIC /end GROUP
/begin GROUP S1498_Determine_FCCPulseCurrent_Condition "VBU0428Test/VBUSystem/BMS/SOH/Subsystem4/Subsystem1/Calculate_Resistance/Determine_Condition_Calculate_Pulse_Average_CurrentVoltage/Determine_Condition/Determine_FCCPulseCurrent_Condition" /begin REF_CHARACTERISTIC ONE_HUNDRED_PERCENT /end REF_CHARACTERISTIC /end GROUP
/begin GROUP S1498_Determine_OBCPulseCurrent_Condition "VBU0428Test/VBUSystem/BMS/SOH/Subsystem4/Subsystem1/Calculate_Resistance/Determine_Condition_Calculate_Pulse_Average_CurrentVoltage/Determine_Condition/Determine_OBCPulseCurrent_Condition" /begin REF_CHARACTERISTIC ONE_HUNDRED_PERCENT /end REF_CHARACTERISTIC /end GROUP
/begin GROUP S1540_Determinate_InletTempValidationDelay "VBU0428Test/VBUSystem/BMS/THM/Subsystem/Subsystem/Calculate_PipeTemperature/Determine_CoolantSensorTemp_Validation/Determine_InletTemp_Validation/Determinate_InletTempValidationDelay" /begin REF_CHARACTERISTIC MILISECONDS_PER_SECOND /end REF_CHARACTERISTIC /end GROUP
/begin GROUP S1541_Determinate_OutletTempValidationDelay "VBU0428Test/VBUSystem/BMS/THM/Subsystem/Subsystem/Calculate_PipeTemperature/Determine_CoolantSensorTemp_Validation/Determine_OutletTemp_Validation/Determinate_OutletTempValidationDelay" /begin REF_CHARACTERISTIC MILISECONDS_PER_SECOND /end REF_CHARACTERISTIC /end GROUP
/begin GROUP S58_Enabled_Subsystem "VBU0428Test/VBUSystem/BMS/BCV/BCV/Subsystem/Calculate_BatteryCurrent/Correct_BatteryCurrent/Calculate_BatteryCurrent_ZeroDrift/Calculate_Current_ZeroDruft/Enabled_Subsystem" /begin REF_CHARACTERISTIC SAMPLE_TIME_TASK_B /end REF_CHARACTERISTIC /end GROUP
/begin GROUP S460_Determine_Accumulated_Cooling "VBU0428Test/VBUSystem/BMS/CTD/Subsystem/Subsystem4/PrechrgProcessMonitoring/Precharge_Thermal_Management/Determine_Precharge_JouleHeat/Determine_Accumulated_RemainingHeat/Determine_Accumulated_Cooling" /begin REF_CHARACTERISTIC MILISECONDS_PER_SECOND SAMPLE_TIME_TASK_B /end REF_CHARACTERISTIC /end GROUP
/begin GROUP S1217_Calculate_Locked_SOC "VBU0428Test/VBUSystem/BMS/SOF/Subsystem6/Subsystem/Determine_Currentlimit_Target/Calculate_CurrentLimit_Target/Calculate_CurrentLimit_Base/Calculate_ContinuousChargeCurrent/Calculate_Locked_SOC" /begin REF_CHARACTERISTIC ONE_HUNDRED_PERCENT /end REF_CHARACTERISTIC /end GROUP
/begin GROUP S1217_Calculate_Locked_SOC1 "VBU0428Test/VBUSystem/BMS/SOF/Subsystem6/Subsystem/Determine_Currentlimit_Target/Calculate_CurrentLimit_Target/Calculate_CurrentLimit_Base/Calculate_ContinuousChargeCurrent/Calculate_Locked_SOC1" /begin REF_CHARACTERISTIC ONE_HUNDRED_PERCENT /end REF_CHARACTERISTIC /end GROUP
/begin GROUP S1217_Calculate_Locked_SOC2 "VBU0428Test/VBUSystem/BMS/SOF/Subsystem6/Subsystem/Determine_Currentlimit_Target/Calculate_CurrentLimit_Target/Calculate_CurrentLimit_Base/Calculate_ContinuousChargeCurrent/Calculate_Locked_SOC2" /begin REF_CHARACTERISTIC ONE_HUNDRED_PERCENT /end REF_CHARACTERISTIC /end GROUP
/begin GROUP S1218_Calculate_Locked_SOC "VBU0428Test/VBUSystem/BMS/SOF/Subsystem6/Subsystem/Determine_Currentlimit_Target/Calculate_CurrentLimit_Target/Calculate_CurrentLimit_Base/Calculate_ContinuousDischargeCurrent/Calculate_Locked_SOC" /begin REF_CHARACTERISTIC ONE_HUNDRED_PERCENT /end REF_CHARACTERISTIC /end GROUP
/begin GROUP S1218_Calculate_Locked_SOC1 "VBU0428Test/VBUSystem/BMS/SOF/Subsystem6/Subsystem/Determine_Currentlimit_Target/Calculate_CurrentLimit_Target/Calculate_CurrentLimit_Base/Calculate_ContinuousDischargeCurrent/Calculate_Locked_SOC1" /begin REF_CHARACTERISTIC ONE_HUNDRED_PERCENT /end REF_CHARACTERISTIC /end GROUP
/begin GROUP S1219_Calculate_Locked_SOC "VBU0428Test/VBUSystem/BMS/SOF/Subsystem6/Subsystem/Determine_Currentlimit_Target/Calculate_CurrentLimit_Target/Calculate_CurrentLimit_Base/Calculate_ShortPulseChargeCurrent/Calculate_Locked_SOC" /begin REF_CHARACTERISTIC ONE_HUNDRED_PERCENT /end REF_CHARACTERISTIC /end GROUP
/begin GROUP S1219_Calculate_Locked_SOC1 "VBU0428Test/VBUSystem/BMS/SOF/Subsystem6/Subsystem/Determine_Currentlimit_Target/Calculate_CurrentLimit_Target/Calculate_CurrentLimit_Base/Calculate_ShortPulseChargeCurrent/Calculate_Locked_SOC1" /begin REF_CHARACTERISTIC ONE_HUNDRED_PERCENT /end REF_CHARACTERISTIC /end GROUP
/begin GROUP S1220_Calculate_Locked_SOC "VBU0428Test/VBUSystem/BMS/SOF/Subsystem6/Subsystem/Determine_Currentlimit_Target/Calculate_CurrentLimit_Target/Calculate_CurrentLimit_Base/Calculate_ShortPulseDischargeCurrent/Calculate_Locked_SOC" /begin REF_CHARACTERISTIC ONE_HUNDRED_PERCENT /end REF_CHARACTERISTIC /end GROUP
/begin GROUP S1220_Calculate_Locked_SOC1 "VBU0428Test/VBUSystem/BMS/SOF/Subsystem6/Subsystem/Determine_Currentlimit_Target/Calculate_CurrentLimit_Target/Calculate_CurrentLimit_Base/Calculate_ShortPulseDischargeCurrent/Calculate_Locked_SOC1" /begin REF_CHARACTERISTIC ONE_HUNDRED_PERCENT /end REF_CHARACTERISTIC /end GROUP
/begin GROUP S1283_FCC_CHARGE_MODE1 "VBU0428Test/VBUSystem/BMS/SOF/Subsystem6/Subsystem/Determine_Currentlimit_Target/Calculate_CurrentLimit_Target/CurrentLimit_FastCharge_Check/FastChrgOneThirdRateCurrentLimitCheck/FCC_CHARGE_MODE1" /begin REF_CHARACTERISTIC BMM_STATE_FAST_CHARGE /end REF_CHARACTERISTIC /end GROUP
/begin GROUP S1284_FCC_CHARGE_MODE1 "VBU0428Test/VBUSystem/BMS/SOF/Subsystem6/Subsystem/Determine_Currentlimit_Target/Calculate_CurrentLimit_Target/CurrentLimit_FastCharge_Check/SegmentChargeCheck/FCC_CHARGE_MODE1" /begin REF_CHARACTERISTIC BMM_STATE_FAST_CHARGE /end REF_CHARACTERISTIC /end GROUP
/begin GROUP S1319_Calculate_CurrentLimit "VBU0428Test/VBUSystem/BMS/SOF/Subsystem6/Subsystem/Determine_Currentlimit_Target/Calculate_CurrentLimit_Target/CurrentLimit_Voltage_Correct/Correct_CurrentLimit/Calculate_CurrentLimit" /begin REF_CHARACTERISTIC BMM_STATE_FAST_CHARGE MILISECONDS_PER_SECOND /end REF_CHARACTERISTIC /end GROUP
/begin GROUP S1449_Determine_Cell_Balanced_Capacity "VBU0428Test/VBUSystem/BMS/SOH/Subsystem4/Subsystem1/Calculate_Capacity/Calculate_CellCapacity_SlowCharge/Determine_AhIntegral_DeltaQ/Determine_AhIntegral_Q/Determine_Cell_Balanced_Capacity" /begin REF_CHARACTERISTIC MILISECONDS_PER_SECOND ONE_HUNDRED_PERCENT /end REF_CHARACTERISTIC /end GROUP
/begin GROUP S1450_CONTACTOR_STATUS_OPENED1 "VBU0428Test/VBUSystem/BMS/SOH/Subsystem4/Subsystem1/Calculate_Capacity/Calculate_CellCapacity_SlowCharge/Determine_AhIntegral_DeltaQ/Determine_Module_Current/CONTACTOR_STATUS_OPENED1" /begin REF_CHARACTERISTIC CTD_MAIN_CONTACTOR_STATUS_OPENED /end REF_CHARACTERISTIC /end GROUP
/begin GROUP S1454_CONTACTOR_STATUS_OPENED1 "VBU0428Test/VBUSystem/BMS/SOH/Subsystem4/Subsystem1/Calculate_Capacity/Calculate_CellCapacity_SlowCharge/Determine_Soc/Determine_Module_Current/CONTACTOR_STATUS_OPENED1" /begin REF_CHARACTERISTIC CTD_MAIN_CONTACTOR_STATUS_OPENED /end REF_CHARACTERISTIC /end GROUP
/begin GROUP S64_Calculate_Current_Sum "VBU0428Test/VBUSystem/BMS/BCV/BCV/Subsystem/Calculate_BatteryCurrent/Correct_BatteryCurrent/Calculate_BatteryCurrent_ZeroDrift/Calculate_ExtremeData/Enabled_Subsystem/Calculate_Current_Sum" /begin REF_CHARACTERISTIC SAMPLE_TIME_TASK_B /end REF_CHARACTERISTIC /end GROUP
/begin GROUP S1264_Calculate_ChargeCurrentLimitBuffer_Use "VBU0428Test/VBUSystem/BMS/SOF/Subsystem6/Subsystem/Determine_Currentlimit_Target/Calculate_CurrentLimit_Target/Calculate_Dynamic_CurrentLimit/Calculate_Dynamic_ChargeCurrentLimit/Calculate_ChargeCurrentLimit_Buff/Calculate_ChargeCurrentLimitBuffer_Use" /begin REF_CHARACTERISTIC MILISECONDS_PER_SECOND /end REF_CHARACTERISTIC /end GROUP
/begin GROUP S1272_Calculate_DischargeCurrentLimitBuffer_Use "VBU0428Test/VBUSystem/BMS/SOF/Subsystem6/Subsystem/Determine_Currentlimit_Target/Calculate_CurrentLimit_Target/Calculate_Dynamic_CurrentLimit/Calculate_Dynamic_DischargeCurrentLimit/Calculate_DischargeCurrentLimit_Buff/Calculate_DischargeCurrentLimitBuffer_Use" /begin REF_CHARACTERISTIC MILISECONDS_PER_SECOND /end REF_CHARACTERISTIC /end GROUP
/begin GROUP S1273_Rate_Limiter "VBU0428Test/VBUSystem/BMS/SOF/Subsystem6/Subsystem/Determine_Currentlimit_Target/Calculate_CurrentLimit_Target/Calculate_Dynamic_CurrentLimit/Calculate_Dynamic_DischargeCurrentLimit/Calculate_Dynamic_DischargeCurrentLimit/Rate_Limiter" /begin REF_CHARACTERISTIC MILISECONDS_PER_SECOND /end REF_CHARACTERISTIC /end GROUP
/begin GROUP S1321_Rate_Limiter1 "VBU0428Test/VBUSystem/BMS/SOF/Subsystem6/Subsystem/Determine_Currentlimit_Target/Calculate_CurrentLimit_Target/CurrentLimit_Voltage_Correct/Correct_CurrentLimit/Calculate_CurrentLimit/Rate_Limiter1" /begin REF_CHARACTERISTIC MILISECONDS_PER_SECOND /end REF_CHARACTERISTIC /end GROUP
/begin GROUP S1324_Calculate_DCIR_Validation "VBU0428Test/VBUSystem/BMS/SOF/Subsystem6/Subsystem/Determine_Currentlimit_Target/Calculate_CurrentLimit_Target/CurrentLimit_Voltage_Correct/Correct_CurrentLimit/Calculate_CurrentLimit/Calculate_Cell_Discharge_DCIR/Calculate_DCIR_Validation" /begin REF_CHARACTERISTIC ONE_HUNDRED_PERCENT /end REF_CHARACTERISTIC /end GROUP
/end MODULE
/end PROJECT
/* (add any file trailer comments here) */ /* EOF VBU0428Test.a2l */
