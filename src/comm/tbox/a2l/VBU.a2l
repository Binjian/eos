ASAP2_VERSION 1 31
/begin PROJECT ProjectName "Project Comment Goes Here"
/begin HEADER "Header Comments go here" /end HEADER
/begin MODULE ModuleName "Module Comment Goes Here"
/begin MOD_COMMON "Mod Common Comment Here" BYTE_ORDER MSB_LAST /end MOD_COMMON
/begin RECORD_LAYOUT Scalar_BOOLEAN FNC_VALUES 1 UBYTE COLUMN_DIR DIRECT /end RECORD_LAYOUT
/begin RECORD_LAYOUT Scalar_UBYTE FNC_VALUES 1 UBYTE COLUMN_DIR DIRECT /end RECORD_LAYOUT
/begin RECORD_LAYOUT Scalar_BYTE FNC_VALUES 1 SBYTE COLUMN_DIR DIRECT /end RECORD_LAYOUT
/begin RECORD_LAYOUT Scalar_UWORD FNC_VALUES 1 UWORD COLUMN_DIR DIRECT /end RECORD_LAYOUT
/begin RECORD_LAYOUT Scalar_ULONG FNC_VALUES 1 ULONG COLUMN_DIR DIRECT /end RECORD_LAYOUT
/begin RECORD_LAYOUT Scalar_FLOAT32_IEEE FNC_VALUES 1 FLOAT32_IEEE COLUMN_DIR DIRECT /end RECORD_LAYOUT
/begin RECORD_LAYOUT Lookup1D_UBYTE FNC_VALUES 1 UBYTE COLUMN_DIR DIRECT /end RECORD_LAYOUT
/begin RECORD_LAYOUT Lookup1D_X_UBYTE AXIS_PTS_X 1 UBYTE INDEX_INCR DIRECT /end RECORD_LAYOUT
/begin RECORD_LAYOUT Lookup1D_UWORD FNC_VALUES 1 UWORD COLUMN_DIR DIRECT /end RECORD_LAYOUT
/begin RECORD_LAYOUT Lookup1D_WORD FNC_VALUES 1 SWORD COLUMN_DIR DIRECT /end RECORD_LAYOUT
/begin RECORD_LAYOUT Lookup1D_FLOAT32_IEEE FNC_VALUES 1 FLOAT32_IEEE COLUMN_DIR DIRECT /end RECORD_LAYOUT
/begin RECORD_LAYOUT Lookup1D_X_FLOAT32_IEEE AXIS_PTS_X 1 FLOAT32_IEEE INDEX_INCR DIRECT /end RECORD_LAYOUT
/begin RECORD_LAYOUT Lookup2D_X_UWORD AXIS_PTS_X 1 UWORD INDEX_INCR DIRECT /end RECORD_LAYOUT
/begin RECORD_LAYOUT Lookup2D_FLOAT32_IEEE FNC_VALUES 1 FLOAT32_IEEE COLUMN_DIR DIRECT /end RECORD_LAYOUT
/begin RECORD_LAYOUT Lookup2D_X_FLOAT32_IEEE AXIS_PTS_X 1 FLOAT32_IEEE INDEX_INCR DIRECT /end RECORD_LAYOUT
/begin CHARACTERISTIC CaCVT_CellVoltageOverDeviationCurrentMapZ_A "" MAP 0x7001529a Lookup2D_FLOAT32_IEEE 0 VBU0428Test_CM_single_cnt -3.4028234663852886E+38 3.4028234663852886E+38
 /begin AXIS_DESCR COM_AXIS SOC_pctBatterySoc VBU0428Test_CM_single_cnt 6 -3.4028234663852886E+38 3.4028234663852886E+38 AXIS_PTS_REF CaCVT_CellVoltageOverDeviationCurrentMapY_pct /end AXIS_DESCR
 /begin AXIS_DESCR COM_AXIS CTM_tCellTempMin VBU0428Test_CM_single_cnt 8 -3.4028234663852886E+38 3.4028234663852886E+38 AXIS_PTS_REF CaCVT_CellVoltageOverDeviationCurrentMapX_C /end AXIS_DESCR
/end CHARACTERISTIC
/begin AXIS_PTS CaCVT_CellVoltageOverDeviationCurrentMapX_C "" 0x700124de CTM_tCellTempMin Lookup2D_X_FLOAT32_IEEE 0 VBU0428Test_CM_single_cnt 8 -3.4028234663852886E+38 3.4028234663852886E+38 /end AXIS_PTS
/begin AXIS_PTS CaCVT_CellVoltageOverDeviationCurrentMapY_pct "" 0x700120ea SOC_pctBatterySoc Lookup2D_X_FLOAT32_IEEE 0 VBU0428Test_CM_single_cnt 6 -3.4028234663852886E+38 3.4028234663852886E+38 /end AXIS_PTS
/begin CHARACTERISTIC CaFCC_ChargeCurrentOverFactorMapY_nbr "" CURVE 0x70011c3a Lookup1D_FLOAT32_IEEE 0 VBU0428Test_CM_single_cnt -3.4028234663852886E+38 3.4028234663852886E+38
 /begin AXIS_DESCR COM_AXIS CTM_tCellTempMin VBU0428Test_CM_single_cnt 4 -3.4028234663852886E+38 3.4028234663852886E+38 AXIS_PTS_REF CaFCC_ChargeCurrentOverFactorMapX_C /end AXIS_DESCR
/end CHARACTERISTIC
/begin AXIS_PTS CaFCC_ChargeCurrentOverFactorMapX_C "" 0x70011c2a CTM_tCellTempMin Lookup1D_X_FLOAT32_IEEE 0 VBU0428Test_CM_single_cnt 4 -3.4028234663852886E+38 3.4028234663852886E+38 /end AXIS_PTS
/begin CHARACTERISTIC CaOCV_RelaxationTimeCurveY_s "" CURVE 0x700130f6 Lookup1D_FLOAT32_IEEE 0 VBU0428Test_CM_single_cnt -3.4028234663852886E+38 3.4028234663852886E+38
 /begin AXIS_DESCR COM_AXIS CTM_tCellTempMin VBU0428Test_CM_single_cnt 12 -3.4028234663852886E+38 3.4028234663852886E+38 AXIS_PTS_REF CaOCV_RelaxationTimeCurveX_C /end AXIS_DESCR
/end CHARACTERISTIC
/begin AXIS_PTS CaOCV_RelaxationTimeCurveX_C "" 0x700130c6 CTM_tCellTempMin Lookup1D_X_FLOAT32_IEEE 0 VBU0428Test_CM_single_cnt 12 -3.4028234663852886E+38 3.4028234663852886E+38 /end AXIS_PTS
/begin CHARACTERISTIC CaOCV_RelaxaShortTimeCurveY_s "" CURVE 0x70011c8a Lookup1D_FLOAT32_IEEE 0 VBU0428Test_CM_single_cnt -3.4028234663852886E+38 3.4028234663852886E+38
 /begin AXIS_DESCR COM_AXIS CTM_tCellTempMin VBU0428Test_CM_single_cnt 4 -3.4028234663852886E+38 3.4028234663852886E+38 AXIS_PTS_REF CaOCV_RelaxaShortTimeCurveX_C /end AXIS_DESCR
/end CHARACTERISTIC
/begin AXIS_PTS CaOCV_RelaxaShortTimeCurveX_C "" 0x70011c7a CTM_tCellTempMin Lookup1D_X_FLOAT32_IEEE 0 VBU0428Test_CM_single_cnt 4 -3.4028234663852886E+38 3.4028234663852886E+38 /end AXIS_PTS
/begin CHARACTERISTIC CaSOC_SOCPLowY_pct "" CURVE 0x700123be Lookup1D_FLOAT32_IEEE 0 VBU0428Test_CM_single_cnt -3.4028234663852886E+38 3.4028234663852886E+38
 /begin AXIS_DESCR COM_AXIS CTM_tCellTempMin VBU0428Test_CM_single_cnt 7 -3.4028234663852886E+38 3.4028234663852886E+38 AXIS_PTS_REF CaSOC_SOCPLowX_C /end AXIS_DESCR
/end CHARACTERISTIC
/begin AXIS_PTS CaSOC_SOCPLowX_C "" 0x700123a2 CTM_tCellTempMin Lookup1D_X_FLOAT32_IEEE 0 VBU0428Test_CM_single_cnt 7 -3.4028234663852886E+38 3.4028234663852886E+38 /end AXIS_PTS
/begin CHARACTERISTIC CaSOC_OcvSocMapZ_pct "" MAP 0x7001acc4 Lookup2D_FLOAT32_IEEE 0 VBU0428Test_CM_single_cnt -3.4028234663852886E+38 3.4028234663852886E+38
 /begin AXIS_DESCR COM_AXIS NO_INPUT_QUANTITY VBU0428Test_CM_uint16_cnt 23 0.0 65535.0 AXIS_PTS_REF CaSOC_OcvSocMapY_mV /end AXIS_DESCR
 /begin AXIS_DESCR COM_AXIS LaSOC_CellTemp_C VBU0428Test_CM_single_cnt 9 -3.4028234663852886E+38 3.4028234663852886E+38 AXIS_PTS_REF CaSOC_OcvSocMapX_C /end AXIS_DESCR
/end CHARACTERISTIC
/begin AXIS_PTS CaSOC_OcvSocMapX_C "" 0x700126c2 LaSOC_CellTemp_C Lookup2D_X_FLOAT32_IEEE 0 VBU0428Test_CM_single_cnt 9 -3.4028234663852886E+38 3.4028234663852886E+38 /end AXIS_PTS
/begin AXIS_PTS CaSOC_OcvSocMapY_mV "" 0x7001303a NO_INPUT_QUANTITY Lookup2D_X_UWORD 0 VBU0428Test_CM_uint16_cnt 23 0.0 65535.0 /end AXIS_PTS
/begin CHARACTERISTIC CaSOC_OcvShortTimeSocErrorCurveY_pct "" CURVE 0x70011caa Lookup1D_FLOAT32_IEEE 0 VBU0428Test_CM_single_cnt -3.4028234663852886E+38 3.4028234663852886E+38
 /begin AXIS_DESCR COM_AXIS CTM_tCellTempMin VBU0428Test_CM_single_cnt 4 -3.4028234663852886E+38 3.4028234663852886E+38 AXIS_PTS_REF CaSOC_OcvShortTimeSocErrorCurveX_C /end AXIS_DESCR
/end CHARACTERISTIC
/begin AXIS_PTS CaSOC_OcvShortTimeSocErrorCurveX_C "" 0x70011c9a CTM_tCellTempMin Lookup1D_X_FLOAT32_IEEE 0 VBU0428Test_CM_single_cnt 4 -3.4028234663852886E+38 3.4028234663852886E+38 /end AXIS_PTS
/begin CHARACTERISTIC CaSOC_OcvShortTimeDischargeSocZ_pct "" MAP 0x700151ea Lookup2D_FLOAT32_IEEE 0 VBU0428Test_CM_single_cnt -3.4028234663852886E+38 3.4028234663852886E+38
 /begin AXIS_DESCR COM_AXIS NO_INPUT_QUANTITY VBU0428Test_CM_uint16_cnt 11 0.0 65535.0 AXIS_PTS_REF CaSOC_OcvShortTimeDischargeVolY_mV /end AXIS_DESCR
 /begin AXIS_DESCR COM_AXIS CTM_tCellTempMin VBU0428Test_CM_single_cnt 4 -3.4028234663852886E+38 3.4028234663852886E+38 AXIS_PTS_REF CaSOC_OcvShortTimeTemX_C /end AXIS_DESCR
/end CHARACTERISTIC
/begin AXIS_PTS CaSOC_OcvShortTimeTemX_C "" 0x70011cba CTM_tCellTempMin Lookup2D_X_FLOAT32_IEEE 0 VBU0428Test_CM_single_cnt 4 -3.4028234663852886E+38 3.4028234663852886E+38 /end AXIS_PTS
/begin AXIS_PTS CaSOC_OcvShortTimeDischargeVolY_mV "" 0x700120d4 NO_INPUT_QUANTITY Lookup2D_X_UWORD 0 VBU0428Test_CM_uint16_cnt 11 0.0 65535.0 /end AXIS_PTS
/begin CHARACTERISTIC CaSOC_OcvShortTimeChargeSocZ_pct "" MAP 0x7001513a Lookup2D_FLOAT32_IEEE 0 VBU0428Test_CM_single_cnt -3.4028234663852886E+38 3.4028234663852886E+38
 /begin AXIS_DESCR COM_AXIS NO_INPUT_QUANTITY VBU0428Test_CM_uint16_cnt 11 0.0 65535.0 AXIS_PTS_REF CaSOC_OcvShortTimeChargeVolY_mV /end AXIS_DESCR
 /begin AXIS_DESCR COM_AXIS CTM_tCellTempMin VBU0428Test_CM_single_cnt 4 -3.4028234663852886E+38 3.4028234663852886E+38 AXIS_PTS_REF CaSOC_OcvShortTimeTemX_C /end AXIS_DESCR
/end CHARACTERISTIC
/begin AXIS_PTS CaSOC_OcvShortTimeChargeVolY_mV "" 0x700120be NO_INPUT_QUANTITY Lookup2D_X_UWORD 0 VBU0428Test_CM_uint16_cnt 11 0.0 65535.0 /end AXIS_PTS
/begin CHARACTERISTIC CaSOE_DispalySocFactorMapY_pct "" CURVE 0x70013156 Lookup1D_FLOAT32_IEEE 0 VBU0428Test_CM_single_cnt -3.4028234663852886E+38 3.4028234663852886E+38
 /begin AXIS_DESCR COM_AXIS SOC_pctBatteryDisplaySoc VBU0428Test_CM_single_cnt 12 -3.4028234663852886E+38 3.4028234663852886E+38 AXIS_PTS_REF CaSOE_DispalySocFactorMapX_pct /end AXIS_DESCR
/end CHARACTERISTIC
/begin AXIS_PTS CaSOE_DispalySocFactorMapX_pct "" 0x70013126 SOC_pctBatteryDisplaySoc Lookup1D_X_FLOAT32_IEEE 0 VBU0428Test_CM_single_cnt 12 -3.4028234663852886E+38 3.4028234663852886E+38 /end AXIS_PTS
/begin CHARACTERISTIC CaSOF_DischargePowerSlopeSocTempMapZ_Kw "" MAP 0x70019840 Lookup2D_FLOAT32_IEEE 0 VBU0428Test_CM_single_cnt -3.4028234663852886E+38 3.4028234663852886E+38
 /begin AXIS_DESCR COM_AXIS SOC_pctCellSocMin VBU0428Test_CM_single_cnt 13 -3.4028234663852886E+38 3.4028234663852886E+38 AXIS_PTS_REF CaSOF_DischargePowerSlopeSocTempMapY_pct /end AXIS_DESCR
 /begin AXIS_DESCR COM_AXIS NO_INPUT_QUANTITY VBU0428Test_CM_single_cnt 14 -3.4028234663852886E+38 3.4028234663852886E+38 AXIS_PTS_REF CaSOF_DischargePowerSlopeSocTempMapX_C /end AXIS_DESCR
/end CHARACTERISTIC
/begin AXIS_PTS CaSOF_DischargePowerSlopeSocTempMapX_C "" 0x7001399e NO_INPUT_QUANTITY Lookup2D_X_FLOAT32_IEEE 0 VBU0428Test_CM_single_cnt 14 -3.4028234663852886E+38 3.4028234663852886E+38 /end AXIS_PTS
/begin AXIS_PTS CaSOF_DischargePowerSlopeSocTempMapY_pct "" 0x700134da SOC_pctCellSocMin Lookup2D_X_FLOAT32_IEEE 0 VBU0428Test_CM_single_cnt 13 -3.4028234663852886E+38 3.4028234663852886E+38 /end AXIS_PTS
/begin CHARACTERISTIC CaSOF_ChargePowerSlopeSocTempMapZ_Kw "" MAP 0x70018a08 Lookup2D_FLOAT32_IEEE 0 VBU0428Test_CM_single_cnt -3.4028234663852886E+38 3.4028234663852886E+38
 /begin AXIS_DESCR COM_AXIS SOC_pctCellSocMax VBU0428Test_CM_single_cnt 13 -3.4028234663852886E+38 3.4028234663852886E+38 AXIS_PTS_REF CaSOF_ChargePowerSlopeSocTempMapY_pct /end AXIS_DESCR
 /begin AXIS_DESCR COM_AXIS NO_INPUT_QUANTITY VBU0428Test_CM_single_cnt 14 -3.4028234663852886E+38 3.4028234663852886E+38 AXIS_PTS_REF CaSOF_ChargePowerSlopeSocTempMapX_C /end AXIS_DESCR
/end CHARACTERISTIC
/begin AXIS_PTS CaSOF_ChargePowerSlopeSocTempMapX_C "" 0x70013886 NO_INPUT_QUANTITY Lookup2D_X_FLOAT32_IEEE 0 VBU0428Test_CM_single_cnt 14 -3.4028234663852886E+38 3.4028234663852886E+38 /end AXIS_PTS
/begin AXIS_PTS CaSOF_ChargePowerSlopeSocTempMapY_pct "" 0x700133d6 SOC_pctCellSocMax Lookup2D_X_FLOAT32_IEEE 0 VBU0428Test_CM_single_cnt 13 -3.4028234663852886E+38 3.4028234663852886E+38 /end AXIS_PTS
/begin CHARACTERISTIC CaTHM_OutletCoolantTempMapZ_C "" MAP 0x70014ed2 Lookup2D_FLOAT32_IEEE 0 VBU0428Test_CM_single_cnt -40.0 80.0
 /begin AXIS_DESCR COM_AXIS THM_tInletCoolantTemp VBU0428Test_CM_single_cnt 5 -40.0 80.0 AXIS_PTS_REF CaTHM_InletCoolantTempMapY_C /end AXIS_DESCR
 /begin AXIS_DESCR COM_AXIS CTM_tCellTempAve VBU0428Test_CM_single_cnt 7 -40.0 80.0 AXIS_PTS_REF CaTHM_CellTempAveMapX_C /end AXIS_DESCR
/end CHARACTERISTIC
/begin AXIS_PTS CaTHM_CellTempAveMapX_C "" 0x700123f6 CTM_tCellTempAve Lookup2D_X_FLOAT32_IEEE 0 VBU0428Test_CM_single_cnt 7 -40.0 80.0 /end AXIS_PTS
/begin AXIS_PTS CaTHM_InletCoolantTempMapY_C "" 0x70011f06 THM_tInletCoolantTemp Lookup2D_X_FLOAT32_IEEE 0 VBU0428Test_CM_single_cnt 5 -40.0 80.0 /end AXIS_PTS
/begin CHARACTERISTIC CcCVT_CSCSupplyPowerLowHysteresis_V "" VALUE 0x700106a0 Scalar_FLOAT32_IEEE 0 VBU0428Test_CM_single_V -3.4028234663852886E+38 3.4028234663852886E+38 /end CHARACTERISTIC
/begin CHARACTERISTIC CcCVT_CSCSupplyPowerLow_V "" VALUE 0x700106a4 Scalar_FLOAT32_IEEE 0 VBU0428Test_CM_single_V -3.4028234663852886E+38 3.4028234663852886E+38 /end CHARACTERISTIC
/begin CHARACTERISTIC CcCVT_CellUnderVoltageLowTemp_C "" VALUE 0x700106ac Scalar_FLOAT32_IEEE 0 VBU0428Test_CM_single_cnt -3.4028234663852886E+38 3.4028234663852886E+38 /end CHARACTERISTIC
/begin CHARACTERISTIC CcCVT_CellVoltageOverDeviationDisableCrrnt_A "" VALUE 0x700106b0 Scalar_FLOAT32_IEEE 0 VBU0428Test_CM_single_A -3.4028234663852886E+38 3.4028234663852886E+38 /end CHARACTERISTIC
/begin CHARACTERISTIC CcFCC_ChargeAbortDelayTime_s "" VALUE 0x700106e0 Scalar_FLOAT32_IEEE 0 VBU0428Test_CM_single_cnt -3.4028234663852886E+38 3.4028234663852886E+38 /end CHARACTERISTIC
/begin CHARACTERISTIC CcFCC_ChargeCurrentOverDelta_A "" VALUE 0x700106f4 Scalar_FLOAT32_IEEE 0 VBU0428Test_CM_single_cnt -3.4028234663852886E+38 3.4028234663852886E+38 /end CHARACTERISTIC
/begin CHARACTERISTIC CcFCC_ChargeCurrentOver_A "" VALUE 0x700106f8 Scalar_FLOAT32_IEEE 0 VBU0428Test_CM_single_cnt -3.4028234663852886E+38 3.4028234663852886E+38 /end CHARACTERISTIC
/begin CHARACTERISTIC CcFCC_ChargeFaultDelayTime_s "" VALUE 0x70010700 Scalar_FLOAT32_IEEE 0 VBU0428Test_CM_single_cnt -3.4028234663852886E+38 3.4028234663852886E+38 /end CHARACTERISTIC
/begin CHARACTERISTIC CcFCC_ChargeFullDelayTime_s "" VALUE 0x70010704 Scalar_FLOAT32_IEEE 0 VBU0428Test_CM_single_cnt -3.4028234663852886E+38 3.4028234663852886E+38 /end CHARACTERISTIC
/begin CHARACTERISTIC CcFCC_ChargeProtectDelayTime_s "" VALUE 0x70010710 Scalar_FLOAT32_IEEE 0 VBU0428Test_CM_single_cnt -3.4028234663852886E+38 3.4028234663852886E+38 /end CHARACTERISTIC
/begin CHARACTERISTIC CcFCC_EightyCustomSOC_pct "" VALUE 0x70010734 Scalar_FLOAT32_IEEE 0 VBU0428Test_CM_single_cnt -3.4028234663852886E+38 3.4028234663852886E+38 /end CHARACTERISTIC
/begin CHARACTERISTIC CcFCC_EstimateChargeInvalidTime_min "" VALUE 0x70010738 Scalar_FLOAT32_IEEE 0 VBU0428Test_CM_single_cnt -3.4028234663852886E+38 3.4028234663852886E+38 /end CHARACTERISTIC
/begin CHARACTERISTIC CcSOC_BatterySocHighFault10Cycles_pct "" VALUE 0x700107d8 Scalar_FLOAT32_IEEE 0 VBU0428Test_CM_single_cnt -3.4028234663852886E+38 3.4028234663852886E+38 /end CHARACTERISTIC
/begin CHARACTERISTIC CcSOC_BatterySocHighFault70Cycles_pct "" VALUE 0x700107dc Scalar_FLOAT32_IEEE 0 VBU0428Test_CM_single_cnt -3.4028234663852886E+38 3.4028234663852886E+38 /end CHARACTERISTIC
/begin CHARACTERISTIC CcSOC_BatterySocHighFault_pct "" VALUE 0x700107e0 Scalar_FLOAT32_IEEE 0 VBU0428Test_CM_single_cnt -3.4028234663852886E+38 3.4028234663852886E+38 /end CHARACTERISTIC
/begin CHARACTERISTIC CcSOC_BatterySocLowFault10Cycles_pct "" VALUE 0x700107e4 Scalar_FLOAT32_IEEE 0 VBU0428Test_CM_single_cnt -3.4028234663852886E+38 3.4028234663852886E+38 /end CHARACTERISTIC
/begin CHARACTERISTIC CcSOC_BatterySocLowFault70Cycles_pct "" VALUE 0x700107e8 Scalar_FLOAT32_IEEE 0 VBU0428Test_CM_single_cnt -3.4028234663852886E+38 3.4028234663852886E+38 /end CHARACTERISTIC
/begin CHARACTERISTIC CcSOC_BatterySocLowFault_pct "" VALUE 0x700107ec Scalar_FLOAT32_IEEE 0 VBU0428Test_CM_single_cnt -3.4028234663852886E+38 3.4028234663852886E+38 /end CHARACTERISTIC
/begin CHARACTERISTIC CcSOC_BatterySocLowerLimit_pct "" VALUE 0x700107f0 Scalar_FLOAT32_IEEE 0 VBU0428Test_CM_single_cnt -3.4028234663852886E+38 3.4028234663852886E+38 /end CHARACTERISTIC
/begin CHARACTERISTIC CcSOC_BatterySocUpperLimit_pct "" VALUE 0x700107f8 Scalar_FLOAT32_IEEE 0 VBU0428Test_CM_single_cnt -3.4028234663852886E+38 3.4028234663852886E+38 /end CHARACTERISTIC
/begin CHARACTERISTIC CcSOC_BatteryUsableSocLowerLimit10Cycles_pct "" VALUE 0x700107fc Scalar_FLOAT32_IEEE 0 VBU0428Test_CM_single_cnt -3.4028234663852886E+38 3.4028234663852886E+38 /end CHARACTERISTIC
/begin CHARACTERISTIC CcSOC_BatteryUsableSocLowerLimit70Cycles_pct "" VALUE 0x70010800 Scalar_FLOAT32_IEEE 0 VBU0428Test_CM_single_cnt -3.4028234663852886E+38 3.4028234663852886E+38 /end CHARACTERISTIC
/begin CHARACTERISTIC CcSOC_BatteryUsableSocLowerLimitHomo_pct "" VALUE 0x70010804 Scalar_FLOAT32_IEEE 0 VBU0428Test_CM_single_cnt -3.4028234663852886E+38 3.4028234663852886E+38 /end CHARACTERISTIC
/begin CHARACTERISTIC CcSOC_BatteryUsableSocLowerLimit_pct "" VALUE 0x70010808 Scalar_FLOAT32_IEEE 0 VBU0428Test_CM_single_cnt -3.4028234663852886E+38 3.4028234663852886E+38 /end CHARACTERISTIC
/begin CHARACTERISTIC CcSOC_BatteryUsableSocUpperLimit10Cycles_pct "" VALUE 0x7001080c Scalar_FLOAT32_IEEE 0 VBU0428Test_CM_single_cnt -3.4028234663852886E+38 3.4028234663852886E+38 /end CHARACTERISTIC
/begin CHARACTERISTIC CcSOC_BatteryUsableSocUpperLimit70Cycles_pct "" VALUE 0x70010810 Scalar_FLOAT32_IEEE 0 VBU0428Test_CM_single_cnt -3.4028234663852886E+38 3.4028234663852886E+38 /end CHARACTERISTIC
/begin CHARACTERISTIC CcSOC_BatteryUsableSocUpperLimitHomo_pct "" VALUE 0x70010814 Scalar_FLOAT32_IEEE 0 VBU0428Test_CM_single_cnt -3.4028234663852886E+38 3.4028234663852886E+38 /end CHARACTERISTIC
/begin CHARACTERISTIC CcSOC_BatteryUsableSocUpperLimit_pct "" VALUE 0x70010818 Scalar_FLOAT32_IEEE 0 VBU0428Test_CM_single_cnt -3.4028234663852886E+38 3.4028234663852886E+38 /end CHARACTERISTIC
/begin CHARACTERISTIC CcSOC_CellArraySOCOvrdVal_pct "" VALUE 0x70010824 Scalar_FLOAT32_IEEE 0 VBU0428Test_CM_single_cnt -3.4028234663852886E+38 3.4028234663852886E+38 /end CHARACTERISTIC
/begin CHARACTERISTIC CcSOC_CellSocLowerLimit_pct "" VALUE 0x70010830 Scalar_FLOAT32_IEEE 0 VBU0428Test_CM_single_cnt -3.4028234663852886E+38 3.4028234663852886E+38 /end CHARACTERISTIC
/begin CHARACTERISTIC CcSOC_CellSocUpperLimit_pct "" VALUE 0x7001083c Scalar_FLOAT32_IEEE 0 VBU0428Test_CM_single_cnt -3.4028234663852886E+38 3.4028234663852886E+38 /end CHARACTERISTIC
/begin CHARACTERISTIC CcSOC_OcvShortTimeSocErrorThreshold_pct "" VALUE 0x70010868 Scalar_FLOAT32_IEEE 0 VBU0428Test_CM_single_cnt -3.4028234663852886E+38 3.4028234663852886E+38 /end CHARACTERISTIC
/begin CHARACTERISTIC CcSOC_OcvShortTimeVolDiffDis_mV "" VALUE 0x7001086c Scalar_FLOAT32_IEEE 0 VBU0428Test_CM_single_cnt -3.4028234663852886E+38 3.4028234663852886E+38 /end CHARACTERISTIC
/begin CHARACTERISTIC CcSOE_DischargeCutOffSoc_pct "" VALUE 0x70010884 Scalar_FLOAT32_IEEE 0 VBU0428Test_CM_single_cnt -3.4028234663852886E+38 3.4028234663852886E+38 /end CHARACTERISTIC
/begin CHARACTERISTIC CcSOE_EnergyDecRate_Kwh "" VALUE 0x70010888 Scalar_FLOAT32_IEEE 0 VBU0428Test_CM_single_cnt -3.4028234663852886E+38 3.4028234663852886E+38 /end CHARACTERISTIC
/begin CHARACTERISTIC CcSOE_EnergyIncRate_Kwh "" VALUE 0x7001088c Scalar_FLOAT32_IEEE 0 VBU0428Test_CM_single_cnt -3.4028234663852886E+38 3.4028234663852886E+38 /end CHARACTERISTIC
/begin CHARACTERISTIC CcSOF_CapacityScalingFactor_n "" VALUE 0x700108b0 Scalar_FLOAT32_IEEE 0 VBU0428Test_CM_single_cnt -3.4028234663852886E+38 3.4028234663852886E+38 /end CHARACTERISTIC
/begin CHARACTERISTIC CcSOF_ChargeCurrentSlopeFccMode_A "" VALUE 0x700108c0 Scalar_FLOAT32_IEEE 0 VBU0428Test_CM_single_cnt -3.4028234663852886E+38 3.4028234663852886E+38 /end CHARACTERISTIC
/begin CHARACTERISTIC CcSOF_ChargeCurrentSlope_A "" VALUE 0x700108c4 Scalar_FLOAT32_IEEE 0 VBU0428Test_CM_single_cnt -3.4028234663852886E+38 3.4028234663852886E+38 /end CHARACTERISTIC
/begin CHARACTERISTIC CcSOF_ChargePowerLimitViolationThreshold_Kws "" VALUE 0x700108c8 Scalar_FLOAT32_IEEE 0 VBU0428Test_CM_single_cnt -3.4028234663852886E+38 3.4028234663852886E+38 /end CHARACTERISTIC
/begin CHARACTERISTIC CcSOF_DischargeCurrentSlope_A "" VALUE 0x70010914 Scalar_FLOAT32_IEEE 0 VBU0428Test_CM_single_cnt -3.4028234663852886E+38 3.4028234663852886E+38 /end CHARACTERISTIC
/begin CHARACTERISTIC CcSOF_DischargePowerLimitViolationThreshold_Kws "" VALUE 0x7001092c Scalar_FLOAT32_IEEE 0 VBU0428Test_CM_single_cnt -3.4028234663852886E+38 3.4028234663852886E+38 /end CHARACTERISTIC
/begin CHARACTERISTIC CcSOF_LowTempOverCurrentBufferEmpty_As "" VALUE 0x70010980 Scalar_FLOAT32_IEEE 0 VBU0428Test_CM_single_cnt -3.4028234663852886E+38 3.4028234663852886E+38 /end CHARACTERISTIC
/begin CHARACTERISTIC CcSOF_LowTempOverCurrent_A "" VALUE 0x70010984 Scalar_FLOAT32_IEEE 0 VBU0428Test_CM_single_cnt -3.4028234663852886E+38 3.4028234663852886E+38 /end CHARACTERISTIC
/begin CHARACTERISTIC CcSYS_BatteryChargeCurrentMax_A "" VALUE 0x70010a88 Scalar_FLOAT32_IEEE 0 VBU0428Test_CM_single_single -3.4028234663852886E+38 3.4028234663852886E+38 /end CHARACTERISTIC
/begin CHARACTERISTIC CcSYS_BatteryRatedVoltage_V "" VALUE 0x70010a8c Scalar_FLOAT32_IEEE 0 VBU0428Test_CM_single_cnt -3.4028234663852886E+38 3.4028234663852886E+38 /end CHARACTERISTIC
/begin CHARACTERISTIC CcSYS_CellSOCLockedMax_pct "" VALUE 0x70010a90 Scalar_FLOAT32_IEEE 0 VBU0428Test_CM_single_cnt -3.4028234663852886E+38 3.4028234663852886E+38 /end CHARACTERISTIC
/begin CHARACTERISTIC CcSYS_CellSOCLockedMin_pct "" VALUE 0x70010a94 Scalar_FLOAT32_IEEE 0 VBU0428Test_CM_single_cnt -3.4028234663852886E+38 3.4028234663852886E+38 /end CHARACTERISTIC
/begin CHARACTERISTIC CcSYS_FullChargeSoc_pct "" VALUE 0x70010a98 Scalar_FLOAT32_IEEE 0 VBU0428Test_CM_single_pct -3.4028234663852886E+38 3.4028234663852886E+38 /end CHARACTERISTIC
/begin CHARACTERISTIC CcSYS_NoChargeHighTemp_C "" VALUE 0x70010aa0 Scalar_FLOAT32_IEEE 0 VBU0428Test_CM_single_cnt -3.4028234663852886E+38 3.4028234663852886E+38 /end CHARACTERISTIC
/begin CHARACTERISTIC CcSYS_TrickleChargeCurrent_A "" VALUE 0x70010ab4 Scalar_FLOAT32_IEEE 0 VBU0428Test_CM_single_cnt -3.4028234663852886E+38 3.4028234663852886E+38 /end CHARACTERISTIC
/begin CHARACTERISTIC CcTHM_CoolantSensorOorHigh_C "" VALUE 0x70010ac4 Scalar_FLOAT32_IEEE 0 VBU0428Test_CM_single_cnt -3.4028234663852886E+38 3.4028234663852886E+38 /end CHARACTERISTIC
/begin CHARACTERISTIC CcTHM_CoolantSensorOorLow_C "" VALUE 0x70010ac8 Scalar_FLOAT32_IEEE 0 VBU0428Test_CM_single_cnt -3.4028234663852886E+38 3.4028234663852886E+38 /end CHARACTERISTIC
/begin CHARACTERISTIC CcTHM_CoolingReponseCellTemp_C "" VALUE 0x70010acc Scalar_FLOAT32_IEEE 0 VBU0428Test_CM_single_cnt -3.4028234663852886E+38 3.4028234663852886E+38 /end CHARACTERISTIC
/begin CHARACTERISTIC CcTHM_CoolingReponseInletTemp_C "" VALUE 0x70010ad0 Scalar_FLOAT32_IEEE 0 VBU0428Test_CM_single_cnt -3.4028234663852886E+38 3.4028234663852886E+38 /end CHARACTERISTIC
/begin CHARACTERISTIC CcTHM_InletCoolingTempDeviation_C "" VALUE 0x70010aec Scalar_FLOAT32_IEEE 0 VBU0428Test_CM_single_cnt -3.4028234663852886E+38 3.4028234663852886E+38 /end CHARACTERISTIC
/begin CHARACTERISTIC CcTHM_InletOutletTempDeltaThreshold_C "" VALUE 0x70010af0 Scalar_FLOAT32_IEEE 0 VBU0428Test_CM_single_cnt -3.4028234663852886E+38 3.4028234663852886E+38 /end CHARACTERISTIC
/begin CHARACTERISTIC CcVCT_BatteryRatedVoltage_V "" VALUE 0x70010bb8 Scalar_FLOAT32_IEEE 0 VBU0428Test_CM_single_V -3.4028234663852886E+38 3.4028234663852886E+38 /end CHARACTERISTIC
/begin CHARACTERISTIC CcVCT_BatteryVoltageLimitMax_V "" VALUE 0x70010bbc Scalar_FLOAT32_IEEE 0 VBU0428Test_CM_single_V -3.4028234663852886E+38 3.4028234663852886E+38 /end CHARACTERISTIC
/begin CHARACTERISTIC CcVCT_BatteryVoltageLimitMin_V "" VALUE 0x70010bc0 Scalar_FLOAT32_IEEE 0 VBU0428Test_CM_single_V -3.4028234663852886E+38 3.4028234663852886E+38 /end CHARACTERISTIC
/begin CHARACTERISTIC CcVCT_NominalCellCapacity_Ah "" VALUE 0x70010bdc Scalar_FLOAT32_IEEE 0 VBU0428Test_CM_single_Ah -3.4028234663852886E+38 3.4028234663852886E+38 /end CHARACTERISTIC
/begin CHARACTERISTIC CcVCT_SOCJumpSOCLow_pct "" VALUE 0x70010be0 Scalar_FLOAT32_IEEE 0 VBU0428Test_CM_single_pct -3.4028234663852886E+38 3.4028234663852886E+38 /end CHARACTERISTIC
/begin CHARACTERISTIC CcVCT_SOCJumpThreshold_pct "" VALUE 0x70010be4 Scalar_FLOAT32_IEEE 0 VBU0428Test_CM_single_pct -3.4028234663852886E+38 3.4028234663852886E+38 /end CHARACTERISTIC
/begin CHARACTERISTIC CcVCT_SOCLowWarningThreshold1_pct "" VALUE 0x70010be8 Scalar_FLOAT32_IEEE 0 VBU0428Test_CM_single_pct -3.4028234663852886E+38 3.4028234663852886E+38 /end CHARACTERISTIC
/begin CHARACTERISTIC CcVCT_SOCLowWarningThreshold2_pct "" VALUE 0x70010bec Scalar_FLOAT32_IEEE 0 VBU0428Test_CM_single_pct -3.4028234663852886E+38 3.4028234663852886E+38 /end CHARACTERISTIC
/begin CHARACTERISTIC CcVCT_SocInitializationMaxTime_ms "" VALUE 0x70010bf0 Scalar_FLOAT32_IEEE 0 VBU0428Test_CM_single_ms -3.4028234663852886E+38 3.4028234663852886E+38 /end CHARACTERISTIC
/begin CHARACTERISTIC DCH_facLimitChrCrnntLvl0V_C "" VALUE 0x70010c74 Scalar_FLOAT32_IEEE 0 VBU0428Test_CM_single_cnt -3.4028234663852886E+38 3.4028234663852886E+38 /end CHARACTERISTIC
/begin CHARACTERISTIC DCH_facLimitChrCrnntLvl1V_C "" VALUE 0x70010c78 Scalar_FLOAT32_IEEE 0 VBU0428Test_CM_single_cnt -3.4028234663852886E+38 3.4028234663852886E+38 /end CHARACTERISTIC
/begin CHARACTERISTIC DCH_facLimitChrCrnntLvl2V_C "" VALUE 0x70010c7c Scalar_FLOAT32_IEEE 0 VBU0428Test_CM_single_cnt -3.4028234663852886E+38 3.4028234663852886E+38 /end CHARACTERISTIC
/begin CHARACTERISTIC DCH_facLimitChrCrnntLvl3V_C "" VALUE 0x70010c80 Scalar_FLOAT32_IEEE 0 VBU0428Test_CM_single_cnt -3.4028234663852886E+38 3.4028234663852886E+38 /end CHARACTERISTIC
/begin CHARACTERISTIC DCH_facOneTmpSnsrInvldLmt_C "" VALUE 0x70010c84 Scalar_FLOAT32_IEEE 0 VBU0428Test_CM_single_cnt -3.4028234663852886E+38 3.4028234663852886E+38 /end CHARACTERISTIC
/begin CHARACTERISTIC DCH_iCMLMinChCurr_C "" VALUE 0x70010c9c Scalar_FLOAT32_IEEE 0 VBU0428Test_CM_single_cnt -3.4028234663852886E+38 3.4028234663852886E+38 /end CHARACTERISTIC
/begin CHARACTERISTIC DCH_iDCChOneSnsrInvldCrntLmt_C "" VALUE 0x70010ca0 Scalar_FLOAT32_IEEE 0 VBU0428Test_CM_single_cnt -3.4028234663852886E+38 3.4028234663852886E+38 /end CHARACTERISTIC
/begin CHARACTERISTIC DCH_iDCChPortFailureChCurr_C "" VALUE 0x70010ca4 Scalar_FLOAT32_IEEE 0 VBU0428Test_CM_single_cnt -3.4028234663852886E+38 3.4028234663852886E+38 /end CHARACTERISTIC
/begin CHARACTERISTIC DCH_iDCChReqLowLim_C "" VALUE 0x70010ca8 Scalar_FLOAT32_IEEE 0 VBU0428Test_CM_single_cnt -3.4028234663852886E+38 3.4028234663852886E+38 /end CHARACTERISTIC
/begin CHARACTERISTIC DCH_iDCChReqUpLim_C "" VALUE 0x70010cac Scalar_FLOAT32_IEEE 0 VBU0428Test_CM_single_cnt -3.4028234663852886E+38 3.4028234663852886E+38 /end CHARACTERISTIC
/begin CHARACTERISTIC DCH_iStatnLackCrnntThres_C "" VALUE 0x70010cb8 Scalar_FLOAT32_IEEE 0 VBU0428Test_CM_single_cnt -3.4028234663852886E+38 3.4028234663852886E+38 /end CHARACTERISTIC
/begin CHARACTERISTIC DCH_tLimitChrCrnntLvl1L_C "" VALUE 0x70010d5c Scalar_FLOAT32_IEEE 0 VBU0428Test_CM_single_cnt -3.4028234663852886E+38 3.4028234663852886E+38 /end CHARACTERISTIC
/begin CHARACTERISTIC DCH_tLimitChrCrnntLvl1R_C "" VALUE 0x70010d60 Scalar_FLOAT32_IEEE 0 VBU0428Test_CM_single_cnt -3.4028234663852886E+38 3.4028234663852886E+38 /end CHARACTERISTIC
/begin CHARACTERISTIC DCH_tLimitChrCrnntLvl2L_C "" VALUE 0x70010d64 Scalar_FLOAT32_IEEE 0 VBU0428Test_CM_single_cnt -3.4028234663852886E+38 3.4028234663852886E+38 /end CHARACTERISTIC
/begin CHARACTERISTIC DCH_tLimitChrCrnntLvl2R_C "" VALUE 0x70010d68 Scalar_FLOAT32_IEEE 0 VBU0428Test_CM_single_cnt -3.4028234663852886E+38 3.4028234663852886E+38 /end CHARACTERISTIC
/begin CHARACTERISTIC DCH_tLimitChrCrnntLvl3L_C "" VALUE 0x70010d6c Scalar_FLOAT32_IEEE 0 VBU0428Test_CM_single_cnt -3.4028234663852886E+38 3.4028234663852886E+38 /end CHARACTERISTIC
/begin CHARACTERISTIC DCH_tLimitChrCrnntLvl3R_C "" VALUE 0x70010d70 Scalar_FLOAT32_IEEE 0 VBU0428Test_CM_single_cnt -3.4028234663852886E+38 3.4028234663852886E+38 /end CHARACTERISTIC
/begin CHARACTERISTIC DCH_tiSmplT_SY "" VALUE 0x70010df0 Scalar_FLOAT32_IEEE 0 VBU0428Test_CM_single_cnt -3.4028234663852886E+38 3.4028234663852886E+38 /end CHARACTERISTIC
/begin CHARACTERISTIC DCH_tiStatnLackCrnntThres_C "" VALUE 0x70010df4 Scalar_FLOAT32_IEEE 0 VBU0428Test_CM_single_cnt -3.4028234663852886E+38 3.4028234663852886E+38 /end CHARACTERISTIC
/begin CHARACTERISTIC WATS_PER_KILOWAT "" VALUE 0x70011a30 Scalar_FLOAT32_IEEE 0 VBU0428Test_CM_single_cnt -3.4028234663852886E+38 3.4028234663852886E+38 /end CHARACTERISTIC
/begin CHARACTERISTIC CaCVT_CellVoltageOverDeviationCurrentMapDimension_n "" VAL_BLK 0x70011a3a Scalar_ULONG 0 VBU0428Test_CM_uint32_cnt 0.0 4.294967295E+9 NUMBER 2 /end CHARACTERISTIC
/begin CHARACTERISTIC CaSOC_OcvShortTimeChMapDimension_n "" VAL_BLK 0x70011a4a Scalar_ULONG 0 VBU0428Test_CM_uint32_cnt 0.0 4.294967295E+9 NUMBER 2 /end CHARACTERISTIC
/begin CHARACTERISTIC CaSOC_OcvShortTimeDisMapDimension_n "" VAL_BLK 0x70011a52 Scalar_ULONG 0 VBU0428Test_CM_uint32_cnt 0.0 4.294967295E+9 NUMBER 2 /end CHARACTERISTIC
/begin CHARACTERISTIC CaSOC_OcvSocMapDimension_n "" VAL_BLK 0x70011a5a Scalar_ULONG 0 VBU0428Test_CM_uint32_cnt 0.0 4.294967295E+9 NUMBER 2 /end CHARACTERISTIC
/begin CHARACTERISTIC CaSOF_ChargePowerSlopeSocTempMapDimension_n "" VAL_BLK 0x70011a7a Scalar_ULONG 0 VBU0428Test_CM_uint32_cnt 0.0 4.294967295E+9 NUMBER 2 /end CHARACTERISTIC
/begin CHARACTERISTIC CaSOF_DischargePowerSlopeSocTempMapDimension_n "" VAL_BLK 0x70011ab2 Scalar_ULONG 0 VBU0428Test_CM_uint32_cnt 0.0 4.294967295E+9 NUMBER 2 /end CHARACTERISTIC
/begin CHARACTERISTIC CcCVT_CellOverVoltageWarningDebounce_ms "" VALUE 0x700106a8 Scalar_ULONG 0 VBU0428Test_CM_uint32_ms 0.0 4.294967295E+9 /end CHARACTERISTIC
/begin CHARACTERISTIC CcRTC_ActualTimeDeviationThreshold_s "" VALUE 0x7001079c Scalar_ULONG 0 VBU0428Test_CM_uint32_cnt 0.0 4.294967295E+9 /end CHARACTERISTIC
/begin CHARACTERISTIC CcSOC_BatteryCapacity10Cycles_n "" VALUE 0x700107b8 Scalar_ULONG 0 VBU0428Test_CM_uint32_cnt 0.0 4.294967295E+9 /end CHARACTERISTIC
/begin CHARACTERISTIC CcSOC_BatteryCapacity70Cycles_n "" VALUE 0x700107bc Scalar_ULONG 0 VBU0428Test_CM_uint32_cnt 0.0 4.294967295E+9 /end CHARACTERISTIC
/begin CHARACTERISTIC CcSOC_OcvShortTimeDisChDiff_n "" VALUE 0x70010864 Scalar_ULONG 0 VBU0428Test_CM_uint32_cnt 0.0 4.294967295E+9 /end CHARACTERISTIC
/begin CHARACTERISTIC CcTHM_BatteryCapacityCycle_n "" VALUE 0x70010ab8 Scalar_ULONG 0 VBU0428Test_CM_uint32_cnt 0.0 4.294967295E+9 /end CHARACTERISTIC
/begin CHARACTERISTIC CcVCT_BMSProtocalVersion_n "" VALUE 0x70010b94 Scalar_ULONG 0 VBU0428Test_CM_uint32_n 0.0 4.294967295E+9 /end CHARACTERISTIC
/begin CHARACTERISTIC THM_INLET_COOLANT_SENSOR_OOR_HIGH_FAULT "" VALUE 0x70011654 Scalar_ULONG 0 VBU0428Test_CM_uint32_cnt 0.0 4.294967295E+9 /end CHARACTERISTIC
/begin CHARACTERISTIC THM_INLET_COOLANT_SENSOR_OOR_LOW_FAULT "" VALUE 0x70011658 Scalar_ULONG 0 VBU0428Test_CM_uint32_cnt 0.0 4.294967295E+9 /end CHARACTERISTIC
/begin CHARACTERISTIC THM_INLET_OUTLET_TEMP_DELTA_FAULT "" VALUE 0x7001165c Scalar_ULONG 0 VBU0428Test_CM_uint32_cnt 0.0 4.294967295E+9 /end CHARACTERISTIC
/begin CHARACTERISTIC THM_OUTLET_COOLANT_SENSOR_OOR_HIGH_FAULT "" VALUE 0x70011660 Scalar_ULONG 0 VBU0428Test_CM_uint32_cnt 0.0 4.294967295E+9 /end CHARACTERISTIC
/begin CHARACTERISTIC THM_OUTLET_COOLANT_SENSOR_OOR_LOW_FAULT "" VALUE 0x70011664 Scalar_ULONG 0 VBU0428Test_CM_uint32_cnt 0.0 4.294967295E+9 /end CHARACTERISTIC
/begin CHARACTERISTIC CcCVT_BDMOutputDelayTime_ms "" VALUE 0x70010072 Scalar_UWORD 0 VBU0428Test_CM_uint16_ms 0.0 65535.0 /end CHARACTERISTIC
/begin CHARACTERISTIC CcCVT_CellOverVoltageEVMFault_mV "" VALUE 0x7001007e Scalar_UWORD 0 VBU0428Test_CM_uint16_mV 0.0 65535.0 /end CHARACTERISTIC
/begin CHARACTERISTIC CcCVT_CellOverVoltageFault_mV "" VALUE 0x70010080 Scalar_UWORD 0 VBU0428Test_CM_uint16_mV 0.0 65535.0 /end CHARACTERISTIC
/begin CHARACTERISTIC CcCVT_CellOverVoltageWarningFault_mV "" VALUE 0x70010082 Scalar_UWORD 0 VBU0428Test_CM_uint16_mV 0.0 65535.0 /end CHARACTERISTIC
/begin CHARACTERISTIC CcCVT_CellUnderVoltageEVMFault_mV "" VALUE 0x70010084 Scalar_UWORD 0 VBU0428Test_CM_uint16_mV 0.0 65535.0 /end CHARACTERISTIC
/begin CHARACTERISTIC CcCVT_CellUnderVoltageFaultLevel2_mV "" VALUE 0x70010086 Scalar_UWORD 0 VBU0428Test_CM_uint16_mV 0.0 65535.0 /end CHARACTERISTIC
/begin CHARACTERISTIC CcCVT_CellUnderVoltageFault_mV "" VALUE 0x70010088 Scalar_UWORD 0 VBU0428Test_CM_uint16_mV 0.0 65535.0 /end CHARACTERISTIC
/begin CHARACTERISTIC CcCVT_CellVoltageInvalidFaultDelayTime_ms "" VALUE 0x7001008a Scalar_UWORD 0 VBU0428Test_CM_uint16_ms 0.0 65535.0 /end CHARACTERISTIC
/begin CHARACTERISTIC CcCVT_CellVoltageOverDeviationCurrentDelay_s "" VALUE 0x7001008c Scalar_UWORD 0 VBU0428Test_CM_uint16_s 0.0 65535.0 /end CHARACTERISTIC
/begin CHARACTERISTIC CcCVT_CellVoltageOverDeviationEVMFault_mV "" VALUE 0x7001008e Scalar_UWORD 0 VBU0428Test_CM_uint16_mV 0.0 65535.0 /end CHARACTERISTIC
/begin CHARACTERISTIC CcCVT_CellVoltageOverDeviationFault_mV "" VALUE 0x70010090 Scalar_UWORD 0 VBU0428Test_CM_uint16_mV 0.0 65535.0 /end CHARACTERISTIC
/begin CHARACTERISTIC CcDSM_DiverCycleflgDelayTime_ms "" VALUE 0x70010092 Scalar_UWORD 0 VBU0428Test_CM_uint16_cnt 0.0 65535.0 /end CHARACTERISTIC
/begin CHARACTERISTIC CcFCC_ChargeCompleteComfirmDelay_ms "" VALUE 0x7001009a Scalar_UWORD 0 VBU0428Test_CM_uint16_cnt 0.0 65535.0 /end CHARACTERISTIC
/begin CHARACTERISTIC CcISO_DCStationFaultDelayTime_ms "" VALUE 0x700100b0 Scalar_UWORD 0 VBU0428Test_CM_uint16_ms 0.0 65535.0 /end CHARACTERISTIC
/begin CHARACTERISTIC CcOCV_RelaxationMinRequiredTime_s "" VALUE 0x700100b4 Scalar_UWORD 0 VBU0428Test_CM_uint16_cnt 0.0 65535.0 /end CHARACTERISTIC
/begin CHARACTERISTIC CcOCV_RelaxationRequiredShortTime_s "" VALUE 0x700100b6 Scalar_UWORD 0 VBU0428Test_CM_uint16_cnt 0.0 65535.0 /end CHARACTERISTIC
/begin CHARACTERISTIC CcSOC_BDMOutputDelayTime_ms "" VALUE 0x700100bc Scalar_UWORD 0 VBU0428Test_CM_uint16_cnt 0.0 65535.0 /end CHARACTERISTIC
/begin CHARACTERISTIC CcSOC_OcvCorrectionIntervalTime_s "" VALUE 0x700100c4 Scalar_UWORD 0 VBU0428Test_CM_uint16_cnt 0.0 65535.0 /end CHARACTERISTIC
/begin CHARACTERISTIC CcSOC_OcvShortTimeCorrIntervalTime_s "" VALUE 0x700100c6 Scalar_UWORD 0 VBU0428Test_CM_uint16_cnt 0.0 65535.0 /end CHARACTERISTIC
/begin CHARACTERISTIC CcSOC_OcvShortTimeVolDiffCh_mV "" VALUE 0x700100c8 Scalar_UWORD 0 VBU0428Test_CM_uint16_cnt 0.0 65535.0 /end CHARACTERISTIC
/begin CHARACTERISTIC CcSOC_OcvShortTimeVolDiffThreshold_mV "" VALUE 0x700100ca Scalar_UWORD 0 VBU0428Test_CM_uint16_cnt 0.0 65535.0 /end CHARACTERISTIC
/begin CHARACTERISTIC CcSOC_OcvShortTimeVolThreshold_mV "" VALUE 0x700100cc Scalar_UWORD 0 VBU0428Test_CM_uint16_cnt 0.0 65535.0 /end CHARACTERISTIC
/begin CHARACTERISTIC CcSOC_SocInitializationDelayTime_ms "" VALUE 0x700100d2 Scalar_UWORD 0 VBU0428Test_CM_uint16_cnt 0.0 65535.0 /end CHARACTERISTIC
/begin CHARACTERISTIC CcSOC_SocInitializationMaxTime_ms "" VALUE 0x700100d4 Scalar_UWORD 0 VBU0428Test_CM_uint16_cnt 0.0 65535.0 /end CHARACTERISTIC
/begin CHARACTERISTIC CcSOE_SocInitializationMaxTime_ms "" VALUE 0x700100d6 Scalar_UWORD 0 VBU0428Test_CM_uint16_cnt 0.0 65535.0 /end CHARACTERISTIC
/begin CHARACTERISTIC CcSOF_ChargePowerViolationCurrentDelay_s "" VALUE 0x700100e8 Scalar_UWORD 0 VBU0428Test_CM_uint16_cnt 0.0 65535.0 /end CHARACTERISTIC
/begin CHARACTERISTIC CcSOF_LowTempOverCurrentCount_C "" VALUE 0x700100ec Scalar_UWORD 0 VBU0428Test_CM_uint16_cnt 0.0 65535.0 /end CHARACTERISTIC
/begin CHARACTERISTIC CcSYS_CellVoltageMaxLimit_mV "" VALUE 0x7001010e Scalar_UWORD 0 VBU0428Test_CM_uint16_mV 0.0 65535.0 /end CHARACTERISTIC
/begin CHARACTERISTIC CcTHM_BdmDelay_s "" VALUE 0x70010114 Scalar_UWORD 0 VBU0428Test_CM_uint16_cnt 0.0 65535.0 /end CHARACTERISTIC
/begin CHARACTERISTIC CcTHM_CoolingResponseDelay_s "" VALUE 0x7001011a Scalar_UWORD 0 VBU0428Test_CM_uint16_cnt 0.0 65535.0 /end CHARACTERISTIC
/begin CHARACTERISTIC CcTHM_InletResponseDebounce_s "" VALUE 0x7001011c Scalar_UWORD 0 VBU0428Test_CM_uint16_cnt 0.0 65535.0 /end CHARACTERISTIC
/begin CHARACTERISTIC MILIVOLTAGES_PER_VOLTAGE "" VALUE 0x70010130 Scalar_UWORD 0 VBU0428Test_CM_uint16_cnt 0.0 65535.0 /end CHARACTERISTIC
/begin CHARACTERISTIC SAMPLE_TIME_TASK_E "" VALUE 0x7001013a Scalar_UWORD 0 VBU0428Test_CM_uint16_cnt 0.0 65535.0 /end CHARACTERISTIC
/begin CHARACTERISTIC SOC_BATTERY_SOC_HIGH_FAULT "" VALUE 0x7001013e Scalar_UWORD 0 VBU0428Test_CM_uint16_cnt 0.0 65535.0 /end CHARACTERISTIC
/begin CHARACTERISTIC SOC_BATTERY_SOC_LOW_FAULT "" VALUE 0x70010140 Scalar_UWORD 0 VBU0428Test_CM_uint16_cnt 0.0 65535.0 /end CHARACTERISTIC
/begin CHARACTERISTIC ABS_flgMsg068ChksmDisbl_C "" VALUE 0x70021ef8 Scalar_BOOLEAN 0 VBU0428Test_CM_boolean_flg 0.0 1.0 /end CHARACTERISTIC
/begin CHARACTERISTIC ABS_flgMsg068RollCntDisbl_C "" VALUE 0x70021ef9 Scalar_BOOLEAN 0 VBU0428Test_CM_boolean_flg 0.0 1.0 /end CHARACTERISTIC
/begin CHARACTERISTIC ABS_flgMsg075ChksmDisbl_C "" VALUE 0x70021efa Scalar_BOOLEAN 0 VBU0428Test_CM_boolean_flg 0.0 1.0 /end CHARACTERISTIC
/begin CHARACTERISTIC ABS_flgMsg075RollCntDisbl_C "" VALUE 0x70021efb Scalar_BOOLEAN 0 VBU0428Test_CM_boolean_flg 0.0 1.0 /end CHARACTERISTIC
/begin CHARACTERISTIC ABS_flgMsg079ChksmDisbl_C "" VALUE 0x70021efc Scalar_BOOLEAN 0 VBU0428Test_CM_boolean_flg 0.0 1.0 /end CHARACTERISTIC
/begin CHARACTERISTIC ABS_flgMsg079RollCntDisbl_C "" VALUE 0x70021efd Scalar_BOOLEAN 0 VBU0428Test_CM_boolean_flg 0.0 1.0 /end CHARACTERISTIC
/begin CHARACTERISTIC ABS_flgMsg115ChksmDisbl_C "" VALUE 0x70021efe Scalar_BOOLEAN 0 VBU0428Test_CM_boolean_flg 0.0 1.0 /end CHARACTERISTIC
/begin CHARACTERISTIC ABS_flgMsg115RollCntDisbl_C "" VALUE 0x70021eff Scalar_BOOLEAN 0 VBU0428Test_CM_boolean_flg 0.0 1.0 /end CHARACTERISTIC
/begin CHARACTERISTIC AVAS_flgMsg1801D0D3ChksmDisbl_C "" VALUE 0x70021f5a Scalar_BOOLEAN 0 VBU0428Test_CM_boolean_flg 0.0 1.0 /end CHARACTERISTIC
/begin CHARACTERISTIC AVAS_flgMsg1801D0D3RollCntDisbl_C "" VALUE 0x70021f5b Scalar_BOOLEAN 0 VBU0428Test_CM_boolean_flg 0.0 1.0 /end CHARACTERISTIC
/begin CHARACTERISTIC BCM_flgMsg18FE0121ChksmDisbl_C "" VALUE 0x70021f6e Scalar_BOOLEAN 0 VBU0428Test_CM_boolean_flg 0.0 1.0 /end CHARACTERISTIC
/begin CHARACTERISTIC BCM_flgMsg18FE0121RollCntDisbl_C "" VALUE 0x70021f6f Scalar_BOOLEAN 0 VBU0428Test_CM_boolean_flg 0.0 1.0 /end CHARACTERISTIC
/begin CHARACTERISTIC CCU_flgMsg248ChksmDisbl_C "" VALUE 0x70021f93 Scalar_BOOLEAN 0 VBU0428Test_CM_boolean_flg 0.0 1.0 /end CHARACTERISTIC
/begin CHARACTERISTIC CCU_flgMsg248RollCntDisbl_C "" VALUE 0x70021f94 Scalar_BOOLEAN 0 VBU0428Test_CM_boolean_flg 0.0 1.0 /end CHARACTERISTIC
/begin CHARACTERISTIC CDC_flgMsg220ChksmDisbl_C "" VALUE 0x70021f95 Scalar_BOOLEAN 0 VBU0428Test_CM_boolean_flg 0.0 1.0 /end CHARACTERISTIC
/begin CHARACTERISTIC CDC_flgMsg220RollCntDisbl_C "" VALUE 0x70021f96 Scalar_BOOLEAN 0 VBU0428Test_CM_boolean_flg 0.0 1.0 /end CHARACTERISTIC
/begin CHARACTERISTIC CbDSM_AbnormalEventOvrValue_flg "" VALUE 0x70022049 Scalar_BOOLEAN 0 VBU0428Test_CM_boolean_cnt 0.0 1.0 /end CHARACTERISTIC
/begin CHARACTERISTIC CbDSM_AbnormalEventOvr_flg "" VALUE 0x7002204a Scalar_BOOLEAN 0 VBU0428Test_CM_boolean_cnt 0.0 1.0 /end CHARACTERISTIC
/begin CHARACTERISTIC CbDSM_ClearFaultData_flg "" VALUE 0x7002204b Scalar_BOOLEAN 0 VBU0428Test_CM_boolean_cnt 0.0 1.0 /end CHARACTERISTIC
/begin CHARACTERISTIC CbDSM_CscValueUncertainOvrValue_flg "" VALUE 0x7002204c Scalar_BOOLEAN 0 VBU0428Test_CM_boolean_cnt 0.0 1.0 /end CHARACTERISTIC
/begin CHARACTERISTIC CbDSM_CscValueUncertainOvr_flg "" VALUE 0x7002204d Scalar_BOOLEAN 0 VBU0428Test_CM_boolean_cnt 0.0 1.0 /end CHARACTERISTIC
/begin CHARACTERISTIC CbDSM_NoChargeOvrValue_flg "" VALUE 0x7002204e Scalar_BOOLEAN 0 VBU0428Test_CM_boolean_cnt 0.0 1.0 /end CHARACTERISTIC
/begin CHARACTERISTIC CbDSM_NoChargeOvr_flg "" VALUE 0x7002204f Scalar_BOOLEAN 0 VBU0428Test_CM_boolean_cnt 0.0 1.0 /end CHARACTERISTIC
/begin CHARACTERISTIC CbDSM_NoRestartOverride_flg "" VALUE 0x70022050 Scalar_BOOLEAN 0 VBU0428Test_CM_boolean_cnt 0.0 1.0 /end CHARACTERISTIC
/begin CHARACTERISTIC CbDSM_NoRestartOvrValue_flg "" VALUE 0x70022051 Scalar_BOOLEAN 0 VBU0428Test_CM_boolean_cnt 0.0 1.0 /end CHARACTERISTIC
/begin CHARACTERISTIC CbFCC_ChargeCurrentOverFaultEnable_flg "" VALUE 0x70022055 Scalar_BOOLEAN 0 VBU0428Test_CM_boolean_cnt 0.0 1.0 /end CHARACTERISTIC
/begin CHARACTERISTIC CbNVM_FirstRun_flg "" VALUE 0x7002205f Scalar_BOOLEAN 0 VBU0428Test_CM_boolean_cnt 0.0 1.0 /end CHARACTERISTIC
/begin CHARACTERISTIC CbRTC_flgActualTimeCheckEnable "" VALUE 0x70022061 Scalar_BOOLEAN 0 VBU0428Test_CM_boolean_cnt 0.0 1.0 /end CHARACTERISTIC
/begin CHARACTERISTIC CbSOC_BatterySocHighFaultEnable_flg "" VALUE 0x70022064 Scalar_BOOLEAN 0 VBU0428Test_CM_boolean_cnt 0.0 1.0 /end CHARACTERISTIC
/begin CHARACTERISTIC CbSOC_BatterySocLowFaultEnable_flg "" VALUE 0x70022065 Scalar_BOOLEAN 0 VBU0428Test_CM_boolean_cnt 0.0 1.0 /end CHARACTERISTIC
/begin CHARACTERISTIC CbSOC_CellArraySOCOvrdFlg_flg "" VALUE 0x70022066 Scalar_BOOLEAN 0 VBU0428Test_CM_boolean_cnt 0.0 1.0 /end CHARACTERISTIC
/begin CHARACTERISTIC CbSOC_OcvShortTime_flg "" VALUE 0x7002206b Scalar_BOOLEAN 0 VBU0428Test_CM_boolean_cnt 0.0 1.0 /end CHARACTERISTIC
/begin CHARACTERISTIC CbSOF_ChargePowerLimitViolationFaultEnable_flg "" VALUE 0x7002206d Scalar_BOOLEAN 0 VBU0428Test_CM_boolean_cnt 0.0 1.0 /end CHARACTERISTIC
/begin CHARACTERISTIC CbSOF_CurrentLimitFastChargeCheckEnable_flg "" VALUE 0x7002206e Scalar_BOOLEAN 0 VBU0428Test_CM_boolean_cnt 0.0 1.0 /end CHARACTERISTIC
/begin CHARACTERISTIC CbSOF_DischargePowerLimitViolationFaultEnable_flg "" VALUE 0x7002206f Scalar_BOOLEAN 0 VBU0428Test_CM_boolean_cnt 0.0 1.0 /end CHARACTERISTIC
/begin CHARACTERISTIC CbSYS_HomoTestEnable_flg "" VALUE 0x70022079 Scalar_BOOLEAN 0 VBU0428Test_CM_boolean_cnt 0.0 1.0 /end CHARACTERISTIC
/begin CHARACTERISTIC CbTHM_InletCoolantSensorOorHighFaultEnable_flg "" VALUE 0x7002207b Scalar_BOOLEAN 0 VBU0428Test_CM_boolean_cnt 0.0 1.0 /end CHARACTERISTIC
/begin CHARACTERISTIC CbTHM_InletCoolantSensorOorLowFaultEnable_flg "" VALUE 0x7002207c Scalar_BOOLEAN 0 VBU0428Test_CM_boolean_cnt 0.0 1.0 /end CHARACTERISTIC
/begin CHARACTERISTIC CbTHM_InletOutletTempDeltaFaultEnable_flg "" VALUE 0x7002207d Scalar_BOOLEAN 0 VBU0428Test_CM_boolean_cnt 0.0 1.0 /end CHARACTERISTIC
/begin CHARACTERISTIC CbTHM_OutletCoolantSensorOorHighFaultEnable_flg "" VALUE 0x7002207e Scalar_BOOLEAN 0 VBU0428Test_CM_boolean_cnt 0.0 1.0 /end CHARACTERISTIC
/begin CHARACTERISTIC CbTHM_OutletCoolantSensorOorLowFaultEnable_flg "" VALUE 0x7002207f Scalar_BOOLEAN 0 VBU0428Test_CM_boolean_cnt 0.0 1.0 /end CHARACTERISTIC
/begin CHARACTERISTIC CcRTC_EnableVCURtcCrection_flg "" VALUE 0x7002218b Scalar_BOOLEAN 0 VBU0428Test_CM_boolean_cnt 0.0 1.0 /end CHARACTERISTIC
/begin CHARACTERISTIC CcSOC_SOCPEnable_flg "" VALUE 0x70022190 Scalar_BOOLEAN 0 VBU0428Test_CM_boolean_cnt 0.0 1.0 /end CHARACTERISTIC
/begin CHARACTERISTIC CcTHM_TempRequestEnable_flg "" VALUE 0x700221b1 Scalar_BOOLEAN 0 VBU0428Test_CM_boolean_cnt 0.0 1.0 /end CHARACTERISTIC
/begin CHARACTERISTIC DCDC_flgMsg303ChksmDisbl_C "" VALUE 0x700221f7 Scalar_BOOLEAN 0 VBU0428Test_CM_boolean_flg 0.0 1.0 /end CHARACTERISTIC
/begin CHARACTERISTIC DCDC_flgMsg303RollCntDisbl_C "" VALUE 0x700221f8 Scalar_BOOLEAN 0 VBU0428Test_CM_boolean_flg 0.0 1.0 /end CHARACTERISTIC
/begin CHARACTERISTIC DCDC_flgMsg509ChksmDisbl_C "" VALUE 0x700221f9 Scalar_BOOLEAN 0 VBU0428Test_CM_boolean_flg 0.0 1.0 /end CHARACTERISTIC
/begin CHARACTERISTIC DCDC_flgMsg509RollCntDisbl_C "" VALUE 0x700221fa Scalar_BOOLEAN 0 VBU0428Test_CM_boolean_flg 0.0 1.0 /end CHARACTERISTIC
/begin CHARACTERISTIC EPB_flgMsg080ChksmDisbl_C "" VALUE 0x7002230c Scalar_BOOLEAN 0 VBU0428Test_CM_boolean_flg 0.0 1.0 /end CHARACTERISTIC
/begin CHARACTERISTIC EPB_flgMsg080RollCntDisbl_C "" VALUE 0x7002230d Scalar_BOOLEAN 0 VBU0428Test_CM_boolean_flg 0.0 1.0 /end CHARACTERISTIC
/begin CHARACTERISTIC EPS_flgMsg070ChksmDisbl_C "" VALUE 0x70022310 Scalar_BOOLEAN 0 VBU0428Test_CM_boolean_flg 0.0 1.0 /end CHARACTERISTIC
/begin CHARACTERISTIC EPS_flgMsg070RollCntDisbl_C "" VALUE 0x70022311 Scalar_BOOLEAN 0 VBU0428Test_CM_boolean_flg 0.0 1.0 /end CHARACTERISTIC
/begin CHARACTERISTIC IC_flgMsg401ChksmDisbl_C "" VALUE 0x70022367 Scalar_BOOLEAN 0 VBU0428Test_CM_boolean_flg 0.0 1.0 /end CHARACTERISTIC
/begin CHARACTERISTIC IC_flgMsg401RollCntDisbl_C "" VALUE 0x70022368 Scalar_BOOLEAN 0 VBU0428Test_CM_boolean_flg 0.0 1.0 /end CHARACTERISTIC
/begin CHARACTERISTIC MCU_flgMsg205ChksmDisbl_C "" VALUE 0x700223a7 Scalar_BOOLEAN 0 VBU0428Test_CM_boolean_flg 0.0 1.0 /end CHARACTERISTIC
/begin CHARACTERISTIC MCU_flgMsg205RollCntDisbl_C "" VALUE 0x700223a8 Scalar_BOOLEAN 0 VBU0428Test_CM_boolean_flg 0.0 1.0 /end CHARACTERISTIC
/begin CHARACTERISTIC MCU_flgMsg405ChksmDisbl_C "" VALUE 0x700223a9 Scalar_BOOLEAN 0 VBU0428Test_CM_boolean_flg 0.0 1.0 /end CHARACTERISTIC
/begin CHARACTERISTIC MCU_flgMsg405RollCntDisbl_C "" VALUE 0x700223aa Scalar_BOOLEAN 0 VBU0428Test_CM_boolean_flg 0.0 1.0 /end CHARACTERISTIC
/begin CHARACTERISTIC NVM_READ_SUCCESS "" VALUE 0x700223be Scalar_BOOLEAN 0 VBU0428Test_CM_boolean_cnt 0.0 1.0 /end CHARACTERISTIC
/begin CHARACTERISTIC PEUR_flgMsg305ChksmDisbl_C "" VALUE 0x700223c1 Scalar_BOOLEAN 0 VBU0428Test_CM_boolean_flg 0.0 1.0 /end CHARACTERISTIC
/begin CHARACTERISTIC PEUR_flgMsg305RollCntDisbl_C "" VALUE 0x700223c2 Scalar_BOOLEAN 0 VBU0428Test_CM_boolean_flg 0.0 1.0 /end CHARACTERISTIC
/begin CHARACTERISTIC PEUR_flgMsg505ChksmDisbl_C "" VALUE 0x700223c3 Scalar_BOOLEAN 0 VBU0428Test_CM_boolean_flg 0.0 1.0 /end CHARACTERISTIC
/begin CHARACTERISTIC PEUR_flgMsg505RollCntDisbl_C "" VALUE 0x700223c4 Scalar_BOOLEAN 0 VBU0428Test_CM_boolean_flg 0.0 1.0 /end CHARACTERISTIC
/begin CHARACTERISTIC SOC_flgOCVCorrection_C "" VALUE 0x70022416 Scalar_BOOLEAN 0 VBU0428Test_CM_boolean 0 1 /end CHARACTERISTIC
/begin CHARACTERISTIC SOC_flgOCValidOvrd_C "" VALUE 0x70022417 Scalar_BOOLEAN 0 VBU0428Test_CM_boolean 0 1 /end CHARACTERISTIC
/begin CHARACTERISTIC VCT_CHARGE_STATE_CHARGING "" VALUE 0x70022462 Scalar_BOOLEAN 0 VBU0428Test_CM_boolean_cnt 0.0 1.0 /end CHARACTERISTIC
/begin CHARACTERISTIC VCT_CHARGE_STATE_CHARGING_FAULT "" VALUE 0x70022463 Scalar_BOOLEAN 0 VBU0428Test_CM_boolean_cnt 0.0 1.0 /end CHARACTERISTIC
/begin CHARACTERISTIC VCT_CHARGE_STATE_NOT_CHARGING "" VALUE 0x70022465 Scalar_BOOLEAN 0 VBU0428Test_CM_boolean_cnt 0.0 1.0 /end CHARACTERISTIC
/begin CHARACTERISTIC CcCVT_CellOverVoltageEVMFaultFIC_n "" VALUE 0x7002216e Scalar_BYTE 0 VBU0428Test_CM_int8_n -128.0 127.0 /end CHARACTERISTIC
/begin CHARACTERISTIC CcCVT_CellOverVoltageEVMFaultPIC_n "" VALUE 0x7002216f Scalar_BYTE 0 VBU0428Test_CM_int8_n -128.0 127.0 /end CHARACTERISTIC
/begin CHARACTERISTIC CcCVT_CellOverVoltageFaultPIC_n "" VALUE 0x70022171 Scalar_BYTE 0 VBU0428Test_CM_int8_n -128.0 127.0 /end CHARACTERISTIC
/begin CHARACTERISTIC CcCVT_CellUnderVoltageEVMFaultFIC_n "" VALUE 0x70022172 Scalar_BYTE 0 VBU0428Test_CM_int8_n -128.0 127.0 /end CHARACTERISTIC
/begin CHARACTERISTIC CcCVT_CellUnderVoltageEVMFaultPIC_n "" VALUE 0x70022173 Scalar_BYTE 0 VBU0428Test_CM_int8_n -128.0 127.0 /end CHARACTERISTIC
/begin CHARACTERISTIC CcCVT_CellUnderVoltageFaultFIC_n "" VALUE 0x70022174 Scalar_BYTE 0 VBU0428Test_CM_int8_n -128.0 127.0 /end CHARACTERISTIC
/begin CHARACTERISTIC CcCVT_CellUnderVoltageFaultPIC_n "" VALUE 0x70022175 Scalar_BYTE 0 VBU0428Test_CM_int8_n -128.0 127.0 /end CHARACTERISTIC
/begin CHARACTERISTIC CcCVT_CellVoltageOverDeviationEVMFaultFIC_n "" VALUE 0x70022177 Scalar_BYTE 0 VBU0428Test_CM_int8_n -128.0 127.0 /end CHARACTERISTIC
/begin CHARACTERISTIC CcCVT_CellVoltageOverDeviationEVMFaultPIC_n "" VALUE 0x70022178 Scalar_BYTE 0 VBU0428Test_CM_int8_n -128.0 127.0 /end CHARACTERISTIC
/begin CHARACTERISTIC CcCVT_CellVoltageOverDeviationFaultFIC_n "" VALUE 0x70022179 Scalar_BYTE 0 VBU0428Test_CM_int8_n -128.0 127.0 /end CHARACTERISTIC
/begin CHARACTERISTIC CcCVT_CellVoltageOverDeviationFaultPIC_n "" VALUE 0x7002217a Scalar_BYTE 0 VBU0428Test_CM_int8_n -128.0 127.0 /end CHARACTERISTIC
/begin CHARACTERISTIC CcFCC_ChargeCurrentOverFaultFIC_n "" VALUE 0x7002217c Scalar_BYTE 0 VBU0428Test_CM_int8_cnt -128.0 127.0 /end CHARACTERISTIC
/begin CHARACTERISTIC CcFCC_ChargeCurrentOverFaultPIC_n "" VALUE 0x7002217d Scalar_BYTE 0 VBU0428Test_CM_int8_cnt -128.0 127.0 /end CHARACTERISTIC
/begin CHARACTERISTIC CcSOC_BatterySocHighFaultFIC_n "" VALUE 0x7002218c Scalar_BYTE 0 VBU0428Test_CM_int8_cnt -128.0 127.0 /end CHARACTERISTIC
/begin CHARACTERISTIC CcSOC_BatterySocHighFaultPIC_n "" VALUE 0x7002218d Scalar_BYTE 0 VBU0428Test_CM_int8_cnt -128.0 127.0 /end CHARACTERISTIC
/begin CHARACTERISTIC CcSOC_BatterySocLowFaultFIC_n "" VALUE 0x7002218e Scalar_BYTE 0 VBU0428Test_CM_int8_cnt -128.0 127.0 /end CHARACTERISTIC
/begin CHARACTERISTIC CcSOC_BatterySocLowFaultPIC_n "" VALUE 0x7002218f Scalar_BYTE 0 VBU0428Test_CM_int8_cnt -128.0 127.0 /end CHARACTERISTIC
/begin CHARACTERISTIC CcSOF_ChargePowerLimitViolationFIC_n "" VALUE 0x70022193 Scalar_BYTE 0 VBU0428Test_CM_int8_cnt -128.0 127.0 /end CHARACTERISTIC
/begin CHARACTERISTIC CcSOF_ChargePowerLimitViolationPIC_n "" VALUE 0x70022194 Scalar_BYTE 0 VBU0428Test_CM_int8_cnt -128.0 127.0 /end CHARACTERISTIC
/begin CHARACTERISTIC CcSOF_DischargePowerLimitViolationFIC_n "" VALUE 0x70022196 Scalar_BYTE 0 VBU0428Test_CM_int8_cnt -128.0 127.0 /end CHARACTERISTIC
/begin CHARACTERISTIC CcSOF_DischargePowerLimitViolationPIC_n "" VALUE 0x70022197 Scalar_BYTE 0 VBU0428Test_CM_int8_cnt -128.0 127.0 /end CHARACTERISTIC
/begin CHARACTERISTIC CcTHM_InletCoolantSensorOorHighFIC_n "" VALUE 0x700221a6 Scalar_BYTE 0 VBU0428Test_CM_int8_cnt -128.0 127.0 /end CHARACTERISTIC
/begin CHARACTERISTIC CcTHM_InletCoolantSensorOorHighPIC_n "" VALUE 0x700221a7 Scalar_BYTE 0 VBU0428Test_CM_int8_cnt -128.0 127.0 /end CHARACTERISTIC
/begin CHARACTERISTIC CcTHM_InletCoolantSensorOorLowFIC_n "" VALUE 0x700221a8 Scalar_BYTE 0 VBU0428Test_CM_int8_cnt -128.0 127.0 /end CHARACTERISTIC
/begin CHARACTERISTIC CcTHM_InletCoolantSensorOorLowPIC_n "" VALUE 0x700221a9 Scalar_BYTE 0 VBU0428Test_CM_int8_cnt -128.0 127.0 /end CHARACTERISTIC
/begin CHARACTERISTIC CcTHM_InletOutletTempDeltaFIC_n "" VALUE 0x700221aa Scalar_BYTE 0 VBU0428Test_CM_int8_cnt -128.0 127.0 /end CHARACTERISTIC
/begin CHARACTERISTIC CcTHM_InletOutletTempDeltaPIC_n "" VALUE 0x700221ab Scalar_BYTE 0 VBU0428Test_CM_int8_cnt -128.0 127.0 /end CHARACTERISTIC
/begin CHARACTERISTIC CcTHM_OutletCoolantSensorOorHighFIC_n "" VALUE 0x700221ac Scalar_BYTE 0 VBU0428Test_CM_int8_cnt -128.0 127.0 /end CHARACTERISTIC
/begin CHARACTERISTIC CcTHM_OutletCoolantSensorOorHighPIC_n "" VALUE 0x700221ad Scalar_BYTE 0 VBU0428Test_CM_int8_cnt -128.0 127.0 /end CHARACTERISTIC
/begin CHARACTERISTIC CcTHM_OutletCoolantSensorOorLowFIC_n "" VALUE 0x700221ae Scalar_BYTE 0 VBU0428Test_CM_int8_cnt -128.0 127.0 /end CHARACTERISTIC
/begin CHARACTERISTIC CcTHM_OutletCoolantSensorOorLowPIC_n "" VALUE 0x700221af Scalar_BYTE 0 VBU0428Test_CM_int8_cnt -128.0 127.0 /end CHARACTERISTIC
/begin CHARACTERISTIC CVT_CELL_VOLTAGE_OVER_DEVIATION_FAULT "" VALUE 0x70021ff0 Scalar_UBYTE 0 VBU0428Test_CM_uint8_cnt 0.0 255.0 /end CHARACTERISTIC
/begin CHARACTERISTIC CaDSM_FaultCat_enum "" VAL_BLK 0x700228c2 Scalar_UBYTE 0 VBU0428Test_CM_uint8_cnt 0.0 255.0 NUMBER 330 /end CHARACTERISTIC
/begin CHARACTERISTIC CbCVT_CellOverVoltageEVMFaultEnable_flg "" VALUE 0x70022043 Scalar_UBYTE 0 VBU0428Test_CM_uint8_cnt 0.0 255.0 /end CHARACTERISTIC
/begin CHARACTERISTIC CbCVT_CellOverVoltageFaultEnable_flg "" VALUE 0x70022044 Scalar_UBYTE 0 VBU0428Test_CM_uint8_cnt 0.0 255.0 /end CHARACTERISTIC
/begin CHARACTERISTIC CbCVT_CellUnderVoltageEVMFaultEnable_flg "" VALUE 0x70022045 Scalar_UBYTE 0 VBU0428Test_CM_uint8_cnt 0.0 255.0 /end CHARACTERISTIC
/begin CHARACTERISTIC CbCVT_CellUnderVoltageFaultEnable_flg "" VALUE 0x70022046 Scalar_UBYTE 0 VBU0428Test_CM_uint8_cnt 0.0 255.0 /end CHARACTERISTIC
/begin CHARACTERISTIC CbCVT_CellVoltageOverDeviationEVMFaultEnable_flg "" VALUE 0x70022047 Scalar_UBYTE 0 VBU0428Test_CM_uint8_cnt 0.0 255.0 /end CHARACTERISTIC
/begin CHARACTERISTIC CbCVT_CellVoltageOverDeviationFaultEnable_flg "" VALUE 0x70022048 Scalar_UBYTE 0 VBU0428Test_CM_uint8_cnt 0.0 255.0 /end CHARACTERISTIC
/begin CHARACTERISTIC CbSYS_AbnormalResetRecoverEnable_flg "" VALUE 0x70022078 Scalar_UBYTE 0 VBU0428Test_CM_uint8_cnt 0.0 255.0 /end CHARACTERISTIC
/begin CHARACTERISTIC CcCVT_CellOverVoltageFaultFIC_n "" VALUE 0x70022170 Scalar_UBYTE 0 VBU0428Test_CM_uint8_n 0.0 255.0 /end CHARACTERISTIC
/begin CHARACTERISTIC CcCVT_CellVoltageInvalidFault_n "" VALUE 0x70022176 Scalar_UBYTE 0 VBU0428Test_CM_uint8_n 0.0 255.0 /end CHARACTERISTIC
/begin CHARACTERISTIC CcSYS_NoOfInvalidCellTemps_n "" VALUE 0x700221a2 Scalar_UBYTE 0 VBU0428Test_CM_uint8_cnt 0.0 255.0 /end CHARACTERISTIC
/begin CHARACTERISTIC CeVCT_BMSBatteryType_enum "" VALUE 0x700221c0 Scalar_UBYTE 0 VBU0428Test_CM_uint8_enum 0.0 255.0 /end CHARACTERISTIC
/begin CHARACTERISTIC DCH_stBCLMode_SY "" VALUE 0x70022286 Scalar_UBYTE 0 VBU0428Test_CM_uint8_cnt 0.0 255.0 /end CHARACTERISTIC
/begin CHARACTERISTIC DCH_stChrgPortSnglSnsr_SY "" VALUE 0x700222a6 Scalar_UBYTE 0 VBU0428Test_CM_uint8_cnt 0.0 255.0 /end CHARACTERISTIC
/begin CHARACTERISTIC DCH_stChrgPortSnsrConfig_C "" VALUE 0x700222a7 Scalar_UBYTE 0 VBU0428Test_CM_uint8_cnt 0.0 15.0 /end CHARACTERISTIC
/begin CHARACTERISTIC DCH_stWaitCHMMode_SY "" VALUE 0x700222d9 Scalar_UBYTE 0 VBU0428Test_CM_uint8_cnt 0.0 255.0 /end CHARACTERISTIC
/begin CHARACTERISTIC FCC_STATE_ABORT_CHARGE "" VALUE 0x70022313 Scalar_UBYTE 0 VBU0428Test_CM_uint8_cnt 0.0 255.0 /end CHARACTERISTIC
/begin CHARACTERISTIC FCC_STATE_BMS_CLOSE_CONTACTORS "" VALUE 0x70022314 Scalar_UBYTE 0 VBU0428Test_CM_uint8_cnt 0.0 255.0 /end CHARACTERISTIC
/begin CHARACTERISTIC FCC_STATE_CHARGE_FAULT "" VALUE 0x70022315 Scalar_UBYTE 0 VBU0428Test_CM_uint8_cnt 0.0 255.0 /end CHARACTERISTIC
/begin CHARACTERISTIC FCC_STATE_CHARGE_FULL "" VALUE 0x70022316 Scalar_UBYTE 0 VBU0428Test_CM_uint8_cnt 0.0 255.0 /end CHARACTERISTIC
/begin CHARACTERISTIC FCC_STATE_CHARGE_PROTECTION "" VALUE 0x70022317 Scalar_UBYTE 0 VBU0428Test_CM_uint8_cnt 0.0 255.0 /end CHARACTERISTIC
/begin CHARACTERISTIC FCC_STATE_CHARGING "" VALUE 0x70022318 Scalar_UBYTE 0 VBU0428Test_CM_uint8_cnt 0.0 255.0 /end CHARACTERISTIC
/begin CHARACTERISTIC FCC_STATE_DEACTIVATE_DEVICES "" VALUE 0x70022319 Scalar_UBYTE 0 VBU0428Test_CM_uint8_cnt 0.0 255.0 /end CHARACTERISTIC
/begin CHARACTERISTIC FCC_STATE_STANDBY "" VALUE 0x7002231a Scalar_UBYTE 0 VBU0428Test_CM_uint8_cnt 0.0 255.0 /end CHARACTERISTIC
/begin CHARACTERISTIC FCC_STATE_SYSTEM_STATUS_CHECK "" VALUE 0x7002231b Scalar_UBYTE 0 VBU0428Test_CM_uint8_cnt 0.0 255.0 /end CHARACTERISTIC
/begin CHARACTERISTIC FCC_STATE_WAIT_VCU_COMMAND "" VALUE 0x7002231c Scalar_UBYTE 0 VBU0428Test_CM_uint8_cnt 0.0 255.0 /end CHARACTERISTIC
/begin CHARACTERISTIC NUMBER_OF_PARALLEL_CELLS_PER_MODULE "" VALUE 0x700223b7 Scalar_UBYTE 0 VBU0428Test_CM_uint8_cnt 0.0 255.0 /end CHARACTERISTIC
/begin CHARACTERISTIC NUMBER_OF_PARALLEL_MODULES "" VALUE 0x700223b8 Scalar_UBYTE 0 VBU0428Test_CM_uint8_cnt 0.0 255.0 /end CHARACTERISTIC
/begin CHARACTERISTIC SOF_DISCHARGE_OVER_POWER_FAULT "" VALUE 0x70022418 Scalar_UBYTE 0 VBU0428Test_CM_uint8_cnt 0.0 255.0 /end CHARACTERISTIC
/begin CHARACTERISTIC VCT_CHARGE_STATE_CHARGING_FULL "" VALUE 0x70022464 Scalar_UBYTE 0 VBU0428Test_CM_uint8_cnt 0.0 255.0 /end CHARACTERISTIC
/begin MEASUREMENT SOC_numLoadDefaultSOCCnt "" ULONG VBU0428Test_CM_uint32 0 0 0 4294967295 ECU_ADDRESS 0x6003baca /end MEASUREMENT
/begin MEASUREMENT OCV_tisRelaxationElapsedTime "" ULONG VBU0428Test_CM_uint32 0 0 0 4294967295 ECU_ADDRESS 0x90000164 /end MEASUREMENT
/begin MEASUREMENT FCC_timinEstimateChargeTime "" ULONG VBU0428Test_CM_uint32 0 0 0 4294967295 ECU_ADDRESS 0x6003bb7e /end MEASUREMENT
/begin MEASUREMENT FCC_timinEstimatePercTime "" ULONG VBU0428Test_CM_uint32 0 0 0 4294967295 ECU_ADDRESS 0x6003bb82 /end MEASUREMENT
/begin MEASUREMENT INP_fBattPresFrq "" FLOAT32_IEEE VBU0428Test_CM_single 0 0 -3.4E+38 3.4E+38 ECU_ADDRESS 0x9000014c /end MEASUREMENT
/begin MEASUREMENT INP_pctBattPresDty "" FLOAT32_IEEE VBU0428Test_CM_single 0 0 -3.4E+38 3.4E+38 ECU_ADDRESS 0x90000150 /end MEASUREMENT
/begin MEASUREMENT INP_pctHVILDty "" FLOAT32_IEEE VBU0428Test_CM_single 0 0 0.0 100.0 ECU_ADDRESS 0x6003bb8a /end MEASUREMENT
/begin MEASUREMENT INP_fHVILFrq "" FLOAT32_IEEE VBU0428Test_CM_single 0 0 -3.4E+38 3.4E+38 ECU_ADDRESS 0x6003bb86 /end MEASUREMENT
/begin MEASUREMENT INP_uDCCHCC2 "" FLOAT32_IEEE VBU0428Test_CM_single 0 0 0.0 30.0 ECU_ADDRESS 0x6003bf92 /end MEASUREMENT
/begin MEASUREMENT INP_tEDSInletCoolTemp "" FLOAT32_IEEE VBU0428Test_CM_single 0 0 -100.0 200.0 ECU_ADDRESS 0x6003be42 /end MEASUREMENT
/begin MEASUREMENT INP_tDCChPortNegTemp "" FLOAT32_IEEE VBU0428Test_CM_single 0 0 -100.0 200.0 ECU_ADDRESS 0x6003be3a /end MEASUREMENT
/begin MEASUREMENT INP_tDCChPortPosTemp "" FLOAT32_IEEE VBU0428Test_CM_single 0 0 -100.0 200.0 ECU_ADDRESS 0x6003be3e /end MEASUREMENT
/begin MEASUREMENT INP_uAccPed2 "" FLOAT32_IEEE VBU0428Test_CM_single 0 0 0.0 5000.0 ECU_ADDRESS 0x6003be4a /end MEASUREMENT
/begin MEASUREMENT INP_uAccPed1 "" FLOAT32_IEEE VBU0428Test_CM_single 0 0 0.0 5000.0 ECU_ADDRESS 0x6003be46 /end MEASUREMENT
/begin MEASUREMENT INP_pVacPres "" FLOAT32_IEEE VBU0428Test_CM_single 0 0 0.0 5000.0 ECU_ADDRESS 0x6003be36 /end MEASUREMENT
/begin MEASUREMENT INP_uBrkPres "" FLOAT32_IEEE VBU0428Test_CM_single 0 0 0.0 5000.0 ECU_ADDRESS 0x6003be4e /end MEASUREMENT
/begin MEASUREMENT DCH_iBMSDCChReqLim "" FLOAT32_IEEE VBU0428Test_CM_single 0 0 -3.4E+38 3.4E+38 ECU_ADDRESS 0x6003baea /end MEASUREMENT
/begin MEASUREMENT OP_pctLsACPump "" FLOAT32_IEEE VBU0428Test_CM_single 0 0 -3.4E+38 3.4E+38 ECU_ADDRESS 0x6003bbaa /end MEASUREMENT
/begin MEASUREMENT OP_fLsACPump "" FLOAT32_IEEE VBU0428Test_CM_single 0 0 -3.4E+38 3.4E+38 ECU_ADDRESS 0x6003bba6 /end MEASUREMENT
/begin MEASUREMENT DCDC_pwrLVOut "" FLOAT32_IEEE VBU0428Test_CM_single 0 0 -3.4E+38 3.4E+38 ECU_ADDRESS 0x90000108 /end MEASUREMENT
/begin MEASUREMENT DCDC_pwrHVInput "" FLOAT32_IEEE VBU0428Test_CM_single 0 0 -3.4E+38 3.4E+38 ECU_ADDRESS 0x90000104 /end MEASUREMENT
/begin MEASUREMENT PEUR_trqMaxLimit "" FLOAT32_IEEE VBU0428Test_CM_single 0 0 -3.4E+38 3.4E+38 ECU_ADDRESS 0x90000168 /end MEASUREMENT
/begin MEASUREMENT PEUR_trqAct "" FLOAT32_IEEE VBU0428Test_CM_single 0 0 -3.4E+38 3.4E+38 ECU_ADDRESS 0x6003bfbe /end MEASUREMENT
/begin MEASUREMENT THM_tInletTempRequest "" FLOAT32_IEEE VBU0428Test_CM_single 0 0 -3.4E+38 3.4E+38 ECU_ADDRESS 0x6003bfd2 /end MEASUREMENT
/begin MEASUREMENT SOE_pctCellSocEndPredict "" FLOAT32_IEEE VBU0428Test_CM_single 0 0 -3.4E+38 3.4E+38 ECU_ADDRESS 0x6003be6e /end MEASUREMENT
/begin MEASUREMENT SOE_kwhPackRemainingEnergy "" FLOAT32_IEEE VBU0428Test_CM_single 0 0 -3.4E+38 3.4E+38 ECU_ADDRESS 0x6003be66 /end MEASUREMENT
/begin MEASUREMENT SOF_kwsChargePowerLimitDeltaTotal "" FLOAT32_IEEE VBU0428Test_CM_single 0 0 -3.4E+38 3.4E+38 ECU_ADDRESS 0x6003bc5a /end MEASUREMENT
/begin MEASUREMENT SOF_kwDischargePowerShortPulseRated "" FLOAT32_IEEE VBU0428Test_CM_single 0 0 -3.4E+38 3.4E+38 ECU_ADDRESS 0x900001dc /end MEASUREMENT
/begin MEASUREMENT SOF_kwDischargePowerContinuousRated "" FLOAT32_IEEE VBU0428Test_CM_single 0 0 -3.4E+38 3.4E+38 ECU_ADDRESS 0x900001d0 /end MEASUREMENT
/begin MEASUREMENT SOF_kwDischargePowerLimitRated "" FLOAT32_IEEE VBU0428Test_CM_single 0 0 -3.4E+38 3.4E+38 ECU_ADDRESS 0x900001d8 /end MEASUREMENT
/begin MEASUREMENT SOF_kwChargePowerShortPulseRated "" FLOAT32_IEEE VBU0428Test_CM_single 0 0 -3.4E+38 3.4E+38 ECU_ADDRESS 0x900001c8 /end MEASUREMENT
/begin MEASUREMENT SOF_kwChargePowerContinuousRated "" FLOAT32_IEEE VBU0428Test_CM_single 0 0 -3.4E+38 3.4E+38 ECU_ADDRESS 0x900001bc /end MEASUREMENT
/begin MEASUREMENT SOF_kwChargePowerLimitRated "" FLOAT32_IEEE VBU0428Test_CM_single 0 0 -3.4E+38 3.4E+38 ECU_ADDRESS 0x900001c4 /end MEASUREMENT
/begin MEASUREMENT SOF_iAShortPulseDischargeCurrentRatedLimit "" FLOAT32_IEEE VBU0428Test_CM_single 0 0 -3.4E+38 3.4E+38 ECU_ADDRESS 0x900001b4 /end MEASUREMENT
/begin MEASUREMENT SOF_iAContinuousDischargeCurrentRatedLimit "" FLOAT32_IEEE VBU0428Test_CM_single 0 0 -3.4E+38 3.4E+38 ECU_ADDRESS 0x900001a8 /end MEASUREMENT
/begin MEASUREMENT SOF_iAShortPulseChargeCurrentRatedLimit "" FLOAT32_IEEE VBU0428Test_CM_single 0 0 -3.4E+38 3.4E+38 ECU_ADDRESS 0x900001b0 /end MEASUREMENT
/begin MEASUREMENT SOF_iAChargeContinuousCurrentRatedLimit "" FLOAT32_IEEE VBU0428Test_CM_single 0 0 -3.4E+38 3.4E+38 ECU_ADDRESS 0x9000019c /end MEASUREMENT
/begin MEASUREMENT SOF_iADischargeCurrentRatedLimit "" FLOAT32_IEEE VBU0428Test_CM_single 0 0 -3.4E+38 3.4E+38 ECU_ADDRESS 0x900001ac /end MEASUREMENT
/begin MEASUREMENT SOF_iAChargeCurrentRatedLimit "" FLOAT32_IEEE VBU0428Test_CM_single 0 0 -3.4E+38 3.4E+38 ECU_ADDRESS 0x900001a0 /end MEASUREMENT
/begin MEASUREMENT SOF_kwContinuousDischargePowerLimitBefoTarget "" FLOAT32_IEEE VBU0428Test_CM_single 0 0 -3.4E+38 3.4E+38 ECU_ADDRESS 0x6003bc42 /end MEASUREMENT
/begin MEASUREMENT SOF_kwDischargePowerLimitBefoTarget "" FLOAT32_IEEE VBU0428Test_CM_single 0 0 -3.4E+38 3.4E+38 ECU_ADDRESS 0x6003bc4a /end MEASUREMENT
/begin MEASUREMENT SOF_kwShortPulseDischargePowerLimitTarget "" FLOAT32_IEEE VBU0428Test_CM_single 0 0 -3.4E+38 3.4E+38 ECU_ADDRESS 0x6003bc56 /end MEASUREMENT
/begin MEASUREMENT SOF_kwShortPulseChargePowerLimitTarget "" FLOAT32_IEEE VBU0428Test_CM_single 0 0 -3.4E+38 3.4E+38 ECU_ADDRESS 0x6003bc52 /end MEASUREMENT
/begin MEASUREMENT SOF_kwContinuousChargePowerLimitTarget "" FLOAT32_IEEE VBU0428Test_CM_single 0 0 -3.4E+38 3.4E+38 ECU_ADDRESS 0x6003bc3e /end MEASUREMENT
/begin MEASUREMENT SOF_kwChargePowerLimitTarget "" FLOAT32_IEEE VBU0428Test_CM_single 0 0 -3.4E+38 3.4E+38 ECU_ADDRESS 0x6003bc3a /end MEASUREMENT
/begin MEASUREMENT SOF_kwChargePowerActual "" FLOAT32_IEEE VBU0428Test_CM_single 0 0 -3.4E+38 3.4E+38 ECU_ADDRESS 0x900001b8 /end MEASUREMENT
/begin MEASUREMENT SOF_kwChargePowerLimitDelta "" FLOAT32_IEEE VBU0428Test_CM_single 0 0 -3.4E+38 3.4E+38 ECU_ADDRESS 0x900001c0 /end MEASUREMENT
/begin MEASUREMENT SOF_kwDischargePowerActual "" FLOAT32_IEEE VBU0428Test_CM_single 0 0 -3.4E+38 3.4E+38 ECU_ADDRESS 0x900001cc /end MEASUREMENT
/begin MEASUREMENT SOF_kwDischargePowerLimitDelta "" FLOAT32_IEEE VBU0428Test_CM_single 0 0 -3.4E+38 3.4E+38 ECU_ADDRESS 0x900001d4 /end MEASUREMENT
/begin MEASUREMENT LaSOC_OcvSoc_pct "" FLOAT32_IEEE VBU0428Test_CM_single 0 0 0.0 100.0 ARRAY_SIZE 198 ECU_ADDRESS 0x600396a6 /end MEASUREMENT
/begin MEASUREMENT LaSOC_pctCellSocOcvShortTimeCorrection "" FLOAT32_IEEE VBU0428Test_CM_single 0 0 0.0 100.0 ARRAY_SIZE 198 ECU_ADDRESS 0x6003a306 /end MEASUREMENT
/begin MEASUREMENT SOC_pctCellSocMin "" FLOAT32_IEEE VBU0428Test_CM_single 0 0 -3.4E+38 3.4E+38 ECU_ADDRESS 0x6003bfca /end MEASUREMENT
/begin MEASUREMENT SOC_pctCellSocMax "" FLOAT32_IEEE VBU0428Test_CM_single 0 0 -3.4E+38 3.4E+38 ECU_ADDRESS 0x6003bbba /end MEASUREMENT
/begin MEASUREMENT SOC_pctCellSocAve "" FLOAT32_IEEE VBU0428Test_CM_single 0 0 -3.4E+38 3.4E+38 ECU_ADDRESS 0x6003bbb6 /end MEASUREMENT
/begin MEASUREMENT GaSOC_pctCellSoc "" FLOAT32_IEEE VBU0428Test_CM_single 0 0 -3.4E+38 3.4E+38 ARRAY_SIZE 198 ECU_ADDRESS 0x6003938e /end MEASUREMENT
/begin MEASUREMENT LaSOC_pctCellSocInitial "" FLOAT32_IEEE VBU0428Test_CM_single 0 0 0.0 100.0 ARRAY_SIZE 198 ECU_ADDRESS 0x60039fee /end MEASUREMENT
/begin MEASUREMENT SOC_pctNoJumpBatterySoc "" FLOAT32_IEEE VBU0428Test_CM_single 0 0 0.0 100.0 ECU_ADDRESS 0x6003bbbe /end MEASUREMENT
/begin MEASUREMENT SOC_numBatteryDisplaySocChargeDecRate "" FLOAT32_IEEE VBU0428Test_CM_single 0 0 -3.4E+38 3.4E+38 ECU_ADDRESS 0x6003bac6 /end MEASUREMENT
/begin MEASUREMENT SOC_numBatteryDisplaySocChargeIncRate "" FLOAT32_IEEE VBU0428Test_CM_single 0 0 -3.4E+38 3.4E+38 ECU_ADDRESS 0x90000178 /end MEASUREMENT
/begin MEASUREMENT SOC_pctBatteryDisplaySoc "" FLOAT32_IEEE VBU0428Test_CM_single 0 0 -3.4E+38 3.4E+38 ECU_ADDRESS 0x6003be62 /end MEASUREMENT
/begin MEASUREMENT SOC_pctBatterySoc "" FLOAT32_IEEE VBU0428Test_CM_single 0 0 -3.4E+38 3.4E+38 ECU_ADDRESS 0x6003bfc6 /end MEASUREMENT
/begin MEASUREMENT SOC_pctBatteryUsableSoc "" FLOAT32_IEEE VBU0428Test_CM_single 0 0 0.0 100.0 ECU_ADDRESS 0x6003bbb2 /end MEASUREMENT
/begin MEASUREMENT FCC_tisChargeFaultTimer "" FLOAT32_IEEE VBU0428Test_CM_single 0 0 -3.4E+38 3.4E+38 ECU_ADDRESS 0x6003bf82 /end MEASUREMENT
/begin MEASUREMENT FCC_tisChargeProtectTimer "" FLOAT32_IEEE VBU0428Test_CM_single 0 0 -3.4E+38 3.4E+38 ECU_ADDRESS 0x6003bf8a /end MEASUREMENT
/begin MEASUREMENT FCC_tisChargeFullTimer "" FLOAT32_IEEE VBU0428Test_CM_single 0 0 -3.4E+38 3.4E+38 ECU_ADDRESS 0x6003bf86 /end MEASUREMENT
/begin MEASUREMENT FCC_tisChargeAbortTimer "" FLOAT32_IEEE VBU0428Test_CM_single 0 0 -3.4E+38 3.4E+38 ECU_ADDRESS 0x6003bf7e /end MEASUREMENT
/begin MEASUREMENT FCC_timinActualRemainChargeTime "" FLOAT32_IEEE VBU0428Test_CM_single 0 0 -3.4E+38 3.4E+38 ECU_ADDRESS 0x9000013c /end MEASUREMENT
/begin MEASUREMENT CVT_uCellVoltagePack "" FLOAT32_IEEE VBU0428Test_CM_single 0 0 -3.4E+38 3.4E+38 ECU_ADDRESS 0x900000fc /end MEASUREMENT
/begin MEASUREMENT OP_fLsFan "" UWORD VBU0428Test_CM_uint16 0 0 0 65535 ECU_ADDRESS 0x9000146c /end MEASUREMENT
/begin MEASUREMENT OP_pctLsFan "" UWORD VBU0428Test_CM_uint16 0 0 0 65535 ECU_ADDRESS 0x90001472 /end MEASUREMENT
/begin MEASUREMENT OP_fLsHVIL1 "" UWORD VBU0428Test_CM_uint16 0 0 0 65535 ECU_ADDRESS 0x900016ea /end MEASUREMENT
/begin MEASUREMENT OP_pctLsHVIL1 "" UWORD VBU0428Test_CM_uint16 0 0 0 65535 ECU_ADDRESS 0x900016ec /end MEASUREMENT
/begin MEASUREMENT OP_fLsWaterPump1 "" UWORD VBU0428Test_CM_uint16 0 0 0 65535 ECU_ADDRESS 0x9000146e /end MEASUREMENT
/begin MEASUREMENT OP_pctLsWaterPump1 "" UWORD VBU0428Test_CM_uint16 0 0 0 65535 ECU_ADDRESS 0x90001474 /end MEASUREMENT
/begin MEASUREMENT OP_fLsWaterPump2 "" UWORD VBU0428Test_CM_uint16 0 0 0 65535 ECU_ADDRESS 0x90001470 /end MEASUREMENT
/begin MEASUREMENT OP_pctLsWaterPump2 "" UWORD VBU0428Test_CM_uint16 0 0 0 65535 ECU_ADDRESS 0x90001476 /end MEASUREMENT
/begin MEASUREMENT THM_ftInletCoolantSensorOorHigh "" UWORD VBU0428Test_CM_uint16 0 0 0 65535 ECU_ADDRESS 0x9000169a /end MEASUREMENT
/begin MEASUREMENT THM_ftInletCoolantSensorOorLow "" UWORD VBU0428Test_CM_uint16 0 0 0 65535 ECU_ADDRESS 0x9000169c /end MEASUREMENT
/begin MEASUREMENT THM_ftInletOutletTempDelta "" UWORD VBU0428Test_CM_uint16 0 0 0 65535 ECU_ADDRESS 0x9000169e /end MEASUREMENT
/begin MEASUREMENT THM_ftOutletCoolantSensorOorHigh "" UWORD VBU0428Test_CM_uint16 0 0 0 65535 ECU_ADDRESS 0x900016a0 /end MEASUREMENT
/begin MEASUREMENT THM_ftOutletCoolantSensorOorLow "" UWORD VBU0428Test_CM_uint16 0 0 0 65535 ECU_ADDRESS 0x900016a2 /end MEASUREMENT
/begin MEASUREMENT SOF_stDischargePowerLimitViolationFault "" UWORD VBU0428Test_CM_uint16 0 0 0 65535 ECU_ADDRESS 0x900016f2 /end MEASUREMENT
/begin MEASUREMENT SOF_stChargePowerLimitViolationFault "" UWORD VBU0428Test_CM_uint16 0 0 0 65535 ECU_ADDRESS 0x900016f0 /end MEASUREMENT
/begin MEASUREMENT SOC_numCellSocMaxID "" UWORD VBU0428Test_CM_uint16 0 0 0 65535 ECU_ADDRESS 0x90000ca2 /end MEASUREMENT
/begin MEASUREMENT GaCVT_CellVoltage_mV "" UWORD VBU0428Test_CM_uint16 0 0 0.0 5000.0 ARRAY_SIZE 198 ECU_ADDRESS 0x6003b73a /end MEASUREMENT
/begin MEASUREMENT CVT_mvCellVoltageSecondMin "" UWORD VBU0428Test_CM_uint16 0 0 0 65535 ECU_ADDRESS 0x900016e4 /end MEASUREMENT
/begin MEASUREMENT CVT_mvCellVoltageSecondMax "" UWORD VBU0428Test_CM_uint16 0 0 0 65535 ECU_ADDRESS 0x900016e2 /end MEASUREMENT
/begin MEASUREMENT CVT_mvCellVoltageMin "" UWORD VBU0428Test_CM_uint16 0 0 0.0 5000.0 ECU_ADDRESS 0x90000c92 /end MEASUREMENT
/begin MEASUREMENT CVT_mvCellVoltageMax "" UWORD VBU0428Test_CM_uint16 0 0 0.0 5000.0 ECU_ADDRESS 0x90000c88 /end MEASUREMENT
/begin MEASUREMENT CVT_mvCellVoltageAve "" UWORD VBU0428Test_CM_uint16 0 0 0 65535 ECU_ADDRESS 0x9000147a /end MEASUREMENT
/begin MEASUREMENT INP_stBattPresFrq "" UBYTE VBU0428Test_CM_uint8 0 0 0 255 ECU_ADDRESS 0x90001f7b /end MEASUREMENT
/begin MEASUREMENT INP_stBattPresDty "" UBYTE VBU0428Test_CM_uint8 0 0 0 255 ECU_ADDRESS 0x90001f7a /end MEASUREMENT
/begin MEASUREMENT INP_stHVILDty "" UBYTE VBU0428Test_CM_INP_stHVILDty 0 0 0.0 255.0 ECU_ADDRESS 0x90001d29 /end MEASUREMENT
/begin MEASUREMENT INP_stHVILFrq "" UBYTE VBU0428Test_CM_INP_stHVILFrq 0 0 0.0 255.0 ECU_ADDRESS 0x90001d2a /end MEASUREMENT
/begin MEASUREMENT SOH_stSohMonitor "" UBYTE VBU0428Test_CM_uint8 0 0 0 255 ECU_ADDRESS 0x90001f89 /end MEASUREMENT
/begin MEASUREMENT SOH_stResistanceIncRatio "" UBYTE VBU0428Test_CM_uint8 0 0 0 255 ECU_ADDRESS 0x90001f88 /end MEASUREMENT
/begin MEASUREMENT SOC_numCellSocMinID "" UBYTE VBU0428Test_CM_uint8 0 0 0 255 ECU_ADDRESS 0x90001f5c /end MEASUREMENT
/begin MEASUREMENT ISO_stIsolationEVM "" UBYTE VBU0428Test_CM_uint8 0 0 0.0 15.0 ECU_ADDRESS 0x90001d2c /end MEASUREMENT
/begin MEASUREMENT ISO_stIsolationLevel "" UBYTE VBU0428Test_CM_uint8 0 0 0.0 15.0 ECU_ADDRESS 0x90001d2d /end MEASUREMENT
/begin MEASUREMENT FCC_stChargeState "" UBYTE VBU0428Test_CM_uint8 0 0 0 255 ECU_ADDRESS 0x90001f37 /end MEASUREMENT
/begin MEASUREMENT FCC_stContactorRequest "" UBYTE VBU0428Test_CM_uint8 0 0 0 255 ECU_ADDRESS 0x90001f38 /end MEASUREMENT
/begin MEASUREMENT CVT_numCellVoltageSecondMinID "" UBYTE VBU0428Test_CM_uint8 0 0 0 255 ECU_ADDRESS 0x90001f71 /end MEASUREMENT
/begin MEASUREMENT CVT_numCellVoltageSecondMaxID "" UBYTE VBU0428Test_CM_uint8 0 0 0 255 ECU_ADDRESS 0x90001f70 /end MEASUREMENT
/begin MEASUREMENT CVT_numCellVoltageMinID "" UBYTE VBU0428Test_CM_uint8 0 0 0 255 ECU_ADDRESS 0x90001f6f /end MEASUREMENT
/begin MEASUREMENT CVT_numCellVoltageMaxID "" UBYTE VBU0428Test_CM_uint8 0 0 0 255 ECU_ADDRESS 0x90001f6e /end MEASUREMENT
/begin MEASUREMENT CVT_numInvalidCellVoltages "" UBYTE VBU0428Test_CM_uint8 0 0 0 255 ECU_ADDRESS 0x90001f72 /end MEASUREMENT
/begin MEASUREMENT INP_flgDriverACOn "" UBYTE VBU0428Test_CM_boolean 0 0 0.0 1.0 ECU_ADDRESS 0x90001d24 /end MEASUREMENT
/begin MEASUREMENT INP_flgCrankConfirm "" UBYTE VBU0428Test_CM_boolean 0 0 0 1 ECU_ADDRESS 0x90001f79 /end MEASUREMENT
/begin MEASUREMENT INP_flgACMidPresSwitch "" UBYTE VBU0428Test_CM_boolean 0 0 0.0 1.0 ECU_ADDRESS 0x90001d20 /end MEASUREMENT
/begin MEASUREMENT INP_flgGearH3 "" UBYTE VBU0428Test_CM_boolean 0 0 0.0 1.0 ECU_ADDRESS 0x90001d27 /end MEASUREMENT
/begin MEASUREMENT INP_flgGearH2 "" UBYTE VBU0428Test_CM_boolean 0 0 0.0 1.0 ECU_ADDRESS 0x90001d26 /end MEASUREMENT
/begin MEASUREMENT INP_flgGearH1 "" UBYTE VBU0428Test_CM_boolean 0 0 0.0 1.0 ECU_ADDRESS 0x90001d25 /end MEASUREMENT
/begin MEASUREMENT INP_flgBrkLmpSwt "" UBYTE VBU0428Test_CM_boolean 0 0 0.0 1.0 ECU_ADDRESS 0x90001d21 /end MEASUREMENT
/begin MEASUREMENT OD_LsMainRly "" UBYTE VBU0428Test_CM_boolean 0 0 0 1 ECU_ADDRESS 0x90001cb0 /end MEASUREMENT
/begin MEASUREMENT OD_flgVBUSleepEnable "" UBYTE VBU0428Test_CM_boolean 0 0 0 1 ECU_ADDRESS 0x90001f81 /end MEASUREMENT
/begin MEASUREMENT OD_HsWakeUp1 "" UBYTE VBU0428Test_CM_boolean 0 0 0 1 ECU_ADDRESS 0x90001f7f /end MEASUREMENT
/begin MEASUREMENT PEUR_flgMotrSpdVld "" UBYTE VBU0428Test_CM_boolean 0 0 0.0 1.0 ECU_ADDRESS 0x90001d38 /end MEASUREMENT
/begin MEASUREMENT THM_flgTempRequestValid "" UBYTE VBU0428Test_CM_boolean 0 0 0 1 ECU_ADDRESS 0x90001ea2 /end MEASUREMENT
/begin MEASUREMENT SOC_flgOcvShortTimeCorrectionComplete "" UBYTE VBU0428Test_CM_boolean 0 0 0.0 1.0 ECU_ADDRESS 0x90001d3f /end MEASUREMENT
/begin MEASUREMENT SOC_flgOcvShortTimeDisChDiff "" UBYTE VBU0428Test_CM_boolean 0 0 0.0 1.0 ECU_ADDRESS 0x90001d41 /end MEASUREMENT
/begin MEASUREMENT SOC_flgOcvShortTimeCorrection "" UBYTE VBU0428Test_CM_boolean 0 0 0.0 1.0 ECU_ADDRESS 0x90001d3e /end MEASUREMENT
/begin MEASUREMENT SOC_flgOcvShortTimeVolDirection "" UBYTE VBU0428Test_CM_boolean 0 0 0.0 1.0 ECU_ADDRESS 0x90001d42 /end MEASUREMENT
/begin MEASUREMENT SOC_flgStartupFilterDelay "" UBYTE VBU0428Test_CM_boolean 0 0 0.0 1.0 ECU_ADDRESS 0x90001d47 /end MEASUREMENT
/begin MEASUREMENT SOC_flgSocInitializationDelay "" UBYTE VBU0428Test_CM_boolean 0 0 0.0 1.0 ECU_ADDRESS 0x90001d45 /end MEASUREMENT
/begin MEASUREMENT SOC_flgCellSocCorrectionFinished "" UBYTE VBU0428Test_CM_boolean 0 0 0.0 1.0 ECU_ADDRESS 0x90001d3c /end MEASUREMENT
/begin MEASUREMENT SOC_flgSocInitializeComplete "" UBYTE VBU0428Test_CM_boolean 0 0 0.0 1.0 ECU_ADDRESS 0x90001d46 /end MEASUREMENT
/begin MEASUREMENT SOC_flgOcvCorrection "" UBYTE VBU0428Test_CM_boolean 0 0 0.0 1.0 ECU_ADDRESS 0x90001d3d /end MEASUREMENT
/begin MEASUREMENT SOC_flgCellDataValid "" UBYTE VBU0428Test_CM_boolean 0 0 0.0 1.0 ECU_ADDRESS 0x90001f5b /end MEASUREMENT
/begin MEASUREMENT OCV_flgOcvValid "" UBYTE VBU0428Test_CM_boolean 0 0 0 1 ECU_ADDRESS 0x90001d34 /end MEASUREMENT
/begin MEASUREMENT OCV_flgQuasiOcvValid "" UBYTE VBU0428Test_CM_boolean 0 0 0 1 ECU_ADDRESS 0x90001d36 /end MEASUREMENT
/begin MEASUREMENT OCV_flgOcvShortTimeValid "" UBYTE VBU0428Test_CM_boolean 0 0 0.0 1.0 ECU_ADDRESS 0x90001f3b /end MEASUREMENT
/begin MEASUREMENT NVM_flgActualTimeInit "" UBYTE VBU0428Test_CM_boolean 0 0 0 1 ECU_ADDRESS 0x90001d30 /end MEASUREMENT
/begin MEASUREMENT NVM_flgNVMRestoreRequest "" UBYTE VBU0428Test_CM_boolean 0 0 0.0 1.0 ECU_ADDRESS 0x90001d31 /end MEASUREMENT
/begin MEASUREMENT NVM_flgNVMReadComplete "" UBYTE VBU0428Test_CM_boolean 0 0 0 1 ECU_ADDRESS 0x90001e87 /end MEASUREMENT
/begin MEASUREMENT ISO_flgIsolationStatus "" UBYTE VBU0428Test_CM_boolean 0 0 0.0 1.0 ECU_ADDRESS 0x90001d2b /end MEASUREMENT
/begin MEASUREMENT FCC_flgChargeTerminated "" UBYTE VBU0428Test_CM_boolean 0 0 0.0 1.0 ECU_ADDRESS 0x90001d08 /end MEASUREMENT
/begin MEASUREMENT DSM_flgNoRestart "" UBYTE VBU0428Test_CM_boolean 0 0 0.0 1.0 ECU_ADDRESS 0x90001f35 /end MEASUREMENT
/begin MEASUREMENT DSM_flgNoCharge "" UBYTE VBU0428Test_CM_boolean 0 0 0 1 ECU_ADDRESS 0x90001cfe /end MEASUREMENT
/begin MEASUREMENT DSM_flgDriverCycleActive "" UBYTE VBU0428Test_CM_boolean 0 0 0.0 1.0 ECU_ADDRESS 0x90001cfc /end MEASUREMENT
/begin MEASUREMENT DSM_flgCscValueUncertain "" UBYTE VBU0428Test_CM_boolean 0 0 0 1 ECU_ADDRESS 0x90001cfb /end MEASUREMENT
/begin MEASUREMENT DSM_flgCycleUploadAbnormalEvent "" UBYTE VBU0428Test_CM_boolean 0 0 0 1 ECU_ADDRESS 0x90001df8 /end MEASUREMENT
/begin MEASUREMENT GaCVT_CellVoltageValid_flg "" UBYTE VBU0428Test_CM_boolean 0 0 0.0 1.0 ARRAY_SIZE 198 ECU_ADDRESS 0x90000f37 /end MEASUREMENT
/begin MEASUREMENT EcOCV_RelaxationStartTime_s "" ULONG VBU0428Test_CM_uint32 0 0 0 4294967295 ECU_ADDRESS 0x6003bb66 /end MEASUREMENT
/begin COMPU_METHOD VBU0428Test_CM_single_cnt "Q = V" RAT_FUNC "%8.6" "cnt" COEFFS 0 1 0 0 0 1 /end COMPU_METHOD
/begin COMPU_METHOD VBU0428Test_CM_uint16_cnt "Q = V" RAT_FUNC "%5.0" "cnt" COEFFS 0 1 0 0 0 1 /end COMPU_METHOD
/begin COMPU_METHOD VBU0428Test_CM_single_pct "Q = V" RAT_FUNC "%8.6" "pct" COEFFS 0 1 0 0 0 1 /end COMPU_METHOD
/begin COMPU_METHOD VBU0428Test_CM_single_A "Q = V" RAT_FUNC "%8.6" "A" COEFFS 0 1 0 0 0 1 /end COMPU_METHOD
/begin COMPU_METHOD VBU0428Test_CM_uint8 "Q = V" RAT_FUNC "%3.0" "" COEFFS 0 1 0 0 0 1 /end COMPU_METHOD
/begin COMPU_METHOD VBU0428Test_CM_single_V "Q = V" RAT_FUNC "%8.6" "V" COEFFS 0 1 0 0 0 1 /end COMPU_METHOD
/begin COMPU_METHOD VBU0428Test_CM_uint16 "Q = V" RAT_FUNC "%5.0" "" COEFFS 0 1 0 0 0 1 /end COMPU_METHOD
/begin COMPU_METHOD VBU0428Test_CM_single "Q = V" RAT_FUNC "%8.6" "" COEFFS 0 1 0 0 0 1 /end COMPU_METHOD
/begin COMPU_METHOD VBU0428Test_CM_single_single "Q = V" RAT_FUNC "%8.6" "single" COEFFS 0 1 0 0 0 1 /end COMPU_METHOD
/begin COMPU_METHOD VBU0428Test_CM_single_Ah "Q = V" RAT_FUNC "%8.6" "Ah" COEFFS 0 1 0 0 0 1 /end COMPU_METHOD
/begin COMPU_METHOD VBU0428Test_CM_single_ms "Q = V" RAT_FUNC "%8.6" "ms" COEFFS 0 1 0 0 0 1 /end COMPU_METHOD
/begin COMPU_METHOD VBU0428Test_CM_uint32_cnt "Q = V" RAT_FUNC "%10.0" "cnt" COEFFS 0 1 0 0 0 1 /end COMPU_METHOD
/begin COMPU_METHOD VBU0428Test_CM_uint32_ms "Q = V" RAT_FUNC "%10.0" "ms" COEFFS 0 1 0 0 0 1 /end COMPU_METHOD
/begin COMPU_METHOD VBU0428Test_CM_uint32_n "Q = V" RAT_FUNC "%10.0" "n" COEFFS 0 1 0 0 0 1 /end COMPU_METHOD
/begin COMPU_METHOD VBU0428Test_CM_uint32 "Q = V" RAT_FUNC "%10.0" "" COEFFS 0 1 0 0 0 1 /end COMPU_METHOD
/begin COMPU_METHOD VBU0428Test_CM_uint16_ms "Q = V" RAT_FUNC "%5.0" "ms" COEFFS 0 1 0 0 0 1 /end COMPU_METHOD
/begin COMPU_METHOD VBU0428Test_CM_uint16_mV "Q = V" RAT_FUNC "%5.0" "mV" COEFFS 0 1 0 0 0 1 /end COMPU_METHOD
/begin COMPU_METHOD VBU0428Test_CM_uint16_s "Q = V" RAT_FUNC "%5.0" "s" COEFFS 0 1 0 0 0 1 /end COMPU_METHOD
/begin COMPU_METHOD VBU0428Test_CM_boolean_flg "Q = V" RAT_FUNC "%1.0" "flg" COEFFS 0 1 0 0 0 1 /end COMPU_METHOD
/begin COMPU_METHOD VBU0428Test_CM_boolean_cnt "Q = V" RAT_FUNC "%1.0" "cnt" COEFFS 0 1 0 0 0 1 /end COMPU_METHOD
/begin COMPU_METHOD VBU0428Test_CM_boolean "Q = V" RAT_FUNC "%1.0" "" COEFFS 0 1 0 0 0 1 /end COMPU_METHOD
/begin COMPU_METHOD VBU0428Test_CM_int8_cnt "Q = V" RAT_FUNC "%3.0" "cnt" COEFFS 0 1 0 0 0 1 /end COMPU_METHOD
/begin COMPU_METHOD VBU0428Test_CM_int8_n "Q = V" RAT_FUNC "%3.0" "n" COEFFS 0 1 0 0 0 1 /end COMPU_METHOD
/begin COMPU_METHOD VBU0428Test_CM_uint8_cnt "Q = V" RAT_FUNC "%3.0" "cnt" COEFFS 0 1 0 0 0 1 /end COMPU_METHOD
/begin COMPU_METHOD VBU0428Test_CM_uint8_n "Q = V" RAT_FUNC "%3.0" "n" COEFFS 0 1 0 0 0 1 /end COMPU_METHOD
/begin COMPU_METHOD VBU0428Test_CM_uint8_enum "Q = V" RAT_FUNC "%3.0" "enum" COEFFS 0 1 0 0 0 1 /end COMPU_METHOD
/begin COMPU_METHOD VBU0428Test_CM_INP_stHVILDty "" TAB_VERB "%0.6" "" /* Conversion Table */ COMPU_TAB_REF VTAB_FOR_VBU0428Test_CM_INP_stHVILDty /end COMPU_METHOD
/begin COMPU_VTAB /* Name of Table */ VTAB_FOR_VBU0428Test_CM_INP_stHVILDty "" TAB_VERB /* Number of Elements */ 4 0 "NoError" 1 "NotConfirmError" 2 "ConfirmError" 3 "MonitorInhibit" /end COMPU_VTAB
/begin COMPU_METHOD VBU0428Test_CM_INP_stHVILFrq "" TAB_VERB "%0.6" "" /* Conversion Table */ COMPU_TAB_REF VTAB_FOR_VBU0428Test_CM_INP_stHVILFrq /end COMPU_METHOD
/begin COMPU_VTAB /* Name of Table */ VTAB_FOR_VBU0428Test_CM_INP_stHVILFrq "" TAB_VERB /* Number of Elements */ 4 0 "NoError" 1 "NotConfirmError" 2 "ConfirmError" 3 "MonitorInhibit" /end COMPU_VTAB
/begin GROUP S649_CellVoltage_ValidCheck "VBU0428Test/VBUSystem/BMS/CVT/CVT/Subsystem/CellVoltage_ValidCheck"
 /begin REF_CHARACTERISTIC CcCVT_CellVoltageInvalidFaultDelayTime_ms CcCVT_CellVoltageInvalidFault_n /end REF_CHARACTERISTIC
/end GROUP
/begin GROUP S649_Determine_CellVoltage_ExtremeData "VBU0428Test/VBUSystem/BMS/CVT/CVT/Subsystem/Determine_CellVoltage_ExtremeData"
 /begin REF_MEASUREMENT CVT_mvCellVoltageAve CVT_mvCellVoltageMax CVT_mvCellVoltageMin CVT_mvCellVoltageSecondMax CVT_mvCellVoltageSecondMin CVT_numCellVoltageMaxID CVT_numCellVoltageMinID CVT_numCellVoltageSecondMaxID CVT_numCellVoltageSecondMinID CVT_numInvalidCellVoltages CVT_uCellVoltagePack GaCVT_CellVoltageValid_flg GaCVT_CellVoltage_mV /end REF_MEASUREMENT
/end GROUP
/begin GROUP S649_Determine_CellVoltage_OverUnderFaults "VBU0428Test/VBUSystem/BMS/CVT/CVT/Subsystem/Determine_CellVoltage_OverUnderFaults"
 /begin SUB_GROUP S652_EVM_FDC_Handler S652_EVM_FDC_Handler1 S652_EVM_FDC_Handler2 /end SUB_GROUP
 /begin REF_CHARACTERISTIC CVT_CELL_VOLTAGE_OVER_DEVIATION_FAULT CaCVT_CellVoltageOverDeviationCurrentMapDimension_n CaCVT_CellVoltageOverDeviationCurrentMapZ_A CbCVT_CellOverVoltageEVMFaultEnable_flg CbCVT_CellOverVoltageFaultEnable_flg CbCVT_CellUnderVoltageEVMFaultEnable_flg CbCVT_CellUnderVoltageFaultEnable_flg CbCVT_CellVoltageOverDeviationEVMFaultEnable_flg CbCVT_CellVoltageOverDeviationFaultEnable_flg CcCVT_CSCSupplyPowerLowHysteresis_V CcCVT_CSCSupplyPowerLow_V CcCVT_CellOverVoltageEVMFaultFIC_n CcCVT_CellOverVoltageEVMFaultPIC_n CcCVT_CellOverVoltageEVMFault_mV CcCVT_CellOverVoltageFaultFIC_n CcCVT_CellOverVoltageFaultPIC_n CcCVT_CellOverVoltageFault_mV CcCVT_CellOverVoltageWarningDebounce_ms CcCVT_CellOverVoltageWarningFault_mV CcCVT_CellUnderVoltageEVMFaultFIC_n CcCVT_CellUnderVoltageEVMFaultPIC_n CcCVT_CellUnderVoltageEVMFault_mV CcCVT_CellUnderVoltageFaultFIC_n CcCVT_CellUnderVoltageFaultLevel2_mV CcCVT_CellUnderVoltageFaultPIC_n CcCVT_CellUnderVoltageFault_mV CcCVT_CellUnderVoltageLowTemp_C CcCVT_CellVoltageOverDeviationCurrentDelay_s CcCVT_CellVoltageOverDeviationDisableCrrnt_A CcCVT_CellVoltageOverDeviationEVMFaultFIC_n CcCVT_CellVoltageOverDeviationEVMFaultPIC_n CcCVT_CellVoltageOverDeviationEVMFault_mV CcCVT_CellVoltageOverDeviationFaultFIC_n CcCVT_CellVoltageOverDeviationFaultPIC_n CcCVT_CellVoltageOverDeviationFault_mV /end REF_CHARACTERISTIC
/end GROUP
/begin GROUP S649_Monitor_CVT_DeviationDynamic "VBU0428Test/VBUSystem/BMS/CVT/CVT/Subsystem/Monitor_CVT_DeviationDynamic" /begin SUB_GROUP S654_Determine_CSCCellVoltage_DeviationDynamicBDM /end SUB_GROUP /begin REF_CHARACTERISTIC CcCVT_BDMOutputDelayTime_ms /end REF_CHARACTERISTIC /end GROUP
/begin GROUP S649_Monitor_CVT_Performance "VBU0428Test/VBUSystem/BMS/CVT/CVT/Subsystem/Monitor_CVT_Performance"
 /begin SUB_GROUP S655_Determine_CellVoltage_OverDeviationBDM S655_Determine_CellVoltage_OverUnderBDM /end SUB_GROUP
 /begin REF_CHARACTERISTIC CcCVT_BDMOutputDelayTime_ms /end REF_CHARACTERISTIC
/end GROUP
/begin GROUP S709_Clear_Fault_Data "VBU0428Test/VBUSystem/BMS/DSM/Subsystem10/Subsystem/Clear_Fault_Data" /begin REF_CHARACTERISTIC CbDSM_ClearFaultData_flg /end REF_CHARACTERISTIC /end GROUP
/begin GROUP S709_Determine_Abnormal_In_PeriodicalUpload "VBU0428Test/VBUSystem/BMS/DSM/Subsystem10/Subsystem/Determine_Abnormal_In_PeriodicalUpload" /begin SUB_GROUP S711_For_Iterator_Subsystem /end SUB_GROUP /begin REF_CHARACTERISTIC CbDSM_AbnormalEventOvrValue_flg CbDSM_AbnormalEventOvr_flg /end REF_CHARACTERISTIC /begin REF_MEASUREMENT DSM_flgCycleUploadAbnormalEvent /end REF_MEASUREMENT /end GROUP
/begin GROUP S709_Determine_CSC_Inhibit "VBU0428Test/VBUSystem/BMS/DSM/Subsystem10/Subsystem/Determine_CSC_Inhibit" /begin SUB_GROUP S712_For_Iterator_Subsystem /end SUB_GROUP
 /begin REF_CHARACTERISTIC CbDSM_CscValueUncertainOvrValue_flg CbDSM_CscValueUncertainOvr_flg /end REF_CHARACTERISTIC
 /begin REF_MEASUREMENT DSM_flgCscValueUncertain /end REF_MEASUREMENT
/end GROUP
/begin GROUP S709_Determine_Drive_Cycle "VBU0428Test/VBUSystem/BMS/DSM/Subsystem10/Subsystem/Determine_Drive_Cycle" /begin REF_CHARACTERISTIC CcDSM_DiverCycleflgDelayTime_ms /end REF_CHARACTERISTIC /begin REF_MEASUREMENT DSM_flgDriverCycleActive /end REF_MEASUREMENT /end GROUP
/begin GROUP S709_Determine_Fault_Category "VBU0428Test/VBUSystem/BMS/DSM/Subsystem10/Subsystem/Determine_Fault_Category" /begin SUB_GROUP S714_Clear_Fault_Category /end SUB_GROUP /begin REF_CHARACTERISTIC CaDSM_FaultCat_enum /end REF_CHARACTERISTIC /end GROUP
/begin GROUP S709_Determine_MIL_Request "VBU0428Test/VBUSystem/BMS/DSM/Subsystem10/Subsystem/Determine_MIL_Request" /begin SUB_GROUP S716_Clear_MIL_Request S716_Determine_Local_MILRequest /end SUB_GROUP /end GROUP
/begin GROUP S709_Determine_No_Charge "VBU0428Test/VBUSystem/BMS/DSM/Subsystem10/Subsystem/Determine_No_Charge" /begin SUB_GROUP S717_For_Iterator_Subsystem /end SUB_GROUP /begin REF_CHARACTERISTIC CbDSM_NoChargeOvrValue_flg CbDSM_NoChargeOvr_flg /end REF_CHARACTERISTIC /begin REF_MEASUREMENT DSM_flgNoCharge /end REF_MEASUREMENT /end GROUP
/begin GROUP S709_Determine_No_Restart "VBU0428Test/VBUSystem/BMS/DSM/Subsystem10/Subsystem/Determine_No_Restart" /begin REF_CHARACTERISTIC CbDSM_NoRestartOverride_flg CbDSM_NoRestartOvrValue_flg /end REF_CHARACTERISTIC /begin REF_MEASUREMENT DSM_flgNoRestart /end REF_MEASUREMENT /end GROUP
/begin GROUP S741_Calculate_Fastcharge_Time "VBU0428Test/VBUSystem/BMS/FCC /FCC/Subsystem/Calculate_Fastcharge_Time"
 /begin SUB_GROUP S742_Calculate_FastChargeBaseRemainTime S742_EightyPercentCustomSOC_CaculateChargeTime S742_EightyPercentCustomSOC_EnableInvalidChargeTimeFlag S742_EightyPercentCustomSOC_UpdateChargeTimeFlag S742_EstimateChargeTime_CellVoltageMax_Coefficient S742_EstimateChargeTime_CellVoltageMax_Slop S742_SOC_Mapping S742_SendInvalidTime_flg S742_UpdateTimeTrigger S742_Update_CustomSOC100RemainTime S742_Update_CustomSOC80RemainTime /end SUB_GROUP
 /begin REF_CHARACTERISTIC CcFCC_EightyCustomSOC_pct CcFCC_EstimateChargeInvalidTime_min /end REF_CHARACTERISTIC
 /begin REF_MEASUREMENT FCC_timinActualRemainChargeTime FCC_timinEstimateChargeTime FCC_timinEstimatePercTime /end REF_MEASUREMENT
/end GROUP
/begin GROUP S741_Determine_Fastcharge_Request "VBU0428Test/VBUSystem/BMS/FCC /FCC/Subsystem/Determine_Fastcharge_Request"
 /begin SUB_GROUP S743_Charge_Request_Protection S743_DetermineComputeResistancePulseCurrent S743_Determine_Base_ChargeRequest S743_Determine_DiagnosedAndLimitedChargeRequestCurrent /end SUB_GROUP
/end GROUP
/begin GROUP S741_Fastcharge_Conditions_Check "VBU0428Test/VBUSystem/BMS/FCC /FCC/Subsystem/Fastcharge_Conditions_Check" /begin SUB_GROUP S744_Condition_Categorize S744_Determine_NoCharge_Cause /end SUB_GROUP /end GROUP
/begin GROUP S741_Fastcharge_State_Management "VBU0428Test/VBUSystem/BMS/FCC /FCC/Subsystem/Fastcharge_State_Management"
 /begin REF_CHARACTERISTIC CcFCC_ChargeAbortDelayTime_s CcFCC_ChargeCompleteComfirmDelay_ms CcFCC_ChargeFaultDelayTime_s CcFCC_ChargeFullDelayTime_s CcFCC_ChargeProtectDelayTime_s FCC_STATE_ABORT_CHARGE FCC_STATE_BMS_CLOSE_CONTACTORS FCC_STATE_CHARGE_FAULT FCC_STATE_CHARGE_FULL FCC_STATE_CHARGE_PROTECTION FCC_STATE_CHARGING FCC_STATE_DEACTIVATE_DEVICES FCC_STATE_STANDBY FCC_STATE_SYSTEM_STATUS_CHECK FCC_STATE_WAIT_VCU_COMMAND /end REF_CHARACTERISTIC
 /begin REF_MEASUREMENT FCC_flgChargeTerminated FCC_stChargeState FCC_stContactorRequest FCC_tisChargeAbortTimer FCC_tisChargeFaultTimer FCC_tisChargeFullTimer FCC_tisChargeProtectTimer /end REF_MEASUREMENT
/end GROUP
/begin GROUP S741_Fastcharge_Violation_Diagnostic "VBU0428Test/VBUSystem/BMS/FCC /FCC/Subsystem/Fastcharge_Violation_Diagnostic"
 /begin REF_CHARACTERISTIC CaFCC_ChargeCurrentOverFactorMapY_nbr CbFCC_ChargeCurrentOverFaultEnable_flg CcFCC_ChargeCurrentOverDelta_A CcFCC_ChargeCurrentOverFaultFIC_n CcFCC_ChargeCurrentOverFaultPIC_n CcFCC_ChargeCurrentOver_A /end REF_CHARACTERISTIC
/end GROUP
/begin GROUP S741_MapingSOC "VBU0428Test/VBUSystem/BMS/FCC /FCC/Subsystem/MapingSOC" /begin REF_CHARACTERISTIC CcSYS_CellSOCLockedMax_pct CcSYS_CellSOCLockedMin_pct /end REF_CHARACTERISTIC /end GROUP
/begin GROUP S871_Determine_EVMandStatus "VBU0428Test/VBUSystem/BMS/ISO/Determine_FaultDetection_Check/Status_Process/Determine_EVMandStatus" /begin REF_MEASUREMENT ISO_flgIsolationStatus ISO_stIsolationEVM /end REF_MEASUREMENT /end GROUP
/begin GROUP S871_Determine_IsolationLevel "VBU0428Test/VBUSystem/BMS/ISO/Determine_FaultDetection_Check/Status_Process/Determine_IsolationLevel" /begin REF_CHARACTERISTIC CcISO_DCStationFaultDelayTime_ms /end REF_CHARACTERISTIC /begin REF_MEASUREMENT ISO_stIsolationLevel /end REF_MEASUREMENT /end GROUP
/begin GROUP S904_Check_First_Run "VBU0428Test/VBUSystem/BMS/NVM /Subsystem3/Read_NVM_Data/Check_First_Run" /begin REF_CHARACTERISTIC CbNVM_FirstRun_flg /end REF_CHARACTERISTIC /begin REF_MEASUREMENT NVM_flgActualTimeInit NVM_flgNVMRestoreRequest /end REF_MEASUREMENT /end GROUP
/begin GROUP S904_Check_NVM_Read "VBU0428Test/VBUSystem/BMS/NVM /Subsystem3/Read_NVM_Data/Check_NVM_Read" /begin REF_CHARACTERISTIC NVM_READ_SUCCESS /end REF_CHARACTERISTIC /begin REF_MEASUREMENT NVM_flgNVMReadComplete /end REF_MEASUREMENT /end GROUP
/begin GROUP S923_Determine_Criteria "VBU0428Test/VBUSystem/BMS/OCV/OCV/Subsystem/Determine_Criteria" /begin SUB_GROUP S924_Determine_OCV_Criteria S924_Determine_QOCV_Criteria /end SUB_GROUP /end GROUP
/begin GROUP S923_Determine_Relax_ElapsedTime "VBU0428Test/VBUSystem/BMS/OCV/OCV/Subsystem/Determine_Relax_ElapsedTime" /begin REF_MEASUREMENT EcOCV_RelaxationStartTime_s OCV_tisRelaxationElapsedTime /end REF_MEASUREMENT /end GROUP
/begin GROUP S923_Determine_Relax_MinTime "VBU0428Test/VBUSystem/BMS/OCV/OCV/Subsystem/Determine_Relax_MinTime"
 /begin REF_CHARACTERISTIC CaOCV_RelaxaShortTimeCurveY_s CaOCV_RelaxationTimeCurveY_s CcOCV_RelaxationMinRequiredTime_s CcOCV_RelaxationRequiredShortTime_s CcSYS_NoOfInvalidCellTemps_n /end REF_CHARACTERISTIC
/end GROUP
/begin GROUP S923_OCV_Valid_Check "VBU0428Test/VBUSystem/BMS/OCV/OCV/Subsystem/OCV_Valid_Check"
 /begin REF_MEASUREMENT OCV_flgOcvShortTimeValid OCV_flgOcvValid OCV_flgQuasiOcvValid /end REF_MEASUREMENT
/end GROUP
/begin GROUP S932_Initialize_Actual_Time "VBU0428Test/VBUSystem/BMS/RTC/RTC/Calculate_Actual_Time/Initialize_Actual_Time" /begin REF_CHARACTERISTIC CbRTC_flgActualTimeCheckEnable /end REF_CHARACTERISTIC /end GROUP
/begin GROUP S934_Calculate_Time_Deviation "VBU0428Test/VBUSystem/BMS/RTC/RTC/Determine_VCU_ActualTime/Calculate_Time_Deviation"
 /begin REF_CHARACTERISTIC CcRTC_ActualTimeDeviationThreshold_s CcRTC_EnableVCURtcCrection_flg /end REF_CHARACTERISTIC
/end GROUP
/begin GROUP S959_Battery_SoC_Diagnostic "VBU0428Test/VBUSystem/BMS/SOC/Subsystem5/Subsystem/Battery_SoC_Diagnostic"
 /begin REF_CHARACTERISTIC CbSOC_BatterySocHighFaultEnable_flg CbSOC_BatterySocLowFaultEnable_flg CcSOC_BDMOutputDelayTime_ms CcSOC_BatteryCapacity10Cycles_n CcSOC_BatteryCapacity70Cycles_n CcSOC_BatterySocHighFault10Cycles_pct CcSOC_BatterySocHighFault70Cycles_pct CcSOC_BatterySocHighFaultFIC_n CcSOC_BatterySocHighFaultPIC_n CcSOC_BatterySocHighFault_pct CcSOC_BatterySocLowFault10Cycles_pct CcSOC_BatterySocLowFault70Cycles_pct CcSOC_BatterySocLowFaultFIC_n CcSOC_BatterySocLowFaultPIC_n CcSOC_BatterySocLowFault_pct SOC_BATTERY_SOC_HIGH_FAULT SOC_BATTERY_SOC_LOW_FAULT /end REF_CHARACTERISTIC
/end GROUP
/begin GROUP S959_Determine_AhIntegral_SoC "VBU0428Test/VBUSystem/BMS/SOC/Subsystem5/Subsystem/Determine_AhIntegral_SoC"
 /begin SUB_GROUP S961_Determine_AhIntegral_Capacity S961_Determine_AhIntegral_SOC S961_Determine_Module_Current /end SUB_GROUP
/end GROUP
/begin GROUP S959_Determine_Battery_SOC "VBU0428Test/VBUSystem/BMS/SOC/Subsystem5/Subsystem/Determine_Battery_SOC"
 /begin REF_CHARACTERISTIC CaSOC_SOCPLowY_pct CbSYS_HomoTestEnable_flg CcSOC_BatteryCapacity10Cycles_n CcSOC_BatteryCapacity70Cycles_n CcSOC_BatterySocLowerLimit_pct CcSOC_BatterySocUpperLimit_pct CcSOC_BatteryUsableSocLowerLimit10Cycles_pct CcSOC_BatteryUsableSocLowerLimit70Cycles_pct CcSOC_BatteryUsableSocLowerLimitHomo_pct CcSOC_BatteryUsableSocLowerLimit_pct CcSOC_BatteryUsableSocUpperLimit10Cycles_pct CcSOC_BatteryUsableSocUpperLimit70Cycles_pct CcSOC_BatteryUsableSocUpperLimitHomo_pct CcSOC_BatteryUsableSocUpperLimit_pct CcSOC_SOCPEnable_flg CcSYS_CellSOCLockedMax_pct CcSYS_CellSOCLockedMin_pct /end REF_CHARACTERISTIC
 /begin REF_MEASUREMENT SOC_pctBatterySoc SOC_pctBatteryUsableSoc /end REF_MEASUREMENT
/end GROUP
/begin GROUP S959_Determine_CellData_Validation "VBU0428Test/VBUSystem/BMS/SOC/Subsystem5/Subsystem/Determine_CellData_Validation" /begin REF_MEASUREMENT SOC_flgCellDataValid /end REF_MEASUREMENT /end GROUP
/begin GROUP S959_Determine_Cell_SOC "VBU0428Test/VBUSystem/BMS/SOC/Subsystem5/Subsystem/Determine_Cell_SOC"
 /begin REF_CHARACTERISTIC CbSOC_CellArraySOCOvrdFlg_flg CcSOC_CellArraySOCOvrdVal_pct CcSOC_CellSocLowerLimit_pct CcSOC_CellSocUpperLimit_pct /end REF_CHARACTERISTIC
 /begin REF_MEASUREMENT GaSOC_pctCellSoc SOC_numCellSocMaxID SOC_numCellSocMinID SOC_pctCellSocAve SOC_pctCellSocMax SOC_pctCellSocMin /end REF_MEASUREMENT
/end GROUP
/begin GROUP S959_Determine_Correction_Condition "VBU0428Test/VBUSystem/BMS/SOC/Subsystem5/Subsystem/Determine_Correction_Condition"
 /begin REF_CHARACTERISTIC CcSOC_OcvCorrectionIntervalTime_s SOC_flgOCVCorrection_C SOC_flgOCValidOvrd_C /end REF_CHARACTERISTIC
 /begin REF_MEASUREMENT SOC_flgOcvCorrection /end REF_MEASUREMENT
/end GROUP
/begin GROUP S959_Determine_Display_SOC "VBU0428Test/VBUSystem/BMS/SOC/Subsystem5/Subsystem/Determine_Display_SOC"
 /begin SUB_GROUP S966_Determine_BatterySOC_ChangeRate S966_DisplaySOC_Driving_Calculation S966_DisplaySOC_Startup_Calculation S966_NoJumpSOC_Driving_Calculation S966_NoJumpSOC_Startup_Calculation /end SUB_GROUP
 /begin REF_CHARACTERISTIC CcSOC_BatterySocLowerLimit_pct CcSOC_BatterySocUpperLimit_pct CcSYS_CellSOCLockedMax_pct CcSYS_CellSOCLockedMin_pct /end REF_CHARACTERISTIC
 /begin REF_MEASUREMENT SOC_numBatteryDisplaySocChargeDecRate SOC_numBatteryDisplaySocChargeIncRate SOC_pctBatteryDisplaySoc SOC_pctNoJumpBatterySoc /end REF_MEASUREMENT
/end GROUP
/begin GROUP S959_Determine_FastChargeCorrection_Soc "VBU0428Test/VBUSystem/BMS/SOC/Subsystem5/Subsystem/Determine_FastChargeCorrection_Soc"
 /begin SUB_GROUP S967_Determine_FastChargeCorrectionCellVoltage S967_Determine_FastChargeCorrectionEnable S967_Determine_InternalResistanceCausedDevCellVoltage S967_FastCharge_DynamicCorrection /end SUB_GROUP
/end GROUP
/begin GROUP S959_Determine_Initial_SoC "VBU0428Test/VBUSystem/BMS/SOC/Subsystem5/Subsystem/Determine_Initial_SoC"
 /begin SUB_GROUP S968_CellSOC_Startup_AbnormalPoweroff S968_CellSOC_Startup_AbnormalReset S968_CellSOC_Startup_EolFlashing S968_CellSOC_Startup_Normal S968_Determine_EOL_Flashing S968_Determine_Soc_Jump /end SUB_GROUP
 /begin REF_CHARACTERISTIC CbSYS_AbnormalResetRecoverEnable_flg /end REF_CHARACTERISTIC
 /begin REF_MEASUREMENT LaSOC_pctCellSocInitial SOC_flgCellSocCorrectionFinished SOC_flgSocInitializeComplete SOC_numLoadDefaultSOCCnt /end REF_MEASUREMENT
/end GROUP
/begin GROUP S959_Determine_Initialization_Condition "VBU0428Test/VBUSystem/BMS/SOC/Subsystem5/Subsystem/Determine_Initialization_Condition"
 /begin REF_CHARACTERISTIC CcSOC_SocInitializationDelayTime_ms CcSOC_SocInitializationMaxTime_ms /end REF_CHARACTERISTIC
 /begin REF_MEASUREMENT SOC_flgSocInitializationDelay SOC_flgStartupFilterDelay /end REF_MEASUREMENT
/end GROUP
/begin GROUP S959_Determine_OcvSoc "VBU0428Test/VBUSystem/BMS/SOC/Subsystem5/Subsystem/Determine_OcvSoc" /begin SUB_GROUP S970_Replace_Invalid_CellTemperature /end SUB_GROUP /begin REF_CHARACTERISTIC CaSOC_OcvSocMapDimension_n CaSOC_OcvSocMapZ_pct /end REF_CHARACTERISTIC /begin REF_MEASUREMENT LaSOC_OcvSoc_pct /end REF_MEASUREMENT /end GROUP
/begin GROUP S959_Determine_ShortTimeCorrection_Condition "VBU0428Test/VBUSystem/BMS/SOC/Subsystem5/Subsystem/Determine_ShortTimeCorrection_Condition" /begin SUB_GROUP S971_Current_Limit_Condition /end SUB_GROUP
 /begin REF_CHARACTERISTIC CcSOC_OcvShortTimeCorrIntervalTime_s CcSOC_OcvShortTimeDisChDiff_n CcSOC_OcvShortTimeVolDiffCh_mV CcSOC_OcvShortTimeVolDiffDis_mV CcSOC_OcvShortTimeVolDiffThreshold_mV /end REF_CHARACTERISTIC
 /begin REF_MEASUREMENT SOC_flgOcvShortTimeCorrection SOC_flgOcvShortTimeDisChDiff SOC_flgOcvShortTimeVolDirection /end REF_MEASUREMENT
/end GROUP
/begin GROUP S959_Ocv_ShortTimeCorrection "VBU0428Test/VBUSystem/BMS/SOC/Subsystem5/Subsystem/Ocv_ShortTimeCorrection"
 /begin REF_CHARACTERISTIC CaSOC_OcvShortTimeChMapDimension_n CaSOC_OcvShortTimeChargeSocZ_pct CaSOC_OcvShortTimeDisMapDimension_n CaSOC_OcvShortTimeDischargeSocZ_pct CaSOC_OcvShortTimeSocErrorCurveY_pct CbSOC_OcvShortTime_flg CcSOC_OcvShortTimeSocErrorThreshold_pct CcSOC_OcvShortTimeVolThreshold_mV CcSYS_NoOfInvalidCellTemps_n /end REF_CHARACTERISTIC
 /begin REF_MEASUREMENT LaSOC_pctCellSocOcvShortTimeCorrection SOC_flgOcvShortTimeCorrectionComplete /end REF_MEASUREMENT
/end GROUP
/begin GROUP S959_Soc_Data_Storage "VBU0428Test/VBUSystem/BMS/SOC/Subsystem5/Subsystem/Soc_Data_Storage" /begin SUB_GROUP S974_Data_Storage /end SUB_GROUP /end GROUP
/begin GROUP S1118_Calculate_History_Average_Current "VBU0428Test/VBUSystem/BMS/SOE/Subsystem2/Subsystem/Calculate_History_Average_Current" /begin SUB_GROUP S1119_Determine_History_Current_Data S1119_Time_Counter /end SUB_GROUP /end GROUP
/begin GROUP S1118_Calculate_Pack_Remaining_Energy "VBU0428Test/VBUSystem/BMS/SOE/Subsystem2/Subsystem/Calculate_Pack_Remaining_Energy" /begin SUB_GROUP S1120_Charge_and_Idle_Mode S1120_Discharge_Mode /end SUB_GROUP /begin REF_MEASUREMENT SOE_kwhPackRemainingEnergy SOE_pctCellSocEndPredict /end REF_MEASUREMENT /end GROUP
/begin GROUP S1118_Calculate_Pack_Remaining_Energy_SOC "VBU0428Test/VBUSystem/BMS/SOE/Subsystem2/Subsystem/Calculate_Pack_Remaining_Energy_SOC"
 /begin REF_CHARACTERISTIC CaSOE_DispalySocFactorMapY_pct CcSOE_DischargeCutOffSoc_pct CcSYS_BatteryRatedVoltage_V CcSYS_CellSOCLockedMax_pct CcSYS_CellSOCLockedMin_pct CcSYS_FullChargeSoc_pct WATS_PER_KILOWAT /end REF_CHARACTERISTIC
/end GROUP
/begin GROUP S1118_Rate_Limit_and_Output "VBU0428Test/VBUSystem/BMS/SOE/Subsystem2/Subsystem/Rate_Limit_and_Output"
 /begin REF_CHARACTERISTIC CcSOE_EnergyDecRate_Kwh CcSOE_EnergyIncRate_Kwh CcSOE_SocInitializationMaxTime_ms /end REF_CHARACTERISTIC
/end GROUP
/begin GROUP S1118_Rate_Limit_and_Output_SOC "VBU0428Test/VBUSystem/BMS/SOE/Subsystem2/Subsystem/Rate_Limit_and_Output_SOC" /begin SUB_GROUP S1123_Rate_Limiter_Reset1 /end SUB_GROUP
 /begin REF_CHARACTERISTIC CcSOE_EnergyDecRate_Kwh CcSOE_EnergyIncRate_Kwh CcSOE_SocInitializationMaxTime_ms /end REF_CHARACTERISTIC
/end GROUP
/begin GROUP S1170_Calculate_ActualPower "VBU0428Test/VBUSystem/BMS/SOF/Subsystem6/Subsystem/Calculate_ActualPower" /begin REF_CHARACTERISTIC WATS_PER_KILOWAT /end REF_CHARACTERISTIC
 /begin REF_MEASUREMENT SOF_kwChargePowerActual SOF_kwChargePowerLimitDelta SOF_kwDischargePowerActual SOF_kwDischargePowerLimitDelta /end REF_MEASUREMENT
/end GROUP
/begin GROUP S1170_Calculate_PowerLimit "VBU0428Test/VBUSystem/BMS/SOF/Subsystem6/Subsystem/Calculate_PowerLimit"
 /begin SUB_GROUP S1172_Calculate_Pack_OCV S1172_Determine_Capacity_Cycle_PowerLimit S1172_Determine_SOCP_PowerLimit /end SUB_GROUP
 /begin REF_CHARACTERISTIC WATS_PER_KILOWAT /end REF_CHARACTERISTIC
 /begin REF_MEASUREMENT SOF_kwChargePowerLimitTarget SOF_kwContinuousChargePowerLimitTarget SOF_kwContinuousDischargePowerLimitBefoTarget SOF_kwDischargePowerLimitBefoTarget SOF_kwShortPulseChargePowerLimitTarget SOF_kwShortPulseDischargePowerLimitTarget /end REF_MEASUREMENT
/end GROUP
/begin GROUP S1170_Count_LowTempOverCurrent "VBU0428Test/VBUSystem/BMS/SOF/Subsystem6/Subsystem/Count_LowTempOverCurrent"
 /begin REF_CHARACTERISTIC CcSOF_LowTempOverCurrentBufferEmpty_As CcSOF_LowTempOverCurrentCount_C CcSOF_LowTempOverCurrent_A /end REF_CHARACTERISTIC
/end GROUP
/begin GROUP S1170_Determine_Currentlimit_Target "VBU0428Test/VBUSystem/BMS/SOF/Subsystem6/Subsystem/Determine_Currentlimit_Target"
 /begin SUB_GROUP S1174_Calculate_CurrentLimit_Target S1174_Determine_CurrentLimitTarget_Enable /end SUB_GROUP
/end GROUP
/begin GROUP S1170_Rate_CurrentLimit "VBU0428Test/VBUSystem/BMS/SOF/Subsystem6/Subsystem/Rate_CurrentLimit" /begin SUB_GROUP S1175_FCC_CHARGE_MODE1 /end SUB_GROUP
 /begin REF_CHARACTERISTIC CbSOF_CurrentLimitFastChargeCheckEnable_flg CcSOF_CapacityScalingFactor_n CcSOF_ChargeCurrentSlopeFccMode_A CcSOF_ChargeCurrentSlope_A CcSOF_DischargeCurrentSlope_A /end REF_CHARACTERISTIC
 /begin REF_MEASUREMENT SOF_iAChargeContinuousCurrentRatedLimit SOF_iAChargeCurrentRatedLimit SOF_iAContinuousDischargeCurrentRatedLimit SOF_iADischargeCurrentRatedLimit SOF_iAShortPulseChargeCurrentRatedLimit SOF_iAShortPulseDischargeCurrentRatedLimit /end REF_MEASUREMENT
/end GROUP
/begin GROUP S1170_Rate_PowerLimit "VBU0428Test/VBUSystem/BMS/SOF/Subsystem6/Subsystem/Rate_PowerLimit"
 /begin REF_CHARACTERISTIC CaSOF_ChargePowerSlopeSocTempMapDimension_n CaSOF_ChargePowerSlopeSocTempMapZ_Kw CaSOF_DischargePowerSlopeSocTempMapDimension_n CaSOF_DischargePowerSlopeSocTempMapZ_Kw /end REF_CHARACTERISTIC
 /begin REF_MEASUREMENT SOF_kwChargePowerContinuousRated SOF_kwChargePowerLimitRated SOF_kwChargePowerShortPulseRated SOF_kwDischargePowerContinuousRated SOF_kwDischargePowerLimitRated SOF_kwDischargePowerShortPulseRated /end REF_MEASUREMENT
/end GROUP
/begin GROUP S1170_SOF_Diagnostic "VBU0428Test/VBUSystem/BMS/SOF/Subsystem6/Subsystem/SOF_Diagnostic"
 /begin REF_CHARACTERISTIC CbSOF_ChargePowerLimitViolationFaultEnable_flg CbSOF_DischargePowerLimitViolationFaultEnable_flg CcSOF_ChargePowerLimitViolationFIC_n CcSOF_ChargePowerLimitViolationPIC_n CcSOF_ChargePowerLimitViolationThreshold_Kws CcSOF_ChargePowerViolationCurrentDelay_s CcSOF_DischargePowerLimitViolationFIC_n CcSOF_DischargePowerLimitViolationPIC_n CcSOF_DischargePowerLimitViolationThreshold_Kws CcSYS_TrickleChargeCurrent_A SOF_DISCHARGE_OVER_POWER_FAULT /end REF_CHARACTERISTIC
 /begin REF_MEASUREMENT SOF_kwsChargePowerLimitDeltaTotal SOF_stChargePowerLimitViolationFault SOF_stDischargePowerLimitViolationFault /end REF_MEASUREMENT
/end GROUP
/begin GROUP S1397_Calculate_Capacity "VBU0428Test/VBUSystem/BMS/SOH/Subsystem4/Subsystem1/Calculate_Capacity"
 /begin SUB_GROUP S1398_Calculate_CellCapacity S1398_Calculate_CellCapacity_SlowCharge S1398_Calculate_MinCellCapacity274_SlowCharge S1398_Determine_CalculateCellCapacity_Condition /end SUB_GROUP
/end GROUP
/begin GROUP S1397_Calculate_Resistance "VBU0428Test/VBUSystem/BMS/SOH/Subsystem4/Subsystem1/Calculate_Resistance"
 /begin SUB_GROUP S1399_BasicCellResistance_Calculation_Check S1399_Caculate_CellResistance S1399_Calculate_ModuleCurrent S1399_Calculate_Relaxation_Average_CurrentVoltage S1399_Compute_Resistance_Request S1399_Determine_Condition_Calculate_Pulse_Average_CurrentVoltage /end SUB_GROUP
/end GROUP
/begin GROUP S1397_Monitor_SOH "VBU0428Test/VBUSystem/BMS/SOH/Subsystem4/Subsystem1/Monitor_SOH" /begin REF_MEASUREMENT SOH_stResistanceIncRatio SOH_stSohMonitor /end REF_MEASUREMENT /end GROUP
/begin GROUP S1397_SOH_Diagnositic "VBU0428Test/VBUSystem/BMS/SOH/Subsystem4/Subsystem1/SOH_Diagnositic"
 /begin SUB_GROUP S1402_CellCapacity_Diagnostic S1402_CellResistanceIncRto_Diagnostic S1402_Monitor_SOH_Performance /end SUB_GROUP
/end GROUP
/begin GROUP S1397_Subsystem "VBU0428Test/VBUSystem/BMS/SOH/Subsystem4/Subsystem1/Subsystem"
 /begin REF_CHARACTERISTIC FCC_STATE_CHARGE_FAULT FCC_STATE_CHARGE_FULL FCC_STATE_CHARGING VCT_CHARGE_STATE_CHARGING VCT_CHARGE_STATE_CHARGING_FAULT VCT_CHARGE_STATE_CHARGING_FULL VCT_CHARGE_STATE_NOT_CHARGING /end REF_CHARACTERISTIC
/end GROUP
/begin GROUP S1528_Calculate_PipeTemperature "VBU0428Test/VBUSystem/BMS/THM/Subsystem/Subsystem/Calculate_PipeTemperature" /begin SUB_GROUP S1529_Determine_CoolantSensorTemp_Validation /end SUB_GROUP /end GROUP
/begin GROUP S1528_Charge_Mode_Temp_Request "VBU0428Test/VBUSystem/BMS/THM/Subsystem/Subsystem/Charge_Mode_Temp_Request"
 /begin SUB_GROUP S1530_FCC_Temp_Request S1530_Invaild_Temp_Request S1530_OBC_Temp_Request /end SUB_GROUP
 /begin REF_MEASUREMENT THM_tInletTempRequest /end REF_MEASUREMENT
/end GROUP
/begin GROUP S1528_Cooling_Request_Respond_Check "VBU0428Test/VBUSystem/BMS/THM/Subsystem/Subsystem/Cooling_Request_Respond_Check"
 /begin REF_CHARACTERISTIC CcTHM_CoolingReponseCellTemp_C CcTHM_CoolingReponseInletTemp_C CcTHM_CoolingResponseDelay_s CcTHM_InletResponseDebounce_s SAMPLE_TIME_TASK_E /end REF_CHARACTERISTIC
/end GROUP
/begin GROUP S1528_Diagnose_InletCoolingHighTemperture_Fault "VBU0428Test/VBUSystem/BMS/THM/Subsystem/Subsystem/Diagnose_InletCoolingHighTemperture_Fault"
 /begin REF_CHARACTERISTIC CbTHM_InletCoolantSensorOorHighFaultEnable_flg CcTHM_CoolantSensorOorHigh_C CcTHM_InletCoolantSensorOorHighFIC_n CcTHM_InletCoolantSensorOorHighPIC_n THM_INLET_COOLANT_SENSOR_OOR_HIGH_FAULT /end REF_CHARACTERISTIC
 /begin REF_MEASUREMENT THM_ftInletCoolantSensorOorHigh /end REF_MEASUREMENT
/end GROUP
/begin GROUP S1528_Diagnose_InletCoolingLowTemperture_Fault "VBU0428Test/VBUSystem/BMS/THM/Subsystem/Subsystem/Diagnose_InletCoolingLowTemperture_Fault"
 /begin REF_CHARACTERISTIC CbTHM_InletCoolantSensorOorLowFaultEnable_flg CcTHM_CoolantSensorOorLow_C CcTHM_InletCoolantSensorOorLowFIC_n CcTHM_InletCoolantSensorOorLowPIC_n THM_INLET_COOLANT_SENSOR_OOR_LOW_FAULT /end REF_CHARACTERISTIC
 /begin REF_MEASUREMENT THM_ftInletCoolantSensorOorLow /end REF_MEASUREMENT
/end GROUP
/begin GROUP S1528_Diagnose_InletOutletTempDelta_Fault "VBU0428Test/VBUSystem/BMS/THM/Subsystem/Subsystem/Diagnose_InletOutletTempDelta_Fault"
 /begin REF_CHARACTERISTIC CbTHM_InletOutletTempDeltaFaultEnable_flg CcTHM_InletOutletTempDeltaFIC_n CcTHM_InletOutletTempDeltaPIC_n CcTHM_InletOutletTempDeltaThreshold_C THM_INLET_OUTLET_TEMP_DELTA_FAULT /end REF_CHARACTERISTIC
 /begin REF_MEASUREMENT THM_ftInletOutletTempDelta /end REF_MEASUREMENT
/end GROUP
/begin GROUP S1528_Diagnose_OutletCoolingHighTemperture_Fault "VBU0428Test/VBUSystem/BMS/THM/Subsystem/Subsystem/Diagnose_OutletCoolingHighTemperture_Fault"
 /begin REF_CHARACTERISTIC CbTHM_OutletCoolantSensorOorHighFaultEnable_flg CcTHM_CoolantSensorOorHigh_C CcTHM_OutletCoolantSensorOorHighFIC_n CcTHM_OutletCoolantSensorOorHighPIC_n THM_OUTLET_COOLANT_SENSOR_OOR_HIGH_FAULT /end REF_CHARACTERISTIC
 /begin REF_MEASUREMENT THM_ftOutletCoolantSensorOorHigh /end REF_MEASUREMENT
/end GROUP
/begin GROUP S1528_Diagnose_OutletCoolingLowTemperture_Fault "VBU0428Test/VBUSystem/BMS/THM/Subsystem/Subsystem/Diagnose_OutletCoolingLowTemperture_Fault"
 /begin REF_CHARACTERISTIC CbTHM_OutletCoolantSensorOorLowFaultEnable_flg CcTHM_CoolantSensorOorLow_C CcTHM_OutletCoolantSensorOorLowFIC_n CcTHM_OutletCoolantSensorOorLowPIC_n THM_OUTLET_COOLANT_SENSOR_OOR_LOW_FAULT /end REF_CHARACTERISTIC
 /begin REF_MEASUREMENT THM_ftOutletCoolantSensorOorLow /end REF_MEASUREMENT
/end GROUP
/begin GROUP S1528_Thermal_System_Damage_Judgement "VBU0428Test/VBUSystem/BMS/THM/Subsystem/Subsystem/Thermal_System_Damage_Judgement" /begin SUB_GROUP S1537_Delay_FallingEdge /end SUB_GROUP
 /begin REF_CHARACTERISTIC CaTHM_OutletCoolantTempMapZ_C CcTHM_BdmDelay_s CcTHM_CoolingReponseCellTemp_C CcTHM_InletCoolingTempDeviation_C SAMPLE_TIME_TASK_E /end REF_CHARACTERISTIC
/end GROUP
/begin GROUP S1528_Valid_Condition_Determination "VBU0428Test/VBUSystem/BMS/THM/Subsystem/Subsystem/Valid_Condition_Determination" /begin SUB_GROUP S1538_FCC_Temp_Valid S1538_OBC_Temp_Valid /end SUB_GROUP /begin REF_CHARACTERISTIC CcTHM_BatteryCapacityCycle_n CcTHM_TempRequestEnable_flg /end REF_CHARACTERISTIC /begin REF_MEASUREMENT THM_flgTempRequestValid /end REF_MEASUREMENT /end GROUP
/begin GROUP S1602_Determine_BMS_VCU_267 "VBU0428Test/VBUSystem/BMS/VCT/Subsystem/Subsystem/Determine_BMS_VCU_267" /begin SUB_GROUP S1603_FCC_CHARGE_MODE1 S1603_Override /end SUB_GROUP /end GROUP
/begin GROUP S1602_Determine_BMS_VCU_268 "VBU0428Test/VBUSystem/BMS/VCT/Subsystem/Subsystem/Determine_BMS_VCU_268" /begin SUB_GROUP S1604_Override /end SUB_GROUP /end GROUP
/begin GROUP S1602_Determine_BMS_VCU_269 "VBU0428Test/VBUSystem/BMS/VCT/Subsystem/Subsystem/Determine_BMS_VCU_269" /begin SUB_GROUP S1605_Override /end SUB_GROUP /end GROUP
/begin GROUP S1602_Determine_BMS_VCU_26A "VBU0428Test/VBUSystem/BMS/VCT/Subsystem/Subsystem/Determine_BMS_VCU_26A" /begin SUB_GROUP S1606_Override /end SUB_GROUP /end GROUP
/begin GROUP S1602_Determine_BMS_VCU_26F "VBU0428Test/VBUSystem/BMS/VCT/Subsystem/Subsystem/Determine_BMS_VCU_26F" /begin SUB_GROUP S1607_Override /end SUB_GROUP
 /begin REF_CHARACTERISTIC CcSYS_CellVoltageMaxLimit_mV CcVCT_BMSProtocalVersion_n CcVCT_NominalCellCapacity_Ah CeVCT_BMSBatteryType_enum MILIVOLTAGES_PER_VOLTAGE /end REF_CHARACTERISTIC
/end GROUP
/begin GROUP S1602_Determine_BMS_VCU_270 "VBU0428Test/VBUSystem/BMS/VCT/Subsystem/Subsystem/Determine_BMS_VCU_270" /begin SUB_GROUP S1608_Override /end SUB_GROUP /begin REF_CHARACTERISTIC CcVCT_BatteryRatedVoltage_V /end REF_CHARACTERISTIC /end GROUP
/begin GROUP S1602_Determine_BMS_VCU_271 "VBU0428Test/VBUSystem/BMS/VCT/Subsystem/Subsystem/Determine_BMS_VCU_271" /begin SUB_GROUP S1609_Override /end SUB_GROUP /begin REF_CHARACTERISTIC CcSYS_FullChargeSoc_pct /end REF_CHARACTERISTIC /end GROUP
/begin GROUP S1602_Determine_BMS_VCU_272 "VBU0428Test/VBUSystem/BMS/VCT/Subsystem/Subsystem/Determine_BMS_VCU_272" /begin SUB_GROUP S1610_Override /end SUB_GROUP
 /begin REF_CHARACTERISTIC CcVCT_SOCJumpSOCLow_pct CcVCT_SOCJumpThreshold_pct CcVCT_SocInitializationMaxTime_ms /end REF_CHARACTERISTIC
/end GROUP
/begin GROUP S1602_Determine_BMS_VCU_273 "VBU0428Test/VBUSystem/BMS/VCT/Subsystem/Subsystem/Determine_BMS_VCU_273" /begin SUB_GROUP S1611_Override /end SUB_GROUP /end GROUP
/begin GROUP S1602_Determine_BMS_VCU_34 "VBU0428Test/VBUSystem/BMS/VCT/Subsystem/Subsystem/Determine_BMS_VCU_34"
 /begin SUB_GROUP S1612_CONTACTOR_STATUS_CLOSED1 S1612_CONTACTOR_STATUS_CLOSED2 S1612_CONTACTOR_STATUS_CLOSED3 S1612_CONTACTOR_STATUS_CLOSED4 S1612_CONTACTOR_STATUS_OPENED2 S1612_Override /end SUB_GROUP
/end GROUP
/begin GROUP S1602_Determine_BMS_VCU_372 "VBU0428Test/VBUSystem/BMS/VCT/Subsystem/Subsystem/Determine_BMS_VCU_372" /begin SUB_GROUP S1613_Override /end SUB_GROUP
 /begin REF_CHARACTERISTIC CcSYS_BatteryChargeCurrentMax_A CcSYS_CellVoltageMaxLimit_mV CcSYS_NoChargeHighTemp_C CcVCT_BatteryRatedVoltage_V CcVCT_NominalCellCapacity_Ah MILIVOLTAGES_PER_VOLTAGE NUMBER_OF_PARALLEL_CELLS_PER_MODULE NUMBER_OF_PARALLEL_MODULES WATS_PER_KILOWAT /end REF_CHARACTERISTIC
/end GROUP
/begin GROUP S1602_Determine_BMS_VCU_373 "VBU0428Test/VBUSystem/BMS/VCT/Subsystem/Subsystem/Determine_BMS_VCU_373" /begin SUB_GROUP S1614_Override /end SUB_GROUP /end GROUP
/begin GROUP S1602_Determine_BMS_VCU_AC "VBU0428Test/VBUSystem/BMS/VCT/Subsystem/Subsystem/Determine_BMS_VCU_AC" /begin SUB_GROUP S1615_FCC_CHARGE_MODE1 S1615_Override /end SUB_GROUP
 /begin REF_CHARACTERISTIC CcVCT_SOCLowWarningThreshold1_pct CcVCT_SOCLowWarningThreshold2_pct /end REF_CHARACTERISTIC
/end GROUP
/begin GROUP S1602_Determine_BMS_VCU_AD "VBU0428Test/VBUSystem/BMS/VCT/Subsystem/Subsystem/Determine_BMS_VCU_AD" /begin SUB_GROUP S1616_OBC_ChargeState_Mapping S1616_Override /end SUB_GROUP
 /begin REF_CHARACTERISTIC CcVCT_BatteryVoltageLimitMax_V CcVCT_BatteryVoltageLimitMin_V /end REF_CHARACTERISTIC
/end GROUP
/begin GROUP S1602_Determine_BMS_VCU_AE "VBU0428Test/VBUSystem/BMS/VCT/Subsystem/Subsystem/Determine_BMS_VCU_AE" /begin SUB_GROUP S1617_Override /end SUB_GROUP /begin REF_CHARACTERISTIC CcSYS_CellVoltageMaxLimit_mV MILIVOLTAGES_PER_VOLTAGE /end REF_CHARACTERISTIC /end GROUP
/begin GROUP S1845_override_signal_Status "VBU0428Test/VBUSystem/HALIn/HW/Subsystem/Input_HW_Signal_Range_Check2/override_signal_Status" /begin REF_MEASUREMENT INP_uAccPed1 /end REF_MEASUREMENT /end GROUP
/begin GROUP S1846_override_signal_Status "VBU0428Test/VBUSystem/HALIn/HW/Subsystem/Input_HW_Signal_Range_Check3/override_signal_Status" /begin REF_MEASUREMENT INP_uBrkPres /end REF_MEASUREMENT /end GROUP
/begin GROUP S1847_override_signal_Status "VBU0428Test/VBUSystem/HALIn/HW/Subsystem/Input_HW_Signal_Range_Check4/override_signal_Status" /begin REF_MEASUREMENT INP_uAccPed2 /end REF_MEASUREMENT /end GROUP
/begin GROUP S1848_override_signal_Status "VBU0428Test/VBUSystem/HALIn/HW/Subsystem/Input_HW_Signal_Range_Check6/override_signal_Status" /begin REF_MEASUREMENT INP_uDCCHCC2 /end REF_MEASUREMENT /end GROUP
/begin GROUP S1849_override_signal_Status "VBU0428Test/VBUSystem/HALIn/HW/Subsystem/Input_HW_Signal_Range_Check_Table1/override_signal_Status" /begin REF_MEASUREMENT INP_pVacPres /end REF_MEASUREMENT /end GROUP
/begin GROUP S1850_override_signal_Status "VBU0428Test/VBUSystem/HALIn/HW/Subsystem/Input_HW_Signal_Range_Check_Table2/override_signal_Status" /begin REF_MEASUREMENT INP_tDCChPortPosTemp /end REF_MEASUREMENT /end GROUP
/begin GROUP S1851_override_signal_Status "VBU0428Test/VBUSystem/HALIn/HW/Subsystem/Input_HW_Signal_Range_Check_Table4/override_signal_Status" /begin REF_MEASUREMENT INP_tDCChPortNegTemp /end REF_MEASUREMENT /end GROUP
/begin GROUP S1852_override_signal_Status "VBU0428Test/VBUSystem/HALIn/HW/Subsystem/Input_HW_Signal_Range_Check_Table5/override_signal_Status" /begin REF_MEASUREMENT INP_tEDSInletCoolTemp /end REF_MEASUREMENT /end GROUP
/begin GROUP S1925_override_signal "VBU0428Test/VBUSystem/HALIn/HW/Subsystem1/BrkLmpSwtConfirm/override_signal" /begin REF_MEASUREMENT INP_flgBrkLmpSwt /end REF_MEASUREMENT /end GROUP
/begin GROUP S1926_override_signal "VBU0428Test/VBUSystem/HALIn/HW/Subsystem1/INP_flgGearH1Confirm/override_signal" /begin REF_MEASUREMENT INP_flgGearH1 /end REF_MEASUREMENT /end GROUP
/begin GROUP S1927_override_signal "VBU0428Test/VBUSystem/HALIn/HW/Subsystem1/INP_flgGearH2Confirm/override_signal" /begin REF_MEASUREMENT INP_flgGearH2 /end REF_MEASUREMENT /end GROUP
/begin GROUP S1928_override_signal "VBU0428Test/VBUSystem/HALIn/HW/Subsystem1/INP_flgGearH3Confirm/override_signal" /begin REF_MEASUREMENT INP_flgGearH3 /end REF_MEASUREMENT /end GROUP
/begin GROUP S1929_override_signal "VBU0428Test/VBUSystem/HALIn/HW/Subsystem1/IN_ACMidPreConfirm/override_signal" /begin REF_MEASUREMENT INP_flgACMidPresSwitch /end REF_MEASUREMENT /end GROUP
/begin GROUP S1930_override_signal "VBU0428Test/VBUSystem/HALIn/HW/Subsystem1/IN_CrankConfirm/override_signal" /begin REF_MEASUREMENT INP_flgCrankConfirm /end REF_MEASUREMENT /end GROUP
/begin GROUP S1931_override_signal "VBU0428Test/VBUSystem/HALIn/HW/Subsystem1/IN_DriverACOnConfirm/override_signal" /begin REF_MEASUREMENT INP_flgDriverACOn /end REF_MEASUREMENT /end GROUP
/begin GROUP S1946_override_signal_Status "VBU0428Test/VBUSystem/HALIn/HW/Subsystem2/Input_HW_Signal_Range_Check1/override_signal_Status" /begin REF_MEASUREMENT INP_pctHVILDty INP_stHVILDty /end REF_MEASUREMENT /end GROUP
/begin GROUP S1947_override_signal_Status "VBU0428Test/VBUSystem/HALIn/HW/Subsystem2/Input_HW_Signal_Range_Check2/override_signal_Status" /begin REF_MEASUREMENT INP_pctBattPresDty INP_stBattPresDty /end REF_MEASUREMENT /end GROUP
/begin GROUP S1948_override_signal_Status "VBU0428Test/VBUSystem/HALIn/HW/Subsystem2/Input_HW_Signal_Range_Check3/override_signal_Status" /begin REF_MEASUREMENT INP_fBattPresFrq INP_stBattPresFrq /end REF_MEASUREMENT /end GROUP
/begin GROUP S1949_override_signal_Status "VBU0428Test/VBUSystem/HALIn/HW/Subsystem2/Input_HW_Signal_Range_Check7/override_signal_Status" /begin REF_MEASUREMENT INP_fHVILFrq INP_stHVILFrq /end REF_MEASUREMENT /end GROUP
/begin GROUP S1993_ABS_0x068 "VBU0428Test/VBUSystem/HALIn/PTCAN/Subsystem/20ms/ABS_0x068"
 /begin SUB_GROUP S2002_Input_CAN_Signal_No_Range_Check S2002_Input_CAN_Signal_No_Range_Check1 S2002_Input_CAN_Signal_No_Range_Check2 S2002_Input_CAN_Signal_No_Range_Check3 S2002_Input_CAN_Signal_No_Range_Check4 S2002_Input_CAN_Signal_No_Range_Check5 /end SUB_GROUP
 /begin REF_CHARACTERISTIC ABS_flgMsg068ChksmDisbl_C ABS_flgMsg068RollCntDisbl_C /end REF_CHARACTERISTIC
/end GROUP
/begin GROUP S1993_ABS_0x115 "VBU0428Test/VBUSystem/HALIn/PTCAN/Subsystem/20ms/ABS_0x115"
 /begin SUB_GROUP S2003_Input_CAN_Signal_No_Range_Check S2003_Input_CAN_Signal_No_Range_Check1 S2003_Input_CAN_Signal_No_Range_Check2 S2003_Input_CAN_Signal_No_Range_Check3 S2003_Input_CAN_Signal_No_Range_Check4 S2003_Input_CAN_Signal_No_Range_Check5 S2003_Input_CAN_Signal_No_Range_Check6 S2003_Input_CAN_Signal_No_Range_Check7 /end SUB_GROUP
 /begin REF_CHARACTERISTIC ABS_flgMsg115ChksmDisbl_C ABS_flgMsg115RollCntDisbl_C /end REF_CHARACTERISTIC
/end GROUP
/begin GROUP S1993_ABS_0x75 "VBU0428Test/VBUSystem/HALIn/PTCAN/Subsystem/20ms/ABS_0x75"
 /begin SUB_GROUP S2004_Input_CAN_Signal_No_Range_Check S2004_Input_CAN_Signal_No_Range_Check1 S2004_Input_CAN_Signal_No_Range_Check2 S2004_Input_CAN_Signal_No_Range_Check3 /end SUB_GROUP
 /begin REF_CHARACTERISTIC ABS_flgMsg075ChksmDisbl_C ABS_flgMsg075RollCntDisbl_C /end REF_CHARACTERISTIC
/end GROUP
/begin GROUP S1993_ABS_0x79 "VBU0428Test/VBUSystem/HALIn/PTCAN/Subsystem/20ms/ABS_0x79"
 /begin SUB_GROUP S2005_Input_CAN_Signal_No_Range_Check S2005_Input_CAN_Signal_No_Range_Check1 S2005_Input_CAN_Signal_No_Range_Check2 S2005_Input_CAN_Signal_No_Range_Check3 /end SUB_GROUP
 /begin REF_CHARACTERISTIC ABS_flgMsg079ChksmDisbl_C ABS_flgMsg079RollCntDisbl_C /end REF_CHARACTERISTIC
/end GROUP
/begin GROUP S1993_EPB_0x80 "VBU0428Test/VBUSystem/HALIn/PTCAN/Subsystem/20ms/EPB_0x80"
 /begin SUB_GROUP S2006_Input_CAN_Signal_No_Range_Check1 S2006_Input_CAN_Signal_No_Range_Check10 S2006_Input_CAN_Signal_No_Range_Check2 S2006_Input_CAN_Signal_No_Range_Check3 S2006_Input_CAN_Signal_No_Range_Check4 S2006_Input_CAN_Signal_No_Range_Check5 S2006_Input_CAN_Signal_No_Range_Check6 S2006_Input_CAN_Signal_No_Range_Check7 S2006_Input_CAN_Signal_No_Range_Check9 /end SUB_GROUP
 /begin REF_CHARACTERISTIC EPB_flgMsg080ChksmDisbl_C EPB_flgMsg080RollCntDisbl_C /end REF_CHARACTERISTIC
/end GROUP
/begin GROUP S1993_EPS_0x70 "VBU0428Test/VBUSystem/HALIn/PTCAN/Subsystem/20ms/EPS_0x70"
 /begin SUB_GROUP S2007_Input_CAN_Signal_No_Range_Check1 S2007_Input_CAN_Signal_No_Range_Check2 S2007_Input_CAN_Signal_No_Range_Check3 S2007_Input_CAN_Signal_No_Range_Check4 S2007_Input_CAN_Signal_No_Range_Check5 S2007_Input_CAN_Signal_No_Range_Check6 /end SUB_GROUP
 /begin REF_CHARACTERISTIC EPS_flgMsg070ChksmDisbl_C EPS_flgMsg070RollCntDisbl_C /end REF_CHARACTERISTIC
/end GROUP
/begin GROUP S1993_MCU_205 "VBU0428Test/VBUSystem/HALIn/PTCAN/Subsystem/20ms/MCU_205"
 /begin SUB_GROUP S2008_Input_CAN_Signal_No_Range_Check1 S2008_Input_CAN_Signal_No_Range_Check2 S2008_Input_CAN_Signal_No_Range_Check3 S2008_Input_CAN_Signal_No_Range_Check4 S2008_Input_CAN_Signal_No_Range_Check5 S2008_Input_CAN_Signal_No_Range_Check6 S2008_Input_CAN_Signal_No_Range_Check7 /end SUB_GROUP
 /begin REF_CHARACTERISTIC MCU_flgMsg205ChksmDisbl_C MCU_flgMsg205RollCntDisbl_C /end REF_CHARACTERISTIC
 /begin REF_MEASUREMENT PEUR_flgMotrSpdVld PEUR_trqAct /end REF_MEASUREMENT
/end GROUP
/begin GROUP S1994_BCM_0x18FE0121 "VBU0428Test/VBUSystem/HALIn/PTCAN/Subsystem/50ms/BCM_0x18FE0121"
 /begin SUB_GROUP S2196_Input_CAN_Signal_No_Range_Check S2196_Input_CAN_Signal_No_Range_Check1 S2196_Input_CAN_Signal_No_Range_Check10 S2196_Input_CAN_Signal_No_Range_Check11 S2196_Input_CAN_Signal_No_Range_Check12 S2196_Input_CAN_Signal_No_Range_Check13 S2196_Input_CAN_Signal_No_Range_Check14 S2196_Input_CAN_Signal_No_Range_Check15 S2196_Input_CAN_Signal_No_Range_Check16 S2196_Input_CAN_Signal_No_Range_Check17 S2196_Input_CAN_Signal_No_Range_Check18 S2196_Input_CAN_Signal_No_Range_Check2 S2196_Input_CAN_Signal_No_Range_Check3 S2196_Input_CAN_Signal_No_Range_Check4 S2196_Input_CAN_Signal_No_Range_Check5 S2196_Input_CAN_Signal_No_Range_Check6 S2196_Input_CAN_Signal_No_Range_Check7 S2196_Input_CAN_Signal_No_Range_Check8 S2196_Input_CAN_Signal_No_Range_Check9 /end SUB_GROUP
 /begin REF_CHARACTERISTIC BCM_flgMsg18FE0121ChksmDisbl_C BCM_flgMsg18FE0121RollCntDisbl_C /end REF_CHARACTERISTIC
/end GROUP
/begin GROUP S1994_MCU_305 "VBU0428Test/VBUSystem/HALIn/PTCAN/Subsystem/50ms/MCU_305"
 /begin SUB_GROUP S2197_Input_CAN_Signal_No_Range_Check S2197_Input_CAN_Signal_No_Range_Check1 S2197_Input_CAN_Signal_No_Range_Check2 /end SUB_GROUP
 /begin REF_CHARACTERISTIC PEUR_flgMsg305ChksmDisbl_C PEUR_flgMsg305RollCntDisbl_C /end REF_CHARACTERISTIC
 /begin REF_MEASUREMENT PEUR_trqMaxLimit /end REF_MEASUREMENT
/end GROUP
/begin GROUP S1997_MsgRxData_Unpack1 "VBU0428Test/VBUSystem/HALIn/PTCAN/Subsystem/CanMsgUnpack/MsgRxData_Unpack1" /begin SUB_GROUP S2380_CanRxData_Unpack /end SUB_GROUP /end GROUP
/begin GROUP S1997_MsgRxData_Unpack10 "VBU0428Test/VBUSystem/HALIn/PTCAN/Subsystem/CanMsgUnpack/MsgRxData_Unpack10" /begin SUB_GROUP S2381_CanRxData_Unpack /end SUB_GROUP /end GROUP
/begin GROUP S1997_MsgRxData_Unpack11 "VBU0428Test/VBUSystem/HALIn/PTCAN/Subsystem/CanMsgUnpack/MsgRxData_Unpack11" /begin SUB_GROUP S2382_CanRxData_Unpack /end SUB_GROUP /end GROUP
/begin GROUP S1997_MsgRxData_Unpack12 "VBU0428Test/VBUSystem/HALIn/PTCAN/Subsystem/CanMsgUnpack/MsgRxData_Unpack12" /begin SUB_GROUP S2383_CanRxData_Unpack /end SUB_GROUP /end GROUP
/begin GROUP S1997_MsgRxData_Unpack13 "VBU0428Test/VBUSystem/HALIn/PTCAN/Subsystem/CanMsgUnpack/MsgRxData_Unpack13" /begin SUB_GROUP S2384_CanRxData_Unpack /end SUB_GROUP /end GROUP
/begin GROUP S1997_MsgRxData_Unpack14 "VBU0428Test/VBUSystem/HALIn/PTCAN/Subsystem/CanMsgUnpack/MsgRxData_Unpack14" /begin SUB_GROUP S2385_CanRxData_Unpack /end SUB_GROUP /end GROUP
/begin GROUP S1997_MsgRxData_Unpack15 "VBU0428Test/VBUSystem/HALIn/PTCAN/Subsystem/CanMsgUnpack/MsgRxData_Unpack15" /begin SUB_GROUP S2386_CanRxData_Unpack /end SUB_GROUP /end GROUP
/begin GROUP S1997_MsgRxData_Unpack16 "VBU0428Test/VBUSystem/HALIn/PTCAN/Subsystem/CanMsgUnpack/MsgRxData_Unpack16" /begin SUB_GROUP S2387_CanRxData_Unpack /end SUB_GROUP /end GROUP
/begin GROUP S1997_MsgRxData_Unpack17 "VBU0428Test/VBUSystem/HALIn/PTCAN/Subsystem/CanMsgUnpack/MsgRxData_Unpack17" /begin SUB_GROUP S2388_CanRxData_Unpack /end SUB_GROUP /end GROUP
/begin GROUP S1997_MsgRxData_Unpack18 "VBU0428Test/VBUSystem/HALIn/PTCAN/Subsystem/CanMsgUnpack/MsgRxData_Unpack18" /begin SUB_GROUP S2389_CanRxData_Unpack /end SUB_GROUP /end GROUP
/begin GROUP S1997_MsgRxData_Unpack19 "VBU0428Test/VBUSystem/HALIn/PTCAN/Subsystem/CanMsgUnpack/MsgRxData_Unpack19" /begin SUB_GROUP S2390_CanRxData_Unpack /end SUB_GROUP /end GROUP
/begin GROUP S1997_MsgRxData_Unpack2 "VBU0428Test/VBUSystem/HALIn/PTCAN/Subsystem/CanMsgUnpack/MsgRxData_Unpack2" /begin SUB_GROUP S2391_CanRxData_Unpack /end SUB_GROUP /end GROUP
/begin GROUP S1997_MsgRxData_Unpack20 "VBU0428Test/VBUSystem/HALIn/PTCAN/Subsystem/CanMsgUnpack/MsgRxData_Unpack20" /begin SUB_GROUP S2392_CanRxData_Unpack /end SUB_GROUP /end GROUP
/begin GROUP S1997_MsgRxData_Unpack3 "VBU0428Test/VBUSystem/HALIn/PTCAN/Subsystem/CanMsgUnpack/MsgRxData_Unpack3" /begin SUB_GROUP S2393_CanRxData_Unpack /end SUB_GROUP /end GROUP
/begin GROUP S1997_MsgRxData_Unpack4 "VBU0428Test/VBUSystem/HALIn/PTCAN/Subsystem/CanMsgUnpack/MsgRxData_Unpack4" /begin SUB_GROUP S2394_CanRxData_Unpack /end SUB_GROUP /end GROUP
/begin GROUP S1997_MsgRxData_Unpack5 "VBU0428Test/VBUSystem/HALIn/PTCAN/Subsystem/CanMsgUnpack/MsgRxData_Unpack5" /begin SUB_GROUP S2395_CanRxData_Unpack /end SUB_GROUP /end GROUP
/begin GROUP S1997_MsgRxData_Unpack6 "VBU0428Test/VBUSystem/HALIn/PTCAN/Subsystem/CanMsgUnpack/MsgRxData_Unpack6" /begin SUB_GROUP S2396_CanRxData_Unpack /end SUB_GROUP /end GROUP
/begin GROUP S1997_MsgRxData_Unpack7 "VBU0428Test/VBUSystem/HALIn/PTCAN/Subsystem/CanMsgUnpack/MsgRxData_Unpack7" /begin SUB_GROUP S2397_CanRxData_Unpack /end SUB_GROUP /end GROUP
/begin GROUP S1997_MsgRxData_Unpack8 "VBU0428Test/VBUSystem/HALIn/PTCAN/Subsystem/CanMsgUnpack/MsgRxData_Unpack8" /begin SUB_GROUP S2398_CanRxData_Unpack /end SUB_GROUP /end GROUP
/begin GROUP S1997_MsgRxData_Unpack9 "VBU0428Test/VBUSystem/HALIn/PTCAN/Subsystem/CanMsgUnpack/MsgRxData_Unpack9" /begin SUB_GROUP S2399_CanRxData_Unpack /end SUB_GROUP /end GROUP
/begin GROUP S1999_AVAS_1801D0D3 "VBU0428Test/VBUSystem/HALIn/PTCAN/Subsystem/Subsystem2/AVAS_1801D0D3"
 /begin SUB_GROUP S2440_Input_CAN_Signal_No_Range_Check S2440_Input_CAN_Signal_No_Range_Check1 S2440_Input_CAN_Signal_No_Range_Check2 /end SUB_GROUP
 /begin REF_CHARACTERISTIC AVAS_flgMsg1801D0D3ChksmDisbl_C AVAS_flgMsg1801D0D3RollCntDisbl_C /end REF_CHARACTERISTIC
/end GROUP
/begin GROUP S1999_IC_401 "VBU0428Test/VBUSystem/HALIn/PTCAN/Subsystem/Subsystem2/IC_401"
 /begin SUB_GROUP S2441_Input_CAN_Signal_No_Range_Check S2441_Input_CAN_Signal_No_Range_Check1 S2441_Input_CAN_Signal_No_Range_Check2 S2441_Input_CAN_Signal_No_Range_Check3 /end SUB_GROUP
 /begin REF_CHARACTERISTIC IC_flgMsg401ChksmDisbl_C IC_flgMsg401RollCntDisbl_C /end REF_CHARACTERISTIC
/end GROUP
/begin GROUP S1999_MCU_505 "VBU0428Test/VBUSystem/HALIn/PTCAN/Subsystem/Subsystem2/MCU_505"
 /begin SUB_GROUP S2442_Input_CAN_Signal_No_Range_Check S2442_Input_CAN_Signal_No_Range_Check1 S2442_Input_CAN_Signal_No_Range_Check10 S2442_Input_CAN_Signal_No_Range_Check11 S2442_Input_CAN_Signal_No_Range_Check12 S2442_Input_CAN_Signal_No_Range_Check13 S2442_Input_CAN_Signal_No_Range_Check14 S2442_Input_CAN_Signal_No_Range_Check15 S2442_Input_CAN_Signal_No_Range_Check16 S2442_Input_CAN_Signal_No_Range_Check17 S2442_Input_CAN_Signal_No_Range_Check18 S2442_Input_CAN_Signal_No_Range_Check19 S2442_Input_CAN_Signal_No_Range_Check2 S2442_Input_CAN_Signal_No_Range_Check20 S2442_Input_CAN_Signal_No_Range_Check3 S2442_Input_CAN_Signal_No_Range_Check4 S2442_Input_CAN_Signal_No_Range_Check5 S2442_Input_CAN_Signal_No_Range_Check6 S2442_Input_CAN_Signal_No_Range_Check7 S2442_Input_CAN_Signal_No_Range_Check8 S2442_Input_CAN_Signal_No_Range_Check9 /end SUB_GROUP
 /begin REF_CHARACTERISTIC PEUR_flgMsg505ChksmDisbl_C PEUR_flgMsg505RollCntDisbl_C /end REF_CHARACTERISTIC
/end GROUP
/begin GROUP S2000_DCDC_509 "VBU0428Test/VBUSystem/HALIn/PTCAN/Subsystem/Subsystem3/DCDC_509"
 /begin SUB_GROUP S2548_Input_CAN_Signal_No_Range_Check S2548_Input_CAN_Signal_No_Range_Check1 S2548_Input_CAN_Signal_No_Range_Check2 S2548_Input_CAN_Signal_No_Range_Check3 S2548_Input_CAN_Signal_No_Range_Check4 S2548_Input_CAN_Signal_No_Range_Check5 S2548_Input_CAN_Signal_No_Range_Check6 S2548_Input_CAN_Signal_No_Range_Check7 S2548_Input_CAN_Signal_No_Range_Check8 /end SUB_GROUP
 /begin REF_CHARACTERISTIC DCDC_flgMsg509ChksmDisbl_C DCDC_flgMsg509RollCntDisbl_C /end REF_CHARACTERISTIC
/end GROUP
/begin GROUP S2001_AC_248 "VBU0428Test/VBUSystem/HALIn/PTCAN/Subsystem/Subsystem4/AC_248"
 /begin SUB_GROUP S2583_Input_CAN_Signal_No_Range_Check S2583_Input_CAN_Signal_No_Range_Check1 S2583_Input_CAN_Signal_No_Range_Check10 S2583_Input_CAN_Signal_No_Range_Check11 S2583_Input_CAN_Signal_No_Range_Check2 S2583_Input_CAN_Signal_No_Range_Check3 S2583_Input_CAN_Signal_No_Range_Check4 S2583_Input_CAN_Signal_No_Range_Check5 S2583_Input_CAN_Signal_No_Range_Check6 S2583_Input_CAN_Signal_No_Range_Check7 S2583_Input_CAN_Signal_No_Range_Check8 S2583_Input_CAN_Signal_No_Range_Check9 /end SUB_GROUP
 /begin REF_CHARACTERISTIC CCU_flgMsg248ChksmDisbl_C CCU_flgMsg248RollCntDisbl_C /end REF_CHARACTERISTIC
/end GROUP
/begin GROUP S2001_CDC_220 "VBU0428Test/VBUSystem/HALIn/PTCAN/Subsystem/Subsystem4/CDC_220"
 /begin SUB_GROUP S2584_Input_CAN_Signal_No_Range_Check S2584_Input_CAN_Signal_No_Range_Check1 S2584_Input_CAN_Signal_No_Range_Check2 S2584_Input_CAN_Signal_No_Range_Check3 S2584_Input_CAN_Signal_No_Range_Check4 /end SUB_GROUP
 /begin REF_CHARACTERISTIC CDC_flgMsg220ChksmDisbl_C CDC_flgMsg220RollCntDisbl_C /end REF_CHARACTERISTIC
/end GROUP
/begin GROUP S2001_DCDC_303 "VBU0428Test/VBUSystem/HALIn/PTCAN/Subsystem/Subsystem4/DCDC_303"
 /begin SUB_GROUP S2585_Input_CAN_Signal_No_Range_Check S2585_Input_CAN_Signal_No_Range_Check1 S2585_Input_CAN_Signal_No_Range_Check2 S2585_Input_CAN_Signal_No_Range_Check3 S2585_Input_CAN_Signal_No_Range_Check4 S2585_Input_CAN_Signal_No_Range_Check5 /end SUB_GROUP
 /begin REF_CHARACTERISTIC DCDC_flgMsg303ChksmDisbl_C DCDC_flgMsg303RollCntDisbl_C /end REF_CHARACTERISTIC
 /begin REF_MEASUREMENT DCDC_pwrHVInput DCDC_pwrLVOut /end REF_MEASUREMENT
/end GROUP
/begin GROUP S2001_MCU_405 "VBU0428Test/VBUSystem/HALIn/PTCAN/Subsystem/Subsystem4/MCU_405"
 /begin SUB_GROUP S2586_Input_CAN_Signal_No_Range_Check S2586_Input_CAN_Signal_No_Range_Check1 S2586_Input_CAN_Signal_No_Range_Check2 S2586_Input_CAN_Signal_No_Range_Check3 /end SUB_GROUP
 /begin REF_CHARACTERISTIC MCU_flgMsg405ChksmDisbl_C MCU_flgMsg405RollCntDisbl_C /end REF_CHARACTERISTIC
/end GROUP
/begin GROUP S2698_CanRxData_Unpack "VBU0428Test/VBUSystem/HALIn/PrivateCAN/CanMsgUnpack1/MsgRxData_Unpack1/CanRxData_Unpack" /begin SUB_GROUP S2776_HCUCellTemp_1 /end SUB_GROUP /end GROUP
/begin GROUP S2699_CanRxData_Unpack "VBU0428Test/VBUSystem/HALIn/PrivateCAN/CanMsgUnpack1/MsgRxData_Unpack10/CanRxData_Unpack" /begin SUB_GROUP S2778_HCU_Message_5 /end SUB_GROUP /end GROUP
/begin GROUP S2700_CanRxData_Unpack "VBU0428Test/VBUSystem/HALIn/PrivateCAN/CanMsgUnpack1/MsgRxData_Unpack11/CanRxData_Unpack" /begin SUB_GROUP S2780_HCU_Message_6 /end SUB_GROUP /end GROUP
/begin GROUP S2701_CanRxData_Unpack "VBU0428Test/VBUSystem/HALIn/PrivateCAN/CanMsgUnpack1/MsgRxData_Unpack12/CanRxData_Unpack" /begin SUB_GROUP S2782_HCU_Message_7_PWM /end SUB_GROUP /end GROUP
/begin GROUP S2702_CanRxData_Unpack "VBU0428Test/VBUSystem/HALIn/PrivateCAN/CanMsgUnpack1/MsgRxData_Unpack13/CanRxData_Unpack" /begin SUB_GROUP S2784_HCU_Statistics_State1 /end SUB_GROUP /end GROUP
/begin GROUP S2703_CanRxData_Unpack "VBU0428Test/VBUSystem/HALIn/PrivateCAN/CanMsgUnpack1/MsgRxData_Unpack14/CanRxData_Unpack" /begin SUB_GROUP S2786_HCU_Statistics_State10 /end SUB_GROUP /end GROUP
/begin GROUP S2704_CanRxData_Unpack "VBU0428Test/VBUSystem/HALIn/PrivateCAN/CanMsgUnpack1/MsgRxData_Unpack15/CanRxData_Unpack" /begin SUB_GROUP S2788_HCU_Statistics_State11 /end SUB_GROUP /end GROUP
/begin GROUP S2705_CanRxData_Unpack "VBU0428Test/VBUSystem/HALIn/PrivateCAN/CanMsgUnpack1/MsgRxData_Unpack16/CanRxData_Unpack" /begin SUB_GROUP S2790_HCU_Statistics_State12 /end SUB_GROUP /end GROUP
/begin GROUP S2706_CanRxData_Unpack "VBU0428Test/VBUSystem/HALIn/PrivateCAN/CanMsgUnpack1/MsgRxData_Unpack17/CanRxData_Unpack" /begin SUB_GROUP S2792_HCU_Statistics_State13 /end SUB_GROUP /end GROUP
/begin GROUP S2707_CanRxData_Unpack "VBU0428Test/VBUSystem/HALIn/PrivateCAN/CanMsgUnpack1/MsgRxData_Unpack18/CanRxData_Unpack" /begin SUB_GROUP S2794_HCU_Statistics_State2 /end SUB_GROUP /end GROUP
/begin GROUP S2708_CanRxData_Unpack "VBU0428Test/VBUSystem/HALIn/PrivateCAN/CanMsgUnpack1/MsgRxData_Unpack19/CanRxData_Unpack" /begin SUB_GROUP S2796_HCU_Statistics_State3 /end SUB_GROUP /end GROUP
/begin GROUP S2709_CanRxData_Unpack "VBU0428Test/VBUSystem/HALIn/PrivateCAN/CanMsgUnpack1/MsgRxData_Unpack2/CanRxData_Unpack" /begin SUB_GROUP S2798_HCUCellTemp_2 /end SUB_GROUP /end GROUP
/begin GROUP S2710_CanRxData_Unpack "VBU0428Test/VBUSystem/HALIn/PrivateCAN/CanMsgUnpack1/MsgRxData_Unpack20/CanRxData_Unpack" /begin SUB_GROUP S2800_HCU_Statistics_State4 /end SUB_GROUP /end GROUP
/begin GROUP S2711_CanRxData_Unpack "VBU0428Test/VBUSystem/HALIn/PrivateCAN/CanMsgUnpack1/MsgRxData_Unpack21/CanRxData_Unpack" /begin SUB_GROUP S2802_HCU_Statistics_State5 /end SUB_GROUP /end GROUP
/begin GROUP S2712_CanRxData_Unpack "VBU0428Test/VBUSystem/HALIn/PrivateCAN/CanMsgUnpack1/MsgRxData_Unpack22/CanRxData_Unpack" /begin SUB_GROUP S2804_HCU_Statistics_State6 /end SUB_GROUP /end GROUP
/begin GROUP S2713_CanRxData_Unpack "VBU0428Test/VBUSystem/HALIn/PrivateCAN/CanMsgUnpack1/MsgRxData_Unpack23/CanRxData_Unpack" /begin SUB_GROUP S2806_HCU_Statistics_State7 /end SUB_GROUP /end GROUP
/begin GROUP S2714_CanRxData_Unpack "VBU0428Test/VBUSystem/HALIn/PrivateCAN/CanMsgUnpack1/MsgRxData_Unpack24/CanRxData_Unpack" /begin SUB_GROUP S2808_HCU_Statistics_State8 /end SUB_GROUP /end GROUP
/begin GROUP S2715_CanRxData_Unpack "VBU0428Test/VBUSystem/HALIn/PrivateCAN/CanMsgUnpack1/MsgRxData_Unpack25/CanRxData_Unpack" /begin SUB_GROUP S2810_HCU_Statistics_State9 /end SUB_GROUP /end GROUP
/begin GROUP S2716_CanRxData_Unpack "VBU0428Test/VBUSystem/HALIn/PrivateCAN/CanMsgUnpack1/MsgRxData_Unpack26/CanRxData_Unpack" /begin SUB_GROUP S2812_HCU_Temp /end SUB_GROUP /end GROUP
/begin GROUP S2717_CanRxData_Unpack "VBU0428Test/VBUSystem/HALIn/PrivateCAN/CanMsgUnpack1/MsgRxData_Unpack27/CanRxData_Unpack" /begin SUB_GROUP S2814_HCU_Total_Cell_Num /end SUB_GROUP /end GROUP
/begin GROUP S2718_CanRxData_Unpack "VBU0428Test/VBUSystem/HALIn/PrivateCAN/CanMsgUnpack1/MsgRxData_Unpack28/CanRxData_Unpack" /begin SUB_GROUP S2816_LEM_CurrentSensor_3C2 /end SUB_GROUP /end GROUP
/begin GROUP S2719_CanRxData_Unpack "VBU0428Test/VBUSystem/HALIn/PrivateCAN/CanMsgUnpack1/MsgRxData_Unpack29/CanRxData_Unpack" /begin SUB_GROUP S2818_HCUCellVolt1 /end SUB_GROUP /end GROUP
/begin GROUP S2720_CanRxData_Unpack "VBU0428Test/VBUSystem/HALIn/PrivateCAN/CanMsgUnpack1/MsgRxData_Unpack3/CanRxData_Unpack" /begin SUB_GROUP S2820_HCUCellTemp_3 /end SUB_GROUP /end GROUP
/begin GROUP S2721_CanRxData_Unpack "VBU0428Test/VBUSystem/HALIn/PrivateCAN/CanMsgUnpack1/MsgRxData_Unpack30/CanRxData_Unpack" /begin SUB_GROUP S2822_HCUCellVolt10 /end SUB_GROUP /end GROUP
/begin GROUP S2722_CanRxData_Unpack "VBU0428Test/VBUSystem/HALIn/PrivateCAN/CanMsgUnpack1/MsgRxData_Unpack31/CanRxData_Unpack" /begin SUB_GROUP S2824_HCUCellVolt11 /end SUB_GROUP /end GROUP
/begin GROUP S2723_CanRxData_Unpack "VBU0428Test/VBUSystem/HALIn/PrivateCAN/CanMsgUnpack1/MsgRxData_Unpack32/CanRxData_Unpack" /begin SUB_GROUP S2826_HCUCellVolt12 /end SUB_GROUP /end GROUP
/begin GROUP S2724_CanRxData_Unpack "VBU0428Test/VBUSystem/HALIn/PrivateCAN/CanMsgUnpack1/MsgRxData_Unpack33/CanRxData_Unpack" /begin SUB_GROUP S2828_HCUCellVolt13 /end SUB_GROUP /end GROUP
/begin GROUP S2725_CanRxData_Unpack "VBU0428Test/VBUSystem/HALIn/PrivateCAN/CanMsgUnpack1/MsgRxData_Unpack34/CanRxData_Unpack" /begin SUB_GROUP S2830_HCUCellVolt14 /end SUB_GROUP /end GROUP
/begin GROUP S2726_CanRxData_Unpack "VBU0428Test/VBUSystem/HALIn/PrivateCAN/CanMsgUnpack1/MsgRxData_Unpack35/CanRxData_Unpack" /begin SUB_GROUP S2832_HCUCellVolt15 /end SUB_GROUP /end GROUP
/begin GROUP S2727_CanRxData_Unpack "VBU0428Test/VBUSystem/HALIn/PrivateCAN/CanMsgUnpack1/MsgRxData_Unpack36/CanRxData_Unpack" /begin SUB_GROUP S2834_HCUCellVolt16 /end SUB_GROUP /end GROUP
/begin GROUP S2728_CanRxData_Unpack "VBU0428Test/VBUSystem/HALIn/PrivateCAN/CanMsgUnpack1/MsgRxData_Unpack37/CanRxData_Unpack" /begin SUB_GROUP S2836_HCUCellVolt17 /end SUB_GROUP /end GROUP
/begin GROUP S2729_CanRxData_Unpack "VBU0428Test/VBUSystem/HALIn/PrivateCAN/CanMsgUnpack1/MsgRxData_Unpack38/CanRxData_Unpack" /begin SUB_GROUP S2838_HCUCellVolt18 /end SUB_GROUP /end GROUP
/begin GROUP S2730_CanRxData_Unpack "VBU0428Test/VBUSystem/HALIn/PrivateCAN/CanMsgUnpack1/MsgRxData_Unpack39/CanRxData_Unpack" /begin SUB_GROUP S2840_HCUCellVolt19 /end SUB_GROUP /end GROUP
/begin GROUP S2731_CanRxData_Unpack "VBU0428Test/VBUSystem/HALIn/PrivateCAN/CanMsgUnpack1/MsgRxData_Unpack4/CanRxData_Unpack" /begin SUB_GROUP S2842_HCUCellTemp_4 /end SUB_GROUP /end GROUP
/begin GROUP S2732_CanRxData_Unpack "VBU0428Test/VBUSystem/HALIn/PrivateCAN/CanMsgUnpack1/MsgRxData_Unpack40/CanRxData_Unpack" /begin SUB_GROUP S2844_HCUCellVolt2 /end SUB_GROUP /end GROUP
/begin GROUP S2733_CanRxData_Unpack "VBU0428Test/VBUSystem/HALIn/PrivateCAN/CanMsgUnpack1/MsgRxData_Unpack41/CanRxData_Unpack" /begin SUB_GROUP S2846_HCUCellVolt20 /end SUB_GROUP /end GROUP
/begin GROUP S2734_CanRxData_Unpack "VBU0428Test/VBUSystem/HALIn/PrivateCAN/CanMsgUnpack1/MsgRxData_Unpack42/CanRxData_Unpack" /begin SUB_GROUP S2848_HCUCellVolt21 /end SUB_GROUP /end GROUP
/begin GROUP S2735_CanRxData_Unpack "VBU0428Test/VBUSystem/HALIn/PrivateCAN/CanMsgUnpack1/MsgRxData_Unpack43/CanRxData_Unpack" /begin SUB_GROUP S2850_HCUCellVolt22 /end SUB_GROUP /end GROUP
/begin GROUP S2736_CanRxData_Unpack "VBU0428Test/VBUSystem/HALIn/PrivateCAN/CanMsgUnpack1/MsgRxData_Unpack44/CanRxData_Unpack" /begin SUB_GROUP S2852_HCUCellVolt23 /end SUB_GROUP /end GROUP
/begin GROUP S2737_CanRxData_Unpack "VBU0428Test/VBUSystem/HALIn/PrivateCAN/CanMsgUnpack1/MsgRxData_Unpack45/CanRxData_Unpack" /begin SUB_GROUP S2854_HCUCellVolt24 /end SUB_GROUP /end GROUP
/begin GROUP S2738_CanRxData_Unpack "VBU0428Test/VBUSystem/HALIn/PrivateCAN/CanMsgUnpack1/MsgRxData_Unpack46/CanRxData_Unpack" /begin SUB_GROUP S2856_HCUCellVolt25 /end SUB_GROUP /end GROUP
/begin GROUP S2739_CanRxData_Unpack "VBU0428Test/VBUSystem/HALIn/PrivateCAN/CanMsgUnpack1/MsgRxData_Unpack47/CanRxData_Unpack" /begin SUB_GROUP S2858_HCUCellVolt26 /end SUB_GROUP /end GROUP
/begin GROUP S2740_CanRxData_Unpack "VBU0428Test/VBUSystem/HALIn/PrivateCAN/CanMsgUnpack1/MsgRxData_Unpack48/CanRxData_Unpack" /begin SUB_GROUP S2860_HCUCellVolt27 /end SUB_GROUP /end GROUP
/begin GROUP S2741_CanRxData_Unpack "VBU0428Test/VBUSystem/HALIn/PrivateCAN/CanMsgUnpack1/MsgRxData_Unpack49/CanRxData_Unpack" /begin SUB_GROUP S2862_HCUCellVolt28 /end SUB_GROUP /end GROUP
/begin GROUP S2742_CanRxData_Unpack "VBU0428Test/VBUSystem/HALIn/PrivateCAN/CanMsgUnpack1/MsgRxData_Unpack5/CanRxData_Unpack" /begin SUB_GROUP S2864_HCUCellTemp_5 /end SUB_GROUP /end GROUP
/begin GROUP S2743_CanRxData_Unpack "VBU0428Test/VBUSystem/HALIn/PrivateCAN/CanMsgUnpack1/MsgRxData_Unpack50/CanRxData_Unpack" /begin SUB_GROUP S2866_HCUCellVolt29 /end SUB_GROUP /end GROUP
/begin GROUP S2744_CanRxData_Unpack "VBU0428Test/VBUSystem/HALIn/PrivateCAN/CanMsgUnpack1/MsgRxData_Unpack51/CanRxData_Unpack" /begin SUB_GROUP S2868_HCUCellVolt3 /end SUB_GROUP /end GROUP
/begin GROUP S2745_CanRxData_Unpack "VBU0428Test/VBUSystem/HALIn/PrivateCAN/CanMsgUnpack1/MsgRxData_Unpack52/CanRxData_Unpack" /begin SUB_GROUP S2870_HCUCellVolt30 /end SUB_GROUP /end GROUP
/begin GROUP S2746_CanRxData_Unpack "VBU0428Test/VBUSystem/HALIn/PrivateCAN/CanMsgUnpack1/MsgRxData_Unpack53/CanRxData_Unpack" /begin SUB_GROUP S2872_HCUCellVolt31 /end SUB_GROUP /end GROUP
/begin GROUP S2747_CanRxData_Unpack "VBU0428Test/VBUSystem/HALIn/PrivateCAN/CanMsgUnpack1/MsgRxData_Unpack54/CanRxData_Unpack" /begin SUB_GROUP S2874_HCUCellVolt32 /end SUB_GROUP /end GROUP
/begin GROUP S2748_CanRxData_Unpack "VBU0428Test/VBUSystem/HALIn/PrivateCAN/CanMsgUnpack1/MsgRxData_Unpack55/CanRxData_Unpack" /begin SUB_GROUP S2876_HCUCellVolt33 /end SUB_GROUP /end GROUP
/begin GROUP S2749_CanRxData_Unpack "VBU0428Test/VBUSystem/HALIn/PrivateCAN/CanMsgUnpack1/MsgRxData_Unpack56/CanRxData_Unpack" /begin SUB_GROUP S2878_HCUCellVolt34 /end SUB_GROUP /end GROUP
/begin GROUP S2750_CanRxData_Unpack "VBU0428Test/VBUSystem/HALIn/PrivateCAN/CanMsgUnpack1/MsgRxData_Unpack57/CanRxData_Unpack" /begin SUB_GROUP S2880_HCUCellVolt35 /end SUB_GROUP /end GROUP
/begin GROUP S2751_CanRxData_Unpack "VBU0428Test/VBUSystem/HALIn/PrivateCAN/CanMsgUnpack1/MsgRxData_Unpack58/CanRxData_Unpack" /begin SUB_GROUP S2882_HCUCellVolt36 /end SUB_GROUP /end GROUP
/begin GROUP S2752_CanRxData_Unpack "VBU0428Test/VBUSystem/HALIn/PrivateCAN/CanMsgUnpack1/MsgRxData_Unpack59/CanRxData_Unpack" /begin SUB_GROUP S2884_HCUCellVolt37 /end SUB_GROUP /end GROUP
/begin GROUP S2753_CanRxData_Unpack "VBU0428Test/VBUSystem/HALIn/PrivateCAN/CanMsgUnpack1/MsgRxData_Unpack6/CanRxData_Unpack" /begin SUB_GROUP S2886_HCU_Message_1_RelayStatus /end SUB_GROUP /end GROUP
/begin GROUP S2754_CanRxData_Unpack "VBU0428Test/VBUSystem/HALIn/PrivateCAN/CanMsgUnpack1/MsgRxData_Unpack60/CanRxData_Unpack" /begin SUB_GROUP S2888_HCUCellVolt38 /end SUB_GROUP /end GROUP
/begin GROUP S2755_CanRxData_Unpack "VBU0428Test/VBUSystem/HALIn/PrivateCAN/CanMsgUnpack1/MsgRxData_Unpack61/CanRxData_Unpack" /begin SUB_GROUP S2890_HCUCellVolt39 /end SUB_GROUP /end GROUP
/begin GROUP S2756_CanRxData_Unpack "VBU0428Test/VBUSystem/HALIn/PrivateCAN/CanMsgUnpack1/MsgRxData_Unpack62/CanRxData_Unpack" /begin SUB_GROUP S2892_HCUCellVolt4 /end SUB_GROUP /end GROUP
/begin GROUP S2757_CanRxData_Unpack "VBU0428Test/VBUSystem/HALIn/PrivateCAN/CanMsgUnpack1/MsgRxData_Unpack63/CanRxData_Unpack" /begin SUB_GROUP S2894_HCUCellVolt40 /end SUB_GROUP /end GROUP
/begin GROUP S2758_CanRxData_Unpack "VBU0428Test/VBUSystem/HALIn/PrivateCAN/CanMsgUnpack1/MsgRxData_Unpack64/CanRxData_Unpack" /begin SUB_GROUP S2896_HCUCellVolt41 /end SUB_GROUP /end GROUP
/begin GROUP S2759_CanRxData_Unpack "VBU0428Test/VBUSystem/HALIn/PrivateCAN/CanMsgUnpack1/MsgRxData_Unpack65/CanRxData_Unpack" /begin SUB_GROUP S2898_HCUCellVolt42 /end SUB_GROUP /end GROUP
/begin GROUP S2760_CanRxData_Unpack "VBU0428Test/VBUSystem/HALIn/PrivateCAN/CanMsgUnpack1/MsgRxData_Unpack66/CanRxData_Unpack" /begin SUB_GROUP S2900_HCUCellVolt43 /end SUB_GROUP /end GROUP
/begin GROUP S2761_CanRxData_Unpack "VBU0428Test/VBUSystem/HALIn/PrivateCAN/CanMsgUnpack1/MsgRxData_Unpack67/CanRxData_Unpack" /begin SUB_GROUP S2902_HCUCellVolt44 /end SUB_GROUP /end GROUP
/begin GROUP S2762_CanRxData_Unpack "VBU0428Test/VBUSystem/HALIn/PrivateCAN/CanMsgUnpack1/MsgRxData_Unpack68/CanRxData_Unpack" /begin SUB_GROUP S2904_HCUCellVolt45 /end SUB_GROUP /end GROUP
/begin GROUP S2763_CanRxData_Unpack "VBU0428Test/VBUSystem/HALIn/PrivateCAN/CanMsgUnpack1/MsgRxData_Unpack69/CanRxData_Unpack" /begin SUB_GROUP S2906_HCUCellVolt46 /end SUB_GROUP /end GROUP
/begin GROUP S2764_CanRxData_Unpack "VBU0428Test/VBUSystem/HALIn/PrivateCAN/CanMsgUnpack1/MsgRxData_Unpack7/CanRxData_Unpack" /begin SUB_GROUP S2908_HCU_Message_2_AD1 /end SUB_GROUP /end GROUP
/begin GROUP S2765_CanRxData_Unpack "VBU0428Test/VBUSystem/HALIn/PrivateCAN/CanMsgUnpack1/MsgRxData_Unpack70/CanRxData_Unpack" /begin SUB_GROUP S2910_HCUCellVolt47 /end SUB_GROUP /end GROUP
/begin GROUP S2766_CanRxData_Unpack "VBU0428Test/VBUSystem/HALIn/PrivateCAN/CanMsgUnpack1/MsgRxData_Unpack71/CanRxData_Unpack" /begin SUB_GROUP S2912_HCUCellVolt48 /end SUB_GROUP /end GROUP
/begin GROUP S2767_CanRxData_Unpack "VBU0428Test/VBUSystem/HALIn/PrivateCAN/CanMsgUnpack1/MsgRxData_Unpack72/CanRxData_Unpack" /begin SUB_GROUP S2914_HCUCellVolt49 /end SUB_GROUP /end GROUP
/begin GROUP S2768_CanRxData_Unpack "VBU0428Test/VBUSystem/HALIn/PrivateCAN/CanMsgUnpack1/MsgRxData_Unpack73/CanRxData_Unpack" /begin SUB_GROUP S2916_HCUCellVolt5 /end SUB_GROUP /end GROUP
/begin GROUP S2769_CanRxData_Unpack "VBU0428Test/VBUSystem/HALIn/PrivateCAN/CanMsgUnpack1/MsgRxData_Unpack74/CanRxData_Unpack" /begin SUB_GROUP S2918_HCUCellVolt50 /end SUB_GROUP /end GROUP
/begin GROUP S2770_CanRxData_Unpack "VBU0428Test/VBUSystem/HALIn/PrivateCAN/CanMsgUnpack1/MsgRxData_Unpack75/CanRxData_Unpack" /begin SUB_GROUP S2920_HCUCellVolt6 /end SUB_GROUP /end GROUP
/begin GROUP S2771_CanRxData_Unpack "VBU0428Test/VBUSystem/HALIn/PrivateCAN/CanMsgUnpack1/MsgRxData_Unpack76/CanRxData_Unpack" /begin SUB_GROUP S2922_HCUCellVolt7 /end SUB_GROUP /end GROUP
/begin GROUP S2772_CanRxData_Unpack "VBU0428Test/VBUSystem/HALIn/PrivateCAN/CanMsgUnpack1/MsgRxData_Unpack77/CanRxData_Unpack" /begin SUB_GROUP S2924_HCUCellVolt8 /end SUB_GROUP /end GROUP
/begin GROUP S2773_CanRxData_Unpack "VBU0428Test/VBUSystem/HALIn/PrivateCAN/CanMsgUnpack1/MsgRxData_Unpack78/CanRxData_Unpack" /begin SUB_GROUP S2926_HCUCellVolt9 /end SUB_GROUP /end GROUP
/begin GROUP S2774_CanRxData_Unpack "VBU0428Test/VBUSystem/HALIn/PrivateCAN/CanMsgUnpack1/MsgRxData_Unpack8/CanRxData_Unpack" /begin SUB_GROUP S2928_HCU_Message_3_AD2 /end SUB_GROUP /end GROUP
/begin GROUP S2775_CanRxData_Unpack "VBU0428Test/VBUSystem/HALIn/PrivateCAN/CanMsgUnpack1/MsgRxData_Unpack9/CanRxData_Unpack" /begin SUB_GROUP S2930_HCU_Message_4_AD3 /end SUB_GROUP /end GROUP
/begin GROUP S3191_PropertyConfirm "VBU0428Test/VBUSystem/VCU /APO2HAL/Subsystem2/Subsystem/PropertyConfirm" /begin REF_MEASUREMENT OD_LsMainRly /end REF_MEASUREMENT /end GROUP
/begin GROUP S3191_PropertyConfirm1 "VBU0428Test/VBUSystem/VCU /APO2HAL/Subsystem2/Subsystem/PropertyConfirm1" /begin REF_MEASUREMENT OD_HsWakeUp1 /end REF_MEASUREMENT /end GROUP
/begin GROUP S3191_PropertyConfirm10 "VBU0428Test/VBUSystem/VCU /APO2HAL/Subsystem2/Subsystem/PropertyConfirm10" /begin REF_MEASUREMENT OP_fLsWaterPump1 /end REF_MEASUREMENT /end GROUP
/begin GROUP S3191_PropertyConfirm11 "VBU0428Test/VBUSystem/VCU /APO2HAL/Subsystem2/Subsystem/PropertyConfirm11" /begin REF_MEASUREMENT OP_pctLsWaterPump1 /end REF_MEASUREMENT /end GROUP
/begin GROUP S3191_PropertyConfirm12 "VBU0428Test/VBUSystem/VCU /APO2HAL/Subsystem2/Subsystem/PropertyConfirm12" /begin REF_MEASUREMENT OP_fLsWaterPump2 /end REF_MEASUREMENT /end GROUP
/begin GROUP S3191_PropertyConfirm13 "VBU0428Test/VBUSystem/VCU /APO2HAL/Subsystem2/Subsystem/PropertyConfirm13" /begin REF_MEASUREMENT OP_pctLsWaterPump2 /end REF_MEASUREMENT /end GROUP
/begin GROUP S3191_PropertyConfirm14 "VBU0428Test/VBUSystem/VCU /APO2HAL/Subsystem2/Subsystem/PropertyConfirm14" /begin REF_MEASUREMENT OP_fLsACPump /end REF_MEASUREMENT /end GROUP
/begin GROUP S3191_PropertyConfirm15 "VBU0428Test/VBUSystem/VCU /APO2HAL/Subsystem2/Subsystem/PropertyConfirm15" /begin REF_MEASUREMENT OP_pctLsACPump /end REF_MEASUREMENT /end GROUP
/begin GROUP S3191_PropertyConfirm4 "VBU0428Test/VBUSystem/VCU /APO2HAL/Subsystem2/Subsystem/PropertyConfirm4" /begin REF_MEASUREMENT OP_fLsHVIL1 /end REF_MEASUREMENT /end GROUP
/begin GROUP S3191_PropertyConfirm5 "VBU0428Test/VBUSystem/VCU /APO2HAL/Subsystem2/Subsystem/PropertyConfirm5" /begin REF_MEASUREMENT OD_flgVBUSleepEnable /end REF_MEASUREMENT /end GROUP
/begin GROUP S3191_PropertyConfirm6 "VBU0428Test/VBUSystem/VCU /APO2HAL/Subsystem2/Subsystem/PropertyConfirm6" /begin REF_MEASUREMENT OP_pctLsHVIL1 /end REF_MEASUREMENT /end GROUP
/begin GROUP S3191_PropertyConfirm8 "VBU0428Test/VBUSystem/VCU /APO2HAL/Subsystem2/Subsystem/PropertyConfirm8" /begin REF_MEASUREMENT OP_fLsFan /end REF_MEASUREMENT /end GROUP
/begin GROUP S3191_PropertyConfirm9 "VBU0428Test/VBUSystem/VCU /APO2HAL/Subsystem2/Subsystem/PropertyConfirm9" /begin REF_MEASUREMENT OP_pctLsFan /end REF_MEASUREMENT /end GROUP
/begin GROUP S3210_DCH_BMSChgrReq "VBU0428Test/VBUSystem/VCU /DCH/DCH_Overall/DCH_DCChargeCtrlOverall/DCH_BMSChgrReq" /begin SUB_GROUP S3213_Turn_On_Delay_Time S3213_Turn_On_Delay_Time1 /end SUB_GROUP
 /begin REF_CHARACTERISTIC DCH_facLimitChrCrnntLvl0V_C DCH_facLimitChrCrnntLvl1V_C DCH_facLimitChrCrnntLvl2V_C DCH_facLimitChrCrnntLvl3V_C DCH_facOneTmpSnsrInvldLmt_C DCH_iCMLMinChCurr_C DCH_iDCChOneSnsrInvldCrntLmt_C DCH_iDCChPortFailureChCurr_C DCH_iDCChReqLowLim_C DCH_iDCChReqUpLim_C DCH_iStatnLackCrnntThres_C DCH_stBCLMode_SY DCH_stChrgPortSnglSnsr_SY DCH_stChrgPortSnsrConfig_C DCH_stWaitCHMMode_SY DCH_tLimitChrCrnntLvl1L_C DCH_tLimitChrCrnntLvl1R_C DCH_tLimitChrCrnntLvl2L_C DCH_tLimitChrCrnntLvl2R_C DCH_tLimitChrCrnntLvl3L_C DCH_tLimitChrCrnntLvl3R_C DCH_tiSmplT_SY DCH_tiStatnLackCrnntThres_C /end REF_CHARACTERISTIC
 /begin REF_MEASUREMENT DCH_iBMSDCChReqLim /end REF_MEASUREMENT
/end GROUP
/begin GROUP S3210_DCH_DCChargeCtrlStateflow "VBU0428Test/VBUSystem/VCU /DCH/DCH_Overall/DCH_DCChargeCtrlOverall/DCH_DCChargeCtrlStateflow" /begin REF_CHARACTERISTIC DCH_stBCLMode_SY DCH_stWaitCHMMode_SY DCH_tiSmplT_SY /end REF_CHARACTERISTIC /end GROUP
/begin GROUP S3210_DSPLLight "VBU0428Test/VBUSystem/VCU /DCH/DCH_Overall/DCH_DCChargeCtrlOverall/DSPLLight" /begin REF_CHARACTERISTIC DCH_stWaitCHMMode_SY /end REF_CHARACTERISTIC /end GROUP
/begin GROUP S3212_DCH_J1939OutputProcessBST "VBU0428Test/VBUSystem/VCU /DCH/DCH_Overall/DCH_J1939OutputSignalProcess/DCH_J1939OutputProcessBST" /begin REF_CHARACTERISTIC DCH_stWaitCHMMode_SY /end REF_CHARACTERISTIC /end GROUP
/begin GROUP S288_DetermineSOCBalance_EnableCondition "VBU0428Test/VBUSystem/BMS/CBL/Subsystem8/Subsystem/Balance_EnableCondition/DetermineSOCBalance_EnableCondition" /begin REF_CHARACTERISTIC SAMPLE_TIME_TASK_E /end REF_CHARACTERISTIC /end GROUP
/begin GROUP S288_DetermineVoltaageBalance_EnableCondition "VBU0428Test/VBUSystem/BMS/CBL/Subsystem8/Subsystem/Balance_EnableCondition/DetermineVoltaageBalance_EnableCondition" /begin REF_CHARACTERISTIC SAMPLE_TIME_TASK_E /end REF_CHARACTERISTIC /end GROUP
/begin GROUP S621_Cell_DataValid_Check "VBU0428Test/VBUSystem/BMS/CTS/CTS/Subsystem/DeterminePrechargeConditions/Cell_DataValid_Check" /begin REF_CHARACTERISTIC CcSYS_NoOfInvalidCellTemps_n /end REF_CHARACTERISTIC /end GROUP
/begin GROUP S742_EightyPercentCustomSOC_EnableInvalidChargeTimeFlag "VBU0428Test/VBUSystem/BMS/FCC /FCC/Subsystem/Calculate_Fastcharge_Time/EightyPercentCustomSOC_EnableInvalidChargeTimeFlag" /begin REF_CHARACTERISTIC CcFCC_EightyCustomSOC_pct /end REF_CHARACTERISTIC /end GROUP
/begin GROUP S742_EightyPercentCustomSOC_UpdateChargeTimeFlag "VBU0428Test/VBUSystem/BMS/FCC /FCC/Subsystem/Calculate_Fastcharge_Time/EightyPercentCustomSOC_UpdateChargeTimeFlag" /begin REF_CHARACTERISTIC CcFCC_EightyCustomSOC_pct /end REF_CHARACTERISTIC /end GROUP
/begin GROUP S742_SOC_Mapping "VBU0428Test/VBUSystem/BMS/FCC /FCC/Subsystem/Calculate_Fastcharge_Time/SOC_Mapping" /begin REF_CHARACTERISTIC CcSYS_CellSOCLockedMax_pct CcSYS_CellSOCLockedMin_pct /end REF_CHARACTERISTIC /end GROUP
/begin GROUP S743_Charge_Request_Protection "VBU0428Test/VBUSystem/BMS/FCC /FCC/Subsystem/Determine_Fastcharge_Request/Charge_Request_Protection" /begin REF_CHARACTERISTIC CcSYS_CellVoltageMaxLimit_mV /end REF_CHARACTERISTIC /end GROUP
/begin GROUP S743_Determine_Base_ChargeRequest "VBU0428Test/VBUSystem/BMS/FCC /FCC/Subsystem/Determine_Fastcharge_Request/Determine_Base_ChargeRequest" /begin REF_CHARACTERISTIC FCC_STATE_CHARGING /end REF_CHARACTERISTIC /end GROUP
/begin GROUP S743_Determine_DiagnosedAndLimitedChargeRequestCurrent "VBU0428Test/VBUSystem/BMS/FCC /FCC/Subsystem/Determine_Fastcharge_Request/Determine_DiagnosedAndLimitedChargeRequestCurrent" /begin REF_CHARACTERISTIC WATS_PER_KILOWAT /end REF_CHARACTERISTIC /end GROUP
/begin GROUP S966_Determine_BatterySOC_ChangeRate "VBU0428Test/VBUSystem/BMS/SOC/Subsystem5/Subsystem/Determine_Display_SOC/Determine_BatterySOC_ChangeRate"
 /begin REF_CHARACTERISTIC CcSOC_BatteryUsableSocLowerLimit_pct CcSOC_BatteryUsableSocUpperLimit_pct CcSYS_CellSOCLockedMax_pct CcSYS_CellSOCLockedMin_pct /end REF_CHARACTERISTIC
/end GROUP
/begin GROUP S966_DisplaySOC_Driving_Calculation "VBU0428Test/VBUSystem/BMS/SOC/Subsystem5/Subsystem/Determine_Display_SOC/DisplaySOC_Driving_Calculation" /begin REF_CHARACTERISTIC CbSOC_CellArraySOCOvrdFlg_flg /end REF_CHARACTERISTIC /end GROUP
/begin GROUP S1119_Time_Counter "VBU0428Test/VBUSystem/BMS/SOE/Subsystem2/Subsystem/Calculate_History_Average_Current/Time_Counter" /begin REF_CHARACTERISTIC NUMBER_OF_PARALLEL_MODULES /end REF_CHARACTERISTIC /end GROUP
/begin GROUP S1120_Charge_and_Idle_Mode "VBU0428Test/VBUSystem/BMS/SOE/Subsystem2/Subsystem/Calculate_Pack_Remaining_Energy/Charge_and_Idle_Mode"
 /begin REF_CHARACTERISTIC CcSOE_DischargeCutOffSoc_pct CcSYS_CellSOCLockedMax_pct CcSYS_CellSOCLockedMin_pct /end REF_CHARACTERISTIC
/end GROUP
/begin GROUP S1120_Discharge_Mode "VBU0428Test/VBUSystem/BMS/SOE/Subsystem2/Subsystem/Calculate_Pack_Remaining_Energy/Discharge_Mode"
 /begin REF_CHARACTERISTIC CcSOE_DischargeCutOffSoc_pct CcSYS_CellSOCLockedMax_pct CcSYS_CellSOCLockedMin_pct /end REF_CHARACTERISTIC
/end GROUP
/begin GROUP S1172_Calculate_Pack_OCV "VBU0428Test/VBUSystem/BMS/SOF/Subsystem6/Subsystem/Calculate_PowerLimit/Calculate_Pack_OCV" /begin REF_CHARACTERISTIC NUMBER_OF_PARALLEL_MODULES /end REF_CHARACTERISTIC /end GROUP
/begin GROUP S1174_Determine_CurrentLimitTarget_Enable "VBU0428Test/VBUSystem/BMS/SOF/Subsystem6/Subsystem/Determine_Currentlimit_Target/Determine_CurrentLimitTarget_Enable" /begin REF_CHARACTERISTIC CcSYS_NoOfInvalidCellTemps_n /end REF_CHARACTERISTIC /end GROUP
/begin GROUP S1616_OBC_ChargeState_Mapping "VBU0428Test/VBUSystem/BMS/VCT/Subsystem/Subsystem/Determine_BMS_VCU_AD/OBC_ChargeState_Mapping"
 /begin REF_CHARACTERISTIC FCC_STATE_CHARGE_FAULT FCC_STATE_CHARGE_FULL FCC_STATE_CHARGING VCT_CHARGE_STATE_CHARGING VCT_CHARGE_STATE_CHARGING_FAULT VCT_CHARGE_STATE_CHARGING_FULL VCT_CHARGE_STATE_NOT_CHARGING /end REF_CHARACTERISTIC
/end GROUP
/begin GROUP S3214_DCH_CtrlStateflowPostProcess "VBU0428Test/VBUSystem/VCU /DCH/DCH_Overall/DCH_DCChargeCtrlOverall/DCH_DCChargeCtrlStateflow/DCH_CtrlStateflowPostProcess" /begin REF_CHARACTERISTIC DCH_tiSmplT_SY /end REF_CHARACTERISTIC /end GROUP
/begin GROUP S3215_DCH_ChargeErrDetect "VBU0428Test/VBUSystem/VCU /DCH/DCH_Overall/DCH_DCChargeCtrlOverall/DCH_Diagnose/DCH_ChargeErrDetect" /begin REF_CHARACTERISTIC DCH_tiSmplT_SY /end REF_CHARACTERISTIC /end GROUP
/begin GROUP S3215_DCH_VehErrDetect "VBU0428Test/VBUSystem/VCU /DCH/DCH_Overall/DCH_DCChargeCtrlOverall/DCH_Diagnose/DCH_VehErrDetect" /begin REF_CHARACTERISTIC DCH_stChrgPortSnglSnsr_SY DCH_stChrgPortSnsrConfig_C /end REF_CHARACTERISTIC /end GROUP
/begin GROUP S322_Balance_Fault_Diagnostic1 "VBU0428Test/VBUSystem/BMS/CBL/Subsystem8/Subsystem/Determine_CSCCellBalanceRequest/Subsystem/Balance_Fault_Diagnostic1" /begin REF_CHARACTERISTIC SAMPLE_TIME_TASK_E /end REF_CHARACTERISTIC /end GROUP
/begin GROUP S798_Decrease_ChargeCurrentRequest "VBU0428Test/VBUSystem/BMS/FCC /FCC/Subsystem/Determine_Fastcharge_Request/Charge_Request_Protection/Decrease_ChargeCurrentRequest" /begin REF_CHARACTERISTIC CcFCC_ChargeCurrentOver_A FCC_STATE_CHARGING /end REF_CHARACTERISTIC /end GROUP
/begin GROUP S798_Override_Voltage_Request "VBU0428Test/VBUSystem/BMS/FCC /FCC/Subsystem/Determine_Fastcharge_Request/Charge_Request_Protection/Override_Voltage_Request" /begin REF_CHARACTERISTIC CcSYS_CellVoltageMaxLimit_mV MILIVOLTAGES_PER_VOLTAGE /end REF_CHARACTERISTIC /end GROUP
/begin GROUP S799_Determine_ComputeResistanceCondition "VBU0428Test/VBUSystem/BMS/FCC /FCC/Subsystem/Determine_Fastcharge_Request/DetermineComputeResistancePulseCurrent/Determine_ComputeResistanceCondition" /begin REF_CHARACTERISTIC FCC_STATE_CHARGING /end REF_CHARACTERISTIC /end GROUP
/begin GROUP S799_Determine_ComputeResistancePulseRequest "VBU0428Test/VBUSystem/BMS/FCC /FCC/Subsystem/Determine_Fastcharge_Request/DetermineComputeResistancePulseCurrent/Determine_ComputeResistancePulseRequest" /begin REF_CHARACTERISTIC WATS_PER_KILOWAT /end REF_CHARACTERISTIC /end GROUP
/begin GROUP S800_Request_At_Charging "VBU0428Test/VBUSystem/BMS/FCC /FCC/Subsystem/Determine_Fastcharge_Request/Determine_Base_ChargeRequest/Request_At_Charging"
 /begin REF_CHARACTERISTIC CcSYS_CellVoltageMaxLimit_mV MILIVOLTAGES_PER_VOLTAGE WATS_PER_KILOWAT /end REF_CHARACTERISTIC
/end GROUP
/begin GROUP S800_Request_At_NoCharging "VBU0428Test/VBUSystem/BMS/FCC /FCC/Subsystem/Determine_Fastcharge_Request/Determine_Base_ChargeRequest/Request_At_NoCharging"
 /begin REF_CHARACTERISTIC CcSYS_CellVoltageMaxLimit_mV MILIVOLTAGES_PER_VOLTAGE WATS_PER_KILOWAT /end REF_CHARACTERISTIC
/end GROUP
/begin GROUP S832_Voltage_Protection "VBU0428Test/VBUSystem/BMS/FCC /FCC/Subsystem/Fastcharge_Conditions_Check/Condition_Categorize/Voltage_Protection" /begin REF_CHARACTERISTIC CcSYS_CellVoltageMaxLimit_mV MILIVOLTAGES_PER_VOLTAGE /end REF_CHARACTERISTIC /end GROUP
/begin GROUP S1065_Battery_SOC_Calculation "VBU0428Test/VBUSystem/BMS/SOC/Subsystem5/Subsystem/Determine_Initial_SoC/CellSOC_Startup_AbnormalReset/Battery_SOC_Calculation"
 /begin REF_CHARACTERISTIC CcSOC_BatterySocLowerLimit_pct CcSOC_BatterySocUpperLimit_pct /end REF_CHARACTERISTIC
/end GROUP
/begin GROUP S1067_Battery_SOC_Calculation "VBU0428Test/VBUSystem/BMS/SOC/Subsystem5/Subsystem/Determine_Initial_SoC/CellSOC_Startup_Normal/Battery SOC Calculation"
 /begin REF_CHARACTERISTIC CcSOC_BatterySocLowerLimit_pct CcSOC_BatterySocUpperLimit_pct /end REF_CHARACTERISTIC
/end GROUP
/begin GROUP S1131_Predict_SOC_End "VBU0428Test/VBUSystem/BMS/SOE/Subsystem2/Subsystem/Calculate_Pack_Remaining_Energy/Discharge_Mode/Predict_SOC_End"
 /begin REF_CHARACTERISTIC CcSOE_DischargeCutOffSoc_pct CcSYS_CellSOCLockedMax_pct CcSYS_CellSOCLockedMin_pct /end REF_CHARACTERISTIC
/end GROUP
/begin GROUP S1178_Calculate_Locked_SOC "VBU0428Test/VBUSystem/BMS/SOF/Subsystem6/Subsystem/Calculate_PowerLimit/Calculate_Pack_OCV/Calculate_Locked_SOC" /begin REF_CHARACTERISTIC CcSYS_CellSOCLockedMax_pct CcSYS_CellSOCLockedMin_pct /end REF_CHARACTERISTIC /end GROUP
/begin GROUP S1180_Calculate_Locked_SOC "VBU0428Test/VBUSystem/BMS/SOF/Subsystem6/Subsystem/Calculate_PowerLimit/Determine_SOCP_PowerLimit/Calculate_Locked_SOC" /begin REF_CHARACTERISTIC CcSYS_CellSOCLockedMax_pct CcSYS_CellSOCLockedMin_pct /end REF_CHARACTERISTIC /end GROUP
/begin GROUP S1407_Determine_SlowCharge "VBU0428Test/VBUSystem/BMS/SOH/Subsystem4/Subsystem1/Calculate_Capacity/Determine_CalculateCellCapacity_Condition/Determine_SlowCharge" /begin REF_CHARACTERISTIC CcSYS_NoOfInvalidCellTemps_n VCT_CHARGE_STATE_CHARGING /end REF_CHARACTERISTIC /end GROUP
/begin GROUP S1407_Determine_SlowChargeEnd "VBU0428Test/VBUSystem/BMS/SOH/Subsystem4/Subsystem1/Calculate_Capacity/Determine_CalculateCellCapacity_Condition/Determine_SlowChargeEnd" /begin REF_CHARACTERISTIC CcSYS_NoOfInvalidCellTemps_n VCT_CHARGE_STATE_CHARGING /end REF_CHARACTERISTIC /end GROUP
/begin GROUP S1407_Determine_SlowChargeStart "VBU0428Test/VBUSystem/BMS/SOH/Subsystem4/Subsystem1/Calculate_Capacity/Determine_CalculateCellCapacity_Condition/Determine_SlowChargeStart" /begin REF_CHARACTERISTIC CcSYS_NoOfInvalidCellTemps_n VCT_CHARGE_STATE_CHARGING /end REF_CHARACTERISTIC /end GROUP
/begin GROUP S1473_ResistanceCalc_Check "VBU0428Test/VBUSystem/BMS/SOH/Subsystem4/Subsystem1/Calculate_Resistance/BasicCellResistance_Calculation_Check/ResistanceCalc_Check" /begin REF_CHARACTERISTIC CcSYS_NoOfInvalidCellTemps_n VCT_CHARGE_STATE_CHARGING /end REF_CHARACTERISTIC /end GROUP
/begin GROUP S1539_Determine_InletTemp_Validation "VBU0428Test/VBUSystem/BMS/THM/Subsystem/Subsystem/Calculate_PipeTemperature/Determine_CoolantSensorTemp_Validation/Determine_InletTemp_Validation" /begin REF_CHARACTERISTIC SAMPLE_TIME_TASK_E /end REF_CHARACTERISTIC /end GROUP
/begin GROUP S1539_Determine_OutletTemp_Validation "VBU0428Test/VBUSystem/BMS/THM/Subsystem/Subsystem/Calculate_PipeTemperature/Determine_CoolantSensorTemp_Validation/Determine_OutletTemp_Validation" /begin REF_CHARACTERISTIC SAMPLE_TIME_TASK_E /end REF_CHARACTERISTIC /end GROUP
/begin GROUP S3229_DCH_BMSChAvlDebounce "VBU0428Test/VBUSystem/VCU /DCH/DCH_Overall/DCH_DCChargeCtrlOverall/DCH_DCChargeCtrlStateflow/DCH_InputSignalPreProcess/DCH_BMSChAvlDebounce" /begin REF_CHARACTERISTIC DCH_tiSmplT_SY /end REF_CHARACTERISTIC /end GROUP
/begin GROUP S3229_DCH_DCRelayCloseDiagnose "VBU0428Test/VBUSystem/VCU /DCH/DCH_Overall/DCH_DCChargeCtrlOverall/DCH_DCChargeCtrlStateflow/DCH_InputSignalPreProcess/DCH_DCRelayCloseDiagnose" /begin REF_CHARACTERISTIC DCH_tiSmplT_SY /end REF_CHARACTERISTIC /end GROUP
/begin GROUP S3229_DCH_VehStateAnalyze "VBU0428Test/VBUSystem/VCU /DCH/DCH_Overall/DCH_DCChargeCtrlOverall/DCH_DCChargeCtrlStateflow/DCH_InputSignalPreProcess/DCH_VehStateAnalyze" /begin REF_CHARACTERISTIC DCH_tiSmplT_SY /end REF_CHARACTERISTIC /end GROUP
/begin GROUP S3230_DCH_OpenPDURelayValid "VBU0428Test/VBUSystem/VCU /DCH/DCH_Overall/DCH_DCChargeCtrlOverall/DCH_DCChargeCtrlStateflow/DCH_SignalPreProcessForStateflow/DCH_OpenPDURelayValid" /begin REF_CHARACTERISTIC DCH_tiSmplT_SY /end REF_CHARACTERISTIC /end GROUP
/begin GROUP S3273_DCH_BSTOrCSTTrigger "VBU0428Test/VBUSystem/VCU /DCH/DCH_Overall/DCH_DCChargeCtrlOverall/DCH_EepromStore/DCH_ChargeStopErrDiagnose/DCH_BSTOrCSTTrigger" /begin REF_CHARACTERISTIC DCH_tiSmplT_SY /end REF_CHARACTERISTIC /end GROUP
/begin GROUP S3275_CSTTrigDly "VBU0428Test/VBUSystem/VCU /DCH/DCH_Overall/DCH_DCChargeCtrlOverall/DCH_EepromStore/DataConvertandCSTEEPROM/CSTTrigDly" /begin REF_CHARACTERISTIC DCH_tiSmplT_SY /end REF_CHARACTERISTIC /end GROUP
/begin GROUP S324_Determine_VoltageBalanceReq "VBU0428Test/VBUSystem/BMS/CBL/Subsystem8/Subsystem/Determine_CSCCellBalanceRequest/Determine_CellBalanceRequest/Cell0/Determine_VoltageBalanceReq" /begin REF_CHARACTERISTIC FCC_STATE_CHARGING /end REF_CHARACTERISTIC /end GROUP
/begin GROUP S841_FullCharge_criteria2 "VBU0428Test/VBUSystem/BMS/FCC /FCC/Subsystem/Fastcharge_Conditions_Check/Condition_Categorize/Full_Charge_Determination/FullCharge_criteria2"
 /begin REF_CHARACTERISTIC MILIVOLTAGES_PER_VOLTAGE NUMBER_OF_PARALLEL_CELLS_PER_MODULE NUMBER_OF_PARALLEL_MODULES /end REF_CHARACTERISTIC
/end GROUP
/begin GROUP S841_FullCharge_criteria4 "VBU0428Test/VBUSystem/BMS/FCC /FCC/Subsystem/Fastcharge_Conditions_Check/Condition_Categorize/Full_Charge_Determination/FullCharge_criteria4" /begin REF_CHARACTERISTIC CbSYS_HomoTestEnable_flg /end REF_CHARACTERISTIC /end GROUP
/begin GROUP S1212_Calculate_ContinuousChargeCurrent "VBU0428Test/VBUSystem/BMS/SOF/Subsystem6/Subsystem/Determine_Currentlimit_Target/Calculate_CurrentLimit_Target/Calculate_CurrentLimit_Base/Calculate_ContinuousChargeCurrent" /begin REF_CHARACTERISTIC CbSYS_HomoTestEnable_flg /end REF_CHARACTERISTIC /end GROUP
/begin GROUP S1214_SegmentChargeCheck "VBU0428Test/VBUSystem/BMS/SOF/Subsystem6/Subsystem/Determine_Currentlimit_Target/Calculate_CurrentLimit_Target/CurrentLimit_FastCharge_Check/SegmentChargeCheck" /begin REF_CHARACTERISTIC CbSOF_CurrentLimitFastChargeCheckEnable_flg /end REF_CHARACTERISTIC /end GROUP
/begin GROUP S1443_Determine_Module_Current "VBU0428Test/VBUSystem/BMS/SOH/Subsystem4/Subsystem1/Calculate_Capacity/Calculate_CellCapacity_SlowCharge/Determine_AhIntegral_DeltaQ/Determine_Module_Current" /begin REF_CHARACTERISTIC NUMBER_OF_PARALLEL_MODULES /end REF_CHARACTERISTIC /end GROUP
/begin GROUP S1498_Determine_FCCPulseCurrent_Condition "VBU0428Test/VBUSystem/BMS/SOH/Subsystem4/Subsystem1/Calculate_Resistance/Determine_Condition_Calculate_Pulse_Average_CurrentVoltage/Determine_Condition/Determine_FCCPulseCurrent_Condition" /begin REF_CHARACTERISTIC NUMBER_OF_PARALLEL_MODULES /end REF_CHARACTERISTIC /end GROUP
/begin GROUP S1540_Determinate_InletTempValidationDelay "VBU0428Test/VBUSystem/BMS/THM/Subsystem/Subsystem/Calculate_PipeTemperature/Determine_CoolantSensorTemp_Validation/Determine_InletTemp_Validation/Determinate_InletTempValidationDelay" /begin REF_CHARACTERISTIC SAMPLE_TIME_TASK_E /end REF_CHARACTERISTIC /end GROUP
/begin GROUP S1541_Determinate_OutletTempValidationDelay "VBU0428Test/VBUSystem/BMS/THM/Subsystem/Subsystem/Calculate_PipeTemperature/Determine_CoolantSensorTemp_Validation/Determine_OutletTemp_Validation/Determinate_OutletTempValidationDelay" /begin REF_CHARACTERISTIC SAMPLE_TIME_TASK_E /end REF_CHARACTERISTIC /end GROUP
/begin GROUP S1217_Calculate_Locked_SOC "VBU0428Test/VBUSystem/BMS/SOF/Subsystem6/Subsystem/Determine_Currentlimit_Target/Calculate_CurrentLimit_Target/Calculate_CurrentLimit_Base/Calculate_ContinuousChargeCurrent/Calculate_Locked_SOC" /begin REF_CHARACTERISTIC CcSYS_CellSOCLockedMax_pct CcSYS_CellSOCLockedMin_pct /end REF_CHARACTERISTIC /end GROUP
/begin GROUP S1217_Calculate_Locked_SOC1 "VBU0428Test/VBUSystem/BMS/SOF/Subsystem6/Subsystem/Determine_Currentlimit_Target/Calculate_CurrentLimit_Target/Calculate_CurrentLimit_Base/Calculate_ContinuousChargeCurrent/Calculate_Locked_SOC1" /begin REF_CHARACTERISTIC CcSYS_CellSOCLockedMax_pct CcSYS_CellSOCLockedMin_pct /end REF_CHARACTERISTIC /end GROUP
/begin GROUP S1217_Calculate_Locked_SOC2 "VBU0428Test/VBUSystem/BMS/SOF/Subsystem6/Subsystem/Determine_Currentlimit_Target/Calculate_CurrentLimit_Target/Calculate_CurrentLimit_Base/Calculate_ContinuousChargeCurrent/Calculate_Locked_SOC2" /begin REF_CHARACTERISTIC CcSYS_CellSOCLockedMax_pct CcSYS_CellSOCLockedMin_pct /end REF_CHARACTERISTIC /end GROUP
/begin GROUP S1218_Calculate_Locked_SOC "VBU0428Test/VBUSystem/BMS/SOF/Subsystem6/Subsystem/Determine_Currentlimit_Target/Calculate_CurrentLimit_Target/Calculate_CurrentLimit_Base/Calculate_ContinuousDischargeCurrent/Calculate_Locked_SOC" /begin REF_CHARACTERISTIC CcSYS_CellSOCLockedMax_pct CcSYS_CellSOCLockedMin_pct /end REF_CHARACTERISTIC /end GROUP
/begin GROUP S1218_Calculate_Locked_SOC1 "VBU0428Test/VBUSystem/BMS/SOF/Subsystem6/Subsystem/Determine_Currentlimit_Target/Calculate_CurrentLimit_Target/Calculate_CurrentLimit_Base/Calculate_ContinuousDischargeCurrent/Calculate_Locked_SOC1" /begin REF_CHARACTERISTIC CcSYS_CellSOCLockedMax_pct CcSYS_CellSOCLockedMin_pct /end REF_CHARACTERISTIC /end GROUP
/begin GROUP S1219_Calculate_Locked_SOC "VBU0428Test/VBUSystem/BMS/SOF/Subsystem6/Subsystem/Determine_Currentlimit_Target/Calculate_CurrentLimit_Target/Calculate_CurrentLimit_Base/Calculate_ShortPulseChargeCurrent/Calculate_Locked_SOC" /begin REF_CHARACTERISTIC CcSYS_CellSOCLockedMax_pct CcSYS_CellSOCLockedMin_pct /end REF_CHARACTERISTIC /end GROUP
/begin GROUP S1219_Calculate_Locked_SOC1 "VBU0428Test/VBUSystem/BMS/SOF/Subsystem6/Subsystem/Determine_Currentlimit_Target/Calculate_CurrentLimit_Target/Calculate_CurrentLimit_Base/Calculate_ShortPulseChargeCurrent/Calculate_Locked_SOC1" /begin REF_CHARACTERISTIC CcSYS_CellSOCLockedMax_pct CcSYS_CellSOCLockedMin_pct /end REF_CHARACTERISTIC /end GROUP
/begin GROUP S1220_Calculate_Locked_SOC "VBU0428Test/VBUSystem/BMS/SOF/Subsystem6/Subsystem/Determine_Currentlimit_Target/Calculate_CurrentLimit_Target/Calculate_CurrentLimit_Base/Calculate_ShortPulseDischargeCurrent/Calculate_Locked_SOC" /begin REF_CHARACTERISTIC CcSYS_CellSOCLockedMax_pct CcSYS_CellSOCLockedMin_pct /end REF_CHARACTERISTIC /end GROUP
/begin GROUP S1220_Calculate_Locked_SOC1 "VBU0428Test/VBUSystem/BMS/SOF/Subsystem6/Subsystem/Determine_Currentlimit_Target/Calculate_CurrentLimit_Target/Calculate_CurrentLimit_Base/Calculate_ShortPulseDischargeCurrent/Calculate_Locked_SOC1" /begin REF_CHARACTERISTIC CcSYS_CellSOCLockedMax_pct CcSYS_CellSOCLockedMin_pct /end REF_CHARACTERISTIC /end GROUP
/begin GROUP S1319_Calculate_CurrentLimit "VBU0428Test/VBUSystem/BMS/SOF/Subsystem6/Subsystem/Determine_Currentlimit_Target/Calculate_CurrentLimit_Target/CurrentLimit_Voltage_Correct/Correct_CurrentLimit/Calculate_CurrentLimit" /begin REF_CHARACTERISTIC MILIVOLTAGES_PER_VOLTAGE /end REF_CHARACTERISTIC /end GROUP
/begin GROUP S1321_BatteryVoltageAveCalculate "VBU0428Test/VBUSystem/BMS/SOF/Subsystem6/Subsystem/Determine_Currentlimit_Target/Calculate_CurrentLimit_Target/CurrentLimit_Voltage_Correct/Correct_CurrentLimit/Calculate_CurrentLimit/BatteryVoltageAveCalculate" /begin REF_CHARACTERISTIC MILIVOLTAGES_PER_VOLTAGE /end REF_CHARACTERISTIC /end GROUP
/end MODULE
/end PROJECT
