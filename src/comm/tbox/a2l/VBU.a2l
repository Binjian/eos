ASAP2_VERSION 1 31
/begin PROJECT ProjectName "Project Comment Goes Here"
/begin HEADER "Header Comments go here" /end HEADER
/begin MODULE ModuleName "Module Comment Goes Here"
/begin MOD_COMMON "Mod Common Comment Here" BYTE_ORDER MSB_LAST /end MOD_COMMON
/begin RECORD_LAYOUT Scalar_BOOLEAN FNC_VALUES 1 UBYTE COLUMN_DIR DIRECT /end RECORD_LAYOUT
/begin RECORD_LAYOUT Scalar_UBYTE FNC_VALUES 1 UBYTE COLUMN_DIR DIRECT /end RECORD_LAYOUT
/begin RECORD_LAYOUT Scalar_BYTE FNC_VALUES 1 SBYTE COLUMN_DIR DIRECT /end RECORD_LAYOUT
/begin RECORD_LAYOUT Scalar_UWORD FNC_VALUES 1 UWORD COLUMN_DIR DIRECT /end RECORD_LAYOUT
/begin RECORD_LAYOUT Scalar_ULONG FNC_VALUES 1 ULONG COLUMN_DIR DIRECT /end RECORD_LAYOUT
/begin RECORD_LAYOUT Scalar_FLOAT32_IEEE FNC_VALUES 1 FLOAT32_IEEE COLUMN_DIR DIRECT /end RECORD_LAYOUT
/begin RECORD_LAYOUT Lookup1D_X_WORD AXIS_PTS_X 1 SWORD INDEX_INCR DIRECT /end RECORD_LAYOUT
/begin RECORD_LAYOUT Lookup1D_ULONG FNC_VALUES 1 ULONG COLUMN_DIR DIRECT /end RECORD_LAYOUT
/begin RECORD_LAYOUT Lookup1D_X_ULONG AXIS_PTS_X 1 ULONG INDEX_INCR DIRECT /end RECORD_LAYOUT
/begin RECORD_LAYOUT Lookup1D_FLOAT32_IEEE FNC_VALUES 1 FLOAT32_IEEE COLUMN_DIR DIRECT /end RECORD_LAYOUT
/begin RECORD_LAYOUT Lookup1D_X_FLOAT32_IEEE AXIS_PTS_X 1 FLOAT32_IEEE INDEX_INCR DIRECT /end RECORD_LAYOUT
/begin RECORD_LAYOUT Lookup2D_FLOAT32_IEEE FNC_VALUES 1 FLOAT32_IEEE COLUMN_DIR DIRECT /end RECORD_LAYOUT
/begin RECORD_LAYOUT Lookup2D_X_FLOAT32_IEEE AXIS_PTS_X 1 FLOAT32_IEEE INDEX_INCR DIRECT /end RECORD_LAYOUT
/begin CHARACTERISTIC EDIS_pwrChDynSpare_CUR_v "" CURVE 0x700121aa Lookup1D_FLOAT32_IEEE 0 VBU0428Test_CM_single_cnt -3.4028234663852886E+38 3.4028234663852886E+38
 /begin AXIS_DESCR COM_AXIS EDIS_pwrChLimLTRaw VBU0428Test_CM_single_cnt 6 -3.4028234663852886E+38 3.4028234663852886E+38 AXIS_PTS_REF EDIS_pwrChDyn_CUR_x /end AXIS_DESCR
/end CHARACTERISTIC
/begin AXIS_PTS EDIS_pwrChDyn_CUR_x "" 0x700121c2 EDIS_pwrChLimLTRaw Lookup1D_X_FLOAT32_IEEE 0 VBU0428Test_CM_single_cnt 6 -3.4028234663852886E+38 3.4028234663852886E+38 /end AXIS_PTS
/begin CHARACTERISTIC VM_aMSLimHomeD_CUR_v "" CURVE 0x70013aee Lookup1D_FLOAT32_IEEE 0 VBU0428Test_CM_single_cnt -3.4028234663852886E+38 3.4028234663852886E+38
 /begin AXIS_DESCR COM_AXIS NO_INPUT_QUANTITY VBU0428Test_CM_single_cnt 14 -3.4028234663852886E+38 3.4028234663852886E+38 AXIS_PTS_REF VM_vMSLimHomeD_CUR_x /end AXIS_DESCR
/end CHARACTERISTIC
/begin AXIS_PTS VM_vMSLimHomeD_CUR_x "" 0x70013b5e NO_INPUT_QUANTITY Lookup1D_X_FLOAT32_IEEE 0 VBU0428Test_CM_single_cnt 14 -3.4028234663852886E+38 3.4028234663852886E+38 /end AXIS_PTS
/begin CHARACTERISTIC VM_aMSLimHomeR_CUR_v "" CURVE 0x70012342 Lookup1D_FLOAT32_IEEE 0 VBU0428Test_CM_single_cnt -3.4028234663852886E+38 3.4028234663852886E+38
 /begin AXIS_DESCR COM_AXIS NO_INPUT_QUANTITY VBU0428Test_CM_single_cnt 6 -3.4028234663852886E+38 3.4028234663852886E+38 AXIS_PTS_REF VM_vMSLimHomeR_CUR_x /end AXIS_DESCR
/end CHARACTERISTIC
/begin AXIS_PTS VM_vMSLimHomeR_CUR_x "" 0x70012372 NO_INPUT_QUANTITY Lookup1D_X_FLOAT32_IEEE 0 VBU0428Test_CM_single_cnt 6 -3.4028234663852886E+38 3.4028234663852886E+38 /end AXIS_PTS
/begin CHARACTERISTIC VM_aMSLimR_CUR_v "" CURVE 0x7001235a Lookup1D_FLOAT32_IEEE 0 VBU0428Test_CM_single_cnt -3.4028234663852886E+38 3.4028234663852886E+38
 /begin AXIS_DESCR COM_AXIS NO_INPUT_QUANTITY VBU0428Test_CM_single_cnt 6 -3.4028234663852886E+38 3.4028234663852886E+38 AXIS_PTS_REF VM_vMSLimR_CUR_x /end AXIS_DESCR
/end CHARACTERISTIC
/begin AXIS_PTS VM_vMSLimR_CUR_x "" 0x7001238a NO_INPUT_QUANTITY Lookup1D_X_FLOAT32_IEEE 0 VBU0428Test_CM_single_cnt 6 -3.4028234663852886E+38 3.4028234663852886E+38 /end AXIS_PTS
/begin CHARACTERISTIC VM_aMSLimD_CUR_v "" CURVE 0x70013ab6 Lookup1D_FLOAT32_IEEE 0 VBU0428Test_CM_single_cnt -3.4028234663852886E+38 3.4028234663852886E+38
 /begin AXIS_DESCR COM_AXIS NO_INPUT_QUANTITY VBU0428Test_CM_single_cnt 14 -3.4028234663852886E+38 3.4028234663852886E+38 AXIS_PTS_REF VM_vMSLimD_CUR_x /end AXIS_DESCR
/end CHARACTERISTIC
/begin AXIS_PTS VM_vMSLimD_CUR_x "" 0x70013b26 NO_INPUT_QUANTITY Lookup1D_X_FLOAT32_IEEE 0 VBU0428Test_CM_single_cnt 14 -3.4028234663852886E+38 3.4028234663852886E+38 /end AXIS_PTS
/begin CHARACTERISTIC CrCtl_facDragSpeed_MAP_v "" MAP 0x70017f90 Lookup2D_FLOAT32_IEEE 0 VBU0428Test_CM_single_cnt -3.4028234663852886E+38 3.4028234663852886E+38
 /begin AXIS_DESCR COM_AXIS NO_INPUT_QUANTITY VBU0428Test_CM_single_cnt 14 -3.4028234663852886E+38 3.4028234663852886E+38 AXIS_PTS_REF CrCtl_vDragSpeed_MAP_y /end AXIS_DESCR
 /begin AXIS_DESCR COM_AXIS NO_INPUT_QUANTITY VBU0428Test_CM_single_cnt 11 -3.4028234663852886E+38 3.4028234663852886E+38 AXIS_PTS_REF CrCtl_pctDragSpeed_MAP_x /end AXIS_DESCR
/end CHARACTERISTIC
/begin AXIS_PTS CrCtl_pctDragSpeed_MAP_x "" 0x70012cf6 NO_INPUT_QUANTITY Lookup2D_X_FLOAT32_IEEE 0 VBU0428Test_CM_single_cnt 11 -3.4028234663852886E+38 3.4028234663852886E+38 /end AXIS_PTS
/begin AXIS_PTS CrCtl_vDragSpeed_MAP_y "" 0x70013a7e NO_INPUT_QUANTITY Lookup2D_X_FLOAT32_IEEE 0 VBU0428Test_CM_single_cnt 14 -3.4028234663852886E+38 3.4028234663852886E+38 /end AXIS_PTS
/begin CHARACTERISTIC TQD_trqTrqSetECO_MAP_v "" MAP 0x7001c67c Lookup2D_FLOAT32_IEEE 0 VBU0428Test_CM_single_Nm -10000.0 10000.0
 /begin AXIS_DESCR COM_AXIS TQD_vVehSpd VBU0428Test_CM_single_kph 21 0.0 110.0 AXIS_PTS_REF TQD_vSgndSpd_MAP_y /end AXIS_DESCR
 /begin AXIS_DESCR COM_AXIS TQD_pctAccPedPosFlt VBU0428Test_CM_single_pct 17 0.0 100.0 AXIS_PTS_REF TQD_pctAccPdl_MAP_x /end AXIS_DESCR
/end CHARACTERISTIC
/begin AXIS_PTS TQD_pctAccPdl_MAP_x "" 0x70013fae TQD_pctAccPedPosFlt Lookup2D_X_FLOAT32_IEEE 0 VBU0428Test_CM_single_pct 17 0.0 100.0 /end AXIS_PTS
/begin AXIS_PTS TQD_vSgndSpd_MAP_y "" 0x700148c6 TQD_vVehSpd Lookup2D_X_FLOAT32_IEEE 0 VBU0428Test_CM_single_kph 21 0.0 110.0 /end AXIS_PTS
/begin CHARACTERISTIC TQD_trqTrqSetNormal_MAP_v "" MAP 0x7001cc10 Lookup2D_FLOAT32_IEEE 0 VBU0428Test_CM_single_Nm -10000.0 10000.0
 /begin AXIS_DESCR COM_AXIS TQD_vVehSpd VBU0428Test_CM_single_kph 21 0.0 110.0 AXIS_PTS_REF TQD_vSgndSpd_MAP_y /end AXIS_DESCR
 /begin AXIS_DESCR COM_AXIS TQD_pctAccPedPosFlt VBU0428Test_CM_single_pct 17 0.0 100.0 AXIS_PTS_REF TQD_pctAccPdl_MAP_x /end AXIS_DESCR
/end CHARACTERISTIC
/begin CHARACTERISTIC TQD_facTrqDesGrR_CUR_v "" CURVE 0x700128ba Lookup1D_FLOAT32_IEEE 0 VBU0428Test_CM_single_pct 0.0 100.0
 /begin AXIS_DESCR COM_AXIS TQD_vVehSpd VBU0428Test_CM_single_kph 9 0.0 110.0 AXIS_PTS_REF TQD_vSgndSpdGrFac_CUR_x /end AXIS_DESCR
/end CHARACTERISTIC
/begin AXIS_PTS TQD_vSgndSpdGrFac_CUR_x "" 0x70012902 TQD_vVehSpd Lookup1D_X_FLOAT32_IEEE 0 VBU0428Test_CM_single_kph 9 0.0 110.0 /end AXIS_PTS
/begin CHARACTERISTIC TQD_pctCrpOff_CUR_v "" CURVE 0x70013ff2 Lookup1D_FLOAT32_IEEE 0 VBU0428Test_CM_single_pct 0.0 100.0
 /begin AXIS_DESCR COM_AXIS APD_pctAccPedPos VBU0428Test_CM_single_pct 17 0.0 100.0 AXIS_PTS_REF TQD_pctAccPdl_CUR_x /end AXIS_DESCR
/end CHARACTERISTIC
/begin AXIS_PTS TQD_pctAccPdl_CUR_x "" 0x70013f6a APD_pctAccPedPos Lookup1D_X_FLOAT32_IEEE 0 VBU0428Test_CM_single_pct 17 0.0 100.0 /end AXIS_PTS
/begin CHARACTERISTIC TQD_trqRoad_CUR_v "" CURVE 0x7001481e Lookup1D_FLOAT32_IEEE 0 VBU0428Test_CM_single_Nm -10000.0 10000.0
 /begin AXIS_DESCR COM_AXIS TQD_vVehSpd VBU0428Test_CM_single_kph 21 -250.0 250.0 AXIS_PTS_REF TQD_vSgndSpd_CUR_x /end AXIS_DESCR
/end CHARACTERISTIC
/begin AXIS_PTS TQD_vSgndSpd_CUR_x "" 0x70014872 TQD_vVehSpd Lookup1D_X_FLOAT32_IEEE 0 VBU0428Test_CM_single_kph 21 -250.0 250.0 /end AXIS_PTS
/begin CHARACTERISTIC MTQL_trqMtrTrqDrvLT_CUR_v "" CURVE 0x7001284e Lookup1D_FLOAT32_IEEE 0 VBU0428Test_CM_single_cnt -3.4028234663852886E+38 3.4028234663852886E+38
 /begin AXIS_DESCR COM_AXIS NO_INPUT_QUANTITY VBU0428Test_CM_single_cnt 9 -3.4028234663852886E+38 3.4028234663852886E+38 AXIS_PTS_REF MTQL_nMotrLT_CUR_x /end AXIS_DESCR
/end CHARACTERISTIC
/begin AXIS_PTS MTQL_nMotrLT_CUR_x "" 0x70012806 NO_INPUT_QUANTITY Lookup1D_X_FLOAT32_IEEE 0 VBU0428Test_CM_single_cnt 9 -3.4028234663852886E+38 3.4028234663852886E+38 /end AXIS_PTS
/begin CHARACTERISTIC BPD_pctBrkPosOverrideVal_C "" VALUE 0x700103e4 Scalar_FLOAT32_IEEE 0 VBU0428Test_CM_single_cnt -3.4028234663852886E+38 3.4028234663852886E+38 /end CHARACTERISTIC
/begin CHARACTERISTIC CBL_BALANCE_RESPOND_MISNATCH_REQUEST_FAULT "" VALUE 0x700103fc Scalar_FLOAT32_IEEE 0 VBU0428Test_CM_single_cnt -3.4028234663852886E+38 3.4028234663852886E+38 /end CHARACTERISTIC
/begin CHARACTERISTIC CcBCV_ABatteryCurrentOoR_C "" VALUE 0x7001048c Scalar_FLOAT32_IEEE 0 VBU0428Test_CM_single_A -3.4028234663852886E+38 3.4028234663852886E+38 /end CHARACTERISTIC
/begin CHARACTERISTIC CcBCV_BatteryBusVoltageMismatchFaultDelta_V "" VALUE 0x70010490 Scalar_FLOAT32_IEEE 0 VBU0428Test_CM_single_cnt -3.4028234663852886E+38 3.4028234663852886E+38 /end CHARACTERISTIC
/begin CHARACTERISTIC CcBCV_BatteryBusVoltageMismatchFault_V "" VALUE 0x70010494 Scalar_FLOAT32_IEEE 0 VBU0428Test_CM_single_cnt -3.4028234663852886E+38 3.4028234663852886E+38 /end CHARACTERISTIC
/begin CHARACTERISTIC CcBCV_BatteryCurrentOoR_A "" VALUE 0x70010498 Scalar_FLOAT32_IEEE 0 VBU0428Test_CM_single_cnt -3.4028234663852886E+38 3.4028234663852886E+38 /end CHARACTERISTIC
/begin CHARACTERISTIC CcBCV_BatteryOverCurrentWarning_A "" VALUE 0x700104a0 Scalar_FLOAT32_IEEE 0 VBU0428Test_CM_single_cnt -3.4028234663852886E+38 3.4028234663852886E+38 /end CHARACTERISTIC
/begin CHARACTERISTIC CcBCV_BatteryOverCurrent_A "" VALUE 0x700104a4 Scalar_FLOAT32_IEEE 0 VBU0428Test_CM_single_cnt -3.4028234663852886E+38 3.4028234663852886E+38 /end CHARACTERISTIC
/begin CHARACTERISTIC CcBCV_BatteryOverVoltageEVM_V "" VALUE 0x700104a8 Scalar_FLOAT32_IEEE 0 VBU0428Test_CM_single_cnt -3.4028234663852886E+38 3.4028234663852886E+38 /end CHARACTERISTIC
/begin CHARACTERISTIC CcBCV_BatteryOverVoltageWarning_V "" VALUE 0x700104b0 Scalar_FLOAT32_IEEE 0 VBU0428Test_CM_single_cnt -3.4028234663852886E+38 3.4028234663852886E+38 /end CHARACTERISTIC
/begin CHARACTERISTIC CcBCV_BatteryOverVoltage_V "" VALUE 0x700104b4 Scalar_FLOAT32_IEEE 0 VBU0428Test_CM_single_cnt -3.4028234663852886E+38 3.4028234663852886E+38 /end CHARACTERISTIC
/begin CHARACTERISTIC CcBCV_BatteryUnderVoltage1_V "" VALUE 0x700104b8 Scalar_FLOAT32_IEEE 0 VBU0428Test_CM_single_cnt -3.4028234663852886E+38 3.4028234663852886E+38 /end CHARACTERISTIC
/begin CHARACTERISTIC CcBCV_BatteryUnderVoltage2_V "" VALUE 0x700104bc Scalar_FLOAT32_IEEE 0 VBU0428Test_CM_single_cnt -3.4028234663852886E+38 3.4028234663852886E+38 /end CHARACTERISTIC
/begin CHARACTERISTIC CcBCV_BatteryUnderVoltageEVM1_V "" VALUE 0x700104c0 Scalar_FLOAT32_IEEE 0 VBU0428Test_CM_single_cnt -3.4028234663852886E+38 3.4028234663852886E+38 /end CHARACTERISTIC
/begin CHARACTERISTIC CcBCV_BatteryUnderVoltageEVM2_V "" VALUE 0x700104c4 Scalar_FLOAT32_IEEE 0 VBU0428Test_CM_single_cnt -3.4028234663852886E+38 3.4028234663852886E+38 /end CHARACTERISTIC
/begin CHARACTERISTIC CcBCV_BatteryUnderVoltageTemp_C "" VALUE 0x700104c8 Scalar_FLOAT32_IEEE 0 VBU0428Test_CM_single_cnt -3.4028234663852886E+38 3.4028234663852886E+38 /end CHARACTERISTIC
/begin CHARACTERISTIC CcBCV_BatteryVoltageOoRHigh_V "" VALUE 0x700104cc Scalar_FLOAT32_IEEE 0 VBU0428Test_CM_single_cnt -3.4028234663852886E+38 3.4028234663852886E+38 /end CHARACTERISTIC
/begin CHARACTERISTIC CcBCV_BatteryVoltageOoRLow_V "" VALUE 0x700104d0 Scalar_FLOAT32_IEEE 0 VBU0428Test_CM_single_cnt -3.4028234663852886E+38 3.4028234663852886E+38 /end CHARACTERISTIC
/begin CHARACTERISTIC CcBCV_DCContactorOverCurrent_A "" VALUE 0x700104fc Scalar_FLOAT32_IEEE 0 VBU0428Test_CM_single_cnt -3.4028234663852886E+38 3.4028234663852886E+38 /end CHARACTERISTIC
/begin CHARACTERISTIC CcBCV_FuseCurrentFactor1_n "" VALUE 0x70010500 Scalar_FLOAT32_IEEE 0 VBU0428Test_CM_single_cnt -3.4028234663852886E+38 3.4028234663852886E+38 /end CHARACTERISTIC
/begin CHARACTERISTIC CcBCV_FuseCurrentFactor2_n "" VALUE 0x70010504 Scalar_FLOAT32_IEEE 0 VBU0428Test_CM_single_cnt -3.4028234663852886E+38 3.4028234663852886E+38 /end CHARACTERISTIC
/begin CHARACTERISTIC CcBCV_FuseCurrentFactor3_n "" VALUE 0x70010508 Scalar_FLOAT32_IEEE 0 VBU0428Test_CM_single_cnt -3.4028234663852886E+38 3.4028234663852886E+38 /end CHARACTERISTIC
/begin CHARACTERISTIC CcBCV_FuseCurrentHigh1_A "" VALUE 0x7001050c Scalar_FLOAT32_IEEE 0 VBU0428Test_CM_single_cnt -3.4028234663852886E+38 3.4028234663852886E+38 /end CHARACTERISTIC
/begin CHARACTERISTIC CcBCV_FuseCurrentHigh2_A "" VALUE 0x70010510 Scalar_FLOAT32_IEEE 0 VBU0428Test_CM_single_cnt -3.4028234663852886E+38 3.4028234663852886E+38 /end CHARACTERISTIC
/begin CHARACTERISTIC CcBCV_FuseCurrentHigh3_A "" VALUE 0x70010514 Scalar_FLOAT32_IEEE 0 VBU0428Test_CM_single_cnt -3.4028234663852886E+38 3.4028234663852886E+38 /end CHARACTERISTIC
/begin CHARACTERISTIC CcBCV_FuseCurrentHigh4_A "" VALUE 0x70010518 Scalar_FLOAT32_IEEE 0 VBU0428Test_CM_single_cnt -3.4028234663852886E+38 3.4028234663852886E+38 /end CHARACTERISTIC
/begin CHARACTERISTIC CcBCV_FuseCurrentLow1_A "" VALUE 0x7001051c Scalar_FLOAT32_IEEE 0 VBU0428Test_CM_single_cnt -3.4028234663852886E+38 3.4028234663852886E+38 /end CHARACTERISTIC
/begin CHARACTERISTIC CcBCV_FuseCurrentLow2_A "" VALUE 0x70010520 Scalar_FLOAT32_IEEE 0 VBU0428Test_CM_single_cnt -3.4028234663852886E+38 3.4028234663852886E+38 /end CHARACTERISTIC
/begin CHARACTERISTIC CcBCV_FuseCurrentLow3_A "" VALUE 0x70010524 Scalar_FLOAT32_IEEE 0 VBU0428Test_CM_single_cnt -3.4028234663852886E+38 3.4028234663852886E+38 /end CHARACTERISTIC
/begin CHARACTERISTIC CcBCV_FuseCurrentLow4_A "" VALUE 0x70010528 Scalar_FLOAT32_IEEE 0 VBU0428Test_CM_single_cnt -3.4028234663852886E+38 3.4028234663852886E+38 /end CHARACTERISTIC
/begin CHARACTERISTIC CcBCV_FuseHealthThreshold_n "" VALUE 0x7001052c Scalar_FLOAT32_IEEE 0 VBU0428Test_CM_single_cnt -3.4028234663852886E+38 3.4028234663852886E+38 /end CHARACTERISTIC
/begin CHARACTERISTIC CcCBL_BalanceStartCellSoc_pct "" VALUE 0x70010558 Scalar_FLOAT32_IEEE 0 VBU0428Test_CM_single_cnt -3.4028234663852886E+38 3.4028234663852886E+38 /end CHARACTERISTIC
/begin CHARACTERISTIC CcCBL_BalanceStartCellTempMaxHysteresis_C "" VALUE 0x7001055c Scalar_FLOAT32_IEEE 0 VBU0428Test_CM_single_cnt -3.4028234663852886E+38 3.4028234663852886E+38 /end CHARACTERISTIC
/begin CHARACTERISTIC CcCBL_BalanceStartCellTempMax_C "" VALUE 0x70010560 Scalar_FLOAT32_IEEE 0 VBU0428Test_CM_single_cnt -3.4028234663852886E+38 3.4028234663852886E+38 /end CHARACTERISTIC
/begin CHARACTERISTIC CcCBL_BalanceStartDeltaSoc_pct "" VALUE 0x70010568 Scalar_FLOAT32_IEEE 0 VBU0428Test_CM_single_cnt -3.4028234663852886E+38 3.4028234663852886E+38 /end CHARACTERISTIC
/begin CHARACTERISTIC CcCBL_BalanceStartIsoResistance_Kohm "" VALUE 0x7001056c Scalar_FLOAT32_IEEE 0 VBU0428Test_CM_single_cnt -3.4028234663852886E+38 3.4028234663852886E+38 /end CHARACTERISTIC
/begin CHARACTERISTIC CcCBL_CellBalanceChargeCurrentHysteresis_A "" VALUE 0x7001057c Scalar_FLOAT32_IEEE 0 VBU0428Test_CM_single_cnt -3.4028234663852886E+38 3.4028234663852886E+38 /end CHARACTERISTIC
/begin CHARACTERISTIC CcCBL_CellBalanceChargeCurrent_A "" VALUE 0x70010580 Scalar_FLOAT32_IEEE 0 VBU0428Test_CM_single_cnt -3.4028234663852886E+38 3.4028234663852886E+38 /end CHARACTERISTIC
/begin CHARACTERISTIC CcCBL_CellBalanceDischargeCurrentHysteresis_A "" VALUE 0x70010584 Scalar_FLOAT32_IEEE 0 VBU0428Test_CM_single_cnt -3.4028234663852886E+38 3.4028234663852886E+38 /end CHARACTERISTIC
/begin CHARACTERISTIC CcCBL_CellBalanceDischargeCurrent_A "" VALUE 0x70010588 Scalar_FLOAT32_IEEE 0 VBU0428Test_CM_single_cnt -3.4028234663852886E+38 3.4028234663852886E+38 /end CHARACTERISTIC
/begin CHARACTERISTIC CcCBL_SocBalanceChargeCurrentHysteresis_A "" VALUE 0x70010590 Scalar_FLOAT32_IEEE 0 VBU0428Test_CM_single_cnt -3.4028234663852886E+38 3.4028234663852886E+38 /end CHARACTERISTIC
/begin CHARACTERISTIC CcCBL_SocBalanceChargeCurrent_A "" VALUE 0x70010594 Scalar_FLOAT32_IEEE 0 VBU0428Test_CM_single_cnt -3.4028234663852886E+38 3.4028234663852886E+38 /end CHARACTERISTIC
/begin CHARACTERISTIC CcCBL_SocBalanceDischargeCurrentHysteresis_A "" VALUE 0x70010598 Scalar_FLOAT32_IEEE 0 VBU0428Test_CM_single_cnt -3.4028234663852886E+38 3.4028234663852886E+38 /end CHARACTERISTIC
/begin CHARACTERISTIC CcCBL_SocBalanceDischargeCurrent_A "" VALUE 0x7001059c Scalar_FLOAT32_IEEE 0 VBU0428Test_CM_single_cnt -3.4028234663852886E+38 3.4028234663852886E+38 /end CHARACTERISTIC
/begin CHARACTERISTIC CcCBL_SystemVoltageMaxHysteresis_V "" VALUE 0x700105a0 Scalar_FLOAT32_IEEE 0 VBU0428Test_CM_single_cnt -3.4028234663852886E+38 3.4028234663852886E+38 /end CHARACTERISTIC
/begin CHARACTERISTIC CcCBL_SystemVoltageMax_V "" VALUE 0x700105a4 Scalar_FLOAT32_IEEE 0 VBU0428Test_CM_single_cnt -3.4028234663852886E+38 3.4028234663852886E+38 /end CHARACTERISTIC
/begin CHARACTERISTIC CcCBL_SystemVoltageMinHysteresis_V "" VALUE 0x700105a8 Scalar_FLOAT32_IEEE 0 VBU0428Test_CM_single_cnt -3.4028234663852886E+38 3.4028234663852886E+38 /end CHARACTERISTIC
/begin CHARACTERISTIC CcCBL_SystemVoltageMin_V "" VALUE 0x700105ac Scalar_FLOAT32_IEEE 0 VBU0428Test_CM_single_cnt -3.4028234663852886E+38 3.4028234663852886E+38 /end CHARACTERISTIC
/begin CHARACTERISTIC CcCTD_MnNegContactorCloseDeltaVoltage_V "" VALUE 0x700105d8 Scalar_FLOAT32_IEEE 0 VBU0428Test_CM_single_cnt -3.4028234663852886E+38 3.4028234663852886E+38 /end CHARACTERISTIC
/begin CHARACTERISTIC CcCTD_PEUMessageDataValidDelay_ms "" VALUE 0x700105ec Scalar_FLOAT32_IEEE 0 VBU0428Test_CM_single_cnt -3.4028234663852886E+38 3.4028234663852886E+38 /end CHARACTERISTIC
/begin CHARACTERISTIC CcCTD_PEURVtoBatVThresholdLower_pct "" VALUE 0x700105f4 Scalar_FLOAT32_IEEE 0 VBU0428Test_CM_single_cnt -3.4028234663852886E+38 3.4028234663852886E+38 /end CHARACTERISTIC
/begin CHARACTERISTIC CcCTD_PEURVtoBatVThresholdUpper_pct "" VALUE 0x700105f8 Scalar_FLOAT32_IEEE 0 VBU0428Test_CM_single_cnt -3.4028234663852886E+38 3.4028234663852886E+38 /end CHARACTERISTIC
/begin CHARACTERISTIC DCH_iBCLCurrReqOvrdVal_C "" VALUE 0x70010c88 Scalar_FLOAT32_IEEE 0 VBU0428Test_CM_single_cnt -3.4028234663852886E+38 3.4028234663852886E+38 /end CHARACTERISTIC
/begin CHARACTERISTIC DCH_numBCSMaxCellNumLowLim_C "" VALUE 0x70010cbc Scalar_FLOAT32_IEEE 0 VBU0428Test_CM_single_cnt -3.4028234663852886E+38 3.4028234663852886E+38 /end CHARACTERISTIC
/begin CHARACTERISTIC DCH_numBCSMaxCellNumUpLim_C "" VALUE 0x70010cc0 Scalar_FLOAT32_IEEE 0 VBU0428Test_CM_single_cnt -3.4028234663852886E+38 3.4028234663852886E+38 /end CHARACTERISTIC
/begin CHARACTERISTIC DCH_pctBSDChEndSocOvrdVal_C "" VALUE 0x70010d38 Scalar_FLOAT32_IEEE 0 VBU0428Test_CM_single_cnt -3.4028234663852886E+38 3.4028234663852886E+38 /end CHARACTERISTIC
/begin CHARACTERISTIC DCH_tBCPMaxPermitTempLowLim_C "" VALUE 0x70010d3c Scalar_FLOAT32_IEEE 0 VBU0428Test_CM_single_cnt -3.4028234663852886E+38 3.4028234663852886E+38 /end CHARACTERISTIC
/begin CHARACTERISTIC DCH_tBCPMaxPermitTempUpLim_C "" VALUE 0x70010d44 Scalar_FLOAT32_IEEE 0 VBU0428Test_CM_single_cnt -3.4028234663852886E+38 3.4028234663852886E+38 /end CHARACTERISTIC
/begin CHARACTERISTIC DCH_tBSDMaxCellTempOvrdVal_C "" VALUE 0x70010d48 Scalar_FLOAT32_IEEE 0 VBU0428Test_CM_single_cnt -3.4028234663852886E+38 3.4028234663852886E+38 /end CHARACTERISTIC
/begin CHARACTERISTIC DCH_tBSDMinCellTempOvrdVal_C "" VALUE 0x70010d4c Scalar_FLOAT32_IEEE 0 VBU0428Test_CM_single_cnt -3.4028234663852886E+38 3.4028234663852886E+38 /end CHARACTERISTIC
/begin CHARACTERISTIC DCH_tBSMMaxCellTempOvrdVal_C "" VALUE 0x70010d50 Scalar_FLOAT32_IEEE 0 VBU0428Test_CM_single_cnt -3.4028234663852886E+38 3.4028234663852886E+38 /end CHARACTERISTIC
/begin CHARACTERISTIC DCH_tBSMMinCellTempOvrdVal_C "" VALUE 0x70010d54 Scalar_FLOAT32_IEEE 0 VBU0428Test_CM_single_cnt -3.4028234663852886E+38 3.4028234663852886E+38 /end CHARACTERISTIC
/begin CHARACTERISTIC DCH_tiBCSEstChTiLowLim_C "" VALUE 0x70010d88 Scalar_FLOAT32_IEEE 0 VBU0428Test_CM_single_cnt -3.4028234663852886E+38 3.4028234663852886E+38 /end CHARACTERISTIC
/begin CHARACTERISTIC DCH_tiBCSEstChTiUpLim_C "" VALUE 0x70010d8c Scalar_FLOAT32_IEEE 0 VBU0428Test_CM_single_cnt -3.4028234663852886E+38 3.4028234663852886E+38 /end CHARACTERISTIC
/begin CHARACTERISTIC DCH_tiCCSTOut_C "" VALUE 0x70010da0 Scalar_FLOAT32_IEEE 0 VBU0428Test_CM_single_cnt -3.4028234663852886E+38 3.4028234663852886E+38 /end CHARACTERISTIC
/begin CHARACTERISTIC DCH_tiCHMtoCRMTOut_C "" VALUE 0x70010da4 Scalar_FLOAT32_IEEE 0 VBU0428Test_CM_single_cnt -3.4028234663852886E+38 3.4028234663852886E+38 /end CHARACTERISTIC
/begin CHARACTERISTIC DCH_tiCRM00TOutStrtFrmCHM_C "" VALUE 0x70010da8 Scalar_FLOAT32_IEEE 0 VBU0428Test_CM_single_cnt -3.4028234663852886E+38 3.4028234663852886E+38 /end CHARACTERISTIC
/begin CHARACTERISTIC DCH_tiCRM00TOut_C "" VALUE 0x70010dac Scalar_FLOAT32_IEEE 0 VBU0428Test_CM_single_cnt -3.4028234663852886E+38 3.4028234663852886E+38 /end CHARACTERISTIC
/begin CHARACTERISTIC DCH_tiCRMAATOut_C "" VALUE 0x70010db0 Scalar_FLOAT32_IEEE 0 VBU0428Test_CM_single_cnt -3.4028234663852886E+38 3.4028234663852886E+38 /end CHARACTERISTIC
/begin CHARACTERISTIC DCH_tiCROAATOutStrtFrmBRO_C "" VALUE 0x70010db4 Scalar_FLOAT32_IEEE 0 VBU0428Test_CM_single_cnt -3.4028234663852886E+38 3.4028234663852886E+38 /end CHARACTERISTIC
/begin CHARACTERISTIC DCH_tiCROAATOut_C "" VALUE 0x70010db8 Scalar_FLOAT32_IEEE 0 VBU0428Test_CM_single_cnt -3.4028234663852886E+38 3.4028234663852886E+38 /end CHARACTERISTIC
/begin CHARACTERISTIC DCH_tiCSTTOut_C "" VALUE 0x70010dbc Scalar_FLOAT32_IEEE 0 VBU0428Test_CM_single_cnt -3.4028234663852886E+38 3.4028234663852886E+38 /end CHARACTERISTIC
/begin CHARACTERISTIC DCH_tiChCap_C "" VALUE 0x70010dc4 Scalar_FLOAT32_IEEE 0 VBU0428Test_CM_single_cnt -3.4028234663852886E+38 3.4028234663852886E+38 /end CHARACTERISTIC
/begin CHARACTERISTIC DCH_tiChRdy_C "" VALUE 0x70010dc8 Scalar_FLOAT32_IEEE 0 VBU0428Test_CM_single_cnt -3.4028234663852886E+38 3.4028234663852886E+38 /end CHARACTERISTIC
/begin CHARACTERISTIC DCH_tiChgrAvl_C "" VALUE 0x70010dcc Scalar_FLOAT32_IEEE 0 VBU0428Test_CM_single_cnt -3.4028234663852886E+38 3.4028234663852886E+38 /end CHARACTERISTIC
/begin CHARACTERISTIC DCH_tiDCChRly_C "" VALUE 0x70010dd8 Scalar_FLOAT32_IEEE 0 VBU0428Test_CM_single_cnt -3.4028234663852886E+38 3.4028234663852886E+38 /end CHARACTERISTIC
/begin CHARACTERISTIC DCH_tiDCRlyDiagDly_C "" VALUE 0x70010ddc Scalar_FLOAT32_IEEE 0 VBU0428Test_CM_single_cnt -3.4028234663852886E+38 3.4028234663852886E+38 /end CHARACTERISTIC
/begin CHARACTERISTIC DCH_tiDlyCCSnotChging_C "" VALUE 0x70010de4 Scalar_FLOAT32_IEEE 0 VBU0428Test_CM_single_cnt -3.4028234663852886E+38 3.4028234663852886E+38 /end CHARACTERISTIC
/begin CHARACTERISTIC DCH_tiOpenHvRly_C "" VALUE 0x70010de8 Scalar_FLOAT32_IEEE 0 VBU0428Test_CM_single_cnt -3.4028234663852886E+38 3.4028234663852886E+38 /end CHARACTERISTIC
/begin CHARACTERISTIC DCH_tiReStartChProcess_C "" VALUE 0x70010dec Scalar_FLOAT32_IEEE 0 VBU0428Test_CM_single_cnt -3.4028234663852886E+38 3.4028234663852886E+38 /end CHARACTERISTIC
/begin CHARACTERISTIC DCH_tisinceBEMCEMTOut_C "" VALUE 0x70010df8 Scalar_FLOAT32_IEEE 0 VBU0428Test_CM_single_cnt -3.4028234663852886E+38 3.4028234663852886E+38 /end CHARACTERISTIC
/begin CHARACTERISTIC DCH_tisinceBSTSentOutTOut_C "" VALUE 0x70010dfc Scalar_FLOAT32_IEEE 0 VBU0428Test_CM_single_cnt -3.4028234663852886E+38 3.4028234663852886E+38 /end CHARACTERISTIC
/begin CHARACTERISTIC DCH_uBCLVltgReqOvrdVal_C "" VALUE 0x70010e00 Scalar_FLOAT32_IEEE 0 VBU0428Test_CM_single_cnt -3.4028234663852886E+38 3.4028234663852886E+38 /end CHARACTERISTIC
/begin CHARACTERISTIC DCH_uBSDMaxCellVltgOvrdVal_C "" VALUE 0x70010e1c Scalar_FLOAT32_IEEE 0 VBU0428Test_CM_single_cnt -3.4028234663852886E+38 3.4028234663852886E+38 /end CHARACTERISTIC
/begin CHARACTERISTIC DCH_uBSDMinCellVltgOvrdVal_C "" VALUE 0x70010e20 Scalar_FLOAT32_IEEE 0 VBU0428Test_CM_single_cnt -3.4028234663852886E+38 3.4028234663852886E+38 /end CHARACTERISTIC
/begin CHARACTERISTIC DCH_uDCChReqLowLim_C "" VALUE 0x70010e24 Scalar_FLOAT32_IEEE 0 VBU0428Test_CM_single_cnt -3.4028234663852886E+38 3.4028234663852886E+38 /end CHARACTERISTIC
/begin CHARACTERISTIC DCH_uDCChReqUpLim_C "" VALUE 0x70010e28 Scalar_FLOAT32_IEEE 0 VBU0428Test_CM_single_cnt -3.4028234663852886E+38 3.4028234663852886E+38 /end CHARACTERISTIC
/begin CHARACTERISTIC EDIS_pwrDrvRstn_C "" VALUE 0x70011148 Scalar_FLOAT32_IEEE 0 VBU0428Test_CM_single_cnt 0.0 1.0E+23 /end CHARACTERISTIC
/begin CHARACTERISTIC LVC_iDCDCOutCrnt_C "" VALUE 0x70011358 Scalar_FLOAT32_IEEE 0 VBU0428Test_CM_single_cnt -3.4028234663852886E+38 3.4028234663852886E+38 /end CHARACTERISTIC
/begin CHARACTERISTIC LVC_iDiaUndrVltgPwrEnough_C "" VALUE 0x7001135c Scalar_FLOAT32_IEEE 0 VBU0428Test_CM_single_cnt -3.4028234663852886E+38 3.4028234663852886E+38 /end CHARACTERISTIC
/begin CHARACTERISTIC LVC_iDiaUndrVltgPwrLack_C "" VALUE 0x70011360 Scalar_FLOAT32_IEEE 0 VBU0428Test_CM_single_cnt -3.4028234663852886E+38 3.4028234663852886E+38 /end CHARACTERISTIC
/begin CHARACTERISTIC LVC_pwrDiaUndrVolHi_C "" VALUE 0x70011364 Scalar_FLOAT32_IEEE 0 VBU0428Test_CM_single_cnt -3.4028234663852886E+38 3.4028234663852886E+38 /end CHARACTERISTIC
/begin CHARACTERISTIC LVC_pwrDiaUndrVolLo_C "" VALUE 0x70011368 Scalar_FLOAT32_IEEE 0 VBU0428Test_CM_single_cnt -3.4028234663852886E+38 3.4028234663852886E+38 /end CHARACTERISTIC
/begin CHARACTERISTIC LVC_stDiaDCDCStsWrk_SY "" VALUE 0x70011370 Scalar_FLOAT32_IEEE 0 VBU0428Test_CM_single_cnt -3.4028234663852886E+38 3.4028234663852886E+38 /end CHARACTERISTIC
/begin CHARACTERISTIC LVC_tiDCDCOutCurnt_C "" VALUE 0x70011374 Scalar_FLOAT32_IEEE 0 VBU0428Test_CM_single_cnt -3.4028234663852886E+38 3.4028234663852886E+38 /end CHARACTERISTIC
/begin CHARACTERISTIC LVC_tiDCDCOutVltg_C "" VALUE 0x70011378 Scalar_FLOAT32_IEEE 0 VBU0428Test_CM_single_cnt -3.4028234663852886E+38 3.4028234663852886E+38 /end CHARACTERISTIC
/begin CHARACTERISTIC LVC_tiDcDcPTNodeAbsent_C "" VALUE 0x7001137c Scalar_FLOAT32_IEEE 0 VBU0428Test_CM_single_cnt -3.4028234663852886E+38 3.4028234663852886E+38 /end CHARACTERISTIC
/begin CHARACTERISTIC LVC_tiDiaDCDCActnDly_C "" VALUE 0x70011380 Scalar_FLOAT32_IEEE 0 VBU0428Test_CM_single_cnt -3.4028234663852886E+38 3.4028234663852886E+38 /end CHARACTERISTIC
/begin CHARACTERISTIC LVC_tiDiaDCDCSmpl_SY "" VALUE 0x70011384 Scalar_FLOAT32_IEEE 0 VBU0428Test_CM_single_cnt -3.4028234663852886E+38 3.4028234663852886E+38 /end CHARACTERISTIC
/begin CHARACTERISTIC LVC_tiHvRlyClReq_C "" VALUE 0x70011388 Scalar_FLOAT32_IEEE 0 VBU0428Test_CM_single_cnt -3.4028234663852886E+38 3.4028234663852886E+38 /end CHARACTERISTIC
/begin CHARACTERISTIC LVC_tiIBSStatusErrAndParked_C "" VALUE 0x7001138c Scalar_FLOAT32_IEEE 0 VBU0428Test_CM_single_cnt -3.4028234663852886E+38 3.4028234663852886E+38 /end CHARACTERISTIC
/begin CHARACTERISTIC LVC_tiLvBattVolLow_C "" VALUE 0x70011390 Scalar_FLOAT32_IEEE 0 VBU0428Test_CM_single_cnt -3.4028234663852886E+38 3.4028234663852886E+38 /end CHARACTERISTIC
/begin CHARACTERISTIC LVC_tiSample_SY "" VALUE 0x70011394 Scalar_FLOAT32_IEEE 0 VBU0428Test_CM_single_cnt -3.4028234663852886E+38 3.4028234663852886E+38 /end CHARACTERISTIC
/begin CHARACTERISTIC LVC_uDCDCCrntDeltaLe_C "" VALUE 0x7001139c Scalar_FLOAT32_IEEE 0 VBU0428Test_CM_single_cnt -3.4028234663852886E+38 3.4028234663852886E+38 /end CHARACTERISTIC
/begin CHARACTERISTIC LVC_uDCDCCrntDeltaRe_C "" VALUE 0x700113a0 Scalar_FLOAT32_IEEE 0 VBU0428Test_CM_single_cnt -3.4028234663852886E+38 3.4028234663852886E+38 /end CHARACTERISTIC
/begin CHARACTERISTIC LVC_uDCDCOutCrntLe_C "" VALUE 0x700113a4 Scalar_FLOAT32_IEEE 0 VBU0428Test_CM_single_cnt -3.4028234663852886E+38 3.4028234663852886E+38 /end CHARACTERISTIC
/begin CHARACTERISTIC LVC_uDCDCOutCrntRe_C "" VALUE 0x700113a8 Scalar_FLOAT32_IEEE 0 VBU0428Test_CM_single_cnt -3.4028234663852886E+38 3.4028234663852886E+38 /end CHARACTERISTIC
/begin CHARACTERISTIC LVC_uDiaDCDCOutOvrVltgThres_C "" VALUE 0x700113bc Scalar_FLOAT32_IEEE 0 VBU0428Test_CM_single_cnt -3.4028234663852886E+38 3.4028234663852886E+38 /end CHARACTERISTIC
/begin CHARACTERISTIC LVC_uDiaDCDCOutUndrVltgThres_C "" VALUE 0x700113c0 Scalar_FLOAT32_IEEE 0 VBU0428Test_CM_single_cnt -3.4028234663852886E+38 3.4028234663852886E+38 /end CHARACTERISTIC
/begin CHARACTERISTIC LVC_uVolLowOnPark_C "" VALUE 0x700113c4 Scalar_FLOAT32_IEEE 0 VBU0428Test_CM_single_cnt -3.4028234663852886E+38 3.4028234663852886E+38 /end CHARACTERISTIC
/begin CHARACTERISTIC MTQL_facVehSpd2MotSpd_C "" VALUE 0x700113d0 Scalar_FLOAT32_IEEE 0 VBU0428Test_CM_single_cnt 0.0 1000.0 /end CHARACTERISTIC
/begin CHARACTERISTIC MTQL_trqDecLim_C "" VALUE 0x700113d4 Scalar_FLOAT32_IEEE 0 VBU0428Test_CM_single_cnt -10000.0 10000.0 /end CHARACTERISTIC
/begin CHARACTERISTIC MTQL_trqIncLim_C "" VALUE 0x700113d8 Scalar_FLOAT32_IEEE 0 VBU0428Test_CM_single_cnt -10000.0 10000.0 /end CHARACTERISTIC
/begin CHARACTERISTIC MTQL_trqMtrDrvLimOvrdVal_C "" VALUE 0x700113dc Scalar_FLOAT32_IEEE 0 VBU0428Test_CM_single -3.4E+38 3.4E+38 /end CHARACTERISTIC
/begin CHARACTERISTIC MTQL_trqMtrRgnLimOvrdVal_C "" VALUE 0x700113e0 Scalar_FLOAT32_IEEE 0 VBU0428Test_CM_single -3.4E+38 3.4E+38 /end CHARACTERISTIC
/begin CHARACTERISTIC MTQL_trqPEURDrvLowLim_C "" VALUE 0x700113e4 Scalar_FLOAT32_IEEE 0 VBU0428Test_CM_single_cnt -10000.0 10000.0 /end CHARACTERISTIC
/begin CHARACTERISTIC MTQL_trqPEURDrvUpLim_C "" VALUE 0x700113e8 Scalar_FLOAT32_IEEE 0 VBU0428Test_CM_single_cnt -10000.0 10000.0 /end CHARACTERISTIC
/begin CHARACTERISTIC MTQL_trqPEURRgnLowLim_C "" VALUE 0x700113ec Scalar_FLOAT32_IEEE 0 VBU0428Test_CM_single_cnt -10000.0 10000.0 /end CHARACTERISTIC
/begin CHARACTERISTIC MTQL_trqPEURRgnUpLim_C "" VALUE 0x700113f0 Scalar_FLOAT32_IEEE 0 VBU0428Test_CM_single_cnt -10000.0 10000.0 /end CHARACTERISTIC
/begin CHARACTERISTIC PMM_tiDiaActvDisChDur_C "" VALUE 0x7001152c Scalar_FLOAT32_IEEE 0 VBU0428Test_CM_single_cnt -3.4028234663852886E+38 3.4028234663852886E+38 /end CHARACTERISTIC
/begin CHARACTERISTIC PMM_tiDiaHVRlyActnDly_C "" VALUE 0x70011530 Scalar_FLOAT32_IEEE 0 VBU0428Test_CM_single_cnt -3.4028234663852886E+38 3.4028234663852886E+38 /end CHARACTERISTIC
/begin CHARACTERISTIC PMM_tiDiaPreChDur_C "" VALUE 0x70011534 Scalar_FLOAT32_IEEE 0 VBU0428Test_CM_single_cnt -3.4028234663852886E+38 3.4028234663852886E+38 /end CHARACTERISTIC
/begin CHARACTERISTIC PMM_tiDiaPreChFail_C "" VALUE 0x70011538 Scalar_FLOAT32_IEEE 0 VBU0428Test_CM_single_cnt -3.4028234663852886E+38 3.4028234663852886E+38 /end CHARACTERISTIC
/begin CHARACTERISTIC PMM_tiDiaUnIntdPreRlyClsdMntn_C "" VALUE 0x7001153c Scalar_FLOAT32_IEEE 0 VBU0428Test_CM_single_cnt -3.4028234663852886E+38 3.4028234663852886E+38 /end CHARACTERISTIC
/begin CHARACTERISTIC PMM_tiDlyACTst_C "" VALUE 0x70011540 Scalar_FLOAT32_IEEE 0 VBU0428Test_CM_single_cnt -3.4028234663852886E+38 3.4028234663852886E+38 /end CHARACTERISTIC
/begin CHARACTERISTIC PMM_tiDlyDiaRlyOp_C "" VALUE 0x70011544 Scalar_FLOAT32_IEEE 0 VBU0428Test_CM_single_cnt -3.4028234663852886E+38 3.4028234663852886E+38 /end CHARACTERISTIC
/begin CHARACTERISTIC PMM_tiDlyPEUShtDwn_C "" VALUE 0x70011568 Scalar_FLOAT32_IEEE 0 VBU0428Test_CM_single_cnt -3.4028234663852886E+38 3.4028234663852886E+38 /end CHARACTERISTIC
/begin CHARACTERISTIC PMM_tiDlyPEUStandBy_C "" VALUE 0x7001156c Scalar_FLOAT32_IEEE 0 VBU0428Test_CM_single_cnt -3.4028234663852886E+38 3.4028234663852886E+38 /end CHARACTERISTIC
/begin CHARACTERISTIC PMM_tiDlySWReset_C "" VALUE 0x70011574 Scalar_FLOAT32_IEEE 0 VBU0428Test_CM_single_cnt -3.4028234663852886E+38 3.4028234663852886E+38 /end CHARACTERISTIC
/begin CHARACTERISTIC PMM_tiDlySelfDiag_C "" VALUE 0x70011578 Scalar_FLOAT32_IEEE 0 VBU0428Test_CM_single_cnt -3.4028234663852886E+38 3.4028234663852886E+38 /end CHARACTERISTIC
/begin CHARACTERISTIC PMM_tiMonDlyDiaPreCh_C "" VALUE 0x700115a0 Scalar_FLOAT32_IEEE 0 VBU0428Test_CM_single_cnt -3.4028234663852886E+38 3.4028234663852886E+38 /end CHARACTERISTIC
/begin CHARACTERISTIC PMM_uDiaActvDisCh_C "" VALUE 0x700115b4 Scalar_FLOAT32_IEEE 0 VBU0428Test_CM_single_cnt 0.0 1000.0 /end CHARACTERISTIC
/begin CHARACTERISTIC PTC_PwrMax_C "" VALUE 0x700115c0 Scalar_FLOAT32_IEEE 0 VBU0428Test_CM_single_cnt 0.0 1.0E+23 /end CHARACTERISTIC
/begin CHARACTERISTIC SPD_tiAxUpdate2_C "" VALUE 0x700115f0 Scalar_FLOAT32_IEEE 0 VBU0428Test_CM_single_cnt -3.4028234663852886E+38 3.4028234663852886E+38 /end CHARACTERISTIC
/begin CHARACTERISTIC SPD_tiAxUpdate_C "" VALUE 0x700115f4 Scalar_FLOAT32_IEEE 0 VBU0428Test_CM_single_cnt -3.4028234663852886E+38 3.4028234663852886E+38 /end CHARACTERISTIC
/begin CHARACTERISTIC SYS_facRPM2KPH_SY "" VALUE 0x7001163c Scalar_FLOAT32_IEEE 0 VBU0428Test_CM_single_cnt -3.4028234663852886E+38 3.4028234663852886E+38 /end CHARACTERISTIC
/begin CHARACTERISTIC SYS_lFWhlRadius_SY "" VALUE 0x70011640 Scalar_FLOAT32_IEEE 0 VBU0428Test_CM_single_cnt -3.4028234663852886E+38 3.4028234663852886E+38 /end CHARACTERISTIC
/begin CHARACTERISTIC SYS_lWheelBase_SY "" VALUE 0x70011644 Scalar_FLOAT32_IEEE 0 VBU0428Test_CM_single_cnt -3.4028234663852886E+38 3.4028234663852886E+38 /end CHARACTERISTIC
/begin CHARACTERISTIC SYS_stShftPosDrv_SY "" VALUE 0x70011648 Scalar_FLOAT32_IEEE 0 VBU0428Test_CM_single_cnt -3.4028234663852886E+38 3.4028234663852886E+38 /end CHARACTERISTIC
/begin CHARACTERISTIC SYS_stShftPosRev_SY "" VALUE 0x7001164c Scalar_FLOAT32_IEEE 0 VBU0428Test_CM_single_cnt -3.4028234663852886E+38 3.4028234663852886E+38 /end CHARACTERISTIC
/begin CHARACTERISTIC TQCMP_trqLowSpdRA "" VALUE 0x700116c4 Scalar_FLOAT32_IEEE 0 VBU0428Test_CM_single_cnt -3.4028234663852886E+38 3.4028234663852886E+38 /end CHARACTERISTIC
/begin CHARACTERISTIC TQC_aAcc2TrqPrpHigh_SY "" VALUE 0x700116c8 Scalar_FLOAT32_IEEE 0 VBU0428Test_CM_single_cnt -3.4028234663852886E+38 3.4028234663852886E+38 /end CHARACTERISTIC
/begin CHARACTERISTIC TQC_aDragLearnMax_C "" VALUE 0x700116cc Scalar_FLOAT32_IEEE 0 VBU0428Test_CM_single_cnt -3.4028234663852886E+38 3.4028234663852886E+38 /end CHARACTERISTIC
/begin CHARACTERISTIC TQC_aDragLearnMin_C "" VALUE 0x700116d0 Scalar_FLOAT32_IEEE 0 VBU0428Test_CM_single_cnt -3.4028234663852886E+38 3.4028234663852886E+38 /end CHARACTERISTIC
/begin CHARACTERISTIC TQC_aSlopeLimitInit_C "" VALUE 0x700116d4 Scalar_FLOAT32_IEEE 0 VBU0428Test_CM_single_cnt -3.4028234663852886E+38 3.4028234663852886E+38 /end CHARACTERISTIC
/begin CHARACTERISTIC TQC_aThresLe_C "" VALUE 0x700116d8 Scalar_FLOAT32_IEEE 0 VBU0428Test_CM_single_cnt -3.4028234663852886E+38 3.4028234663852886E+38 /end CHARACTERISTIC
/begin CHARACTERISTIC TQC_aThresRi_C "" VALUE 0x700116dc Scalar_FLOAT32_IEEE 0 VBU0428Test_CM_single_cnt -3.4028234663852886E+38 3.4028234663852886E+38 /end CHARACTERISTIC
/begin CHARACTERISTIC TQC_aXFltGradDec_C "" VALUE 0x700116e0 Scalar_FLOAT32_IEEE 0 VBU0428Test_CM_single_cnt -3.4028234663852886E+38 3.4028234663852886E+38 /end CHARACTERISTIC
/begin CHARACTERISTIC TQC_aXFltGradInc_C "" VALUE 0x700116e4 Scalar_FLOAT32_IEEE 0 VBU0428Test_CM_single_cnt -3.4028234663852886E+38 3.4028234663852886E+38 /end CHARACTERISTIC
/begin CHARACTERISTIC TQC_facDecDrag_C "" VALUE 0x700116e8 Scalar_FLOAT32_IEEE 0 VBU0428Test_CM_single_cnt -3.4028234663852886E+38 3.4028234663852886E+38 /end CHARACTERISTIC
/begin CHARACTERISTIC TQC_facDelayShiftFilter_C "" VALUE 0x700116ec Scalar_FLOAT32_IEEE 0 VBU0428Test_CM_single_cnt -3.4028234663852886E+38 3.4028234663852886E+38 /end CHARACTERISTIC
/begin CHARACTERISTIC TQC_facDragCalGradDec_C "" VALUE 0x700116f0 Scalar_FLOAT32_IEEE 0 VBU0428Test_CM_single_cnt -3.4028234663852886E+38 3.4028234663852886E+38 /end CHARACTERISTIC
/begin CHARACTERISTIC TQC_facDragCalGradInc_C "" VALUE 0x700116f4 Scalar_FLOAT32_IEEE 0 VBU0428Test_CM_single_cnt -3.4028234663852886E+38 3.4028234663852886E+38 /end CHARACTERISTIC
/begin CHARACTERISTIC TQC_facDragCalGradMax_C "" VALUE 0x700116f8 Scalar_FLOAT32_IEEE 0 VBU0428Test_CM_single_cnt -3.4028234663852886E+38 3.4028234663852886E+38 /end CHARACTERISTIC
/begin CHARACTERISTIC TQC_facDragCalGradMin_C "" VALUE 0x700116fc Scalar_FLOAT32_IEEE 0 VBU0428Test_CM_single_cnt -3.4028234663852886E+38 3.4028234663852886E+38 /end CHARACTERISTIC
/begin CHARACTERISTIC TQC_facDragFastFilter_C "" VALUE 0x70011700 Scalar_FLOAT32_IEEE 0 VBU0428Test_CM_single_cnt -3.4028234663852886E+38 3.4028234663852886E+38 /end CHARACTERISTIC
/begin CHARACTERISTIC TQC_facDragNormalFilter_C "" VALUE 0x70011704 Scalar_FLOAT32_IEEE 0 VBU0428Test_CM_single_cnt -3.4028234663852886E+38 3.4028234663852886E+38 /end CHARACTERISTIC
/begin CHARACTERISTIC TQC_facDragShiftFilter_C "" VALUE 0x70011708 Scalar_FLOAT32_IEEE 0 VBU0428Test_CM_single_cnt -3.4028234663852886E+38 3.4028234663852886E+38 /end CHARACTERISTIC
/begin CHARACTERISTIC TQC_facDragWheelFilter_C "" VALUE 0x7001170c Scalar_FLOAT32_IEEE 0 VBU0428Test_CM_single_cnt -3.4028234663852886E+38 3.4028234663852886E+38 /end CHARACTERISTIC
/begin CHARACTERISTIC TQC_facMinDrag_C "" VALUE 0x70011710 Scalar_FLOAT32_IEEE 0 VBU0428Test_CM_single_cnt 0.0 1.0 /end CHARACTERISTIC
/begin CHARACTERISTIC TQC_facNormalDrag_C "" VALUE 0x70011714 Scalar_FLOAT32_IEEE 0 VBU0428Test_CM_single_cnt -3.4028234663852886E+38 3.4028234663852886E+38 /end CHARACTERISTIC
/begin CHARACTERISTIC TQC_facSlopeLimitIntegral_C "" VALUE 0x70011718 Scalar_FLOAT32_IEEE 0 VBU0428Test_CM_single_cnt -3.4028234663852886E+38 3.4028234663852886E+38 /end CHARACTERISTIC
/begin CHARACTERISTIC TQC_facSlopeLimitProportion_C "" VALUE 0x7001171c Scalar_FLOAT32_IEEE 0 VBU0428Test_CM_single_cnt -3.4028234663852886E+38 3.4028234663852886E+38 /end CHARACTERISTIC
/begin CHARACTERISTIC TQC_facTrqWheelFilter_C "" VALUE 0x70011720 Scalar_FLOAT32_IEEE 0 VBU0428Test_CM_single_cnt 0.0 1.0 /end CHARACTERISTIC
/begin CHARACTERISTIC TQC_facVehSpdFilter_C "" VALUE 0x70011724 Scalar_FLOAT32_IEEE 0 VBU0428Test_CM_single_cnt -3.4028234663852886E+38 3.4028234663852886E+38 /end CHARACTERISTIC
/begin CHARACTERISTIC TQC_mInrt_C "" VALUE 0x70011728 Scalar_FLOAT32_IEEE 0 VBU0428Test_CM_single_cnt -3.4028234663852886E+38 3.4028234663852886E+38 /end CHARACTERISTIC
/begin CHARACTERISTIC TQC_mVeh_C "" VALUE 0x7001172c Scalar_FLOAT32_IEEE 0 VBU0428Test_CM_single_kg 0.0 10000.0 /end CHARACTERISTIC
/begin CHARACTERISTIC TQC_numDragCalAverageAccStepDown_C "" VALUE 0x70011730 Scalar_FLOAT32_IEEE 0 VBU0428Test_CM_single_cnt -10000.0 10000.0 /end CHARACTERISTIC
/begin CHARACTERISTIC TQC_numDragCalAverageAccStepUp_C "" VALUE 0x70011734 Scalar_FLOAT32_IEEE 0 VBU0428Test_CM_single_cnt -10000.0 10000.0 /end CHARACTERISTIC
/begin CHARACTERISTIC TQC_numDragCalAverageAcc_C "" VALUE 0x70011738 Scalar_FLOAT32_IEEE 0 VBU0428Test_CM_single_cnt 0.0 255.0 /end CHARACTERISTIC
/begin CHARACTERISTIC TQC_numDragCalAverageBrk_C "" VALUE 0x7001173c Scalar_FLOAT32_IEEE 0 VBU0428Test_CM_single_cnt -3.4028234663852886E+38 3.4028234663852886E+38 /end CHARACTERISTIC
/begin CHARACTERISTIC TQC_numDragFastLearn_C "" VALUE 0x70011740 Scalar_FLOAT32_IEEE 0 VBU0428Test_CM_single_cnt -10000.0 10000.0 /end CHARACTERISTIC
/begin CHARACTERISTIC TQC_numDragLearnMin_C "" VALUE 0x70011744 Scalar_FLOAT32_IEEE 0 VBU0428Test_CM_single_cnt -3.4028234663852886E+38 3.4028234663852886E+38 /end CHARACTERISTIC
/begin CHARACTERISTIC TQC_numDragLearnStepDown_C "" VALUE 0x70011748 Scalar_FLOAT32_IEEE 0 VBU0428Test_CM_single_cnt -10000.0 10000.0 /end CHARACTERISTIC
/begin CHARACTERISTIC TQC_numDragLearnStepMax_C "" VALUE 0x7001174c Scalar_FLOAT32_IEEE 0 VBU0428Test_CM_single_cnt -10000.0 10000.0 /end CHARACTERISTIC
/begin CHARACTERISTIC TQC_numDragLearnStepUp_C "" VALUE 0x70011750 Scalar_FLOAT32_IEEE 0 VBU0428Test_CM_single_cnt -10000.0 10000.0 /end CHARACTERISTIC
/begin CHARACTERISTIC TQC_numDragLearnStep_C "" VALUE 0x70011754 Scalar_FLOAT32_IEEE 0 VBU0428Test_CM_single_cnt -10000.0 10000.0 /end CHARACTERISTIC
/begin CHARACTERISTIC TQC_numFltAccAverage_C "" VALUE 0x70011758 Scalar_FLOAT32_IEEE 0 VBU0428Test_CM_single_cnt 0.0 255.0 /end CHARACTERISTIC
/begin CHARACTERISTIC TQC_numSlopeSample_C "" VALUE 0x7001175c Scalar_FLOAT32_IEEE 0 VBU0428Test_CM_single_cnt -3.4028234663852886E+38 3.4028234663852886E+38 /end CHARACTERISTIC
/begin CHARACTERISTIC TQC_pctDragCalPedLe_C "" VALUE 0x70011760 Scalar_FLOAT32_IEEE 0 VBU0428Test_CM_single_cnt 0.0 100.0 /end CHARACTERISTIC
/begin CHARACTERISTIC TQC_pctDragCalPedRi_C "" VALUE 0x70011764 Scalar_FLOAT32_IEEE 0 VBU0428Test_CM_single_cnt 0.0 100.0 /end CHARACTERISTIC
/begin CHARACTERISTIC TQC_rRatioReducer_C "" VALUE 0x70011768 Scalar_FLOAT32_IEEE 0 VBU0428Test_CM_single_cnt 0.0 100.0 /end CHARACTERISTIC
/begin CHARACTERISTIC TQC_rTire19Wheel_C "" VALUE 0x7001176c Scalar_FLOAT32_IEEE 0 VBU0428Test_CM_single_m 0.0 3.0 /end CHARACTERISTIC
/begin CHARACTERISTIC TQC_tiDelayDragTime_C "" VALUE 0x70011770 Scalar_FLOAT32_IEEE 0 VBU0428Test_CM_single_cnt -3.4028234663852886E+38 3.4028234663852886E+38 /end CHARACTERISTIC
/begin CHARACTERISTIC TQC_tiDragDelayTime_C "" VALUE 0x70011774 Scalar_FLOAT32_IEEE 0 VBU0428Test_CM_single_cnt -3.4028234663852886E+38 3.4028234663852886E+38 /end CHARACTERISTIC
/begin CHARACTERISTIC TQC_tiSampleTime_C "" VALUE 0x70011778 Scalar_FLOAT32_IEEE 0 VBU0428Test_CM_single_cnt -3.4028234663852886E+38 3.4028234663852886E+38 /end CHARACTERISTIC
/begin CHARACTERISTIC TQC_trqDefaultLimit_C "" VALUE 0x7001177c Scalar_FLOAT32_IEEE 0 VBU0428Test_CM_single_cnt -10000.0 10000.0 /end CHARACTERISTIC
/begin CHARACTERISTIC TQC_trqDefaultSlope_C "" VALUE 0x70011780 Scalar_FLOAT32_IEEE 0 VBU0428Test_CM_single_cnt -10000.0 10000.0 /end CHARACTERISTIC
/begin CHARACTERISTIC TQC_trqDragCalGradDec_C "" VALUE 0x70011784 Scalar_FLOAT32_IEEE 0 VBU0428Test_CM_single_cnt -10000.0 10000.0 /end CHARACTERISTIC
/begin CHARACTERISTIC TQC_trqDragCalGradInc_C "" VALUE 0x70011788 Scalar_FLOAT32_IEEE 0 VBU0428Test_CM_single_cnt -10000.0 10000.0 /end CHARACTERISTIC
/begin CHARACTERISTIC TQC_trqDragMax_C "" VALUE 0x7001178c Scalar_FLOAT32_IEEE 0 VBU0428Test_CM_single_cnt -10000.0 10000.0 /end CHARACTERISTIC
/begin CHARACTERISTIC TQC_trqSlopeLimitInit_C "" VALUE 0x70011790 Scalar_FLOAT32_IEEE 0 VBU0428Test_CM_single_cnt -10000.0 10000.0 /end CHARACTERISTIC
/begin CHARACTERISTIC TQC_trqSlopeLimitMax_C "" VALUE 0x70011794 Scalar_FLOAT32_IEEE 0 VBU0428Test_CM_single_cnt -10000.0 10000.0 /end CHARACTERISTIC
/begin CHARACTERISTIC TQC_trqSlopeLimitMin_C "" VALUE 0x70011798 Scalar_FLOAT32_IEEE 0 VBU0428Test_CM_single_cnt -10000.0 10000.0 /end CHARACTERISTIC
/begin CHARACTERISTIC TQC_trqVehMax_C "" VALUE 0x7001179c Scalar_FLOAT32_IEEE 0 VBU0428Test_CM_single_cnt -10000.0 10000.0 /end CHARACTERISTIC
/begin CHARACTERISTIC TQC_trqVehMin_C "" VALUE 0x700117a0 Scalar_FLOAT32_IEEE 0 VBU0428Test_CM_single_cnt -10000.0 10000.0 /end CHARACTERISTIC
/begin CHARACTERISTIC TQC_vDragSpeedLe_C "" VALUE 0x700117a4 Scalar_FLOAT32_IEEE 0 VBU0428Test_CM_single_cnt -3.4028234663852886E+38 3.4028234663852886E+38 /end CHARACTERISTIC
/begin CHARACTERISTIC TQC_vDragSpeedLearnLe_C "" VALUE 0x700117a8 Scalar_FLOAT32_IEEE 0 VBU0428Test_CM_single_cnt -3.4028234663852886E+38 3.4028234663852886E+38 /end CHARACTERISTIC
/begin CHARACTERISTIC TQC_vDragSpeedLearnRi_C "" VALUE 0x700117ac Scalar_FLOAT32_IEEE 0 VBU0428Test_CM_single_cnt -3.4028234663852886E+38 3.4028234663852886E+38 /end CHARACTERISTIC
/begin CHARACTERISTIC TQC_vDragSpeedRi_C "" VALUE 0x700117b0 Scalar_FLOAT32_IEEE 0 VBU0428Test_CM_single_cnt -3.4028234663852886E+38 3.4028234663852886E+38 /end CHARACTERISTIC
/begin CHARACTERISTIC TQD_facBrkPressFilt_C "" VALUE 0x70011884 Scalar_FLOAT32_IEEE 0 VBU0428Test_CM_single_cnt -3.4028234663852886E+38 3.4028234663852886E+38 /end CHARACTERISTIC
/begin CHARACTERISTIC TQD_facVehSpdFlt_C "" VALUE 0x70011888 Scalar_FLOAT32_IEEE 0 VBU0428Test_CM_single_cnt -3.4028234663852886E+38 3.4028234663852886E+38 /end CHARACTERISTIC
/begin CHARACTERISTIC TQD_facVehSpdHys_C "" VALUE 0x7001188c Scalar_FLOAT32_IEEE 0 VBU0428Test_CM_single_cnt -3.4028234663852886E+38 3.4028234663852886E+38 /end CHARACTERISTIC
/begin CHARACTERISTIC TQD_pctAccPedalDeadband_C "" VALUE 0x70011894 Scalar_FLOAT32_IEEE 0 VBU0428Test_CM_single_cnt -3.4028234663852886E+38 3.4028234663852886E+38 /end CHARACTERISTIC
/begin CHARACTERISTIC TQD_pctVehSlideRes_C "" VALUE 0x70011898 Scalar_FLOAT32_IEEE 0 VBU0428Test_CM_single_cnt -3.4028234663852886E+38 3.4028234663852886E+38 /end CHARACTERISTIC
/begin CHARACTERISTIC TQD_rAppFltGain_C "" VALUE 0x7001189c Scalar_FLOAT32_IEEE 0 VBU0428Test_CM_single_cnt -3.4028234663852886E+38 3.4028234663852886E+38 /end CHARACTERISTIC
/begin CHARACTERISTIC TQD_rAppThresFltLowNeg_C "" VALUE 0x700118a0 Scalar_FLOAT32_IEEE 0 VBU0428Test_CM_single_cnt -3.4028234663852886E+38 3.4028234663852886E+38 /end CHARACTERISTIC
/begin CHARACTERISTIC TQD_rAppThresFltLowPos_C "" VALUE 0x700118a4 Scalar_FLOAT32_IEEE 0 VBU0428Test_CM_single_cnt -3.4028234663852886E+38 3.4028234663852886E+38 /end CHARACTERISTIC
/begin CHARACTERISTIC TQD_rAppThresFltMidNeg_C "" VALUE 0x700118a8 Scalar_FLOAT32_IEEE 0 VBU0428Test_CM_single_cnt -3.4028234663852886E+38 3.4028234663852886E+38 /end CHARACTERISTIC
/begin CHARACTERISTIC TQD_rAppThresFltMidPos_C "" VALUE 0x700118ac Scalar_FLOAT32_IEEE 0 VBU0428Test_CM_single_cnt -3.4028234663852886E+38 3.4028234663852886E+38 /end CHARACTERISTIC
/begin CHARACTERISTIC TQD_rBpsFltGain_C "" VALUE 0x700118b0 Scalar_FLOAT32_IEEE 0 VBU0428Test_CM_single_cnt -3.4028234663852886E+38 3.4028234663852886E+38 /end CHARACTERISTIC
/begin CHARACTERISTIC TQD_rBpsThresFltLowNeg_C "" VALUE 0x700118b4 Scalar_FLOAT32_IEEE 0 VBU0428Test_CM_single_cnt -3.4028234663852886E+38 3.4028234663852886E+38 /end CHARACTERISTIC
/begin CHARACTERISTIC TQD_rBpsThresFltLowPos_C "" VALUE 0x700118b8 Scalar_FLOAT32_IEEE 0 VBU0428Test_CM_single_cnt -3.4028234663852886E+38 3.4028234663852886E+38 /end CHARACTERISTIC
/begin CHARACTERISTIC TQD_rBpsThresFltMidNeg_C "" VALUE 0x700118bc Scalar_FLOAT32_IEEE 0 VBU0428Test_CM_single_cnt -3.4028234663852886E+38 3.4028234663852886E+38 /end CHARACTERISTIC
/begin CHARACTERISTIC TQD_rBpsThresFltMidPos_C "" VALUE 0x700118c0 Scalar_FLOAT32_IEEE 0 VBU0428Test_CM_single_cnt -3.4028234663852886E+38 3.4028234663852886E+38 /end CHARACTERISTIC
/begin CHARACTERISTIC TQD_tiAppLowNegPT1_C "" VALUE 0x700118c4 Scalar_FLOAT32_IEEE 0 VBU0428Test_CM_single_cnt -3.4028234663852886E+38 3.4028234663852886E+38 /end CHARACTERISTIC
/begin CHARACTERISTIC TQD_tiAppLowPosPT1_C "" VALUE 0x700118c8 Scalar_FLOAT32_IEEE 0 VBU0428Test_CM_single_cnt -3.4028234663852886E+38 3.4028234663852886E+38 /end CHARACTERISTIC
/begin CHARACTERISTIC TQD_tiAppMidNegPT1_C "" VALUE 0x700118cc Scalar_FLOAT32_IEEE 0 VBU0428Test_CM_single_cnt -3.4028234663852886E+38 3.4028234663852886E+38 /end CHARACTERISTIC
/begin CHARACTERISTIC TQD_tiAppMidPosPT1_C "" VALUE 0x700118d0 Scalar_FLOAT32_IEEE 0 VBU0428Test_CM_single_cnt -3.4028234663852886E+38 3.4028234663852886E+38 /end CHARACTERISTIC
/begin CHARACTERISTIC TQD_tiAppUppNegPT1_C "" VALUE 0x700118d4 Scalar_FLOAT32_IEEE 0 VBU0428Test_CM_single_cnt -3.4028234663852886E+38 3.4028234663852886E+38 /end CHARACTERISTIC
/begin CHARACTERISTIC TQD_tiAppUppPosPT1_C "" VALUE 0x700118d8 Scalar_FLOAT32_IEEE 0 VBU0428Test_CM_single_cnt -3.4028234663852886E+38 3.4028234663852886E+38 /end CHARACTERISTIC
/begin CHARACTERISTIC TQD_tiBpsLowNegPT1_C "" VALUE 0x700118dc Scalar_FLOAT32_IEEE 0 VBU0428Test_CM_single_cnt -3.4028234663852886E+38 3.4028234663852886E+38 /end CHARACTERISTIC
/begin CHARACTERISTIC TQD_tiBpsLowPosPT1_C "" VALUE 0x700118e0 Scalar_FLOAT32_IEEE 0 VBU0428Test_CM_single_cnt -3.4028234663852886E+38 3.4028234663852886E+38 /end CHARACTERISTIC
/begin CHARACTERISTIC TQD_tiBpsMidNegPT1_C "" VALUE 0x700118e4 Scalar_FLOAT32_IEEE 0 VBU0428Test_CM_single_cnt -3.4028234663852886E+38 3.4028234663852886E+38 /end CHARACTERISTIC
/begin CHARACTERISTIC TQD_tiBpsMidPosPT1_C "" VALUE 0x700118e8 Scalar_FLOAT32_IEEE 0 VBU0428Test_CM_single_cnt -3.4028234663852886E+38 3.4028234663852886E+38 /end CHARACTERISTIC
/begin CHARACTERISTIC TQD_tiBpsUppNegPT1_C "" VALUE 0x700118ec Scalar_FLOAT32_IEEE 0 VBU0428Test_CM_single_cnt -3.4028234663852886E+38 3.4028234663852886E+38 /end CHARACTERISTIC
/begin CHARACTERISTIC TQD_tiBpsUppPosPT1_C "" VALUE 0x700118f0 Scalar_FLOAT32_IEEE 0 VBU0428Test_CM_single_cnt -3.4028234663852886E+38 3.4028234663852886E+38 /end CHARACTERISTIC
/begin CHARACTERISTIC TQD_vVehSlideEna_C "" VALUE 0x70011908 Scalar_FLOAT32_IEEE 0 VBU0428Test_CM_single_cnt -3.4028234663852886E+38 3.4028234663852886E+38 /end CHARACTERISTIC
/begin CHARACTERISTIC TQD_vVehSlideRes_C "" VALUE 0x7001190c Scalar_FLOAT32_IEEE 0 VBU0428Test_CM_single_cnt -3.4028234663852886E+38 3.4028234663852886E+38 /end CHARACTERISTIC
/begin CHARACTERISTIC VM_aVehLimDifNeg_C "" VALUE 0x7001193c Scalar_FLOAT32_IEEE 0 VBU0428Test_CM_single_cnt -3.4028234663852886E+38 3.4028234663852886E+38 /end CHARACTERISTIC
/begin CHARACTERISTIC VM_aVehLimDifPos_C "" VALUE 0x70011940 Scalar_FLOAT32_IEEE 0 VBU0428Test_CM_single_cnt -3.4028234663852886E+38 3.4028234663852886E+38 /end CHARACTERISTIC
/begin CHARACTERISTIC VM_aVehLimMax_C "" VALUE 0x70011944 Scalar_FLOAT32_IEEE 0 VBU0428Test_CM_single_cnt -3.4028234663852886E+38 3.4028234663852886E+38 /end CHARACTERISTIC
/begin CHARACTERISTIC VM_vVehLimExtDefault_C "" VALUE 0x0000 Scalar_FLOAT32_IEEE 0 VBU0428Test_CM_single_cnt -3.4028234663852886E+38 3.4028234663852886E+38 /end CHARACTERISTIC
/begin CHARACTERISTIC VM_vVehLimFix_C "" VALUE 0x70011948 Scalar_FLOAT32_IEEE 0 VBU0428Test_CM_single_cnt -3.4028234663852886E+38 3.4028234663852886E+38 /end CHARACTERISTIC
/begin CHARACTERISTIC VM_vVehLimMaxRThresHi_C "" VALUE 0x7001194c Scalar_FLOAT32_IEEE 0 VBU0428Test_CM_single_cnt -3.4028234663852886E+38 3.4028234663852886E+38 /end CHARACTERISTIC
/begin CHARACTERISTIC VM_vVehLimMaxRThresLo_C "" VALUE 0x70011950 Scalar_FLOAT32_IEEE 0 VBU0428Test_CM_single_cnt -3.4028234663852886E+38 3.4028234663852886E+38 /end CHARACTERISTIC
/begin CHARACTERISTIC VM_vVehLimMaxR_C "" VALUE 0x70011954 Scalar_FLOAT32_IEEE 0 VBU0428Test_CM_single_cnt -3.4028234663852886E+38 3.4028234663852886E+38 /end CHARACTERISTIC
/begin CHARACTERISTIC VM_vVehLimMaxThresHi_C "" VALUE 0x70011958 Scalar_FLOAT32_IEEE 0 VBU0428Test_CM_single_cnt -3.4028234663852886E+38 3.4028234663852886E+38 /end CHARACTERISTIC
/begin CHARACTERISTIC VM_vVehLimMaxThresLo_C "" VALUE 0x7001195c Scalar_FLOAT32_IEEE 0 VBU0428Test_CM_single_cnt -3.4028234663852886E+38 3.4028234663852886E+38 /end CHARACTERISTIC
/begin CHARACTERISTIC VM_vVehLimMax_C "" VALUE 0x70011960 Scalar_FLOAT32_IEEE 0 VBU0428Test_CM_single_cnt -3.4028234663852886E+38 3.4028234663852886E+38 /end CHARACTERISTIC
/begin CHARACTERISTIC VM_vVehLimServerGearD_C "" VALUE 0x70011964 Scalar_FLOAT32_IEEE 0 VBU0428Test_CM_single_cnt -3.4028234663852886E+38 3.4028234663852886E+38 /end CHARACTERISTIC
/begin CHARACTERISTIC VM_vVehLimServerGearR_C "" VALUE 0x70011968 Scalar_FLOAT32_IEEE 0 VBU0428Test_CM_single_cnt -3.4028234663852886E+38 3.4028234663852886E+38 /end CHARACTERISTIC
/begin CHARACTERISTIC VM_vVehLimThresD_C "" VALUE 0x7001196c Scalar_FLOAT32_IEEE 0 VBU0428Test_CM_single_cnt -3.4028234663852886E+38 3.4028234663852886E+38 /end CHARACTERISTIC
/begin CHARACTERISTIC VM_vVehLimThresR_C "" VALUE 0x70011970 Scalar_FLOAT32_IEEE 0 VBU0428Test_CM_single_cnt -3.4028234663852886E+38 3.4028234663852886E+38 /end CHARACTERISTIC
/begin CHARACTERISTIC VM_vVehLimpHomeThresD_C "" VALUE 0x70011974 Scalar_FLOAT32_IEEE 0 VBU0428Test_CM_single_cnt -3.4028234663852886E+38 3.4028234663852886E+38 /end CHARACTERISTIC
/begin CHARACTERISTIC VM_vVehLimpHomeThresR_C "" VALUE 0x70011978 Scalar_FLOAT32_IEEE 0 VBU0428Test_CM_single_cnt -3.4028234663852886E+38 3.4028234663852886E+38 /end CHARACTERISTIC
/begin CHARACTERISTIC VM_vVehSpdLimHiServerGearD_C "" VALUE 0x7001197c Scalar_FLOAT32_IEEE 0 VBU0428Test_CM_single_cnt -3.4028234663852886E+38 3.4028234663852886E+38 /end CHARACTERISTIC
/begin CHARACTERISTIC VM_vVehSpdLimHiServerGearR_C "" VALUE 0x70011980 Scalar_FLOAT32_IEEE 0 VBU0428Test_CM_single_cnt -3.4028234663852886E+38 3.4028234663852886E+38 /end CHARACTERISTIC
/begin CHARACTERISTIC VM_vVehSpdLimREDSServerGearDMax_C "" VALUE 0x70011984 Scalar_FLOAT32_IEEE 0 VBU0428Test_CM_single_cnt -3.4028234663852886E+38 3.4028234663852886E+38 /end CHARACTERISTIC
/begin CHARACTERISTIC VM_vVehSpdLimREDSServerGearDMin_C "" VALUE 0x70011988 Scalar_FLOAT32_IEEE 0 VBU0428Test_CM_single_cnt -3.4028234663852886E+38 3.4028234663852886E+38 /end CHARACTERISTIC
/begin CHARACTERISTIC VM_vVehSpdLimREDSServerGearR_C "" VALUE 0x7001198c Scalar_FLOAT32_IEEE 0 VBU0428Test_CM_single_cnt -3.4028234663852886E+38 3.4028234663852886E+38 /end CHARACTERISTIC
/begin CHARACTERISTIC VM_vVehSpdLimServerGearD_C "" VALUE 0x70011990 Scalar_FLOAT32_IEEE 0 VBU0428Test_CM_single_cnt -3.4028234663852886E+38 3.4028234663852886E+38 /end CHARACTERISTIC
/begin CHARACTERISTIC VM_vVehSpdLimServerGearR_C "" VALUE 0x70011994 Scalar_FLOAT32_IEEE 0 VBU0428Test_CM_single_cnt -3.4028234663852886E+38 3.4028234663852886E+38 /end CHARACTERISTIC
/begin CHARACTERISTIC CcBCV_BatteryOverCurrentWarningFaultDelay_ms "" VALUE 0x7001049c Scalar_ULONG 0 VBU0428Test_CM_uint32_cnt 0.0 4.294967295E+9 /end CHARACTERISTIC
/begin CHARACTERISTIC CcBCV_BatteryOverVoltageWarningFaultDelay_ms "" VALUE 0x700104ac Scalar_ULONG 0 VBU0428Test_CM_uint32_cnt 0.0 4.294967295E+9 /end CHARACTERISTIC
/begin CHARACTERISTIC DCH_numBRMBatChgTOvrdVal_C "" VALUE 0x70010cc8 Scalar_ULONG 0 VBU0428Test_CM_uint32_cnt 0.0 4.294967295E+9 /end CHARACTERISTIC
/begin CHARACTERISTIC DCH_numBRMBatGrpOvrdVal_C "" VALUE 0x70010ccc Scalar_ULONG 0 VBU0428Test_CM_uint32_cnt 0.0 4.294967295E+9 /end CHARACTERISTIC
/begin CHARACTERISTIC DCH_numBRMBatProtcVerNew_C "" VALUE 0x70010cd0 Scalar_ULONG 0 VBU0428Test_CM_uint32_cnt 0.0 4.294967295E+9 /end CHARACTERISTIC
/begin CHARACTERISTIC DCH_numBRMBatProtcVerOld_C "" VALUE 0x70010cd4 Scalar_ULONG 0 VBU0428Test_CM_uint32_cnt 0.0 4.294967295E+9 /end CHARACTERISTIC
/begin CHARACTERISTIC DCH_numBRMBatSfwrVer1OvrdVal_C "" VALUE 0x70010cd8 Scalar_ULONG 0 VBU0428Test_CM_uint32_cnt 0.0 4.294967295E+9 /end CHARACTERISTIC
/begin CHARACTERISTIC DCH_numBRMBatSfwrVer1_C "" VALUE 0x70010cdc Scalar_ULONG 0 VBU0428Test_CM_uint32_cnt 0.0 4.294967295E+9 /end CHARACTERISTIC
/begin CHARACTERISTIC DCH_numBRMBatSfwrVer2OvrdVal_C "" VALUE 0x70010ce0 Scalar_ULONG 0 VBU0428Test_CM_uint32_cnt 0.0 4.294967295E+9 /end CHARACTERISTIC
/begin CHARACTERISTIC DCH_numBRMBatSfwrVer2_C "" VALUE 0x70010ce4 Scalar_ULONG 0 VBU0428Test_CM_uint32_cnt 0.0 4.294967295E+9 /end CHARACTERISTIC
/begin CHARACTERISTIC DCH_numBRMBatSupOvrdVal_C "" VALUE 0x70010ce8 Scalar_ULONG 0 VBU0428Test_CM_uint32_cnt 0.0 4.294967295E+9 /end CHARACTERISTIC
/begin CHARACTERISTIC DCH_numBRMVin1OvrdVal_C "" VALUE 0x70010cec Scalar_ULONG 0 VBU0428Test_CM_uint32_cnt 0.0 4.294967295E+9 /end CHARACTERISTIC
/begin CHARACTERISTIC DCH_numBRMVin1_C "" VALUE 0x70010cf0 Scalar_ULONG 0 VBU0428Test_CM_uint32_cnt 0.0 4.294967295E+9 /end CHARACTERISTIC
/begin CHARACTERISTIC DCH_numBRMVin2OvrdVal_C "" VALUE 0x70010cf4 Scalar_ULONG 0 VBU0428Test_CM_uint32_cnt 0.0 4.294967295E+9 /end CHARACTERISTIC
/begin CHARACTERISTIC DCH_numBRMVin2_C "" VALUE 0x70010cf8 Scalar_ULONG 0 VBU0428Test_CM_uint32_cnt 0.0 4.294967295E+9 /end CHARACTERISTIC
/begin CHARACTERISTIC DCH_numBRMVin3OvrdVal_C "" VALUE 0x70010cfc Scalar_ULONG 0 VBU0428Test_CM_uint32_cnt 0.0 4.294967295E+9 /end CHARACTERISTIC
/begin CHARACTERISTIC DCH_numBRMVin3_C "" VALUE 0x70010d00 Scalar_ULONG 0 VBU0428Test_CM_uint32_cnt 0.0 4.294967295E+9 /end CHARACTERISTIC
/begin CHARACTERISTIC DCH_numBSMMaxCellTempNumOvrdVal_C "" VALUE 0x70010d04 Scalar_ULONG 0 VBU0428Test_CM_uint32_cnt 0.0 4.294967295E+9 /end CHARACTERISTIC
/begin CHARACTERISTIC DCH_numBSMMaxCellVltgNumOvrdVal_C "" VALUE 0x70010d08 Scalar_ULONG 0 VBU0428Test_CM_uint32_cnt 0.0 4.294967295E+9 /end CHARACTERISTIC
/begin CHARACTERISTIC DCH_numBSMMinCellTempNumOvrdVal_C "" VALUE 0x70010d0c Scalar_ULONG 0 VBU0428Test_CM_uint32_cnt 0.0 4.294967295E+9 /end CHARACTERISTIC
/begin CHARACTERISTIC DCH_numInitialBRMBatChgT_C "" VALUE 0x70010d10 Scalar_ULONG 0 VBU0428Test_CM_uint32_cnt 0.0 4.294967295E+9 /end CHARACTERISTIC
/begin CHARACTERISTIC DCH_numInitialBRMBatGrp_C "" VALUE 0x70010d14 Scalar_ULONG 0 VBU0428Test_CM_uint32_cnt 0.0 4.294967295E+9 /end CHARACTERISTIC
/begin CHARACTERISTIC DCH_numInitialBRMBatSup_C "" VALUE 0x70010d18 Scalar_ULONG 0 VBU0428Test_CM_uint32_cnt 0.0 4.294967295E+9 /end CHARACTERISTIC
/begin CHARACTERISTIC DCH_numMaxChErrReconn_C "" VALUE 0x70010d1c Scalar_ULONG 0 VBU0428Test_CM_uint32_cnt 0.0 4.294967295E+9 /end CHARACTERISTIC
/begin CHARACTERISTIC DCH_numTOutCnt_C "" VALUE 0x70010d2c Scalar_ULONG 0 VBU0428Test_CM_uint32_cnt 0.0 4.294967295E+9 /end CHARACTERISTIC
/begin CHARACTERISTIC EcBCV_nbrFuseProtectCounter3W "" VALUE 0x70011230 Scalar_ULONG 0 VBU0428Test_CM_uint32 0 4294967295 /end CHARACTERISTIC
/begin CHARACTERISTIC CcBCV_BatteryCurrentDelay_ms "" VALUE 0x7001002a Scalar_UWORD 0 VBU0428Test_CM_uint16_cnt 0.0 65535.0 /end CHARACTERISTIC
/begin CHARACTERISTIC CcBCV_FuseProtectDelay1_ms "" VALUE 0x7001002e Scalar_UWORD 0 VBU0428Test_CM_uint16_cnt 0.0 65535.0 /end CHARACTERISTIC
/begin CHARACTERISTIC CcBCV_FuseProtectDelay2_ms "" VALUE 0x70010030 Scalar_UWORD 0 VBU0428Test_CM_uint16_cnt 0.0 65535.0 /end CHARACTERISTIC
/begin CHARACTERISTIC CcBCV_FuseProtectDelay3_ms "" VALUE 0x70010032 Scalar_UWORD 0 VBU0428Test_CM_uint16_cnt 0.0 65535.0 /end CHARACTERISTIC
/begin CHARACTERISTIC CcBCV_FuseProtectDelay4_ms "" VALUE 0x70010034 Scalar_UWORD 0 VBU0428Test_CM_uint16_cnt 0.0 65535.0 /end CHARACTERISTIC
/begin CHARACTERISTIC CcBCV_HighVoltageDelay_ms "" VALUE 0x70010036 Scalar_UWORD 0 VBU0428Test_CM_uint16_cnt 0.0 65535.0 /end CHARACTERISTIC
/begin CHARACTERISTIC CcCBL_BalanceStartCellVoltageMinHysteresis_mV "" VALUE 0x70010048 Scalar_UWORD 0 VBU0428Test_CM_uint16_cnt 0.0 65535.0 /end CHARACTERISTIC
/begin CHARACTERISTIC CcCBL_BalanceStartCellVoltageMin_mV "" VALUE 0x7001004a Scalar_UWORD 0 VBU0428Test_CM_uint16_cnt 0.0 65535.0 /end CHARACTERISTIC
/begin CHARACTERISTIC CcCBL_BalanceStartDeltaVoltage_mV "" VALUE 0x7001004e Scalar_UWORD 0 VBU0428Test_CM_uint16_cnt 0.0 65535.0 /end CHARACTERISTIC
/begin CHARACTERISTIC CcCBL_CellBalanceCurrentCheckTime_s "" VALUE 0x70010050 Scalar_UWORD 0 VBU0428Test_CM_uint16_cnt 0.0 65535.0 /end CHARACTERISTIC
/begin CHARACTERISTIC CcCBL_SocBalanceCurrentCheckTime_s "" VALUE 0x70010058 Scalar_UWORD 0 VBU0428Test_CM_uint16_cnt 0.0 65535.0 /end CHARACTERISTIC
/begin CHARACTERISTIC SECONDS_PER_HOUR "" VALUE 0x7001013c Scalar_UWORD 0 VBU0428Test_CM_uint16_cnt 0.0 65535.0 /end CHARACTERISTIC
/begin CHARACTERISTIC BPD_flgBrkPosOverride_C "" VALUE 0x70021f88 Scalar_BOOLEAN 0 VBU0428Test_CM_boolean_cnt 0.0 1.0 /end CHARACTERISTIC
/begin CHARACTERISTIC BPD_flgBrkPosVldOverrideVal_C "" VALUE 0x70021f89 Scalar_BOOLEAN 0 VBU0428Test_CM_boolean_cnt 0.0 1.0 /end CHARACTERISTIC
/begin CHARACTERISTIC BPD_flgBrkPosVldOverride_C "" VALUE 0x70021f8a Scalar_BOOLEAN 0 VBU0428Test_CM_boolean_cnt 0.0 1.0 /end CHARACTERISTIC
/begin CHARACTERISTIC BPD_flgBrkSwtOverride_C "" VALUE 0x70021f8b Scalar_BOOLEAN 0 VBU0428Test_CM_boolean_cnt 0.0 1.0 /end CHARACTERISTIC
/begin CHARACTERISTIC CbBCV_BatteryBusVoltageMismatch_flg "" VALUE 0x70021ff5 Scalar_BOOLEAN 0 VBU0428Test_CM_boolean_cnt 0.0 1.0 /end CHARACTERISTIC
/begin CHARACTERISTIC CbBCV_BatteryCurrentOoR_flg "" VALUE 0x70021ff6 Scalar_BOOLEAN 0 VBU0428Test_CM_boolean_cnt 0.0 1.0 /end CHARACTERISTIC
/begin CHARACTERISTIC CbBCV_BatteryCurrentZeroDriftEnable_flg "" VALUE 0x70021ff7 Scalar_BOOLEAN 0 VBU0428Test_CM_boolean_cnt 0.0 1.0 /end CHARACTERISTIC
/begin CHARACTERISTIC CbBCV_BatteryOverCurrentWarning_flg "" VALUE 0x70021ff8 Scalar_BOOLEAN 0 VBU0428Test_CM_boolean_cnt 0.0 1.0 /end CHARACTERISTIC
/begin CHARACTERISTIC CbBCV_BatteryOverCurrent_flg "" VALUE 0x70021ff9 Scalar_BOOLEAN 0 VBU0428Test_CM_boolean_cnt 0.0 1.0 /end CHARACTERISTIC
/begin CHARACTERISTIC CbBCV_BatteryOverVoltageEVMFaultEnable_flg "" VALUE 0x70021ffa Scalar_BOOLEAN 0 VBU0428Test_CM_boolean_cnt 0.0 1.0 /end CHARACTERISTIC
/begin CHARACTERISTIC CbBCV_BatteryOverVoltageWarning_flg "" VALUE 0x70021ffb Scalar_BOOLEAN 0 VBU0428Test_CM_boolean_cnt 0.0 1.0 /end CHARACTERISTIC
/begin CHARACTERISTIC CbBCV_BatteryOverVoltage_flg "" VALUE 0x70021ffc Scalar_BOOLEAN 0 VBU0428Test_CM_boolean_cnt 0.0 1.0 /end CHARACTERISTIC
/begin CHARACTERISTIC CbBCV_BatteryUnderVoltageEVMFaultEnable_flg "" VALUE 0x70021ffd Scalar_BOOLEAN 0 VBU0428Test_CM_boolean_cnt 0.0 1.0 /end CHARACTERISTIC
/begin CHARACTERISTIC CbBCV_BatteryUnderVoltage_flg "" VALUE 0x70021ffe Scalar_BOOLEAN 0 VBU0428Test_CM_boolean_cnt 0.0 1.0 /end CHARACTERISTIC
/begin CHARACTERISTIC CbBCV_BatteryVoltageOoR_flg "" VALUE 0x70021fff Scalar_BOOLEAN 0 VBU0428Test_CM_boolean_cnt 0.0 1.0 /end CHARACTERISTIC
/begin CHARACTERISTIC CbCBL_CellBalanceEnable_flg "" VALUE 0x7002201f Scalar_BOOLEAN 0 VBU0428Test_CM_boolean_cnt 0.0 1.0 /end CHARACTERISTIC
/begin CHARACTERISTIC CbCBL_CellBalanceOCVCheckEnable_flg "" VALUE 0x70022020 Scalar_BOOLEAN 0 VBU0428Test_CM_boolean_cnt 0.0 1.0 /end CHARACTERISTIC
/begin CHARACTERISTIC CbCBL_CellBalanceRespMismatchReqtFault_flg "" VALUE 0x70022021 Scalar_BOOLEAN 0 VBU0428Test_CM_boolean_cnt 0.0 1.0 /end CHARACTERISTIC
/begin CHARACTERISTIC CbCBL_CellTempCheckEnable_flg "" VALUE 0x70022022 Scalar_BOOLEAN 0 VBU0428Test_CM_boolean_cnt 0.0 1.0 /end CHARACTERISTIC
/begin CHARACTERISTIC CbCBL_IsolationResistanceEnable_flg "" VALUE 0x70022023 Scalar_BOOLEAN 0 VBU0428Test_CM_boolean_cnt 0.0 1.0 /end CHARACTERISTIC
/begin CHARACTERISTIC CbCTD_MnNegContactorWeldFaultEnable_flg "" VALUE 0x70022026 Scalar_BOOLEAN 0 VBU0428Test_CM_boolean_cnt 0.0 1.0 /end CHARACTERISTIC
/begin CHARACTERISTIC DCH_flgBCLChModeReqOvrd_C "" VALUE 0x700221fe Scalar_BOOLEAN 0 VBU0428Test_CM_boolean_cnt 0.0 1.0 /end CHARACTERISTIC
/begin CHARACTERISTIC DCH_flgBCLCurrReqOvrd_C "" VALUE 0x700221ff Scalar_BOOLEAN 0 VBU0428Test_CM_boolean_cnt 0.0 1.0 /end CHARACTERISTIC
/begin CHARACTERISTIC DCH_flgBCLVltgReqOvrd_C "" VALUE 0x70022200 Scalar_BOOLEAN 0 VBU0428Test_CM_boolean_cnt 0.0 1.0 /end CHARACTERISTIC
/begin CHARACTERISTIC DCH_flgBCPBattVltgOvrd_C "" VALUE 0x70022201 Scalar_BOOLEAN 0 VBU0428Test_CM_boolean_cnt 0.0 1.0 /end CHARACTERISTIC
/begin CHARACTERISTIC DCH_flgBCPMaxCellVltgForChOvrd_C "" VALUE 0x70022202 Scalar_BOOLEAN 0 VBU0428Test_CM_boolean_cnt 0.0 1.0 /end CHARACTERISTIC
/begin CHARACTERISTIC DCH_flgBCPMaxChCurrOvrd_C "" VALUE 0x70022203 Scalar_BOOLEAN 0 VBU0428Test_CM_boolean_cnt 0.0 1.0 /end CHARACTERISTIC
/begin CHARACTERISTIC DCH_flgBCPMaxPermitTempOvrd_C "" VALUE 0x70022204 Scalar_BOOLEAN 0 VBU0428Test_CM_boolean_cnt 0.0 1.0 /end CHARACTERISTIC
/begin CHARACTERISTIC DCH_flgBCPMaxVltgForChOvrd_C "" VALUE 0x70022205 Scalar_BOOLEAN 0 VBU0428Test_CM_boolean_cnt 0.0 1.0 /end CHARACTERISTIC
/begin CHARACTERISTIC DCH_flgBCPNrmCapOvrd_C "" VALUE 0x70022206 Scalar_BOOLEAN 0 VBU0428Test_CM_boolean_cnt 0.0 1.0 /end CHARACTERISTIC
/begin CHARACTERISTIC DCH_flgBCPSocOvrd_C "" VALUE 0x70022207 Scalar_BOOLEAN 0 VBU0428Test_CM_boolean_cnt 0.0 1.0 /end CHARACTERISTIC
/begin CHARACTERISTIC DCH_flgBCSChCurrMeasureOvrd_C "" VALUE 0x70022208 Scalar_BOOLEAN 0 VBU0428Test_CM_boolean_cnt 0.0 1.0 /end CHARACTERISTIC
/begin CHARACTERISTIC DCH_flgBCSChNeedTOvrd_C "" VALUE 0x70022209 Scalar_BOOLEAN 0 VBU0428Test_CM_boolean_cnt 0.0 1.0 /end CHARACTERISTIC
/begin CHARACTERISTIC DCH_flgBCSChVltgMeasureOvrd_C "" VALUE 0x7002220a Scalar_BOOLEAN 0 VBU0428Test_CM_boolean_cnt 0.0 1.0 /end CHARACTERISTIC
/begin CHARACTERISTIC DCH_flgBCSCurrSocOvrd_C "" VALUE 0x7002220b Scalar_BOOLEAN 0 VBU0428Test_CM_boolean_cnt 0.0 1.0 /end CHARACTERISTIC
/begin CHARACTERISTIC DCH_flgBCSMaxCellVltgNumOvrd_C "" VALUE 0x7002220c Scalar_BOOLEAN 0 VBU0428Test_CM_boolean_cnt 0.0 1.0 /end CHARACTERISTIC
/begin CHARACTERISTIC DCH_flgBCSMaxCellVltgOvrd_C "" VALUE 0x7002220d Scalar_BOOLEAN 0 VBU0428Test_CM_boolean_cnt 0.0 1.0 /end CHARACTERISTIC
/begin CHARACTERISTIC DCH_flgBEMChCapTOutOvrd_C "" VALUE 0x7002220e Scalar_BOOLEAN 0 VBU0428Test_CM_boolean_cnt 0.0 1.0 /end CHARACTERISTIC
/begin CHARACTERISTIC DCH_flgBEMChRdyTOutOvrd_C "" VALUE 0x7002220f Scalar_BOOLEAN 0 VBU0428Test_CM_boolean_cnt 0.0 1.0 /end CHARACTERISTIC
/begin CHARACTERISTIC DCH_flgBEMChStTOutOvrd_C "" VALUE 0x70022210 Scalar_BOOLEAN 0 VBU0428Test_CM_boolean_cnt 0.0 1.0 /end CHARACTERISTIC
/begin CHARACTERISTIC DCH_flgBEMChgrStopTOutOvrd_C "" VALUE 0x70022211 Scalar_BOOLEAN 0 VBU0428Test_CM_boolean_cnt 0.0 1.0 /end CHARACTERISTIC
/begin CHARACTERISTIC DCH_flgBEMId00TOutOvrd_C "" VALUE 0x70022212 Scalar_BOOLEAN 0 VBU0428Test_CM_boolean_cnt 0.0 1.0 /end CHARACTERISTIC
/begin CHARACTERISTIC DCH_flgBEMIdAATOutOvrd_C "" VALUE 0x70022213 Scalar_BOOLEAN 0 VBU0428Test_CM_boolean_cnt 0.0 1.0 /end CHARACTERISTIC
/begin CHARACTERISTIC DCH_flgBEMStatsDataTOutOvrd_C "" VALUE 0x70022214 Scalar_BOOLEAN 0 VBU0428Test_CM_boolean_cnt 0.0 1.0 /end CHARACTERISTIC
/begin CHARACTERISTIC DCH_flgBRMBatChgTOvrd_C "" VALUE 0x70022215 Scalar_BOOLEAN 0 VBU0428Test_CM_boolean_cnt 0.0 1.0 /end CHARACTERISTIC
/begin CHARACTERISTIC DCH_flgBRMBatDateDayOvrd_C "" VALUE 0x70022216 Scalar_BOOLEAN 0 VBU0428Test_CM_boolean_cnt 0.0 1.0 /end CHARACTERISTIC
/begin CHARACTERISTIC DCH_flgBRMBatDateMonthOvrd_C "" VALUE 0x70022217 Scalar_BOOLEAN 0 VBU0428Test_CM_boolean_cnt 0.0 1.0 /end CHARACTERISTIC
/begin CHARACTERISTIC DCH_flgBRMBatDateYearOvrd_C "" VALUE 0x70022218 Scalar_BOOLEAN 0 VBU0428Test_CM_boolean_cnt 0.0 1.0 /end CHARACTERISTIC
/begin CHARACTERISTIC DCH_flgBRMBatGrpOvrd_C "" VALUE 0x70022219 Scalar_BOOLEAN 0 VBU0428Test_CM_boolean_cnt 0.0 1.0 /end CHARACTERISTIC
/begin CHARACTERISTIC DCH_flgBRMBatIdentifyOvrd_C "" VALUE 0x7002221a Scalar_BOOLEAN 0 VBU0428Test_CM_boolean_cnt 0.0 1.0 /end CHARACTERISTIC
/begin CHARACTERISTIC DCH_flgBRMBatSfwrVer1Ovrd_C "" VALUE 0x7002221b Scalar_BOOLEAN 0 VBU0428Test_CM_boolean_cnt 0.0 1.0 /end CHARACTERISTIC
/begin CHARACTERISTIC DCH_flgBRMBatSfwrVer2Ovrd_C "" VALUE 0x7002221c Scalar_BOOLEAN 0 VBU0428Test_CM_boolean_cnt 0.0 1.0 /end CHARACTERISTIC
/begin CHARACTERISTIC DCH_flgBRMBatSupOvrd_C "" VALUE 0x7002221d Scalar_BOOLEAN 0 VBU0428Test_CM_boolean_cnt 0.0 1.0 /end CHARACTERISTIC
/begin CHARACTERISTIC DCH_flgBRMResevedOvrd_C "" VALUE 0x7002221e Scalar_BOOLEAN 0 VBU0428Test_CM_boolean_cnt 0.0 1.0 /end CHARACTERISTIC
/begin CHARACTERISTIC DCH_flgBRMVin1Ovrd_C "" VALUE 0x7002221f Scalar_BOOLEAN 0 VBU0428Test_CM_boolean_cnt 0.0 1.0 /end CHARACTERISTIC
/begin CHARACTERISTIC DCH_flgBRMVin2Ovrd_C "" VALUE 0x70022220 Scalar_BOOLEAN 0 VBU0428Test_CM_boolean_cnt 0.0 1.0 /end CHARACTERISTIC
/begin CHARACTERISTIC DCH_flgBRMVin3Ovrd_C "" VALUE 0x70022221 Scalar_BOOLEAN 0 VBU0428Test_CM_boolean_cnt 0.0 1.0 /end CHARACTERISTIC
/begin CHARACTERISTIC DCH_flgBROBattChRdyOvrd_C "" VALUE 0x70022222 Scalar_BOOLEAN 0 VBU0428Test_CM_boolean_cnt 0.0 1.0 /end CHARACTERISTIC
/begin CHARACTERISTIC DCH_flgBSDChEndSocOvrd_C "" VALUE 0x70022223 Scalar_BOOLEAN 0 VBU0428Test_CM_boolean_cnt 0.0 1.0 /end CHARACTERISTIC
/begin CHARACTERISTIC DCH_flgBSDMaxCellTempOvrd_C "" VALUE 0x70022224 Scalar_BOOLEAN 0 VBU0428Test_CM_boolean_cnt 0.0 1.0 /end CHARACTERISTIC
/begin CHARACTERISTIC DCH_flgBSDMaxCellVltgOvrd_C "" VALUE 0x70022225 Scalar_BOOLEAN 0 VBU0428Test_CM_boolean_cnt 0.0 1.0 /end CHARACTERISTIC
/begin CHARACTERISTIC DCH_flgBSDMinCellTempOvrd_C "" VALUE 0x70022226 Scalar_BOOLEAN 0 VBU0428Test_CM_boolean_cnt 0.0 1.0 /end CHARACTERISTIC
/begin CHARACTERISTIC DCH_flgBSDMinCellVltgOvrd_C "" VALUE 0x70022227 Scalar_BOOLEAN 0 VBU0428Test_CM_boolean_cnt 0.0 1.0 /end CHARACTERISTIC
/begin CHARACTERISTIC DCH_flgBSMBattOutConnStOvrdVal_C "" VALUE 0x70022228 Scalar_BOOLEAN 0 VBU0428Test_CM_boolean_cnt 0.0 1.0 /end CHARACTERISTIC
/begin CHARACTERISTIC DCH_flgBSMBattOutConnStOvrd_C "" VALUE 0x70022229 Scalar_BOOLEAN 0 VBU0428Test_CM_boolean_cnt 0.0 1.0 /end CHARACTERISTIC
/begin CHARACTERISTIC DCH_flgBSMCellVltgOverUndOvrdVal_C "" VALUE 0x7002222a Scalar_BOOLEAN 0 VBU0428Test_CM_boolean_cnt 0.0 1.0 /end CHARACTERISTIC
/begin CHARACTERISTIC DCH_flgBSMCellVltgOverUndOvrd_C "" VALUE 0x7002222b Scalar_BOOLEAN 0 VBU0428Test_CM_boolean_cnt 0.0 1.0 /end CHARACTERISTIC
/begin CHARACTERISTIC DCH_flgBSMChCurrOverOvrdVal_C "" VALUE 0x7002222c Scalar_BOOLEAN 0 VBU0428Test_CM_boolean_cnt 0.0 1.0 /end CHARACTERISTIC
/begin CHARACTERISTIC DCH_flgBSMChCurrOverOvrd_C "" VALUE 0x7002222d Scalar_BOOLEAN 0 VBU0428Test_CM_boolean_cnt 0.0 1.0 /end CHARACTERISTIC
/begin CHARACTERISTIC DCH_flgBSMChPermitOvrdVal_C "" VALUE 0x7002222e Scalar_BOOLEAN 0 VBU0428Test_CM_boolean_cnt 0.0 1.0 /end CHARACTERISTIC
/begin CHARACTERISTIC DCH_flgBSMChPermitOvrd_C "" VALUE 0x7002222f Scalar_BOOLEAN 0 VBU0428Test_CM_boolean_cnt 0.0 1.0 /end CHARACTERISTIC
/begin CHARACTERISTIC DCH_flgBSMIsoStOvrdVal_C "" VALUE 0x70022230 Scalar_BOOLEAN 0 VBU0428Test_CM_boolean_cnt 0.0 1.0 /end CHARACTERISTIC
/begin CHARACTERISTIC DCH_flgBSMIsoStOvrd_C "" VALUE 0x70022231 Scalar_BOOLEAN 0 VBU0428Test_CM_boolean_cnt 0.0 1.0 /end CHARACTERISTIC
/begin CHARACTERISTIC DCH_flgBSMMaxCellTempNumOvrd_C "" VALUE 0x70022232 Scalar_BOOLEAN 0 VBU0428Test_CM_boolean_cnt 0.0 1.0 /end CHARACTERISTIC
/begin CHARACTERISTIC DCH_flgBSMMaxCellTempOvrd_C "" VALUE 0x70022233 Scalar_BOOLEAN 0 VBU0428Test_CM_boolean_cnt 0.0 1.0 /end CHARACTERISTIC
/begin CHARACTERISTIC DCH_flgBSMMaxCellVltgNumOvrd_C "" VALUE 0x70022234 Scalar_BOOLEAN 0 VBU0428Test_CM_boolean_cnt 0.0 1.0 /end CHARACTERISTIC
/begin CHARACTERISTIC DCH_flgBSMMinCellTempNumOvrd_C "" VALUE 0x70022235 Scalar_BOOLEAN 0 VBU0428Test_CM_boolean_cnt 0.0 1.0 /end CHARACTERISTIC
/begin CHARACTERISTIC DCH_flgBSMMinCellTempOvrd_C "" VALUE 0x70022236 Scalar_BOOLEAN 0 VBU0428Test_CM_boolean_cnt 0.0 1.0 /end CHARACTERISTIC
/begin CHARACTERISTIC DCH_flgBSMSocOverUndOvrdVal_C "" VALUE 0x70022237 Scalar_BOOLEAN 0 VBU0428Test_CM_boolean_cnt 0.0 1.0 /end CHARACTERISTIC
/begin CHARACTERISTIC DCH_flgBSMSocOverUndOvrd_C "" VALUE 0x70022238 Scalar_BOOLEAN 0 VBU0428Test_CM_boolean_cnt 0.0 1.0 /end CHARACTERISTIC
/begin CHARACTERISTIC DCH_flgBSMTempOverOvrdVal_C "" VALUE 0x70022239 Scalar_BOOLEAN 0 VBU0428Test_CM_boolean_cnt 0.0 1.0 /end CHARACTERISTIC
/begin CHARACTERISTIC DCH_flgBSMTempOverOvrd_C "" VALUE 0x7002223a Scalar_BOOLEAN 0 VBU0428Test_CM_boolean_cnt 0.0 1.0 /end CHARACTERISTIC
/begin CHARACTERISTIC DCH_flgBSTChStopForBMSConnOverTempOvrdVal_C "" VALUE 0x7002223b Scalar_BOOLEAN 0 VBU0428Test_CM_boolean_cnt 0.0 1.0 /end CHARACTERISTIC
/begin CHARACTERISTIC DCH_flgBSTChStopForBMSConnOverTempOvrd_C "" VALUE 0x7002223c Scalar_BOOLEAN 0 VBU0428Test_CM_boolean_cnt 0.0 1.0 /end CHARACTERISTIC
/begin CHARACTERISTIC DCH_flgBSTChStopForBattOverTempOvrdVal_C "" VALUE 0x7002223d Scalar_BOOLEAN 0 VBU0428Test_CM_boolean_cnt 0.0 1.0 /end CHARACTERISTIC
/begin CHARACTERISTIC DCH_flgBSTChStopForBattOverTempOvrd_C "" VALUE 0x7002223e Scalar_BOOLEAN 0 VBU0428Test_CM_boolean_cnt 0.0 1.0 /end CHARACTERISTIC
/begin CHARACTERISTIC DCH_flgBSTChStopForCCToVltgFaultOvrdVal_C "" VALUE 0x7002223f Scalar_BOOLEAN 0 VBU0428Test_CM_boolean_cnt 0.0 1.0 /end CHARACTERISTIC
/begin CHARACTERISTIC DCH_flgBSTChStopForCCToVltgFaultOvrd_C "" VALUE 0x70022240 Scalar_BOOLEAN 0 VBU0428Test_CM_boolean_cnt 0.0 1.0 /end CHARACTERISTIC
/begin CHARACTERISTIC DCH_flgBSTChStopForCellVltgOvrdVal_C "" VALUE 0x70022241 Scalar_BOOLEAN 0 VBU0428Test_CM_boolean_cnt 0.0 1.0 /end CHARACTERISTIC
/begin CHARACTERISTIC DCH_flgBSTChStopForCellVltgOvrd_C "" VALUE 0x70022242 Scalar_BOOLEAN 0 VBU0428Test_CM_boolean_cnt 0.0 1.0 /end CHARACTERISTIC
/begin CHARACTERISTIC DCH_flgBSTChStopForChgrReqStopOvrdVal_C "" VALUE 0x70022243 Scalar_BOOLEAN 0 VBU0428Test_CM_boolean_cnt 0.0 1.0 /end CHARACTERISTIC
/begin CHARACTERISTIC DCH_flgBSTChStopForChgrReqStopOvrd_C "" VALUE 0x70022244 Scalar_BOOLEAN 0 VBU0428Test_CM_boolean_cnt 0.0 1.0 /end CHARACTERISTIC
/begin CHARACTERISTIC DCH_flgBSTChStopForConnFaultOvrdVal_C "" VALUE 0x70022245 Scalar_BOOLEAN 0 VBU0428Test_CM_boolean_cnt 0.0 1.0 /end CHARACTERISTIC
/begin CHARACTERISTIC DCH_flgBSTChStopForConnFaultOvrd_C "" VALUE 0x70022246 Scalar_BOOLEAN 0 VBU0428Test_CM_boolean_cnt 0.0 1.0 /end CHARACTERISTIC
/begin CHARACTERISTIC DCH_flgBSTChStopForConnOverTempOvrdVal_C "" VALUE 0x70022247 Scalar_BOOLEAN 0 VBU0428Test_CM_boolean_cnt 0.0 1.0 /end CHARACTERISTIC
/begin CHARACTERISTIC DCH_flgBSTChStopForConnOverTempOvrd_C "" VALUE 0x70022248 Scalar_BOOLEAN 0 VBU0428Test_CM_boolean_cnt 0.0 1.0 /end CHARACTERISTIC
/begin CHARACTERISTIC DCH_flgBSTChStopForHvRlyFaultOvrdVal_C "" VALUE 0x70022249 Scalar_BOOLEAN 0 VBU0428Test_CM_boolean_cnt 0.0 1.0 /end CHARACTERISTIC
/begin CHARACTERISTIC DCH_flgBSTChStopForHvRlyFaultOvrd_C "" VALUE 0x7002224a Scalar_BOOLEAN 0 VBU0428Test_CM_boolean_cnt 0.0 1.0 /end CHARACTERISTIC
/begin CHARACTERISTIC DCH_flgBSTChStopForIsoFaultOvrdVal_C "" VALUE 0x7002224b Scalar_BOOLEAN 0 VBU0428Test_CM_boolean_cnt 0.0 1.0 /end CHARACTERISTIC
/begin CHARACTERISTIC DCH_flgBSTChStopForIsoFaultOvrd_C "" VALUE 0x7002224c Scalar_BOOLEAN 0 VBU0428Test_CM_boolean_cnt 0.0 1.0 /end CHARACTERISTIC
/begin CHARACTERISTIC DCH_flgBSTChStopForOtherFaultOvrdVal_C "" VALUE 0x7002224d Scalar_BOOLEAN 0 VBU0428Test_CM_boolean_cnt 0.0 1.0 /end CHARACTERISTIC
/begin CHARACTERISTIC DCH_flgBSTChStopForOtherFaultOvrd_C "" VALUE 0x7002224e Scalar_BOOLEAN 0 VBU0428Test_CM_boolean_cnt 0.0 1.0 /end CHARACTERISTIC
/begin CHARACTERISTIC DCH_flgBSTChStopForOverCurrOvrdVal_C "" VALUE 0x7002224f Scalar_BOOLEAN 0 VBU0428Test_CM_boolean_cnt 0.0 1.0 /end CHARACTERISTIC
/begin CHARACTERISTIC DCH_flgBSTChStopForOverCurrOvrd_C "" VALUE 0x70022250 Scalar_BOOLEAN 0 VBU0428Test_CM_boolean_cnt 0.0 1.0 /end CHARACTERISTIC
/begin CHARACTERISTIC DCH_flgBSTChStopForSocOvrdVal_C "" VALUE 0x70022251 Scalar_BOOLEAN 0 VBU0428Test_CM_boolean_cnt 0.0 1.0 /end CHARACTERISTIC
/begin CHARACTERISTIC DCH_flgBSTChStopForSocOvrd_C "" VALUE 0x70022252 Scalar_BOOLEAN 0 VBU0428Test_CM_boolean_cnt 0.0 1.0 /end CHARACTERISTIC
/begin CHARACTERISTIC DCH_flgBSTChStopForTotalVltgOvrdVal_C "" VALUE 0x70022253 Scalar_BOOLEAN 0 VBU0428Test_CM_boolean_cnt 0.0 1.0 /end CHARACTERISTIC
/begin CHARACTERISTIC DCH_flgBSTChStopForTotalVltgOvrd_C "" VALUE 0x70022254 Scalar_BOOLEAN 0 VBU0428Test_CM_boolean_cnt 0.0 1.0 /end CHARACTERISTIC
/begin CHARACTERISTIC DCH_flgBSTChStopForVltgAbNrmOvrdVal_C "" VALUE 0x70022255 Scalar_BOOLEAN 0 VBU0428Test_CM_boolean_cnt 0.0 1.0 /end CHARACTERISTIC
/begin CHARACTERISTIC DCH_flgBSTChStopForVltgAbNrmOvrd_C "" VALUE 0x70022256 Scalar_BOOLEAN 0 VBU0428Test_CM_boolean_cnt 0.0 1.0 /end CHARACTERISTIC
/begin CHARACTERISTIC DCH_flgDCChRlyClose_SY "" VALUE 0x70022259 Scalar_BOOLEAN 0 VBU0428Test_CM_boolean_cnt 0.0 1.0 /end CHARACTERISTIC
/begin CHARACTERISTIC DCH_flgDCChRlyOpen_SY "" VALUE 0x7002225a Scalar_BOOLEAN 0 VBU0428Test_CM_boolean_cnt 0.0 1.0 /end CHARACTERISTIC
/begin CHARACTERISTIC DCH_flgHvRlyClose_SY "" VALUE 0x7002225c Scalar_BOOLEAN 0 VBU0428Test_CM_boolean_cnt 0.0 1.0 /end CHARACTERISTIC
/begin CHARACTERISTIC DCH_flgHvRlyOpen_SY "" VALUE 0x7002225d Scalar_BOOLEAN 0 VBU0428Test_CM_boolean_cnt 0.0 1.0 /end CHARACTERISTIC
/begin CHARACTERISTIC DCH_flgOvrdReceiveCCS_C "" VALUE 0x7002225e Scalar_BOOLEAN 0 VBU0428Test_CM_boolean_cnt 0.0 1.0 /end CHARACTERISTIC
/begin CHARACTERISTIC DCH_flgOvrdReceiveCEM_C "" VALUE 0x7002225f Scalar_BOOLEAN 0 VBU0428Test_CM_boolean_cnt 0.0 1.0 /end CHARACTERISTIC
/begin CHARACTERISTIC DCH_flgOvrdReceiveCHM_C "" VALUE 0x70022260 Scalar_BOOLEAN 0 VBU0428Test_CM_boolean_cnt 0.0 1.0 /end CHARACTERISTIC
/begin CHARACTERISTIC DCH_flgOvrdReceiveCML_C "" VALUE 0x70022261 Scalar_BOOLEAN 0 VBU0428Test_CM_boolean_cnt 0.0 1.0 /end CHARACTERISTIC
/begin CHARACTERISTIC DCH_flgOvrdReceiveCRM_C "" VALUE 0x70022262 Scalar_BOOLEAN 0 VBU0428Test_CM_boolean_cnt 0.0 1.0 /end CHARACTERISTIC
/begin CHARACTERISTIC DCH_flgOvrdReceiveCRO_C "" VALUE 0x70022263 Scalar_BOOLEAN 0 VBU0428Test_CM_boolean_cnt 0.0 1.0 /end CHARACTERISTIC
/begin CHARACTERISTIC DCH_flgOvrdReceiveCSD_C "" VALUE 0x70022264 Scalar_BOOLEAN 0 VBU0428Test_CM_boolean_cnt 0.0 1.0 /end CHARACTERISTIC
/begin CHARACTERISTIC DCH_flgOvrdReceiveCST_C "" VALUE 0x70022265 Scalar_BOOLEAN 0 VBU0428Test_CM_boolean_cnt 0.0 1.0 /end CHARACTERISTIC
/begin CHARACTERISTIC DCH_flgOvrdValReceiveCCS_C "" VALUE 0x70022266 Scalar_BOOLEAN 0 VBU0428Test_CM_boolean_cnt 0.0 1.0 /end CHARACTERISTIC
/begin CHARACTERISTIC DCH_flgOvrdValReceiveCEM_C "" VALUE 0x70022267 Scalar_BOOLEAN 0 VBU0428Test_CM_boolean_cnt 0.0 1.0 /end CHARACTERISTIC
/begin CHARACTERISTIC DCH_flgOvrdValReceiveCHM_C "" VALUE 0x70022268 Scalar_BOOLEAN 0 VBU0428Test_CM_boolean_cnt 0.0 1.0 /end CHARACTERISTIC
/begin CHARACTERISTIC DCH_flgOvrdValReceiveCML_C "" VALUE 0x70022269 Scalar_BOOLEAN 0 VBU0428Test_CM_boolean_cnt 0.0 1.0 /end CHARACTERISTIC
/begin CHARACTERISTIC DCH_flgOvrdValReceiveCRM_C "" VALUE 0x7002226a Scalar_BOOLEAN 0 VBU0428Test_CM_boolean_cnt 0.0 1.0 /end CHARACTERISTIC
/begin CHARACTERISTIC DCH_flgOvrdValReceiveCRO_C "" VALUE 0x7002226b Scalar_BOOLEAN 0 VBU0428Test_CM_boolean_cnt 0.0 1.0 /end CHARACTERISTIC
/begin CHARACTERISTIC DCH_flgOvrdValReceiveCSD_C "" VALUE 0x7002226c Scalar_BOOLEAN 0 VBU0428Test_CM_boolean_cnt 0.0 1.0 /end CHARACTERISTIC
/begin CHARACTERISTIC DCH_flgOvrdValReceiveCST_C "" VALUE 0x7002226d Scalar_BOOLEAN 0 VBU0428Test_CM_boolean_cnt 0.0 1.0 /end CHARACTERISTIC
/begin CHARACTERISTIC LVC_flgIbsSocLowHvRlyOpen_C "" VALUE 0x70022397 Scalar_BOOLEAN 0 VBU0428Test_CM_boolean_cnt 0.0 1.0 /end CHARACTERISTIC
/begin CHARACTERISTIC MTQL_trqMtrDrvLimOvrd_C "" VALUE 0x700223b3 Scalar_BOOLEAN 0 VBU0428Test_CM_boolean 0 1 /end CHARACTERISTIC
/begin CHARACTERISTIC MTQL_trqMtrRgnLimOvrd_C "" VALUE 0x700223b4 Scalar_BOOLEAN 0 VBU0428Test_CM_boolean 0 1 /end CHARACTERISTIC
/begin CHARACTERISTIC PMM_flgAccDisblOvrdSwt_C "" VALUE 0x700223c5 Scalar_BOOLEAN 0 VBU0428Test_CM_boolean_cnt 0.0 1.0 /end CHARACTERISTIC
/begin CHARACTERISTIC PMM_flgAccDisblOvrdVal_C "" VALUE 0x700223c6 Scalar_BOOLEAN 0 VBU0428Test_CM_boolean_cnt 0.0 1.0 /end CHARACTERISTIC
/begin CHARACTERISTIC PMM_flgActvDisWihtHVRlyCldSwt_C "" VALUE 0x700223c7 Scalar_BOOLEAN 0 VBU0428Test_CM_boolean_cnt 0.0 1.0 /end CHARACTERISTIC
/begin CHARACTERISTIC PMM_flgActvDisWihtHVRlyCldVal_C "" VALUE 0x700223c8 Scalar_BOOLEAN 0 VBU0428Test_CM_boolean_cnt 0.0 1.0 /end CHARACTERISTIC
/begin CHARACTERISTIC PMM_flgHVPwrDwnEnaOvrdSwt_C "" VALUE 0x700223c9 Scalar_BOOLEAN 0 VBU0428Test_CM_boolean_cnt 0.0 1.0 /end CHARACTERISTIC
/begin CHARACTERISTIC PMM_flgHVPwrDwnEnaOvrdVal_C "" VALUE 0x700223ca Scalar_BOOLEAN 0 VBU0428Test_CM_boolean_cnt 0.0 1.0 /end CHARACTERISTIC
/begin CHARACTERISTIC PMM_flgHVPwrUpEnaOvrdSwt_C "" VALUE 0x700223cb Scalar_BOOLEAN 0 VBU0428Test_CM_boolean_cnt 0.0 1.0 /end CHARACTERISTIC
/begin CHARACTERISTIC PMM_flgHVPwrUpEnaOvrdVal_C "" VALUE 0x700223cc Scalar_BOOLEAN 0 VBU0428Test_CM_boolean_cnt 0.0 1.0 /end CHARACTERISTIC
/begin CHARACTERISTIC PMM_flgHVRdyOvrdSwt_C "" VALUE 0x700223cd Scalar_BOOLEAN 0 VBU0428Test_CM_boolean_cnt 0.0 1.0 /end CHARACTERISTIC
/begin CHARACTERISTIC PMM_flgHVRdyOvrdVal_C "" VALUE 0x700223ce Scalar_BOOLEAN 0 VBU0428Test_CM_boolean_cnt 0.0 1.0 /end CHARACTERISTIC
/begin CHARACTERISTIC PMM_flgHVRlyReqOvrdSwt_C "" VALUE 0x700223cf Scalar_BOOLEAN 0 VBU0428Test_CM_boolean_cnt 0.0 1.0 /end CHARACTERISTIC
/begin CHARACTERISTIC PMM_flgPEURActvDisChEnaOvrdSwt_C "" VALUE 0x700223d1 Scalar_BOOLEAN 0 VBU0428Test_CM_boolean_cnt 0.0 1.0 /end CHARACTERISTIC
/begin CHARACTERISTIC PMM_flgPEURActvDisChEnaOvrdVal_C "" VALUE 0x700223d2 Scalar_BOOLEAN 0 VBU0428Test_CM_boolean_cnt 0.0 1.0 /end CHARACTERISTIC
/begin CHARACTERISTIC PMM_flgPEURShtDwnOvrdSwt_C "" VALUE 0x700223d3 Scalar_BOOLEAN 0 VBU0428Test_CM_boolean_cnt 0.0 1.0 /end CHARACTERISTIC
/begin CHARACTERISTIC PMM_flgPEURShtDwnOvrdVal_C "" VALUE 0x700223d4 Scalar_BOOLEAN 0 VBU0428Test_CM_boolean_cnt 0.0 1.0 /end CHARACTERISTIC
/begin CHARACTERISTIC PMM_flgRMCUZrTrqReqOvrdSwt_C "" VALUE 0x700223d7 Scalar_BOOLEAN 0 VBU0428Test_CM_boolean_cnt 0.0 1.0 /end CHARACTERISTIC
/begin CHARACTERISTIC PMM_flgRMCUZrTrqReqOvrdVal_C "" VALUE 0x700223d8 Scalar_BOOLEAN 0 VBU0428Test_CM_boolean_cnt 0.0 1.0 /end CHARACTERISTIC
/begin CHARACTERISTIC PMM_flgSelfDiagEnaOvrdSwt_C "" VALUE 0x700223d9 Scalar_BOOLEAN 0 VBU0428Test_CM_boolean_cnt 0.0 1.0 /end CHARACTERISTIC
/begin CHARACTERISTIC PMM_flgSelfDiagEnaOvrdVal_C "" VALUE 0x700223da Scalar_BOOLEAN 0 VBU0428Test_CM_boolean_cnt 0.0 1.0 /end CHARACTERISTIC
/begin CHARACTERISTIC PMM_flgVehRdyOvrdSwt_C "" VALUE 0x700223df Scalar_BOOLEAN 0 VBU0428Test_CM_boolean_cnt 0.0 1.0 /end CHARACTERISTIC
/begin CHARACTERISTIC PMM_flgWkupModOvrdSwt_C "" VALUE 0x700223e4 Scalar_BOOLEAN 0 VBU0428Test_CM_boolean_cnt 0.0 1.0 /end CHARACTERISTIC
/begin CHARACTERISTIC TQC_flgDragCalEn_C "" VALUE 0x70022444 Scalar_BOOLEAN 0 VBU0428Test_CM_boolean_cnt 0.0 1.0 /end CHARACTERISTIC
/begin CHARACTERISTIC TQC_flgDragTrqMovingOn_C "" VALUE 0x70022445 Scalar_BOOLEAN 0 VBU0428Test_CM_boolean_cnt 0.0 1.0 /end CHARACTERISTIC
/begin CHARACTERISTIC TQC_flgSlopeLimitEn_C "" VALUE 0x70022446 Scalar_BOOLEAN 0 VBU0428Test_CM_boolean_cnt 0.0 1.0 /end CHARACTERISTIC
/begin CHARACTERISTIC TQC_flgVehAccCalcEnable_C "" VALUE 0x70022447 Scalar_BOOLEAN 0 VBU0428Test_CM_boolean_cnt 0.0 1.0 /end CHARACTERISTIC
/begin CHARACTERISTIC TQD_flgAPDFltByp_C "" VALUE 0x70022456 Scalar_BOOLEAN 0 VBU0428Test_CM_boolean_cnt 0.0 1.0 /end CHARACTERISTIC
/begin CHARACTERISTIC TQD_flgBpsFlt_C "" VALUE 0x70022457 Scalar_BOOLEAN 0 VBU0428Test_CM_boolean_cnt 0.0 1.0 /end CHARACTERISTIC
/begin CHARACTERISTIC TQD_flgVectorSpdUsed_C "" VALUE 0x7002245b Scalar_BOOLEAN 0 VBU0428Test_CM_boolean_cnt 0.0 1.0 /end CHARACTERISTIC
/begin CHARACTERISTIC TQD_flgVirtualNeutralEnable_C "" VALUE 0x7002245c Scalar_BOOLEAN 0 VBU0428Test_CM_boolean_cnt 0.0 1.0 /end CHARACTERISTIC
/begin CHARACTERISTIC VM_flgVehLimFixEnable_C "" VALUE 0x7002246b Scalar_BOOLEAN 0 VBU0428Test_CM_boolean_cnt 0.0 1.0 /end CHARACTERISTIC
/begin CHARACTERISTIC CcBCV_BatteryBusVoltageMismatchFaultFIC_n "" VALUE 0x70022110 Scalar_BYTE 0 VBU0428Test_CM_int8_cnt -128.0 127.0 /end CHARACTERISTIC
/begin CHARACTERISTIC CcBCV_BatteryBusVoltageMismatchFaultPIC_n "" VALUE 0x70022111 Scalar_BYTE 0 VBU0428Test_CM_int8_cnt -128.0 127.0 /end CHARACTERISTIC
/begin CHARACTERISTIC CcBCV_BatteryCurrentOoRFaultFIC_n "" VALUE 0x70022112 Scalar_BYTE 0 VBU0428Test_CM_int8_cnt -128.0 127.0 /end CHARACTERISTIC
/begin CHARACTERISTIC CcBCV_BatteryCurrentOoRFaultPIC_n "" VALUE 0x70022113 Scalar_BYTE 0 VBU0428Test_CM_int8_cnt -128.0 127.0 /end CHARACTERISTIC
/begin CHARACTERISTIC CcBCV_BatteryOverCurrentFaultFIC_n "" VALUE 0x70022114 Scalar_BYTE 0 VBU0428Test_CM_int8_cnt -128.0 127.0 /end CHARACTERISTIC
/begin CHARACTERISTIC CcBCV_BatteryOverCurrentFaultPIC_n "" VALUE 0x70022115 Scalar_BYTE 0 VBU0428Test_CM_int8_cnt -128.0 127.0 /end CHARACTERISTIC
/begin CHARACTERISTIC CcBCV_BatteryOverCurrentWarningFaultFIC_n "" VALUE 0x70022116 Scalar_BYTE 0 VBU0428Test_CM_int8_cnt -128.0 127.0 /end CHARACTERISTIC
/begin CHARACTERISTIC CcBCV_BatteryOverCurrentWarningFaultPIC_n "" VALUE 0x70022117 Scalar_BYTE 0 VBU0428Test_CM_int8_cnt -128.0 127.0 /end CHARACTERISTIC
/begin CHARACTERISTIC CcBCV_BatteryOverVoltageEVMFaultFIC_n "" VALUE 0x70022118 Scalar_BYTE 0 VBU0428Test_CM_int8_cnt -128.0 127.0 /end CHARACTERISTIC
/begin CHARACTERISTIC CcBCV_BatteryOverVoltageEVMFaultPIC_n "" VALUE 0x70022119 Scalar_BYTE 0 VBU0428Test_CM_int8_cnt -128.0 127.0 /end CHARACTERISTIC
/begin CHARACTERISTIC CcBCV_BatteryOverVoltageFaultFIC_n "" VALUE 0x7002211a Scalar_BYTE 0 VBU0428Test_CM_int8_cnt -128.0 127.0 /end CHARACTERISTIC
/begin CHARACTERISTIC CcBCV_BatteryOverVoltageFaultPIC_n "" VALUE 0x7002211b Scalar_BYTE 0 VBU0428Test_CM_int8_cnt -128.0 127.0 /end CHARACTERISTIC
/begin CHARACTERISTIC CcBCV_BatteryOverVoltageWarningFaultFIC_n "" VALUE 0x7002211c Scalar_BYTE 0 VBU0428Test_CM_int8_cnt -128.0 127.0 /end CHARACTERISTIC
/begin CHARACTERISTIC CcBCV_BatteryOverVoltageWarningFaultPIC_n "" VALUE 0x7002211d Scalar_BYTE 0 VBU0428Test_CM_int8_cnt -128.0 127.0 /end CHARACTERISTIC
/begin CHARACTERISTIC CcBCV_BatteryUnderVoltageEVMFaultFIC_n "" VALUE 0x7002211e Scalar_BYTE 0 VBU0428Test_CM_int8_cnt -128.0 127.0 /end CHARACTERISTIC
/begin CHARACTERISTIC CcBCV_BatteryUnderVoltageEVMFaultPIC_n "" VALUE 0x7002211f Scalar_BYTE 0 VBU0428Test_CM_int8_cnt -128.0 127.0 /end CHARACTERISTIC
/begin CHARACTERISTIC CcBCV_BatteryUnderVoltageFaultFIC_n "" VALUE 0x70022120 Scalar_BYTE 0 VBU0428Test_CM_int8_cnt -128.0 127.0 /end CHARACTERISTIC
/begin CHARACTERISTIC CcBCV_BatteryUnderVoltageFaultPIC_n "" VALUE 0x70022121 Scalar_BYTE 0 VBU0428Test_CM_int8_cnt -128.0 127.0 /end CHARACTERISTIC
/begin CHARACTERISTIC CcBCV_BatteryVoltageOoRFaultFIC_n "" VALUE 0x70022122 Scalar_BYTE 0 VBU0428Test_CM_int8_cnt -128.0 127.0 /end CHARACTERISTIC
/begin CHARACTERISTIC CcBCV_BatteryVoltageOoRFaultPIC_n "" VALUE 0x70022123 Scalar_BYTE 0 VBU0428Test_CM_int8_cnt -128.0 127.0 /end CHARACTERISTIC
/begin CHARACTERISTIC CcCBL_CellBalanceRespMismatchReqtFIC_n "" VALUE 0x70022132 Scalar_BYTE 0 VBU0428Test_CM_int8_cnt -128.0 127.0 /end CHARACTERISTIC
/begin CHARACTERISTIC CcCBL_CellBalanceRespMismatchReqtPIC_n "" VALUE 0x70022133 Scalar_BYTE 0 VBU0428Test_CM_int8_cnt -128.0 127.0 /end CHARACTERISTIC
/begin CHARACTERISTIC CcCTD_MNCWeldTestEnablePEURVoltageRatio_pct "" VALUE 0x70022134 Scalar_BYTE 0 VBU0428Test_CM_int8_cnt -128.0 127.0 /end CHARACTERISTIC
/begin CHARACTERISTIC CcCTD_MnNegContactorWeldFaultFIC_n "" VALUE 0x7002213a Scalar_BYTE 0 VBU0428Test_CM_int8_cnt -128.0 127.0 /end CHARACTERISTIC
/begin CHARACTERISTIC CcCTD_MnNegContactorWeldFaultPIC_n "" VALUE 0x7002213b Scalar_BYTE 0 VBU0428Test_CM_int8_cnt -128.0 127.0 /end CHARACTERISTIC
/begin CHARACTERISTIC BCV_BATTERY_BUS_VOLTAGE_MISMATCH_FAULT "" VALUE 0x70021f70 Scalar_UBYTE 0 VBU0428Test_CM_uint8_cnt 0.0 255.0 /end CHARACTERISTIC
/begin CHARACTERISTIC BCV_BATTERY_OVER_CURRENT_WARNING_FAULT "" VALUE 0x70021f71 Scalar_UBYTE 0 VBU0428Test_CM_uint8_cnt 0.0 255.0 /end CHARACTERISTIC
/begin CHARACTERISTIC BCV_BATTERY_UNDER_VOLTAGEEVM_FAULT "" VALUE 0x70021f72 Scalar_UBYTE 0 VBU0428Test_CM_uint8_cnt 0.0 255.0 /end CHARACTERISTIC
/begin CHARACTERISTIC BCV_BATTERY_UNDER_VOLTAGE_FAULT "" VALUE 0x70021f73 Scalar_UBYTE 0 VBU0428Test_CM_uint8_cnt 0.0 255.0 /end CHARACTERISTIC
/begin CHARACTERISTIC BCV_BATTERY_VOLTAGE_SENSE_OOR_FAULT "" VALUE 0x70021f74 Scalar_UBYTE 0 VBU0428Test_CM_uint8_cnt 0.0 255.0 /end CHARACTERISTIC
/begin CHARACTERISTIC BCV_LEM_CURRENT_SENSE_OOR_FAULT "" VALUE 0x70021f75 Scalar_UBYTE 0 VBU0428Test_CM_uint8_cnt 0.0 255.0 /end CHARACTERISTIC
/begin CHARACTERISTIC BPD_stBrkPedPrsNoActv_C "" VALUE 0x70021f8d Scalar_UBYTE 0 VBU0428Test_CM_uint8_cnt 0.0 15.0 /end CHARACTERISTIC
/begin CHARACTERISTIC BPD_stBrkSwtOverrideVal_C "" VALUE 0x70021f90 Scalar_UBYTE 0 VBU0428Test_CM_uint8_cnt 0.0 15.0 /end CHARACTERISTIC
/begin CHARACTERISTIC DCH_numBRMBatDateDayOvrdVal_C "" VALUE 0x70022273 Scalar_UBYTE 0 VBU0428Test_CM_uint8_cnt 0.0 255.0 /end CHARACTERISTIC
/begin CHARACTERISTIC DCH_numBRMBatDateMonthOvrdVal_C "" VALUE 0x70022274 Scalar_UBYTE 0 VBU0428Test_CM_uint8_cnt 0.0 255.0 /end CHARACTERISTIC
/begin CHARACTERISTIC DCH_numBRMBatDateYearOvrdVal_C "" VALUE 0x70022275 Scalar_UBYTE 0 VBU0428Test_CM_uint8_cnt 0.0 255.0 /end CHARACTERISTIC
/begin CHARACTERISTIC DCH_numBRMBatIdentifyOvrdVal_C "" VALUE 0x70022276 Scalar_UBYTE 0 VBU0428Test_CM_uint8_cnt 0.0 255.0 /end CHARACTERISTIC
/begin CHARACTERISTIC DCH_numBRMBatIdentify_C "" VALUE 0x70022277 Scalar_UBYTE 0 VBU0428Test_CM_uint8_cnt 0.0 255.0 /end CHARACTERISTIC
/begin CHARACTERISTIC DCH_numBRMResevedOvrdVal_C "" VALUE 0x7002227c Scalar_UBYTE 0 VBU0428Test_CM_uint8_cnt 0.0 255.0 /end CHARACTERISTIC
/begin CHARACTERISTIC DCH_numBRMReseved_C "" VALUE 0x7002227d Scalar_UBYTE 0 VBU0428Test_CM_uint8_cnt 0.0 255.0 /end CHARACTERISTIC
/begin CHARACTERISTIC DCH_numInitialBRMBatDateDay_C "" VALUE 0x7002227e Scalar_UBYTE 0 VBU0428Test_CM_uint8_cnt 0.0 255.0 /end CHARACTERISTIC
/begin CHARACTERISTIC DCH_numInitialBRMBatDateMonth_C "" VALUE 0x7002227f Scalar_UBYTE 0 VBU0428Test_CM_uint8_cnt 0.0 255.0 /end CHARACTERISTIC
/begin CHARACTERISTIC DCH_numInitialBRMBatDateYear_C "" VALUE 0x70022280 Scalar_UBYTE 0 VBU0428Test_CM_uint8_cnt 0.0 255.0 /end CHARACTERISTIC
/begin CHARACTERISTIC DCH_stBCLChModeReqOvrdVal_C "" VALUE 0x70022283 Scalar_UBYTE 0 VBU0428Test_CM_uint8_cnt 0.0 15.0 /end CHARACTERISTIC
/begin CHARACTERISTIC DCH_stBCLConstantCurrMode_C "" VALUE 0x70022284 Scalar_UBYTE 0 VBU0428Test_CM_uint8_cnt 0.0 15.0 /end CHARACTERISTIC
/begin CHARACTERISTIC DCH_stBCLConstantVltgMode_C "" VALUE 0x70022285 Scalar_UBYTE 0 VBU0428Test_CM_uint8_cnt 0.0 15.0 /end CHARACTERISTIC
/begin CHARACTERISTIC DCH_stBCPMode_SY "" VALUE 0x70022287 Scalar_UBYTE 0 VBU0428Test_CM_uint8_cnt 0.0 255.0 /end CHARACTERISTIC
/begin CHARACTERISTIC DCH_stBEMChCapTOutOvrdVal_C "" VALUE 0x7002228b Scalar_UBYTE 0 VBU0428Test_CM_uint8_cnt 0.0 15.0 /end CHARACTERISTIC
/begin CHARACTERISTIC DCH_stBEMChRdyTOutOvrdVal_C "" VALUE 0x7002228d Scalar_UBYTE 0 VBU0428Test_CM_uint8_cnt 0.0 15.0 /end CHARACTERISTIC
/begin CHARACTERISTIC DCH_stBEMChStTOutOvrdVal_C "" VALUE 0x7002228f Scalar_UBYTE 0 VBU0428Test_CM_uint8_cnt 0.0 15.0 /end CHARACTERISTIC
/begin CHARACTERISTIC DCH_stBEMChgrStopTOutOvrdVal_C "" VALUE 0x70022291 Scalar_UBYTE 0 VBU0428Test_CM_uint8_cnt 0.0 15.0 /end CHARACTERISTIC
/begin CHARACTERISTIC DCH_stBEMId00TOutOvrdVal_C "" VALUE 0x70022292 Scalar_UBYTE 0 VBU0428Test_CM_uint8_cnt 0.0 15.0 /end CHARACTERISTIC
/begin CHARACTERISTIC DCH_stBEMIdAATOutOvrdVal_C "" VALUE 0x70022293 Scalar_UBYTE 0 VBU0428Test_CM_uint8_cnt 0.0 15.0 /end CHARACTERISTIC
/begin CHARACTERISTIC DCH_stBEMStatsDataTOutOvrdVal_C "" VALUE 0x70022295 Scalar_UBYTE 0 VBU0428Test_CM_uint8_cnt 0.0 15.0 /end CHARACTERISTIC
/begin CHARACTERISTIC DCH_stBRMMode_SY "" VALUE 0x70022298 Scalar_UBYTE 0 VBU0428Test_CM_uint8_cnt 0.0 255.0 /end CHARACTERISTIC
/begin CHARACTERISTIC DCH_stBROBattChRdyOvrdVal_C "" VALUE 0x70022299 Scalar_UBYTE 0 VBU0428Test_CM_uint8_cnt 0.0 15.0 /end CHARACTERISTIC
/begin CHARACTERISTIC DCH_stBRONoRdyMode_SY "" VALUE 0x7002229a Scalar_UBYTE 0 VBU0428Test_CM_uint8_cnt 0.0 255.0 /end CHARACTERISTIC
/begin CHARACTERISTIC DCH_stBRORdyMode_SY "" VALUE 0x7002229b Scalar_UBYTE 0 VBU0428Test_CM_uint8_cnt 0.0 255.0 /end CHARACTERISTIC
/begin CHARACTERISTIC DCH_stBSTForNrmMode_SY "" VALUE 0x7002229c Scalar_UBYTE 0 VBU0428Test_CM_uint8_cnt 0.0 255.0 /end CHARACTERISTIC
/begin CHARACTERISTIC DCH_stCC2AplusConnect_SY "" VALUE 0x7002229d Scalar_UBYTE 0 VBU0428Test_CM_uint8_cnt 0.0 255.0 /end CHARACTERISTIC
/begin CHARACTERISTIC DCH_stChStopChgrErr_SY "" VALUE 0x7002229f Scalar_UBYTE 0 VBU0428Test_CM_uint8_cnt 0.0 255.0 /end CHARACTERISTIC
/begin CHARACTERISTIC DCH_stChStopChgrManual_SY "" VALUE 0x700222a0 Scalar_UBYTE 0 VBU0428Test_CM_uint8_cnt 0.0 255.0 /end CHARACTERISTIC
/begin CHARACTERISTIC DCH_stChStopIso_SY "" VALUE 0x700222a1 Scalar_UBYTE 0 VBU0428Test_CM_uint8_cnt 0.0 255.0 /end CHARACTERISTIC
/begin CHARACTERISTIC DCH_stChStopVehCmpt_SY "" VALUE 0x700222a2 Scalar_UBYTE 0 VBU0428Test_CM_uint8_cnt 0.0 255.0 /end CHARACTERISTIC
/begin CHARACTERISTIC DCH_stChStopVehErr_SY "" VALUE 0x700222a3 Scalar_UBYTE 0 VBU0428Test_CM_uint8_cnt 0.0 255.0 /end CHARACTERISTIC
/begin CHARACTERISTIC DCH_stChargeFinishMode_SY "" VALUE 0x700222a4 Scalar_UBYTE 0 VBU0428Test_CM_uint8_cnt 0.0 255.0 /end CHARACTERISTIC
/begin CHARACTERISTIC DCH_stCharging_SY "" VALUE 0x700222a5 Scalar_UBYTE 0 VBU0428Test_CM_uint8_cnt 0.0 255.0 /end CHARACTERISTIC
/begin CHARACTERISTIC DCH_stClDCChRlyMode_SY "" VALUE 0x700222a8 Scalar_UBYTE 0 VBU0428Test_CM_uint8_cnt 0.0 255.0 /end CHARACTERISTIC
/begin CHARACTERISTIC DCH_stComTOut_SY "" VALUE 0x700222a9 Scalar_UBYTE 0 VBU0428Test_CM_uint8_cnt 0.0 255.0 /end CHARACTERISTIC
/begin CHARACTERISTIC DCH_stHandshake_SY "" VALUE 0x700222af Scalar_UBYTE 0 VBU0428Test_CM_uint8_cnt 0.0 255.0 /end CHARACTERISTIC
/begin CHARACTERISTIC DCH_stHvRlyMode_SY "" VALUE 0x700222b0 Scalar_UBYTE 0 VBU0428Test_CM_uint8_cnt 0.0 255.0 /end CHARACTERISTIC
/begin CHARACTERISTIC DCH_stInitMode_SY "" VALUE 0x700222b1 Scalar_UBYTE 0 VBU0428Test_CM_uint8_cnt 0.0 255.0 /end CHARACTERISTIC
/begin CHARACTERISTIC DCH_stInit_SY "" VALUE 0x700222b2 Scalar_UBYTE 0 VBU0428Test_CM_uint8_cnt 0.0 255.0 /end CHARACTERISTIC
/begin CHARACTERISTIC DCH_stLvShutDownForNrmMode_SY "" VALUE 0x700222b4 Scalar_UBYTE 0 VBU0428Test_CM_uint8_cnt 0.0 255.0 /end CHARACTERISTIC
/begin CHARACTERISTIC DCH_stOpenDCRlyForBMSTOutMode_SY "" VALUE 0x700222b6 Scalar_UBYTE 0 VBU0428Test_CM_uint8_cnt 0.0 255.0 /end CHARACTERISTIC
/begin CHARACTERISTIC DCH_stOpenDCRlyForNrmMode_SY "" VALUE 0x700222b7 Scalar_UBYTE 0 VBU0428Test_CM_uint8_cnt 0.0 255.0 /end CHARACTERISTIC
/begin CHARACTERISTIC DCH_stOpenHvForBMSTOutMode_SY "" VALUE 0x700222b8 Scalar_UBYTE 0 VBU0428Test_CM_uint8_cnt 0.0 255.0 /end CHARACTERISTIC
/begin CHARACTERISTIC DCH_stParConfig_SY "" VALUE 0x700222bb Scalar_UBYTE 0 VBU0428Test_CM_uint8_cnt 0.0 255.0 /end CHARACTERISTIC
/begin CHARACTERISTIC DCH_stPreOpenDCRly_SY "" VALUE 0x700222bc Scalar_UBYTE 0 VBU0428Test_CM_uint8_cnt 0.0 255.0 /end CHARACTERISTIC
/begin CHARACTERISTIC DCH_stReConnectChProcessMode_SY "" VALUE 0x700222bd Scalar_UBYTE 0 VBU0428Test_CM_uint8_cnt 0.0 255.0 /end CHARACTERISTIC
/begin CHARACTERISTIC DCH_stStopBMS_SY "" VALUE 0x700222c3 Scalar_UBYTE 0 VBU0428Test_CM_uint8_cnt 0.0 255.0 /end CHARACTERISTIC
/begin CHARACTERISTIC DCH_stStopCC2ConnErr_SY "" VALUE 0x700222c4 Scalar_UBYTE 0 VBU0428Test_CM_uint8_cnt 0.0 255.0 /end CHARACTERISTIC
/begin CHARACTERISTIC DCH_stStopChAvlErr_SY "" VALUE 0x700222c5 Scalar_UBYTE 0 VBU0428Test_CM_uint8_cnt 0.0 255.0 /end CHARACTERISTIC
/begin CHARACTERISTIC DCH_stStopChRdyTout_SY "" VALUE 0x700222c6 Scalar_UBYTE 0 VBU0428Test_CM_uint8_cnt 0.0 255.0 /end CHARACTERISTIC
/begin CHARACTERISTIC DCH_stStopChgrAvl_SY "" VALUE 0x700222c7 Scalar_UBYTE 0 VBU0428Test_CM_uint8_cnt 0.0 255.0 /end CHARACTERISTIC
/begin CHARACTERISTIC DCH_stStopChgrErr_SY "" VALUE 0x700222c8 Scalar_UBYTE 0 VBU0428Test_CM_uint8_cnt 0.0 255.0 /end CHARACTERISTIC
/begin CHARACTERISTIC DCH_stStopCrntLrgErr_SY "" VALUE 0x700222c9 Scalar_UBYTE 0 VBU0428Test_CM_uint8_cnt 0.0 255.0 /end CHARACTERISTIC
/begin CHARACTERISTIC DCH_stStopCrntOvr_SY "" VALUE 0x700222ca Scalar_UBYTE 0 VBU0428Test_CM_uint8_cnt 0.0 255.0 /end CHARACTERISTIC
/begin CHARACTERISTIC DCH_stStopDCRlyClTout_SY "" VALUE 0x700222cb Scalar_UBYTE 0 VBU0428Test_CM_uint8_cnt 0.0 255.0 /end CHARACTERISTIC
/begin CHARACTERISTIC DCH_stStopDCRlyOpErr_SY "" VALUE 0x700222cc Scalar_UBYTE 0 VBU0428Test_CM_uint8_cnt 0.0 255.0 /end CHARACTERISTIC
/begin CHARACTERISTIC DCH_stStopFidErr_SY "" VALUE 0x700222cd Scalar_UBYTE 0 VBU0428Test_CM_uint8_cnt 0.0 255.0 /end CHARACTERISTIC
/begin CHARACTERISTIC DCH_stStopHVRlyOpErr_SY "" VALUE 0x700222ce Scalar_UBYTE 0 VBU0428Test_CM_uint8_cnt 0.0 255.0 /end CHARACTERISTIC
/begin CHARACTERISTIC DCH_stStopHlfConnErr_SY "" VALUE 0x700222cf Scalar_UBYTE 0 VBU0428Test_CM_uint8_cnt 0.0 255.0 /end CHARACTERISTIC
/begin CHARACTERISTIC DCH_stStopIso_SY "" VALUE 0x700222d0 Scalar_UBYTE 0 VBU0428Test_CM_uint8_cnt 0.0 255.0 /end CHARACTERISTIC
/begin CHARACTERISTIC DCH_stStopManual_SY "" VALUE 0x700222d1 Scalar_UBYTE 0 VBU0428Test_CM_uint8_cnt 0.0 255.0 /end CHARACTERISTIC
/begin CHARACTERISTIC DCH_stStopToutOvr3_SY "" VALUE 0x700222d2 Scalar_UBYTE 0 VBU0428Test_CM_uint8_cnt 0.0 255.0 /end CHARACTERISTIC
/begin CHARACTERISTIC DCH_stStopZeroCrnt_SY "" VALUE 0x700222d3 Scalar_UBYTE 0 VBU0428Test_CM_uint8_cnt 0.0 255.0 /end CHARACTERISTIC
/begin CHARACTERISTIC DCH_stTimeOutInTimeOut_SY "" VALUE 0x700222d5 Scalar_UBYTE 0 VBU0428Test_CM_uint8_cnt 0.0 255.0 /end CHARACTERISTIC
/begin CHARACTERISTIC DCH_stWaitCRMMode_SY "" VALUE 0x700222da Scalar_UBYTE 0 VBU0428Test_CM_uint8_cnt 0.0 255.0 /end CHARACTERISTIC
/begin CHARACTERISTIC DCH_stWaitCSDForNrmMode_SY "" VALUE 0x700222db Scalar_UBYTE 0 VBU0428Test_CM_uint8_cnt 0.0 255.0 /end CHARACTERISTIC
/begin CHARACTERISTIC DIAGS_stNRCFail_SY "" VALUE 0x700222e7 Scalar_UBYTE 0 VBU0428Test_CM_uint8_cnt 0.0 255.0 /end CHARACTERISTIC
/begin CHARACTERISTIC DIAGS_stPsvRespIn_SY "" VALUE 0x700222e9 Scalar_UBYTE 0 VBU0428Test_CM_uint8_cnt 0.0 255.0 /end CHARACTERISTIC
/begin CHARACTERISTIC DIAGS_stPsvRespNok_SY "" VALUE 0x700222ea Scalar_UBYTE 0 VBU0428Test_CM_uint8_cnt 0.0 255.0 /end CHARACTERISTIC
/begin CHARACTERISTIC DIAGS_stPsvRespOk_SY "" VALUE 0x700222eb Scalar_UBYTE 0 VBU0428Test_CM_uint8_cnt 0.0 255.0 /end CHARACTERISTIC
/begin CHARACTERISTIC PMM_stDiaPEUActvDisCh_SY "" VALUE 0x700223ee Scalar_UBYTE 0 VBU0428Test_CM_uint8_cnt 0.0 255.0 /end CHARACTERISTIC
/begin CHARACTERISTIC PMM_stDiaPreChRlyClsd_SY "" VALUE 0x700223ef Scalar_UBYTE 0 VBU0428Test_CM_uint8_cnt 0.0 255.0 /end CHARACTERISTIC
/begin CHARACTERISTIC PMM_stDiaRlyOpn_SY "" VALUE 0x700223f0 Scalar_UBYTE 0 VBU0428Test_CM_uint8_cnt 0.0 255.0 /end CHARACTERISTIC
/begin CHARACTERISTIC PMM_stDrvMode_SY "" VALUE 0x700223f1 Scalar_UBYTE 0 VBU0428Test_CM_uint8_cnt 0.0 255.0 /end CHARACTERISTIC
/begin CHARACTERISTIC PMM_stHVRlyReqOvrdVal_C "" VALUE 0x700223fb Scalar_UBYTE 0 VBU0428Test_CM_uint8_cnt 0.0 15.0 /end CHARACTERISTIC
/begin CHARACTERISTIC PMM_stImmoPass_SY "" VALUE 0x700223fc Scalar_UBYTE 0 VBU0428Test_CM_uint8_cnt 0.0 255.0 /end CHARACTERISTIC
/begin CHARACTERISTIC PMM_stNoReqMode_SY "" VALUE 0x70022400 Scalar_UBYTE 0 VBU0428Test_CM_uint8_cnt 0.0 255.0 /end CHARACTERISTIC
/begin CHARACTERISTIC PMM_stPEUInvrOff_SY "" VALUE 0x70022401 Scalar_UBYTE 0 VBU0428Test_CM_uint8_cnt 0.0 255.0 /end CHARACTERISTIC
/begin CHARACTERISTIC PMM_stPEUOpStandbyMod_SY "" VALUE 0x70022402 Scalar_UBYTE 0 VBU0428Test_CM_uint8_cnt 0.0 255.0 /end CHARACTERISTIC
/begin CHARACTERISTIC PMM_stPEUOpTorMod_SY "" VALUE 0x70022403 Scalar_UBYTE 0 VBU0428Test_CM_uint8_cnt 0.0 255.0 /end CHARACTERISTIC
/begin CHARACTERISTIC PMM_stPEUROpModOvrdSwt_C "" VALUE 0x70022404 Scalar_UBYTE 0 VBU0428Test_CM_uint8_cnt 0.0 15.0 /end CHARACTERISTIC
/begin CHARACTERISTIC PMM_stPEUROpModOvrdVal_C "" VALUE 0x70022405 Scalar_UBYTE 0 VBU0428Test_CM_uint8_cnt 0.0 15.0 /end CHARACTERISTIC
/begin CHARACTERISTIC PMM_stWkupModOvrdVal_C "" VALUE 0x70022408 Scalar_UBYTE 0 VBU0428Test_CM_uint8_cnt 0.0 15.0 /end CHARACTERISTIC
/begin CHARACTERISTIC PMM_trqMaxPEUStandBy_C "" VALUE 0x70022409 Scalar_UBYTE 0 VBU0428Test_CM_uint8_cnt 0.0 255.0 /end CHARACTERISTIC
/begin CHARACTERISTIC SYS_stMCUDisChMalFunc_SY "" VALUE 0x7002242a Scalar_UBYTE 0 VBU0428Test_CM_uint8_cnt 0.0 255.0 /end CHARACTERISTIC
/begin CHARACTERISTIC TQC_stCurrentGearD_C "" VALUE 0x70022448 Scalar_UBYTE 0 VBU0428Test_CM_uint8_cnt 0.0 15.0 /end CHARACTERISTIC
/begin CHARACTERISTIC TQC_stDGear_C "" VALUE 0x70022449 Scalar_UBYTE 0 VBU0428Test_CM_uint8_cnt 0.0 15.0 /end CHARACTERISTIC
/begin CHARACTERISTIC VM_stVehLimExtSpd_C "" VALUE 0x7002246c Scalar_UBYTE 0 VBU0428Test_CM_uint8_cnt 0.0 15.0 /end CHARACTERISTIC
/begin CHARACTERISTIC VM_stVehLimMaxSpdD_C "" VALUE 0x7002246d Scalar_UBYTE 0 VBU0428Test_CM_uint8_cnt 0.0 15.0 /end CHARACTERISTIC
/begin CHARACTERISTIC VM_stVehLimMaxSpdR_C "" VALUE 0x7002246e Scalar_UBYTE 0 VBU0428Test_CM_uint8_cnt 0.0 15.0 /end CHARACTERISTIC
/begin CHARACTERISTIC VM_stVehLimServerGearD_C "" VALUE 0x7002246f Scalar_UBYTE 0 VBU0428Test_CM_uint8_cnt 0.0 15.0 /end CHARACTERISTIC
/begin CHARACTERISTIC VM_stVehLimServerGearR_C "" VALUE 0x70022470 Scalar_UBYTE 0 VBU0428Test_CM_uint8_cnt 0.0 15.0 /end CHARACTERISTIC
/begin MEASUREMENT EcBCV_nbrFuseProtectCounter3r "" ULONG VBU0428Test_CM_uint32 0 0 0 4294967295 ECU_ADDRESS 0x90000110 /end MEASUREMENT
/begin MEASUREMENT SPD_vVehSpdSlp "" FLOAT32_IEEE VBU0428Test_CM_single 0 0 -3.4E+38 3.4E+38 ECU_ADDRESS 0x6003bc92 /end MEASUREMENT
/begin MEASUREMENT TQC_trqLIM "" FLOAT32_IEEE VBU0428Test_CM_single 0 0 -10000.0 10000.0 ECU_ADDRESS 0x6003be72 /end MEASUREMENT
/begin MEASUREMENT SPD_nDeltaRALR "" FLOAT32_IEEE VBU0428Test_CM_single 0 0 -3.4E+38 3.4E+38 ECU_ADDRESS 0x6003bc6a /end MEASUREMENT
/begin MEASUREMENT SPD_nFA "" FLOAT32_IEEE VBU0428Test_CM_single 0 0 -3.4E+38 3.4E+38 ECU_ADDRESS 0x6003bc6e /end MEASUREMENT
/begin MEASUREMENT SPD_nRA "" FLOAT32_IEEE VBU0428Test_CM_single 0 0 -3.4E+38 3.4E+38 ECU_ADDRESS 0x6003bc76 /end MEASUREMENT
/begin MEASUREMENT SPD_nFARADelta "" FLOAT32_IEEE VBU0428Test_CM_single 0 0 -3.4E+38 3.4E+38 ECU_ADDRESS 0x6003bc72 /end MEASUREMENT
/begin MEASUREMENT SPD_nDSpdTarFR "" FLOAT32_IEEE VBU0428Test_CM_single 0 0 -3.4E+38 3.4E+38 ECU_ADDRESS 0x6003bc66 /end MEASUREMENT
/begin MEASUREMENT MTQL_trqRMotrMaxLim "" FLOAT32_IEEE VBU0428Test_CM_single 0 0 -10000.0 10000.0 ECU_ADDRESS 0x6003be56 /end MEASUREMENT
/begin MEASUREMENT MTQL_trqRMotrMinLim "" FLOAT32_IEEE VBU0428Test_CM_single 0 0 -10000.0 10000.0 ECU_ADDRESS 0x6003be5a /end MEASUREMENT
/begin MEASUREMENT MTQL_trqMtrDrvLimRaw "" FLOAT32_IEEE VBU0428Test_CM_single 0 0 -3.4E+38 3.4E+38 ECU_ADDRESS 0x9000015c /end MEASUREMENT
/begin MEASUREMENT MTQL_trqMtrRgnLimRaw "" FLOAT32_IEEE VBU0428Test_CM_single 0 0 -3.4E+38 3.4E+38 ECU_ADDRESS 0x90000160 /end MEASUREMENT
/begin MEASUREMENT MTQL_trqMtrDrvLim "" FLOAT32_IEEE VBU0428Test_CM_single 0 0 -3.4E+38 3.4E+38 ECU_ADDRESS 0x6003bb9a /end MEASUREMENT
/begin MEASUREMENT MTQL_trqMtrRgnLim "" FLOAT32_IEEE VBU0428Test_CM_single 0 0 -3.4E+38 3.4E+38 ECU_ADDRESS 0x6003bb9e /end MEASUREMENT
/begin MEASUREMENT MTQL_trqMtrTrqDrvLT "" FLOAT32_IEEE VBU0428Test_CM_single 0 0 -3.4E+38 3.4E+38 ECU_ADDRESS 0x6003bba2 /end MEASUREMENT
/begin MEASUREMENT TQD_pctAccPedPosFlt "" FLOAT32_IEEE VBU0428Test_CM_single 0 0 0.0 100.0 ECU_ADDRESS 0x6003be86 /end MEASUREMENT
/begin MEASUREMENT TQD_pBrkPressFlt "" FLOAT32_IEEE VBU0428Test_CM_single 0 0 -3.4E+38 3.4E+38 ECU_ADDRESS 0x6003be82 /end MEASUREMENT
/begin MEASUREMENT TQD_trqRoad "" FLOAT32_IEEE VBU0428Test_CM_single 0 0 -10000.0 10000.0 ECU_ADDRESS 0x6003beae /end MEASUREMENT
/begin MEASUREMENT TQD_trqDesWeighted "" FLOAT32_IEEE VBU0428Test_CM_single 0 0 -10000.0 10000.0 ECU_ADDRESS 0x6003bea2 /end MEASUREMENT
/begin MEASUREMENT TQD_trqDesDecel "" FLOAT32_IEEE VBU0428Test_CM_single 0 0 -10000.0 10000.0 ECU_ADDRESS 0x6003be9a /end MEASUREMENT
/begin MEASUREMENT TQD_trqDemRegen "" FLOAT32_IEEE VBU0428Test_CM_single 0 0 -10000.0 10000.0 ECU_ADDRESS 0x6003be96 /end MEASUREMENT
/begin MEASUREMENT TQD_trqNrmDes "" FLOAT32_IEEE VBU0428Test_CM_single 0 0 -10000.0 10000.0 ECU_ADDRESS 0x6003beaa /end MEASUREMENT
/begin MEASUREMENT TQD_facDesTrqGr "" FLOAT32_IEEE VBU0428Test_CM_single 0 0 0.0 1.0 ECU_ADDRESS 0x6003be7e /end MEASUREMENT
/begin MEASUREMENT TQD_trqDesRaw "" FLOAT32_IEEE VBU0428Test_CM_single 0 0 -10000.0 10000.0 ECU_ADDRESS 0x6003be9e /end MEASUREMENT
/begin MEASUREMENT TQD_trqZrPed "" FLOAT32_IEEE VBU0428Test_CM_single 0 0 -3.4E+38 3.4E+38 ECU_ADDRESS 0x6003bd82 /end MEASUREMENT
/begin MEASUREMENT TQD_trqNrmLead "" FLOAT32_IEEE VBU0428Test_CM_single 0 0 -3.4E+38 3.4E+38 ECU_ADDRESS 0x6003bd7e /end MEASUREMENT
/begin MEASUREMENT SPD_aXSlope "" FLOAT32_IEEE VBU0428Test_CM_single 0 0 -3.4E+38 3.4E+38 ECU_ADDRESS 0x6003bc62 /end MEASUREMENT
/begin MEASUREMENT EDIS_pwrAcsyAct "" FLOAT32_IEEE VBU0428Test_CM_single 0 0 0.0 1000.0 ECU_ADDRESS 0x6003bdd2 /end MEASUREMENT
/begin MEASUREMENT EDIS_pwrDrvPwrLimDrvMode "" FLOAT32_IEEE VBU0428Test_CM_single 0 0 -3.4E+38 3.4E+38 ECU_ADDRESS 0x6003be0a /end MEASUREMENT
/begin MEASUREMENT CBL_tCTMBoardTempMaxORV "" FLOAT32_IEEE VBU0428Test_CM_single 0 0 -3.4E+38 3.4E+38 ECU_ADDRESS 0x900000f4 /end MEASUREMENT
/begin MEASUREMENT LcSOH_AhMinSocCellCapacity "" FLOAT32_IEEE VBU0428Test_CM_single 0 0 -3.4E+38 3.4E+38 ECU_ADDRESS 0x6003bfb2 /end MEASUREMENT
/begin MEASUREMENT CBL_pctBalanceTargeSoc "" FLOAT32_IEEE VBU0428Test_CM_single 0 0 -3.4E+38 3.4E+38 ECU_ADDRESS 0x6003befe /end MEASUREMENT
/begin MEASUREMENT LcSOC_AhLifeTimeCoulomb "" FLOAT32_IEEE VBU0428Test_CM_single 0 0 -3.4E+38 3.4E+38 ECU_ADDRESS 0x6003bfae /end MEASUREMENT
/begin MEASUREMENT BCV_AhLifeTimeCharge "" FLOAT32_IEEE VBU0428Test_CM_single 0 0 -3.4E+38 3.4E+38 ECU_ADDRESS 0x6003bdb6 /end MEASUREMENT
/begin MEASUREMENT BCV_AhLifeTimeDischarge "" FLOAT32_IEEE VBU0428Test_CM_single 0 0 -3.4E+38 3.4E+38 ECU_ADDRESS 0x6003bdba /end MEASUREMENT
/begin MEASUREMENT BCV_AhLifeTimeFastcharge "" FLOAT32_IEEE VBU0428Test_CM_single 0 0 -3.4E+38 3.4E+38 ECU_ADDRESS 0x6003bdbe /end MEASUREMENT
/begin MEASUREMENT BCV_uVx2Voltage "" FLOAT32_IEEE VBU0428Test_CM_single 0 0 -3.4E+38 3.4E+38 ECU_ADDRESS 0x6003bf26 /end MEASUREMENT
/begin MEASUREMENT BCV_uPrechargeVoltage "" FLOAT32_IEEE VBU0428Test_CM_single 0 0 -3.4E+38 3.4E+38 ECU_ADDRESS 0x6003bf22 /end MEASUREMENT
/begin MEASUREMENT BCV_uFuseVoltage "" FLOAT32_IEEE VBU0428Test_CM_single 0 0 -3.4E+38 3.4E+38 ECU_ADDRESS 0x6003bf1e /end MEASUREMENT
/begin MEASUREMENT BCV_uBusVoltage "" FLOAT32_IEEE VBU0428Test_CM_single 0 0 -3.4E+38 3.4E+38 ECU_ADDRESS 0x6003bf1a /end MEASUREMENT
/begin MEASUREMENT BCV_uBusNegativeVoltage "" FLOAT32_IEEE VBU0428Test_CM_single 0 0 -3.4E+38 3.4E+38 ECU_ADDRESS 0x6003bf16 /end MEASUREMENT
/begin MEASUREMENT BCV_uBatteryVoltage "" FLOAT32_IEEE VBU0428Test_CM_single 0 0 -3.4E+38 3.4E+38 ECU_ADDRESS 0x6003bad2 /end MEASUREMENT
/begin MEASUREMENT BCV_iAUpdateBatteryCurrent "" FLOAT32_IEEE VBU0428Test_CM_single 0 0 -3.4E+38 3.4E+38 ECU_ADDRESS 0x900000e0 /end MEASUREMENT
/begin MEASUREMENT BCV_iABatteryCurrent "" FLOAT32_IEEE VBU0428Test_CM_single 0 0 -3.4E+38 3.4E+38 ECU_ADDRESS 0x6003bf12 /end MEASUREMENT
/begin MEASUREMENT DCH_stChStopReason "" UWORD VBU0428Test_CM_uint16 0 0 0 65535 ECU_ADDRESS 0x90000c9a /end MEASUREMENT
/begin MEASUREMENT CBL_mvBalanceTargetVoltage "" UWORD VBU0428Test_CM_uint16 0 0 0 65535 ECU_ADDRESS 0x90001478 /end MEASUREMENT
/begin MEASUREMENT BCV_stBatteryOverVoltageFault "" UWORD VBU0428Test_CM_uint16 0 0 0 65535 ECU_ADDRESS 0x900016cc /end MEASUREMENT
/begin MEASUREMENT BCV_stBatteryUnderVoltageFault "" UWORD VBU0428Test_CM_uint16 0 0 0 65535 ECU_ADDRESS 0x900016d2 /end MEASUREMENT
/begin MEASUREMENT BCV_stBatteryOverCurrentFault "" UWORD VBU0428Test_CM_uint16 0 0 0 65535 ECU_ADDRESS 0x900016c6 /end MEASUREMENT
/begin MEASUREMENT BCV_stBatteryOverVoltageEVMFault "" UWORD VBU0428Test_CM_uint16 0 0 0 65535 ECU_ADDRESS 0x900016ca /end MEASUREMENT
/begin MEASUREMENT BCV_stBatteryUnderVoltageEVMFault "" UWORD VBU0428Test_CM_uint16 0 0 0 65535 ECU_ADDRESS 0x900016d0 /end MEASUREMENT
/begin MEASUREMENT BCV_stBatteryOverVoltageWarningFault "" UWORD VBU0428Test_CM_uint16 0 0 0 65535 ECU_ADDRESS 0x900016ce /end MEASUREMENT
/begin MEASUREMENT BCV_stBatteryOverCurrentWarningFault "" UWORD VBU0428Test_CM_uint16 0 0 0 65535 ECU_ADDRESS 0x900016c8 /end MEASUREMENT
/begin MEASUREMENT BCV_stBatteryBusVoltageMismatchFault "" UWORD VBU0428Test_CM_uint16 0 0 0 65535 ECU_ADDRESS 0x900016c4 /end MEASUREMENT
/begin MEASUREMENT BCV_stBatteryCurrentOoRFault "" UWORD VBU0428Test_CM_uint16 0 0 0 65535 ECU_ADDRESS 0x900016b2 /end MEASUREMENT
/begin MEASUREMENT BCV_stBatteryVoltageOoRFault "" UWORD VBU0428Test_CM_uint16 0 0 0 65535 ECU_ADDRESS 0x900016d4 /end MEASUREMENT
/begin MEASUREMENT FPV_st4WayVlvPosFdbk "" UBYTE VBU0428Test_CM_uint8 0 0 0 255 ECU_ADDRESS 0x90001f75 /end MEASUREMENT
/begin MEASUREMENT TQD_stVehCreepMode "" UBYTE VBU0428Test_CM_uint8 0 0 0.0 15.0 ECU_ADDRESS 0x90001d87 /end MEASUREMENT
/begin MEASUREMENT SPD_stAX "" UBYTE VBU0428Test_CM_uint8 0 0 0.0 15.0 ECU_ADDRESS 0x90001d51 /end MEASUREMENT
/begin MEASUREMENT PMM_stHVRlyReq "" UBYTE VBU0428Test_CM_uint8 0 0 0 255 ECU_ADDRESS 0x90001f55 /end MEASUREMENT
/begin MEASUREMENT PMM_stSelfDiagResp "" UBYTE VBU0428Test_CM_uint8 0 0 0 255 ECU_ADDRESS 0x90001f59 /end MEASUREMENT
/begin MEASUREMENT PMM_stWkupMod "" UBYTE VBU0428Test_CM_uint8 0 0 0.0 255.0 ECU_ADDRESS 0x90001f5a /end MEASUREMENT
/begin MEASUREMENT PMM_stPEUROpMod "" UBYTE VBU0428Test_CM_uint8 0 0 0 255 ECU_ADDRESS 0x90001f57 /end MEASUREMENT
/begin MEASUREMENT DCH_stBEMChCapTOut "" UBYTE VBU0428Test_CM_uint8 0 0 0 255 ECU_ADDRESS 0x90001cf1 /end MEASUREMENT
/begin MEASUREMENT DCH_stBEMChRdyTOut "" UBYTE VBU0428Test_CM_uint8 0 0 0 255 ECU_ADDRESS 0x90001cf2 /end MEASUREMENT
/begin MEASUREMENT DCH_stBEMChStTOut "" UBYTE VBU0428Test_CM_uint8 0 0 0 255 ECU_ADDRESS 0x90001cf3 /end MEASUREMENT
/begin MEASUREMENT DCH_stBEMChgrStopTOut "" UBYTE VBU0428Test_CM_uint8 0 0 0 255 ECU_ADDRESS 0x90001cf4 /end MEASUREMENT
/begin MEASUREMENT DCH_stBEMId00TOut "" UBYTE VBU0428Test_CM_uint8 0 0 0 255 ECU_ADDRESS 0x90001cf5 /end MEASUREMENT
/begin MEASUREMENT DCH_stBEMIdAATOut "" UBYTE VBU0428Test_CM_uint8 0 0 0 255 ECU_ADDRESS 0x90001cf6 /end MEASUREMENT
/begin MEASUREMENT DCH_stBEMStatsDataTOut "" UBYTE VBU0428Test_CM_uint8 0 0 0 255 ECU_ADDRESS 0x90001cf7 /end MEASUREMENT
/begin MEASUREMENT DCH_stBROBattChRdy "" UBYTE VBU0428Test_CM_uint8 0 0 0 255 ECU_ADDRESS 0x90001cf8 /end MEASUREMENT
/begin MEASUREMENT DCH_stSup "" UBYTE VBU0428Test_CM_uint8 0 0 0 255 ECU_ADDRESS 0x90001cfa /end MEASUREMENT
/begin MEASUREMENT DCH_stChStateGen "" UBYTE VBU0428Test_CM_uint8 0 0 0 255 ECU_ADDRESS 0x90001cf9 /end MEASUREMENT
/begin MEASUREMENT CBL_numCellBalanceNumber "" UBYTE VBU0428Test_CM_uint8 0 0 0 255 ECU_ADDRESS 0x90001f2d /end MEASUREMENT
/begin MEASUREMENT DCH_flgReceiveCEM "" UBYTE VBU0428Test_CM_boolean 0 0 0.0 1.0 ECU_ADDRESS 0x90001ce5 /end MEASUREMENT
/begin MEASUREMENT DCH_flgReceiveCHM "" UBYTE VBU0428Test_CM_boolean 0 0 0.0 1.0 ECU_ADDRESS 0x90001ce6 /end MEASUREMENT
/begin MEASUREMENT DCH_flgReceiveCML "" UBYTE VBU0428Test_CM_boolean 0 0 0.0 1.0 ECU_ADDRESS 0x90001ce7 /end MEASUREMENT
/begin MEASUREMENT DCH_flgReceiveCRM "" UBYTE VBU0428Test_CM_boolean 0 0 0.0 1.0 ECU_ADDRESS 0x90001ce8 /end MEASUREMENT
/begin MEASUREMENT DCH_flgReceiveCRO "" UBYTE VBU0428Test_CM_boolean 0 0 0.0 1.0 ECU_ADDRESS 0x90001ce9 /end MEASUREMENT
/begin MEASUREMENT DCH_flgReceiveCSD "" UBYTE VBU0428Test_CM_boolean 0 0 0.0 1.0 ECU_ADDRESS 0x90001cea /end MEASUREMENT
/begin MEASUREMENT DCH_flgReceiveCCS "" UBYTE VBU0428Test_CM_boolean 0 0 0.0 1.0 ECU_ADDRESS 0x90001ce4 /end MEASUREMENT
/begin MEASUREMENT DCH_flgReceiveCST "" UBYTE VBU0428Test_CM_boolean 0 0 0.0 1.0 ECU_ADDRESS 0x90001ceb /end MEASUREMENT
/begin MEASUREMENT Veh_flgVacPumpReq "" UBYTE VBU0428Test_CM_boolean 0 0 0 1 ECU_ADDRESS 0x90001f91 /end MEASUREMENT
/begin MEASUREMENT BPD_flgBrkSwt "" UBYTE VBU0428Test_CM_boolean 0 0 0.0 1.0 ECU_ADDRESS 0x90001d61 /end MEASUREMENT
/begin MEASUREMENT DCH_flgReceiveCTS "" UBYTE VBU0428Test_CM_boolean 0 0 0.0 1.0 ECU_ADDRESS 0x90001cec /end MEASUREMENT
/begin MEASUREMENT TQD_flgSlideRst "" UBYTE VBU0428Test_CM_boolean 0 0 0.0 1.0 ECU_ADDRESS 0x90001d5b /end MEASUREMENT
/begin MEASUREMENT TQD_flgVirtualNeutral "" UBYTE VBU0428Test_CM_boolean 0 0 0.0 1.0 ECU_ADDRESS 0x90001d86 /end MEASUREMENT
/begin MEASUREMENT PMM_flgPEURActvDisChEnaOvrd "" UBYTE VBU0428Test_CM_boolean 0 0 0 1 ECU_ADDRESS 0x90001f4c /end MEASUREMENT
/begin MEASUREMENT PMM_flgSelfDiagEnaOvrd "" UBYTE VBU0428Test_CM_boolean 0 0 0 1 ECU_ADDRESS 0x90001f4f /end MEASUREMENT
/begin MEASUREMENT PMM_flgHVPwrUpEnaOvrd "" UBYTE VBU0428Test_CM_boolean 0 0 0 1 ECU_ADDRESS 0x90001f46 /end MEASUREMENT
/begin MEASUREMENT PMM_flgHVPwrUpEna "" UBYTE VBU0428Test_CM_boolean 0 0 0 1 ECU_ADDRESS 0x90001f45 /end MEASUREMENT
/begin MEASUREMENT PMM_flgHVPwrDwnEnaOvrd "" UBYTE VBU0428Test_CM_boolean 0 0 0 1 ECU_ADDRESS 0x90001f44 /end MEASUREMENT
/begin MEASUREMENT PMM_flgHVPwrDwnEna "" UBYTE VBU0428Test_CM_boolean 0 0 0 1 ECU_ADDRESS 0x90001f43 /end MEASUREMENT
/begin MEASUREMENT PMM_flgRMCUActvDisChReq "" UBYTE VBU0428Test_CM_boolean 0 0 0 1 ECU_ADDRESS 0x90001f4e /end MEASUREMENT
/begin MEASUREMENT PMM_flgAccDisbl "" UBYTE VBU0428Test_CM_boolean 0 0 0.0 1.0 ECU_ADDRESS 0x90001d3a /end MEASUREMENT
/begin MEASUREMENT PMM_flgSetPEURRdy "" UBYTE VBU0428Test_CM_boolean 0 0 0 1 ECU_ADDRESS 0x90001f50 /end MEASUREMENT
/begin MEASUREMENT PMM_flgPEURShtDwn "" UBYTE VBU0428Test_CM_boolean 0 0 0 1 ECU_ADDRESS 0x90001f4d /end MEASUREMENT
/begin MEASUREMENT PMM_flgVehRdy "" UBYTE VBU0428Test_CM_boolean 0 0 0 1 ECU_ADDRESS 0x90001f53 /end MEASUREMENT
/begin MEASUREMENT PMM_flgHVRdy "" UBYTE VBU0428Test_CM_boolean 0 0 0.0 1.0 ECU_ADDRESS 0x90001d3b /end MEASUREMENT
/begin MEASUREMENT DCH_flgBEMTxEna "" UBYTE VBU0428Test_CM_boolean 0 0 0.0 1.0 ECU_ADDRESS 0x90001cc6 /end MEASUREMENT
/begin MEASUREMENT DCH_flgBSTTxEna "" UBYTE VBU0428Test_CM_boolean 0 0 0.0 1.0 ECU_ADDRESS 0x90001ccd /end MEASUREMENT
/begin MEASUREMENT DCH_flgBHMTxEna "" UBYTE VBU0428Test_CM_boolean 0 0 0.0 1.0 ECU_ADDRESS 0x90001cc7 /end MEASUREMENT
/begin MEASUREMENT DCH_flgBRMTxEna "" UBYTE VBU0428Test_CM_boolean 0 0 0.0 1.0 ECU_ADDRESS 0x90001cc9 /end MEASUREMENT
/begin MEASUREMENT DCH_flgBCPTxEna "" UBYTE VBU0428Test_CM_boolean 0 0 0.0 1.0 ECU_ADDRESS 0x90001cc4 /end MEASUREMENT
/begin MEASUREMENT DCH_flgBROTxEna "" UBYTE VBU0428Test_CM_boolean 0 0 0.0 1.0 ECU_ADDRESS 0x90001cca /end MEASUREMENT
/begin MEASUREMENT DCH_flgBCLTxEna "" UBYTE VBU0428Test_CM_boolean 0 0 0.0 1.0 ECU_ADDRESS 0x90001cc3 /end MEASUREMENT
/begin MEASUREMENT DCH_flgBCSTxEna "" UBYTE VBU0428Test_CM_boolean 0 0 0.0 1.0 ECU_ADDRESS 0x90001cc5 /end MEASUREMENT
/begin MEASUREMENT DCH_flgBSMTxEna "" UBYTE VBU0428Test_CM_boolean 0 0 0.0 1.0 ECU_ADDRESS 0x90001ccc /end MEASUREMENT
/begin MEASUREMENT DCH_flgBSDTxEna "" UBYTE VBU0428Test_CM_boolean 0 0 0.0 1.0 ECU_ADDRESS 0x90001ccb /end MEASUREMENT
/begin MEASUREMENT DCH_flgHvRlyReq "" UBYTE VBU0428Test_CM_boolean 0 0 0.0 1.0 ECU_ADDRESS 0x90001cdf /end MEASUREMENT
/begin MEASUREMENT DCH_flgDCChWakeUp "" UBYTE VBU0428Test_CM_boolean 0 0 0.0 1.0 ECU_ADDRESS 0x90001cd9 /end MEASUREMENT
/begin MEASUREMENT DCH_flgNwOldCNReg "" UBYTE VBU0428Test_CM_boolean 0 0 0.0 1.0 ECU_ADDRESS 0x90001ce2 /end MEASUREMENT
/begin MEASUREMENT DCH_flgOffLoadTOut "" UBYTE VBU0428Test_CM_boolean 0 0 0.0 1.0 ECU_ADDRESS 0x90001ce3 /end MEASUREMENT
/begin MEASUREMENT DCH_flgDftDCChZeroCrntDlyEna "" UBYTE VBU0428Test_CM_boolean 0 0 0.0 1.0 ECU_ADDRESS 0x90001cdc /end MEASUREMENT
/begin MEASUREMENT DCH_flgDCChRlyReq "" UBYTE VBU0428Test_CM_boolean 0 0 0.0 1.0 ECU_ADDRESS 0x90001cd8 /end MEASUREMENT
/begin MEASUREMENT LbCBL_flgBalanceEnableCondition "" UBYTE VBU0428Test_CM_boolean 0 0 0 1 ECU_ADDRESS 0x90001e41 /end MEASUREMENT
/begin MEASUREMENT CBL_flgVoltageBalanceEnable "" UBYTE VBU0428Test_CM_boolean 0 0 0 1 ECU_ADDRESS 0x90001f66 /end MEASUREMENT
/begin MEASUREMENT CBL_flgSocBalanceEnable "" UBYTE VBU0428Test_CM_boolean 0 0 0 1 ECU_ADDRESS 0x90001f65 /end MEASUREMENT
/begin MEASUREMENT CBL_flgCTMBoardTempValidORV "" UBYTE VBU0428Test_CM_boolean 0 0 0 1 ECU_ADDRESS 0x90001f64 /end MEASUREMENT
/begin MEASUREMENT CBL_flgBalanceStatus "" UBYTE VBU0428Test_CM_boolean 0 0 0 1 ECU_ADDRESS 0x90001f2c /end MEASUREMENT
/begin MEASUREMENT LbCTD_MnNegContactorWeldTestFail_flg "" UBYTE VBU0428Test_CM_boolean 0 0 0 1 ECU_ADDRESS 0x90001f7c /end MEASUREMENT
/begin MEASUREMENT BMM_flgWakeupLine "" UBYTE VBU0428Test_CM_boolean 0 0 0 1 ECU_ADDRESS 0x90001dc2 /end MEASUREMENT
/begin MEASUREMENT BCV_flgFuseHealthWarning "" UBYTE VBU0428Test_CM_boolean 0 0 0 1 ECU_ADDRESS 0x90001f2a /end MEASUREMENT
/begin MEASUREMENT SPD_tiStAx "" FLOAT32_IEEE VBU0428Test_CM_single 0 0 -3.4E+38 3.4E+38 ECU_ADDRESS 0x6003bc7e /end MEASUREMENT
/begin MEASUREMENT DCH_numTOutCnt "" FLOAT32_IEEE VBU0428Test_CM_single 0 0 -3.4E+38 3.4E+38 ECU_ADDRESS 0x6003baf2 /end MEASUREMENT
/begin MEASUREMENT DCH_tiDurInChStop "" FLOAT32_IEEE VBU0428Test_CM_single 0 0 -3.4E+38 3.4E+38 ECU_ADDRESS 0x6003baf6 /end MEASUREMENT
/begin MEASUREMENT DCH_tiDurTBRO0xAA "" FLOAT32_IEEE VBU0428Test_CM_single 0 0 -3.4E+38 3.4E+38 ECU_ADDRESS 0x6003bafa /end MEASUREMENT
/begin MEASUREMENT DCH_tiDurTBROCloseDCRly "" FLOAT32_IEEE VBU0428Test_CM_single 0 0 -3.4E+38 3.4E+38 ECU_ADDRESS 0x6003bafe /end MEASUREMENT
/begin MEASUREMENT DCH_tiDurTBROCloseHVRly "" FLOAT32_IEEE VBU0428Test_CM_single 0 0 -3.4E+38 3.4E+38 ECU_ADDRESS 0x6003bb02 /end MEASUREMENT
/begin MEASUREMENT DCH_tiDurTBRONotReady "" FLOAT32_IEEE VBU0428Test_CM_single 0 0 -3.4E+38 3.4E+38 ECU_ADDRESS 0x6003bb06 /end MEASUREMENT
/begin MEASUREMENT DCH_tiDurTHandshake "" FLOAT32_IEEE VBU0428Test_CM_single 0 0 -3.4E+38 3.4E+38 ECU_ADDRESS 0x6003bb0a /end MEASUREMENT
/begin MEASUREMENT DCH_tiDurTOpenDCRly "" FLOAT32_IEEE VBU0428Test_CM_single 0 0 -3.4E+38 3.4E+38 ECU_ADDRESS 0x6003bb0e /end MEASUREMENT
/begin MEASUREMENT DCH_tiDurTOpenHVRly "" FLOAT32_IEEE VBU0428Test_CM_single 0 0 -3.4E+38 3.4E+38 ECU_ADDRESS 0x6003bb12 /end MEASUREMENT
/begin MEASUREMENT DCH_tiDurTWaitCCS "" FLOAT32_IEEE VBU0428Test_CM_single 0 0 -3.4E+38 3.4E+38 ECU_ADDRESS 0x6003bb16 /end MEASUREMENT
/begin MEASUREMENT DCH_tiDurTWaitCHM "" FLOAT32_IEEE VBU0428Test_CM_single 0 0 -3.4E+38 3.4E+38 ECU_ADDRESS 0x6003bb1a /end MEASUREMENT
/begin MEASUREMENT DCH_tiDurTWaitCML "" FLOAT32_IEEE VBU0428Test_CM_single 0 0 -3.4E+38 3.4E+38 ECU_ADDRESS 0x6003bb1e /end MEASUREMENT
/begin MEASUREMENT DCH_tiDurTWaitCRM "" FLOAT32_IEEE VBU0428Test_CM_single 0 0 -3.4E+38 3.4E+38 ECU_ADDRESS 0x6003bb22 /end MEASUREMENT
/begin MEASUREMENT DCH_tiDurTWaitCRM0xAA "" FLOAT32_IEEE VBU0428Test_CM_single 0 0 -3.4E+38 3.4E+38 ECU_ADDRESS 0x6003bb26 /end MEASUREMENT
/begin MEASUREMENT DCH_tiDurTWaitCRO0xAA "" FLOAT32_IEEE VBU0428Test_CM_single 0 0 -3.4E+38 3.4E+38 ECU_ADDRESS 0x6003bb2a /end MEASUREMENT
/begin MEASUREMENT DCH_tiDurTWaitCST "" FLOAT32_IEEE VBU0428Test_CM_single 0 0 -3.4E+38 3.4E+38 ECU_ADDRESS 0x6003bb2e /end MEASUREMENT
/begin MEASUREMENT DCH_tiDurTWaitDCRlyOff "" FLOAT32_IEEE VBU0428Test_CM_single 0 0 -3.4E+38 3.4E+38 ECU_ADDRESS 0x6003bb32 /end MEASUREMENT
/begin MEASUREMENT DCH_tiDurTZeroCrnt "" FLOAT32_IEEE VBU0428Test_CM_single 0 0 -3.4E+38 3.4E+38 ECU_ADDRESS 0x6003bb36 /end MEASUREMENT
/begin MEASUREMENT DCH_tiDurTimeOut "" FLOAT32_IEEE VBU0428Test_CM_single 0 0 -3.4E+38 3.4E+38 ECU_ADDRESS 0x6003bb3a /end MEASUREMENT
/begin MEASUREMENT DCH_numChErrCnt "" FLOAT32_IEEE VBU0428Test_CM_single 0 0 -3.4E+38 3.4E+38 ECU_ADDRESS 0x6003baee /end MEASUREMENT
/begin MEASUREMENT DCH_flgChgrAvlTOut "" UBYTE VBU0428Test_CM_boolean 0 0 0.0 1.0 ECU_ADDRESS 0x90001cd3 /end MEASUREMENT
/begin MEASUREMENT DCH_flgDCChRlyCloseTOut "" UBYTE VBU0428Test_CM_boolean 0 0 0.0 1.0 ECU_ADDRESS 0x90001cd7 /end MEASUREMENT
/begin MEASUREMENT DCH_flgVehChRdyTOut "" UBYTE VBU0428Test_CM_boolean 0 0 0.0 1.0 ECU_ADDRESS 0x90001cf0 /end MEASUREMENT
/begin MEASUREMENT DCH_flgRlyAccidentOpn "" UBYTE VBU0428Test_CM_boolean 0 0 0.0 1.0 ECU_ADDRESS 0x90001ced /end MEASUREMENT
/begin COMPU_METHOD VBU0428Test_CM_single_cnt "Q = V" RAT_FUNC "%8.6" "cnt" COEFFS 0 1 0 0 0 1 /end COMPU_METHOD
/begin COMPU_METHOD VBU0428Test_CM_uint16_cnt "Q = V" RAT_FUNC "%5.0" "cnt" COEFFS 0 1 0 0 0 1 /end COMPU_METHOD
/begin COMPU_METHOD VBU0428Test_CM_single_Nm "Q = V" RAT_FUNC "%8.6" "Nm" COEFFS 0 1 0 0 0 1 /end COMPU_METHOD
/begin COMPU_METHOD VBU0428Test_CM_single_kph "Q = V" RAT_FUNC "%8.6" "kph" COEFFS 0 1 0 0 0 1 /end COMPU_METHOD
/begin COMPU_METHOD VBU0428Test_CM_single_pct "Q = V" RAT_FUNC "%8.6" "pct" COEFFS 0 1 0 0 0 1 /end COMPU_METHOD
/begin COMPU_METHOD VBU0428Test_CM_single_A "Q = V" RAT_FUNC "%8.6" "A" COEFFS 0 1 0 0 0 1 /end COMPU_METHOD
/begin COMPU_METHOD VBU0428Test_CM_uint8 "Q = V" RAT_FUNC "%3.0" "" COEFFS 0 1 0 0 0 1 /end COMPU_METHOD
/begin COMPU_METHOD VBU0428Test_CM_uint16 "Q = V" RAT_FUNC "%5.0" "" COEFFS 0 1 0 0 0 1 /end COMPU_METHOD
/begin COMPU_METHOD VBU0428Test_CM_single "Q = V" RAT_FUNC "%8.6" "" COEFFS 0 1 0 0 0 1 /end COMPU_METHOD
/begin COMPU_METHOD VBU0428Test_CM_single_kg "Q = V" RAT_FUNC "%8.6" "kg" COEFFS 0 1 0 0 0 1 /end COMPU_METHOD
/begin COMPU_METHOD VBU0428Test_CM_single_m "Q = V" RAT_FUNC "%8.6" "m" COEFFS 0 1 0 0 0 1 /end COMPU_METHOD
/begin COMPU_METHOD VBU0428Test_CM_uint32_cnt "Q = V" RAT_FUNC "%10.0" "cnt" COEFFS 0 1 0 0 0 1 /end COMPU_METHOD
/begin COMPU_METHOD VBU0428Test_CM_uint32 "Q = V" RAT_FUNC "%10.0" "" COEFFS 0 1 0 0 0 1 /end COMPU_METHOD
/begin COMPU_METHOD VBU0428Test_CM_boolean_cnt "Q = V" RAT_FUNC "%1.0" "cnt" COEFFS 0 1 0 0 0 1 /end COMPU_METHOD
/begin COMPU_METHOD VBU0428Test_CM_boolean "Q = V" RAT_FUNC "%1.0" "" COEFFS 0 1 0 0 0 1 /end COMPU_METHOD
/begin COMPU_METHOD VBU0428Test_CM_int8_cnt "Q = V" RAT_FUNC "%3.0" "cnt" COEFFS 0 1 0 0 0 1 /end COMPU_METHOD
/begin COMPU_METHOD VBU0428Test_CM_uint8_cnt "Q = V" RAT_FUNC "%3.0" "cnt" COEFFS 0 1 0 0 0 1 /end COMPU_METHOD
/begin GROUP S3210_DCH_DCChargeCtrlStateflow "VBU0428Test/VBUSystem/VCU /DCH/DCH_Overall/DCH_DCChargeCtrlOverall/DCH_DCChargeCtrlStateflow"
 /begin SUB_GROUP S3214_DCH_CtrlStateflowPostProcess S3214_DCH_InputSignalPreProcess S3214_DCH_SignalPreProcessForStateflow /end SUB_GROUP
 /begin REF_CHARACTERISTIC DCH_flgDCChRlyClose_SY DCH_flgDCChRlyOpen_SY DCH_flgHvRlyClose_SY DCH_flgHvRlyOpen_SY DCH_numMaxChErrReconn_C DCH_numTOutCnt_C DCH_stBCPMode_SY DCH_stBRMMode_SY DCH_stBRONoRdyMode_SY DCH_stBRORdyMode_SY DCH_stBSTForNrmMode_SY DCH_stCC2AplusConnect_SY DCH_stChStopChgrErr_SY DCH_stChStopChgrManual_SY DCH_stChStopIso_SY DCH_stChStopVehCmpt_SY DCH_stChStopVehErr_SY DCH_stChargeFinishMode_SY DCH_stCharging_SY DCH_stClDCChRlyMode_SY DCH_stComTOut_SY DCH_stHandshake_SY DCH_stHvRlyMode_SY DCH_stInitMode_SY DCH_stInit_SY DCH_stLvShutDownForNrmMode_SY DCH_stOpenDCRlyForBMSTOutMode_SY DCH_stOpenDCRlyForNrmMode_SY DCH_stOpenHvForBMSTOutMode_SY DCH_stParConfig_SY DCH_stPreOpenDCRly_SY DCH_stReConnectChProcessMode_SY DCH_stStopBMS_SY DCH_stStopCC2ConnErr_SY DCH_stStopChAvlErr_SY DCH_stStopChRdyTout_SY DCH_stStopChgrAvl_SY DCH_stStopChgrErr_SY DCH_stStopCrntLrgErr_SY DCH_stStopCrntOvr_SY DCH_stStopDCRlyClTout_SY DCH_stStopDCRlyOpErr_SY DCH_stStopFidErr_SY DCH_stStopHVRlyOpErr_SY DCH_stStopHlfConnErr_SY DCH_stStopIso_SY DCH_stStopManual_SY DCH_stStopToutOvr3_SY DCH_stStopZeroCrnt_SY DCH_stTimeOutInTimeOut_SY DCH_stWaitCRMMode_SY DCH_stWaitCSDForNrmMode_SY DCH_tiCCSTOut_C DCH_tiCHMtoCRMTOut_C DCH_tiCRM00TOutStrtFrmCHM_C DCH_tiCRM00TOut_C DCH_tiCRMAATOut_C DCH_tiCROAATOutStrtFrmBRO_C DCH_tiCROAATOut_C DCH_tiCSTTOut_C DCH_tiChCap_C DCH_tiChRdy_C DCH_tiChgrAvl_C DCH_tiDCChRly_C DCH_tiDCRlyDiagDly_C DCH_tiDlyCCSnotChging_C DCH_tiOpenHvRly_C DCH_tiReStartChProcess_C DCH_tisinceBEMCEMTOut_C DCH_tisinceBSTSentOutTOut_C /end REF_CHARACTERISTIC
 /begin REF_MEASUREMENT DCH_flgBCLTxEna DCH_flgBCPTxEna DCH_flgBCSTxEna DCH_flgBEMTxEna DCH_flgBHMTxEna DCH_flgBRMTxEna DCH_flgBROTxEna DCH_flgBSDTxEna DCH_flgBSMTxEna DCH_flgBSTTxEna DCH_flgChgrAvlTOut DCH_flgDCChRlyCloseTOut DCH_flgDCChRlyReq DCH_flgDCChWakeUp DCH_flgDftDCChZeroCrntDlyEna DCH_flgHvRlyReq DCH_flgNwOldCNReg DCH_flgOffLoadTOut DCH_flgRlyAccidentOpn DCH_flgVehChRdyTOut DCH_numChErrCnt DCH_numTOutCnt DCH_stBEMChCapTOut DCH_stBEMChRdyTOut DCH_stBEMChStTOut DCH_stBEMChgrStopTOut DCH_stBEMId00TOut DCH_stBEMIdAATOut DCH_stBEMStatsDataTOut DCH_stBROBattChRdy DCH_stChStateGen DCH_stChStopReason DCH_stSup DCH_tiDurInChStop DCH_tiDurTBRO0xAA DCH_tiDurTBROCloseDCRly DCH_tiDurTBROCloseHVRly DCH_tiDurTBRONotReady DCH_tiDurTHandshake DCH_tiDurTOpenDCRly DCH_tiDurTOpenHVRly DCH_tiDurTWaitCCS DCH_tiDurTWaitCHM DCH_tiDurTWaitCML DCH_tiDurTWaitCRM DCH_tiDurTWaitCRM0xAA DCH_tiDurTWaitCRO0xAA DCH_tiDurTWaitCST DCH_tiDurTWaitDCRlyOff DCH_tiDurTZeroCrnt DCH_tiDurTimeOut /end REF_MEASUREMENT
/end GROUP
/begin GROUP S3210_DCH_Diagnose "VBU0428Test/VBUSystem/VCU /DCH/DCH_Overall/DCH_DCChargeCtrlOverall/DCH_Diagnose"
 /begin SUB_GROUP S3215_DCH_BmsVoltagCurrentDiagnose S3215_DCH_ChargeErrDetect S3215_DCH_DCRelayDiag S3215_DCH_VehErrDetect /end SUB_GROUP
/end GROUP
/begin GROUP S3210_DCH_EepromStore "VBU0428Test/VBUSystem/VCU /DCH/DCH_Overall/DCH_DCChargeCtrlOverall/DCH_EepromStore"
 /begin SUB_GROUP S3216_DCH_ChargeStopErrDiagnose S3216_DCH_ChargeTimeOutDiagnose S3216_DataConvertandCSTEEPROM /end SUB_GROUP
/end GROUP
/begin GROUP S3210_DSPLLight "VBU0428Test/VBUSystem/VCU /DCH/DCH_Overall/DCH_DCChargeCtrlOverall/DSPLLight"
 /begin REF_CHARACTERISTIC DCH_stChStopChgrErr_SY DCH_stChStopChgrManual_SY DCH_stChStopIso_SY DCH_stChStopVehCmpt_SY DCH_stChStopVehErr_SY DCH_stChargeFinishMode_SY DCH_stInit_SY /end REF_CHARACTERISTIC
/end GROUP
/begin GROUP S3211_DCH_J1939ReceiveProcess "VBU0428Test/VBUSystem/VCU /DCH/DCH_Overall/DCH_J1939InputProcess/DCH_J1939ReceiveProcess"
 /begin REF_CHARACTERISTIC DCH_flgOvrdReceiveCCS_C DCH_flgOvrdReceiveCEM_C DCH_flgOvrdReceiveCHM_C DCH_flgOvrdReceiveCML_C DCH_flgOvrdReceiveCRM_C DCH_flgOvrdReceiveCRO_C DCH_flgOvrdReceiveCSD_C DCH_flgOvrdReceiveCST_C DCH_flgOvrdValReceiveCCS_C DCH_flgOvrdValReceiveCEM_C DCH_flgOvrdValReceiveCHM_C DCH_flgOvrdValReceiveCML_C DCH_flgOvrdValReceiveCRM_C DCH_flgOvrdValReceiveCRO_C DCH_flgOvrdValReceiveCSD_C DCH_flgOvrdValReceiveCST_C /end REF_CHARACTERISTIC
 /begin REF_MEASUREMENT DCH_flgReceiveCCS DCH_flgReceiveCEM DCH_flgReceiveCHM DCH_flgReceiveCML DCH_flgReceiveCRM DCH_flgReceiveCRO DCH_flgReceiveCSD DCH_flgReceiveCST DCH_flgReceiveCTS /end REF_MEASUREMENT
/end GROUP
/begin GROUP S3212_DCH_J1939OutputProcessBCL "VBU0428Test/VBUSystem/VCU /DCH/DCH_Overall/DCH_J1939OutputSignalProcess/DCH_J1939OutputProcessBCL"
 /begin REF_CHARACTERISTIC DCH_flgBCLChModeReqOvrd_C DCH_flgBCLCurrReqOvrd_C DCH_flgBCLVltgReqOvrd_C DCH_iBCLCurrReqOvrdVal_C DCH_stBCLChModeReqOvrdVal_C DCH_stBCLConstantCurrMode_C DCH_stBCLConstantVltgMode_C DCH_uBCLVltgReqOvrdVal_C DCH_uDCChReqLowLim_C DCH_uDCChReqUpLim_C /end REF_CHARACTERISTIC
/end GROUP
/begin GROUP S3212_DCH_J1939OutputProcessBCP "VBU0428Test/VBUSystem/VCU /DCH/DCH_Overall/DCH_J1939OutputSignalProcess/DCH_J1939OutputProcessBCP"
 /begin REF_CHARACTERISTIC DCH_flgBCPBattVltgOvrd_C DCH_flgBCPMaxCellVltgForChOvrd_C DCH_flgBCPMaxChCurrOvrd_C DCH_flgBCPMaxPermitTempOvrd_C DCH_flgBCPMaxVltgForChOvrd_C DCH_flgBCPNrmCapOvrd_C DCH_flgBCPSocOvrd_C DCH_tBCPMaxPermitTempLowLim_C DCH_tBCPMaxPermitTempUpLim_C /end REF_CHARACTERISTIC
/end GROUP
/begin GROUP S3212_DCH_J1939OutputProcessBCS "VBU0428Test/VBUSystem/VCU /DCH/DCH_Overall/DCH_J1939OutputSignalProcess/DCH_J1939OutputProcessBCS"
 /begin REF_CHARACTERISTIC DCH_flgBCSChCurrMeasureOvrd_C DCH_flgBCSChNeedTOvrd_C DCH_flgBCSChVltgMeasureOvrd_C DCH_flgBCSCurrSocOvrd_C DCH_flgBCSMaxCellVltgNumOvrd_C DCH_flgBCSMaxCellVltgOvrd_C DCH_numBCSMaxCellNumLowLim_C DCH_numBCSMaxCellNumUpLim_C DCH_tiBCSEstChTiLowLim_C DCH_tiBCSEstChTiUpLim_C /end REF_CHARACTERISTIC
/end GROUP
/begin GROUP S3212_DCH_J1939OutputProcessBEM "VBU0428Test/VBUSystem/VCU /DCH/DCH_Overall/DCH_J1939OutputSignalProcess/DCH_J1939OutputProcessBEM"
 /begin REF_CHARACTERISTIC DCH_flgBEMChCapTOutOvrd_C DCH_flgBEMChRdyTOutOvrd_C DCH_flgBEMChStTOutOvrd_C DCH_flgBEMChgrStopTOutOvrd_C DCH_flgBEMId00TOutOvrd_C DCH_flgBEMIdAATOutOvrd_C DCH_flgBEMStatsDataTOutOvrd_C DCH_stBEMChCapTOutOvrdVal_C DCH_stBEMChRdyTOutOvrdVal_C DCH_stBEMChStTOutOvrdVal_C DCH_stBEMChgrStopTOutOvrdVal_C DCH_stBEMId00TOutOvrdVal_C DCH_stBEMIdAATOutOvrdVal_C DCH_stBEMStatsDataTOutOvrdVal_C /end REF_CHARACTERISTIC
/end GROUP
/begin GROUP S3212_DCH_J1939OutputProcessBRM "VBU0428Test/VBUSystem/VCU /DCH/DCH_Overall/DCH_J1939OutputSignalProcess/DCH_J1939OutputProcessBRM"
 /begin REF_CHARACTERISTIC DCH_flgBRMBatChgTOvrd_C DCH_flgBRMBatDateDayOvrd_C DCH_flgBRMBatDateMonthOvrd_C DCH_flgBRMBatDateYearOvrd_C DCH_flgBRMBatGrpOvrd_C DCH_flgBRMBatIdentifyOvrd_C DCH_flgBRMBatSfwrVer1Ovrd_C DCH_flgBRMBatSfwrVer2Ovrd_C DCH_flgBRMBatSupOvrd_C DCH_flgBRMResevedOvrd_C DCH_flgBRMVin1Ovrd_C DCH_flgBRMVin2Ovrd_C DCH_flgBRMVin3Ovrd_C DCH_numBRMBatChgTOvrdVal_C DCH_numBRMBatDateDayOvrdVal_C DCH_numBRMBatDateMonthOvrdVal_C DCH_numBRMBatDateYearOvrdVal_C DCH_numBRMBatGrpOvrdVal_C DCH_numBRMBatIdentifyOvrdVal_C DCH_numBRMBatIdentify_C DCH_numBRMBatProtcVerNew_C DCH_numBRMBatProtcVerOld_C DCH_numBRMBatSfwrVer1OvrdVal_C DCH_numBRMBatSfwrVer1_C DCH_numBRMBatSfwrVer2OvrdVal_C DCH_numBRMBatSfwrVer2_C DCH_numBRMBatSupOvrdVal_C DCH_numBRMResevedOvrdVal_C DCH_numBRMReseved_C DCH_numBRMVin1OvrdVal_C DCH_numBRMVin1_C DCH_numBRMVin2OvrdVal_C DCH_numBRMVin2_C DCH_numBRMVin3OvrdVal_C DCH_numBRMVin3_C DCH_numInitialBRMBatChgT_C DCH_numInitialBRMBatDateDay_C DCH_numInitialBRMBatDateMonth_C DCH_numInitialBRMBatDateYear_C DCH_numInitialBRMBatGrp_C DCH_numInitialBRMBatSup_C /end REF_CHARACTERISTIC
/end GROUP
/begin GROUP S3212_DCH_J1939OutputProcessBRO "VBU0428Test/VBUSystem/VCU /DCH/DCH_Overall/DCH_J1939OutputSignalProcess/DCH_J1939OutputProcessBRO" /begin REF_CHARACTERISTIC DCH_flgBROBattChRdyOvrd_C DCH_stBROBattChRdyOvrdVal_C /end REF_CHARACTERISTIC /end GROUP
/begin GROUP S3212_DCH_J1939OutputProcessBSD "VBU0428Test/VBUSystem/VCU /DCH/DCH_Overall/DCH_J1939OutputSignalProcess/DCH_J1939OutputProcessBSD"
 /begin REF_CHARACTERISTIC DCH_flgBSDChEndSocOvrd_C DCH_flgBSDMaxCellTempOvrd_C DCH_flgBSDMaxCellVltgOvrd_C DCH_flgBSDMinCellTempOvrd_C DCH_flgBSDMinCellVltgOvrd_C DCH_pctBSDChEndSocOvrdVal_C DCH_tBSDMaxCellTempOvrdVal_C DCH_tBSDMinCellTempOvrdVal_C DCH_uBSDMaxCellVltgOvrdVal_C DCH_uBSDMinCellVltgOvrdVal_C /end REF_CHARACTERISTIC
/end GROUP
/begin GROUP S3212_DCH_J1939OutputProcessBSM "VBU0428Test/VBUSystem/VCU /DCH/DCH_Overall/DCH_J1939OutputSignalProcess/DCH_J1939OutputProcessBSM"
 /begin REF_CHARACTERISTIC DCH_flgBSMBattOutConnStOvrdVal_C DCH_flgBSMBattOutConnStOvrd_C DCH_flgBSMCellVltgOverUndOvrdVal_C DCH_flgBSMCellVltgOverUndOvrd_C DCH_flgBSMChCurrOverOvrdVal_C DCH_flgBSMChCurrOverOvrd_C DCH_flgBSMChPermitOvrdVal_C DCH_flgBSMChPermitOvrd_C DCH_flgBSMIsoStOvrdVal_C DCH_flgBSMIsoStOvrd_C DCH_flgBSMMaxCellTempNumOvrd_C DCH_flgBSMMaxCellTempOvrd_C DCH_flgBSMMaxCellVltgNumOvrd_C DCH_flgBSMMinCellTempNumOvrd_C DCH_flgBSMMinCellTempOvrd_C DCH_flgBSMSocOverUndOvrdVal_C DCH_flgBSMSocOverUndOvrd_C DCH_flgBSMTempOverOvrdVal_C DCH_flgBSMTempOverOvrd_C DCH_numBSMMaxCellTempNumOvrdVal_C DCH_numBSMMaxCellVltgNumOvrdVal_C DCH_numBSMMinCellTempNumOvrdVal_C DCH_tBSMMaxCellTempOvrdVal_C DCH_tBSMMinCellTempOvrdVal_C /end REF_CHARACTERISTIC
/end GROUP
/begin GROUP S3212_DCH_J1939OutputProcessBST "VBU0428Test/VBUSystem/VCU /DCH/DCH_Overall/DCH_J1939OutputSignalProcess/DCH_J1939OutputProcessBST"
 /begin REF_CHARACTERISTIC DCH_flgBSTChStopForBMSConnOverTempOvrdVal_C DCH_flgBSTChStopForBMSConnOverTempOvrd_C DCH_flgBSTChStopForBattOverTempOvrdVal_C DCH_flgBSTChStopForBattOverTempOvrd_C DCH_flgBSTChStopForCCToVltgFaultOvrdVal_C DCH_flgBSTChStopForCCToVltgFaultOvrd_C DCH_flgBSTChStopForCellVltgOvrdVal_C DCH_flgBSTChStopForCellVltgOvrd_C DCH_flgBSTChStopForChgrReqStopOvrdVal_C DCH_flgBSTChStopForChgrReqStopOvrd_C DCH_flgBSTChStopForConnFaultOvrdVal_C DCH_flgBSTChStopForConnFaultOvrd_C DCH_flgBSTChStopForConnOverTempOvrdVal_C DCH_flgBSTChStopForConnOverTempOvrd_C DCH_flgBSTChStopForHvRlyFaultOvrdVal_C DCH_flgBSTChStopForHvRlyFaultOvrd_C DCH_flgBSTChStopForIsoFaultOvrdVal_C DCH_flgBSTChStopForIsoFaultOvrd_C DCH_flgBSTChStopForOtherFaultOvrdVal_C DCH_flgBSTChStopForOtherFaultOvrd_C DCH_flgBSTChStopForOverCurrOvrdVal_C DCH_flgBSTChStopForOverCurrOvrd_C DCH_flgBSTChStopForSocOvrdVal_C DCH_flgBSTChStopForSocOvrd_C DCH_flgBSTChStopForTotalVltgOvrdVal_C DCH_flgBSTChStopForTotalVltgOvrd_C DCH_flgBSTChStopForVltgAbNrmOvrdVal_C DCH_flgBSTChStopForVltgAbNrmOvrd_C /end REF_CHARACTERISTIC
/end GROUP
/begin GROUP S3334_DSPL_Consumption "VBU0428Test/VBUSystem/VCU /DSPL /DSPL/DriveRange/DSPL_Consumption"
 /begin SUB_GROUP S3337_DSPL_EnergySelfLearn S3337_Range10kmConsumption S3337_Range50kmConsumption /end SUB_GROUP
/end GROUP
/begin GROUP S3334_RemainingRange "VBU0428Test/VBUSystem/VCU /DSPL /DSPL/DriveRange/RemainingRange"
 /begin SUB_GROUP S3338_ChargeConditon S3338_ChargeTemp S3338_DriveTemp S3338_FullRangeAndSocDeclineFactor S3338_RangeTempSelect S3338_SelectDisplayRange /end SUB_GROUP
/end GROUP
/begin GROUP S3477_Drive_Mode_Power_Calculate "VBU0428Test/VBUSystem/VCU /EDIS/EDIS_Ctrl/BatDis_Power_Lim_Calc/Drive_Mode_Power_Calculate" /begin REF_CHARACTERISTIC EDIS_pwrDrvRstn_C /end REF_CHARACTERISTIC /begin REF_MEASUREMENT EDIS_pwrDrvPwrLimDrvMode /end REF_MEASUREMENT /end GROUP
/begin GROUP S3477_Power_Arbitration "VBU0428Test/VBUSystem/VCU /EDIS/EDIS_Ctrl/BatDis_Power_Lim_Calc/Power_Arbitration"
 /begin SUB_GROUP S3481_accessory_power_limit_Calculate S3481_drive_power_limit_calculate /end SUB_GROUP
/end GROUP
/begin GROUP S3477_Regen_Mode_Power_Calculate "VBU0428Test/VBUSystem/VCU /EDIS/EDIS_Ctrl/BatDis_Power_Lim_Calc/Regen_Mode_Power_Calculate" /begin REF_CHARACTERISTIC EDIS_pwrChDynSpare_CUR_v /end REF_CHARACTERISTIC /end GROUP
/begin GROUP S3478_charge_power_calculate "VBU0428Test/VBUSystem/VCU /EDIS/EDIS_Ctrl/battery_power_calculate/charge_power_calculate" /begin SUB_GROUP S3500_BatDis_Regen_Power_PI_Filter S3500_ChPowSetPoint /end SUB_GROUP /end GROUP
/begin GROUP S3478_discharge_power_calculate "VBU0428Test/VBUSystem/VCU /EDIS/EDIS_Ctrl/battery_power_calculate/discharge_power_calculate" /begin SUB_GROUP S3501_DchPowSetpiont S3501_discharge_pid /end SUB_GROUP /end GROUP
/begin GROUP S3479_accessory_load_power "VBU0428Test/VBUSystem/VCU /EDIS/EDIS_Ctrl/drive_power_calculate/accessory_load_power" /begin REF_CHARACTERISTIC PTC_PwrMax_C /end REF_CHARACTERISTIC /begin REF_MEASUREMENT EDIS_pwrAcsyAct /end REF_MEASUREMENT /end GROUP
/begin GROUP S3560_DSM_DisableFault "VBU0428Test/VBUSystem/VCU /LVC/LVC/LVC_DIAG/DSM_DisableFault"
 /begin REF_CHARACTERISTIC LVC_stDiaDCDCStsWrk_SY LVC_tiDcDcPTNodeAbsent_C LVC_tiDiaDCDCActnDly_C LVC_tiSample_SY /end REF_CHARACTERISTIC
/end GROUP
/begin GROUP S3560_DSM_EnableFault "VBU0428Test/VBUSystem/VCU /LVC/LVC/LVC_DIAG/DSM_EnableFault"
 /begin REF_CHARACTERISTIC LVC_stDiaDCDCStsWrk_SY LVC_tiDiaDCDCActnDly_C LVC_tiDiaDCDCSmpl_SY /end REF_CHARACTERISTIC
/end GROUP
/begin GROUP S3560_DSM_OutputCurrent "VBU0428Test/VBUSystem/VCU /LVC/LVC/LVC_DIAG/DSM_OutputCurrent"
 /begin REF_CHARACTERISTIC LVC_iDCDCOutCrnt_C LVC_stDiaDCDCStsWrk_SY LVC_tiDCDCOutCurnt_C LVC_tiSample_SY LVC_uDCDCCrntDeltaLe_C LVC_uDCDCCrntDeltaRe_C LVC_uDCDCOutCrntLe_C LVC_uDCDCOutCrntRe_C /end REF_CHARACTERISTIC
/end GROUP
/begin GROUP S3560_DSM_OutputOverVol "VBU0428Test/VBUSystem/VCU /LVC/LVC/LVC_DIAG/DSM_OutputOverVol"
 /begin REF_CHARACTERISTIC LVC_stDiaDCDCStsWrk_SY LVC_tiDCDCOutVltg_C LVC_tiSample_SY LVC_uDiaDCDCOutOvrVltgThres_C /end REF_CHARACTERISTIC
/end GROUP
/begin GROUP S3560_DSM_OutputUnderVol "VBU0428Test/VBUSystem/VCU /LVC/LVC/LVC_DIAG/DSM_OutputUnderVol"
 /begin REF_CHARACTERISTIC LVC_iDiaUndrVltgPwrEnough_C LVC_iDiaUndrVltgPwrLack_C LVC_pwrDiaUndrVolHi_C LVC_pwrDiaUndrVolLo_C LVC_stDiaDCDCStsWrk_SY LVC_tiDCDCOutVltg_C LVC_tiSample_SY LVC_uDiaDCDCOutUndrVltgThres_C /end REF_CHARACTERISTIC
/end GROUP
/begin GROUP S3561_LVC_DcdcSpCtl "VBU0428Test/VBUSystem/VCU /LVC/LVC/LowVoltageBalanceControl/LVC_DcdcSpCtl"
 /begin REF_CHARACTERISTIC LVC_flgIbsSocLowHvRlyOpen_C LVC_tiHvRlyClReq_C LVC_tiIBSStatusErrAndParked_C LVC_tiLvBattVolLow_C LVC_tiSample_SY LVC_uVolLowOnPark_C /end REF_CHARACTERISTIC
/end GROUP
/begin GROUP S3561_LVC_DcdcStCtl "VBU0428Test/VBUSystem/VCU /LVC/LVC/LowVoltageBalanceControl/LVC_DcdcStCtl" /begin SUB_GROUP S3583_DCDC_Enable S3583_RoutineControl /end SUB_GROUP /end GROUP
/begin GROUP S3605_DVM_PEUShtDwn "VBU0428Test/VBUSystem/VCU /PMM/PMM_Ctrl/DrvMod_Ctrl/DVM_PEUShtDwn" /begin SUB_GROUP S3609_Turn_On_Delay_Time2 /end SUB_GROUP
 /begin REF_CHARACTERISTIC PMM_flgPEURShtDwnOvrdSwt_C PMM_flgPEURShtDwnOvrdVal_C PMM_stPEUInvrOff_SY PMM_stPEUOpStandbyMod_SY PMM_tiDlyACTst_C PMM_tiDlyPEUShtDwn_C /end REF_CHARACTERISTIC
 /begin REF_MEASUREMENT PMM_flgPEURShtDwn /end REF_MEASUREMENT
/end GROUP
/begin GROUP S3605_DVM_SetRdy "VBU0428Test/VBUSystem/VCU /PMM/PMM_Ctrl/DrvMod_Ctrl/DVM_SetRdy"
 /begin REF_CHARACTERISTIC PMM_flgHVRdyOvrdSwt_C PMM_flgHVRdyOvrdVal_C PMM_flgVehRdyOvrdSwt_C PMM_stImmoPass_SY SYS_stShftPosDrv_SY SYS_stShftPosRev_SY /end REF_CHARACTERISTIC
 /begin REF_MEASUREMENT PMM_flgHVRdy PMM_flgSetPEURRdy PMM_flgVehRdy /end REF_MEASUREMENT
/end GROUP
/begin GROUP S3605_DVM_VehRdy "VBU0428Test/VBUSystem/VCU /PMM/PMM_Ctrl/DrvMod_Ctrl/DVM_VehRdy"
 /begin REF_CHARACTERISTIC PMM_flgRMCUZrTrqReqOvrdSwt_C PMM_flgRMCUZrTrqReqOvrdVal_C PMM_stPEUOpStandbyMod_SY PMM_stPEUOpTorMod_SY PMM_stPEUROpModOvrdSwt_C PMM_stPEUROpModOvrdVal_C PMM_tiDlyPEUStandBy_C PMM_trqMaxPEUStandBy_C /end REF_CHARACTERISTIC
 /begin REF_MEASUREMENT PMM_stPEUROpMod /end REF_MEASUREMENT
/end GROUP
/begin GROUP S3606_LvWakeUp_Mode_Calc "VBU0428Test/VBUSystem/VCU /PMM/PMM_Ctrl/LvWakeUp_Ctrl/LvWakeUp_Mode_Calc"
 /begin REF_CHARACTERISTIC PMM_flgWkupModOvrdSwt_C PMM_stDrvMode_SY PMM_stNoReqMode_SY PMM_stWkupModOvrdVal_C PMM_tiDlySWReset_C /end REF_CHARACTERISTIC
 /begin REF_MEASUREMENT PMM_stWkupMod /end REF_MEASUREMENT
/end GROUP
/begin GROUP S3606_LvWakeUp_State_Calc "VBU0428Test/VBUSystem/VCU /PMM/PMM_Ctrl/LvWakeUp_Ctrl/LvWakeUp_State_Calc" /begin SUB_GROUP S3620_LVWSrc S3620_Wakeup /end SUB_GROUP /end GROUP
/begin GROUP S3607_ActiveDisChFault "VBU0428Test/VBUSystem/VCU /PMM/PMM_Ctrl/PMM_DIAG/ActiveDisChFault"
 /begin REF_CHARACTERISTIC PMM_stDiaPEUActvDisCh_SY PMM_tiDiaActvDisChDur_C PMM_uDiaActvDisCh_C /end REF_CHARACTERISTIC
/end GROUP
/begin GROUP S3607_PreChargeCheck "VBU0428Test/VBUSystem/VCU /PMM/PMM_Ctrl/PMM_DIAG/PreChargeCheck"
 /begin REF_CHARACTERISTIC PMM_stDiaPreChRlyClsd_SY PMM_stDiaRlyOpn_SY PMM_tiDiaPreChDur_C PMM_tiDiaPreChFail_C PMM_tiDlyDiaRlyOp_C PMM_tiMonDlyDiaPreCh_C /end REF_CHARACTERISTIC
/end GROUP
/begin GROUP S3607_UnintendAction "VBU0428Test/VBUSystem/VCU /PMM/PMM_Ctrl/PMM_DIAG/UnintendAction"
 /begin REF_CHARACTERISTIC PMM_stDiaPreChRlyClsd_SY PMM_stDiaRlyOpn_SY PMM_tiDiaHVRlyActnDly_C PMM_tiDiaUnIntdPreRlyClsdMntn_C /end REF_CHARACTERISTIC
/end GROUP
/begin GROUP S3608_AcTvDisCh "VBU0428Test/VBUSystem/VCU /PMM/PMM_Ctrl/PwrMod_Ctrl/AcTvDisCh"
 /begin REF_CHARACTERISTIC PMM_flgAccDisblOvrdSwt_C PMM_flgAccDisblOvrdVal_C PMM_flgActvDisWihtHVRlyCldSwt_C PMM_flgActvDisWihtHVRlyCldVal_C SYS_stMCUDisChMalFunc_SY /end REF_CHARACTERISTIC
 /begin REF_MEASUREMENT PMM_flgAccDisbl PMM_flgRMCUActvDisChReq /end REF_MEASUREMENT
/end GROUP
/begin GROUP S3608_HVRlyCtrl "VBU0428Test/VBUSystem/VCU /PMM/PMM_Ctrl/PwrMod_Ctrl/HVRlyCtrl" /begin REF_CHARACTERISTIC PMM_flgHVRlyReqOvrdSwt_C PMM_stHVRlyReqOvrdVal_C /end REF_CHARACTERISTIC /begin REF_MEASUREMENT PMM_stHVRlyReq /end REF_MEASUREMENT /end GROUP
/begin GROUP S3608_PwrMod_PowerUp "VBU0428Test/VBUSystem/VCU /PMM/PMM_Ctrl/PwrMod_Ctrl/PwrMod_PowerUp"
 /begin SUB_GROUP S3669_CtrlSht S3669_EmgcySht S3669_HVClReqSrc S3669_OllLoad S3669_VehStsJudgement S3669_stateflowcondition /end SUB_GROUP
/end GROUP
/begin GROUP S3608_Routine "VBU0428Test/VBUSystem/VCU /PMM/PMM_Ctrl/PwrMod_Ctrl/Routine"
 /begin SUB_GROUP S3671_PwrUpRoutine S3671_Routine_PwrDwn S3671_Rouutine_RActiveDis /end SUB_GROUP
/end GROUP
/begin GROUP S3608_RoutineOvrd "VBU0428Test/VBUSystem/VCU /PMM/PMM_Ctrl/PwrMod_Ctrl/RoutineOvrd"
 /begin REF_CHARACTERISTIC PMM_flgHVPwrDwnEnaOvrdSwt_C PMM_flgHVPwrDwnEnaOvrdVal_C PMM_flgHVPwrUpEnaOvrdSwt_C PMM_flgHVPwrUpEnaOvrdVal_C PMM_flgPEURActvDisChEnaOvrdSwt_C PMM_flgPEURActvDisChEnaOvrdVal_C PMM_flgSelfDiagEnaOvrdSwt_C PMM_flgSelfDiagEnaOvrdVal_C /end REF_CHARACTERISTIC
 /begin REF_MEASUREMENT PMM_flgHVPwrDwnEnaOvrd PMM_flgHVPwrUpEnaOvrd PMM_flgPEURActvDisChEnaOvrd PMM_flgSelfDiagEnaOvrd /end REF_MEASUREMENT
/end GROUP
/begin GROUP S3608_SelfRoutine "VBU0428Test/VBUSystem/VCU /PMM/PMM_Ctrl/PwrMod_Ctrl/SelfRoutine"
 /begin REF_CHARACTERISTIC DIAGS_stNRCFail_SY DIAGS_stPsvRespIn_SY DIAGS_stPsvRespNok_SY DIAGS_stPsvRespOk_SY PMM_tiDlySelfDiag_C /end REF_CHARACTERISTIC
 /begin REF_MEASUREMENT PMM_flgHVPwrDwnEna PMM_flgHVPwrUpEna PMM_stSelfDiagResp /end REF_MEASUREMENT
/end GROUP
/begin GROUP S3719_AxleSpeedDiff "VBU0428Test/VBUSystem/VCU /SPD/SPD/SignalProcessing_10ms/AxleSpeedDiff" /begin REF_CHARACTERISTIC SYS_facRPM2KPH_SY SYS_lFWhlRadius_SY SYS_lWheelBase_SY /end REF_CHARACTERISTIC
 /begin REF_MEASUREMENT SPD_nDSpdTarFR SPD_nDeltaRALR SPD_nFA SPD_nFARADelta SPD_nRA /end REF_MEASUREMENT
/end GROUP
/begin GROUP S3719_Bench "VBU0428Test/VBUSystem/VCU /SPD/SPD/SignalProcessing_10ms/Bench" /begin SUB_GROUP S3721_BenchArb /end SUB_GROUP /end GROUP
/begin GROUP S3719_SlopeCal1 "VBU0428Test/VBUSystem/VCU /SPD/SPD/SignalProcessing_10ms/SlopeCal1" /begin SUB_GROUP S3722_SlopeCal S3722_VehSt /end SUB_GROUP /begin REF_CHARACTERISTIC SPD_tiAxUpdate2_C SPD_tiAxUpdate_C /end REF_CHARACTERISTIC /begin REF_MEASUREMENT SPD_aXSlope SPD_stAX SPD_tiStAx /end REF_MEASUREMENT /end GROUP
/begin GROUP S3719_Subsystem1 "VBU0428Test/VBUSystem/VCU /SPD/SPD/SignalProcessing_10ms/Subsystem1" /begin SUB_GROUP S3723_vWhlProcess S3723_v_Axle /end SUB_GROUP /end GROUP
/begin GROUP S3719_VehDir "VBU0428Test/VBUSystem/VCU /SPD/SPD/SignalProcessing_10ms/VehDir" /begin SUB_GROUP S3724_RearWhl /end SUB_GROUP /begin REF_MEASUREMENT SPD_vVehSpdSlp /end REF_MEASUREMENT /end GROUP
/begin GROUP S3719_VehSpdNorm "VBU0428Test/VBUSystem/VCU /SPD/SPD/SignalProcessing_10ms/VehSpdNorm" /begin SUB_GROUP S3725_Normal_VehSpdCal S3725_nMotr2vVeh /end SUB_GROUP /end GROUP
/begin GROUP S3778_Subsystem "VBU0428Test/VBUSystem/VCU /TQC/TQC/TQC_VehSpdLimit/Subsystem"
 /begin REF_CHARACTERISTIC TQC_aAcc2TrqPrpHigh_SY TQC_aSlopeLimitInit_C TQC_aThresLe_C TQC_aThresRi_C TQC_facDecDrag_C TQC_facDragFastFilter_C TQC_facDragNormalFilter_C TQC_facMinDrag_C TQC_facNormalDrag_C TQC_facSlopeLimitIntegral_C TQC_facSlopeLimitProportion_C TQC_flgSlopeLimitEn_C TQC_numSlopeSample_C TQC_tiDragDelayTime_C TQC_tiSampleTime_C TQC_trqDefaultLimit_C TQC_trqDefaultSlope_C TQC_trqSlopeLimitInit_C TQC_trqSlopeLimitMax_C TQC_trqSlopeLimitMin_C TQC_trqVehMax_C TQC_trqVehMin_C /end REF_CHARACTERISTIC
 /begin REF_MEASUREMENT TQC_trqLIM /end REF_MEASUREMENT
/end GROUP
/begin GROUP S3778_VLIMCal "VBU0428Test/VBUSystem/VCU /TQC/TQC/TQC_VehSpdLimit/VLIMCal"
 /begin REF_CHARACTERISTIC VM_aMSLimD_CUR_v VM_aMSLimHomeD_CUR_v VM_aMSLimHomeR_CUR_v VM_aMSLimR_CUR_v VM_aVehLimDifNeg_C VM_aVehLimDifPos_C VM_aVehLimMax_C VM_stVehLimMaxSpdR_C VM_stVehLimServerGearD_C VM_stVehLimServerGearR_C VM_vVehLimThresD_C VM_vVehLimThresR_C VM_vVehLimpHomeThresD_C VM_vVehLimpHomeThresR_C /end REF_CHARACTERISTIC
/end GROUP
/begin GROUP S3778_VMax "VBU0428Test/VBUSystem/VCU /TQC/TQC/TQC_VehSpdLimit/VMax"
 /begin REF_CHARACTERISTIC TQC_stCurrentGearD_C VM_flgVehLimFixEnable_C VM_stVehLimMaxSpdD_C VM_stVehLimMaxSpdR_C VM_vVehLimFix_C VM_vVehLimMaxRThresHi_C VM_vVehLimMaxRThresLo_C VM_vVehLimMaxR_C VM_vVehLimMaxThresHi_C VM_vVehLimMaxThresLo_C VM_vVehLimMax_C /end REF_CHARACTERISTIC
/end GROUP
/begin GROUP S3778_VMaxExt "VBU0428Test/VBUSystem/VCU /TQC/TQC/TQC_VehSpdLimit/VMaxExt" /begin REF_CHARACTERISTIC VM_stVehLimExtSpd_C VM_vVehLimExtDefault_C /end REF_CHARACTERISTIC /end GROUP
/begin GROUP S3778_VMaxServer "VBU0428Test/VBUSystem/VCU /TQC/TQC/TQC_VehSpdLimit/VMaxServer"
 /begin REF_CHARACTERISTIC TQC_stCurrentGearD_C VM_stVehLimServerGearD_C VM_stVehLimServerGearR_C VM_vVehLimMax_C VM_vVehLimServerGearD_C VM_vVehLimServerGearR_C VM_vVehSpdLimHiServerGearD_C VM_vVehSpdLimHiServerGearR_C VM_vVehSpdLimREDSServerGearDMax_C VM_vVehSpdLimREDSServerGearDMin_C VM_vVehSpdLimREDSServerGearR_C VM_vVehSpdLimServerGearD_C VM_vVehSpdLimServerGearR_C /end REF_CHARACTERISTIC
/end GROUP
/begin GROUP S3779_TQC_VehInfoAnalysis "VBU0428Test/VBUSystem/VCU /TQC/TQC/VehInfo1/TQC_VehInfoAnalysis"
 /begin REF_CHARACTERISTIC TQC_aXFltGradDec_C TQC_aXFltGradInc_C TQC_facDelayShiftFilter_C TQC_facDragShiftFilter_C TQC_facVehSpdFilter_C TQC_flgDragCalEn_C TQC_flgVehAccCalcEnable_C TQC_numFltAccAverage_C TQC_rRatioReducer_C TQC_stDGear_C TQC_tiDelayDragTime_C TQC_tiSampleTime_C TQC_vDragSpeedLe_C TQC_vDragSpeedRi_C /end REF_CHARACTERISTIC
/end GROUP
/begin GROUP S3779_Veh_Drag "VBU0428Test/VBUSystem/VCU /TQC/TQC/VehInfo1/Veh_Drag"
 /begin REF_CHARACTERISTIC CrCtl_facDragSpeed_MAP_v TQC_aDragLearnMax_C TQC_aDragLearnMin_C TQC_facDragCalGradDec_C TQC_facDragCalGradInc_C TQC_facDragCalGradMax_C TQC_facDragCalGradMin_C TQC_facDragWheelFilter_C TQC_facTrqWheelFilter_C TQC_flgDragTrqMovingOn_C TQC_numDragCalAverageAccStepDown_C TQC_numDragCalAverageAccStepUp_C TQC_numDragCalAverageAcc_C TQC_numDragCalAverageBrk_C TQC_numDragFastLearn_C TQC_numDragLearnMin_C TQC_numDragLearnStepDown_C TQC_numDragLearnStepMax_C TQC_numDragLearnStepUp_C TQC_numDragLearnStep_C TQC_pctDragCalPedLe_C TQC_pctDragCalPedRi_C TQC_rRatioReducer_C TQC_trqDragCalGradDec_C TQC_trqDragCalGradInc_C TQC_trqDragMax_C TQC_vDragSpeedLearnLe_C TQC_vDragSpeedLearnRi_C /end REF_CHARACTERISTIC
/end GROUP
/begin GROUP S3779_Veh_a2Trq "VBU0428Test/VBUSystem/VCU /TQC/TQC/VehInfo1/Veh_a2Trq" /begin REF_CHARACTERISTIC TQC_mInrt_C TQC_mVeh_C TQC_rTire19Wheel_C /end REF_CHARACTERISTIC /end GROUP
/begin GROUP S3826_TrqDem_DrvTrq_Cal "VBU0428Test/VBUSystem/VCU /TQD/TrqDem/TrqDem_DrvTrq_Cal/TrqDem_DrvTrq_Cal"
 /begin REF_CHARACTERISTIC TQD_facTrqDesGrR_CUR_v TQD_trqTrqSetECO_MAP_v TQD_trqTrqSetNormal_MAP_v /end REF_CHARACTERISTIC
 /begin REF_MEASUREMENT TQD_facDesTrqGr TQD_trqDesRaw TQD_trqNrmLead TQD_trqZrPed /end REF_MEASUREMENT
/end GROUP
/begin GROUP S3826_TrqDem_MinTrq_Cal "VBU0428Test/VBUSystem/VCU /TQD/TrqDem/TrqDem_DrvTrq_Cal/TrqDem_MinTrq_Cal"
 /begin SUB_GROUP S3829_BrakeCrpModify S3829_CrpEnaArb S3829_CrpRgnTrqArb S3829_CrpRgnTrqCal S3829_CrpRgnTrqLim /end SUB_GROUP
/end GROUP
/begin GROUP S3826_TrqDem_TrqDes_Cal "VBU0428Test/VBUSystem/VCU /TQD/TrqDem/TrqDem_DrvTrq_Cal/TrqDem_TrqDes_Cal" /begin REF_CHARACTERISTIC TQD_pctCrpOff_CUR_v TQD_trqRoad_CUR_v /end REF_CHARACTERISTIC
 /begin REF_MEASUREMENT TQD_trqDemRegen TQD_trqDesDecel TQD_trqDesWeighted TQD_trqNrmDes TQD_trqRoad /end REF_MEASUREMENT
/end GROUP
/begin GROUP S3827_BrakePressureFilter "VBU0428Test/VBUSystem/VCU /TQD/TrqDem/TrqDem_InputTransfer/BrakePressureFilter" /begin SUB_GROUP S3841_First_Order_Low_Pass_Filter /end SUB_GROUP
 /begin REF_CHARACTERISTIC TQD_facBrkPressFilt_C TQD_flgBpsFlt_C TQD_rBpsFltGain_C TQD_rBpsThresFltLowNeg_C TQD_rBpsThresFltLowPos_C TQD_rBpsThresFltMidNeg_C TQD_rBpsThresFltMidPos_C TQD_tiBpsLowNegPT1_C TQD_tiBpsLowPosPT1_C TQD_tiBpsMidNegPT1_C TQD_tiBpsMidPosPT1_C TQD_tiBpsUppNegPT1_C TQD_tiBpsUppPosPT1_C /end REF_CHARACTERISTIC
 /begin REF_MEASUREMENT TQD_pBrkPressFlt /end REF_MEASUREMENT
/end GROUP
/begin GROUP S3827_TrqDem_AccPdl_Filter "VBU0428Test/VBUSystem/VCU /TQD/TrqDem/TrqDem_InputTransfer/TrqDem_AccPdl_Filter"
 /begin REF_CHARACTERISTIC TQD_flgAPDFltByp_C TQD_rAppFltGain_C TQD_rAppThresFltLowNeg_C TQD_rAppThresFltLowPos_C TQD_rAppThresFltMidNeg_C TQD_rAppThresFltMidPos_C TQD_tiAppLowNegPT1_C TQD_tiAppLowPosPT1_C TQD_tiAppMidNegPT1_C TQD_tiAppMidPosPT1_C TQD_tiAppUppNegPT1_C TQD_tiAppUppPosPT1_C /end REF_CHARACTERISTIC
 /begin REF_MEASUREMENT TQD_pctAccPedPosFlt /end REF_MEASUREMENT
/end GROUP
/begin GROUP S3827_TrqDem_GearDet "VBU0428Test/VBUSystem/VCU /TQD/TrqDem/TrqDem_InputTransfer/TrqDem_GearDet" /begin REF_CHARACTERISTIC TQD_flgVirtualNeutralEnable_C TQD_pctAccPedalDeadband_C /end REF_CHARACTERISTIC /begin REF_MEASUREMENT TQD_flgVirtualNeutral TQD_stVehCreepMode /end REF_MEASUREMENT /end GROUP
/begin GROUP S3827_TrqDem_VehSpeed_Filter "VBU0428Test/VBUSystem/VCU /TQD/TrqDem/TrqDem_InputTransfer/TrqDem_VehSpeed_Filter" /begin SUB_GROUP S3844_DejitterFIL S3844_SR_Flip_Flop /end SUB_GROUP
 /begin REF_CHARACTERISTIC TQD_facVehSpdFlt_C TQD_facVehSpdHys_C TQD_flgVectorSpdUsed_C TQD_pctVehSlideRes_C TQD_vVehSlideEna_C TQD_vVehSlideRes_C /end REF_CHARACTERISTIC
 /begin REF_MEASUREMENT TQD_flgSlideRst /end REF_MEASUREMENT
/end GROUP
/begin GROUP S3853_STC "VBU0428Test/VBUSystem/VCU /TQO/TQOAll/STC/STC"
 /begin SUB_GROUP S3861_ABSRgnTorque S3861_DTCRgnTorque S3861_PIRgnTorque S3861_ReverseRgnTorque S3861_RgnControlState /end SUB_GROUP
/end GROUP
/begin GROUP S3855_TQDMP "VBU0428Test/VBUSystem/VCU /TQO/TQOAll/Subsystem/TQDMP" /begin SUB_GROUP S3874_CMB S3874_Dibl S3874_RAROTC /end SUB_GROUP /end GROUP
/begin GROUP S3856_TQARB "VBU0428Test/VBUSystem/VCU /TQO/TQOAll/TQARB/TQARB" /begin SUB_GROUP S3917_Limitation S3917_TrqArb /end SUB_GROUP /end GROUP
/begin GROUP S3857_TQCMP "VBU0428Test/VBUSystem/VCU /TQO/TQOAll/TQCMP/TQCMP" /begin SUB_GROUP S3923_SinCmp S3923_TrqPulse /end SUB_GROUP /begin REF_CHARACTERISTIC TQCMP_trqLowSpdRA /end REF_CHARACTERISTIC /end GROUP
/begin GROUP S3858_TQDIS "VBU0428Test/VBUSystem/VCU /TQO/TQOAll/TQDIS/TQDIS"
 /begin SUB_GROUP S3947_AxleArb S3947_BrkRgnCp S3947_CstBrkArb S3947_Dmp S3947_TrqFilter S3947_TrqForFacCal S3947_TrqLim /end SUB_GROUP
/end GROUP
/begin GROUP S3859_TQO "VBU0428Test/VBUSystem/VCU /TQO/TQOAll/TQO/TQO" /begin SUB_GROUP S4002_MotorTorque S4002_Subsystem S4002_Trq /end SUB_GROUP /end GROUP
/begin GROUP S4015_TorqueRamp "VBU0428Test/VBUSystem/VCU /VTQA/Subsystem/MTrqLim/TorqueRamp" /begin REF_CHARACTERISTIC MTQL_trqDecLim_C MTQL_trqIncLim_C /end REF_CHARACTERISTIC /end GROUP
/begin GROUP S4015_TrqCapacityArb "VBU0428Test/VBUSystem/VCU /VTQA/Subsystem/MTrqLim/TrqCapacityArb"
 /begin REF_CHARACTERISTIC MTQL_trqMtrDrvLimOvrdVal_C MTQL_trqMtrDrvLimOvrd_C MTQL_trqMtrRgnLimOvrdVal_C MTQL_trqMtrRgnLimOvrd_C MTQL_trqPEURDrvLowLim_C MTQL_trqPEURDrvUpLim_C MTQL_trqPEURRgnLowLim_C MTQL_trqPEURRgnUpLim_C /end REF_CHARACTERISTIC
 /begin REF_MEASUREMENT MTQL_trqMtrDrvLim MTQL_trqMtrDrvLimRaw MTQL_trqMtrRgnLim MTQL_trqMtrRgnLimRaw /end REF_MEASUREMENT
/end GROUP
/begin GROUP S4015_TrqCapacityCal "VBU0428Test/VBUSystem/VCU /VTQA/Subsystem/MTrqLim/TrqCapacityCal" /begin REF_MEASUREMENT MTQL_trqRMotrMaxLim MTQL_trqRMotrMinLim /end REF_MEASUREMENT /end GROUP
/begin GROUP S4015_TrqCapacityLim "VBU0428Test/VBUSystem/VCU /VTQA/Subsystem/MTrqLim/TrqCapacityLim"
 /begin SUB_GROUP S4020_FIDTrqLim S4020_Motor_Inhibit S4020_VehicleSpeedLim S4020_dnLim /end SUB_GROUP
/end GROUP
/begin GROUP S4015_TrqCapacityOffline "VBU0428Test/VBUSystem/VCU /VTQA/Subsystem/MTrqLim/TrqCapacityOffline" /begin REF_CHARACTERISTIC MTQL_facVehSpd2MotSpd_C MTQL_trqMtrTrqDrvLT_CUR_v /end REF_CHARACTERISTIC /begin REF_MEASUREMENT MTQL_trqMtrTrqDrvLT /end REF_MEASUREMENT /end GROUP
/begin GROUP S4016_BattLim_Transfer "VBU0428Test/VBUSystem/VCU /VTQA/Subsystem/VehTrqArb/BattLim_Transfer" /begin SUB_GROUP S4031_AxleTrq_Limit_Calc S4031_Motor_PwrLoss_Calc /end SUB_GROUP /end GROUP
/begin GROUP S4016_Trq_Arb "VBU0428Test/VBUSystem/VCU /VTQA/Subsystem/VehTrqArb/Trq_Arb" /begin SUB_GROUP S4032_AlxeMax S4032_AlxeMin S4032_Arb /end SUB_GROUP /end GROUP
/begin GROUP S4049_APD "VBU0428Test/VBUSystem/VCU /VehINP/VehINP_Logic/APD/APD"
 /begin SUB_GROUP S4060_APD1_Norm S4060_APD2_Norm S4060_APD_Dejitter1 S4060_APD_Dejitter2 S4060_APD_Override S4060_Diag_Ratio S4060_Diag_Status S4060_Value_Selection /end SUB_GROUP
/end GROUP
/begin GROUP S4050_Charge_Port_Temp "VBU0428Test/VBUSystem/VCU /VehINP/VehINP_Logic/DCPortTemp/Charge_Port_Temp"
 /begin SUB_GROUP S4092_Veh_DCPortTempPlausibility S4092_Veh_DCPortTempStatus /end SUB_GROUP
/end GROUP
/begin GROUP S4051_IF_Then_Else1 "VBU0428Test/VBUSystem/VCU /VehINP/VehINP_Logic/FPV/IF_Then_Else1" /begin REF_MEASUREMENT FPV_st4WayVlvPosFdbk /end REF_MEASUREMENT /end GROUP
/begin GROUP S4052_Gear1 "VBU0428Test/VBUSystem/VCU /VehINP/VehINP_Logic/GearShift/Gear1"
 /begin SUB_GROUP S4101_Digital_Gear_D_R S4101_Gear4DriveIntend S4101_Gear_BrakeCondition S4101_Gear_DriverShiftPReq S4101_Gear_EPBStatus S4101_Gear_ExternalReq S4101_Gear_P S4101_Gear_ProtectCondition S4101_Gear_Status S4101_Gear_VehSpeed S4101_Gear_VehicleStatus /end SUB_GROUP
/end GROUP
/begin GROUP S4053_VehMode "VBU0428Test/VBUSystem/VCU /VehINP/VehINP_Logic/Mode/VehMode"
 /begin SUB_GROUP S4218_Veh_AccrMode S4218_Veh_CreepMode S4218_Veh_DrvMode S4218_Veh_RgnMode /end SUB_GROUP
/end GROUP
/begin GROUP S4057_Hysteresis_LLC_RHC "VBU0428Test/VBUSystem/VCU /VehINP/VehINP_Logic/VacuumPump Control/Hysteresis_LLC_RHC" /begin REF_MEASUREMENT Veh_flgVacPumpReq /end REF_MEASUREMENT /end GROUP
/begin GROUP S4058_BPD_BrakePercent "VBU0428Test/VBUSystem/VCU /VehINP/VehINP_Logic/VehINP_BPD/BPD_BrakePercent" /begin SUB_GROUP S4261_BPD_BrakePercentStatus S4261_BPD_PressBrake /end SUB_GROUP /end GROUP
/begin GROUP S4058_BPD_BrakeSwitch "VBU0428Test/VBUSystem/VCU /VehINP/VehINP_Logic/VehINP_BPD/BPD_BrakeSwitch" /begin SUB_GROUP S4262_BPD_BrakeSwitchHW S4262_BPD_BrakeSwitchSelect /end SUB_GROUP /end GROUP
/begin GROUP S4058_BPD_BrkSwtPosPlausibilityCheck "VBU0428Test/VBUSystem/VCU /VehINP/VehINP_Logic/VehINP_BPD/BPD_BrkSwtPosPlausibilityCheck" /begin SUB_GROUP S4263_DiagBrkPosDft /end SUB_GROUP /end GROUP
/begin GROUP S4058_VehINP_BrkPedOverride "VBU0428Test/VBUSystem/VCU /VehINP/VehINP_Logic/VehINP_BPD/VehINP_BrkPedOverride" /begin SUB_GROUP S4264_override_signal1 S4264_override_signal4 /end SUB_GROUP
 /begin REF_CHARACTERISTIC BPD_flgBrkPosOverride_C BPD_flgBrkPosVldOverrideVal_C BPD_flgBrkPosVldOverride_C BPD_flgBrkSwtOverride_C BPD_pctBrkPosOverrideVal_C BPD_stBrkPedPrsNoActv_C BPD_stBrkSwtOverrideVal_C /end REF_CHARACTERISTIC
 /begin REF_MEASUREMENT BPD_flgBrkSwt /end REF_MEASUREMENT
/end GROUP
/begin GROUP S4059_VehHVIL "VBU0428Test/VBUSystem/VCU /VehINP/VehINP_Logic/Veh_Status/VehHVIL" /begin SUB_GROUP S4281_HVIL /end SUB_GROUP /end GROUP
/begin GROUP S36_Check_BatteryCurrent_Valid "VBU0428Test/VBUSystem/BMS/BCV/BCV/Subsystem/Calculate_BatteryCurrent/Check_BatteryCurrent_Valid" /begin REF_CHARACTERISTIC CcBCV_ABatteryCurrentOoR_C /end REF_CHARACTERISTIC /end GROUP
/begin GROUP S36_Correct_BatteryCurrent "VBU0428Test/VBUSystem/BMS/BCV/BCV/Subsystem/Calculate_BatteryCurrent/Correct_BatteryCurrent"
 /begin SUB_GROUP S54_Calculate_BatteryCurrent_ZeroDrift S54_Delay_RisingEdge /end SUB_GROUP
 /begin REF_CHARACTERISTIC CbBCV_BatteryCurrentZeroDriftEnable_flg CcBCV_BatteryCurrentDelay_ms /end REF_CHARACTERISTIC
 /begin REF_MEASUREMENT BCV_iABatteryCurrent /end REF_MEASUREMENT
/end GROUP
/begin GROUP S36_UpdateBatteryCurrent "VBU0428Test/VBUSystem/BMS/BCV/BCV/Subsystem/Calculate_BatteryCurrent/UpdateBatteryCurrent" /begin REF_MEASUREMENT BCV_iAUpdateBatteryCurrent /end REF_MEASUREMENT /end GROUP
/begin GROUP S37_Check_BatteryVoltage_Valid "VBU0428Test/VBUSystem/BMS/BCV/BCV/Subsystem/Calculate_BatteryVoltage/Check_BatteryVoltage_Valid" /begin SUB_GROUP S68_Delay_FallingEdge /end SUB_GROUP
 /begin REF_CHARACTERISTIC CcBCV_BatteryVoltageOoRHigh_V CcBCV_BatteryVoltageOoRLow_V CcBCV_HighVoltageDelay_ms /end REF_CHARACTERISTIC
/end GROUP
/begin GROUP S37_Check_BusNegativeVoltage_Valid "VBU0428Test/VBUSystem/BMS/BCV/BCV/Subsystem/Calculate_BatteryVoltage/Check_BusNegativeVoltage_Valid" /begin SUB_GROUP S69_Delay_FallingEdge /end SUB_GROUP /begin REF_CHARACTERISTIC CcBCV_HighVoltageDelay_ms /end REF_CHARACTERISTIC /end GROUP
/begin GROUP S37_Check_BusVoltage_Valid "VBU0428Test/VBUSystem/BMS/BCV/BCV/Subsystem/Calculate_BatteryVoltage/Check_BusVoltage_Valid" /begin SUB_GROUP S70_Delay_FallingEdge /end SUB_GROUP /begin REF_CHARACTERISTIC CcBCV_HighVoltageDelay_ms /end REF_CHARACTERISTIC /end GROUP
/begin GROUP S37_Check_FuseVoltage_Valid "VBU0428Test/VBUSystem/BMS/BCV/BCV/Subsystem/Calculate_BatteryVoltage/Check_FuseVoltage_Valid" /begin SUB_GROUP S71_Delay_FallingEdge /end SUB_GROUP /begin REF_CHARACTERISTIC CcBCV_HighVoltageDelay_ms /end REF_CHARACTERISTIC /end GROUP
/begin GROUP S37_Check_PrechargeVoltage_Valid "VBU0428Test/VBUSystem/BMS/BCV/BCV/Subsystem/Calculate_BatteryVoltage/Check_PrechargeVoltage_Valid" /begin SUB_GROUP S72_Delay_FallingEdge /end SUB_GROUP /begin REF_CHARACTERISTIC CcBCV_HighVoltageDelay_ms /end REF_CHARACTERISTIC /end GROUP
/begin GROUP S37_Check_Vx1Voltage_Valid "VBU0428Test/VBUSystem/BMS/BCV/BCV/Subsystem/Calculate_BatteryVoltage/Check_Vx1Voltage_Valid" /begin SUB_GROUP S73_Delay_FallingEdge /end SUB_GROUP
 /begin REF_CHARACTERISTIC CcBCV_BatteryVoltageOoRHigh_V CcBCV_BatteryVoltageOoRLow_V CcBCV_HighVoltageDelay_ms /end REF_CHARACTERISTIC
/end GROUP
/begin GROUP S37_Check_Vx2Voltage_Valid "VBU0428Test/VBUSystem/BMS/BCV/BCV/Subsystem/Calculate_BatteryVoltage/Check_Vx2Voltage_Valid" /begin SUB_GROUP S74_Delay_FallingEdge /end SUB_GROUP /begin REF_CHARACTERISTIC CcBCV_HighVoltageDelay_ms /end REF_CHARACTERISTIC /end GROUP
/begin GROUP S37_Update_BatteryVoltage "VBU0428Test/VBUSystem/BMS/BCV/BCV/Subsystem/Calculate_BatteryVoltage/Update_BatteryVoltage" /begin REF_MEASUREMENT BCV_uBatteryVoltage /end REF_MEASUREMENT /end GROUP
/begin GROUP S37_Update_BusNegativeVoltage "VBU0428Test/VBUSystem/BMS/BCV/BCV/Subsystem/Calculate_BatteryVoltage/Update_BusNegativeVoltage" /begin REF_MEASUREMENT BCV_uBusNegativeVoltage /end REF_MEASUREMENT /end GROUP
/begin GROUP S37_Update_BusVoltage "VBU0428Test/VBUSystem/BMS/BCV/BCV/Subsystem/Calculate_BatteryVoltage/Update_BusVoltage" /begin REF_MEASUREMENT BCV_uBusVoltage /end REF_MEASUREMENT /end GROUP
/begin GROUP S37_Update_FuseVoltage "VBU0428Test/VBUSystem/BMS/BCV/BCV/Subsystem/Calculate_BatteryVoltage/Update_FuseVoltage" /begin REF_MEASUREMENT BCV_uFuseVoltage /end REF_MEASUREMENT /end GROUP
/begin GROUP S37_Update_PrechargeVoltage "VBU0428Test/VBUSystem/BMS/BCV/BCV/Subsystem/Calculate_BatteryVoltage/Update_PrechargeVoltage" /begin REF_MEASUREMENT BCV_uPrechargeVoltage /end REF_MEASUREMENT /end GROUP
/begin GROUP S37_Update_Vx2Voltage "VBU0428Test/VBUSystem/BMS/BCV/BCV/Subsystem/Calculate_BatteryVoltage/Update_Vx2Voltage" /begin REF_MEASUREMENT BCV_uVx2Voltage /end REF_MEASUREMENT /end GROUP
/begin GROUP S38_Calculate_FuseProtect_Counter "VBU0428Test/VBUSystem/BMS/BCV/BCV/Subsystem/Calculate_Lifetime_Data/Calculate_FuseProtect_Counter"
 /begin REF_CHARACTERISTIC CcBCV_FuseCurrentFactor1_n CcBCV_FuseCurrentFactor2_n CcBCV_FuseCurrentFactor3_n CcBCV_FuseCurrentHigh1_A CcBCV_FuseCurrentHigh2_A CcBCV_FuseCurrentHigh3_A CcBCV_FuseCurrentHigh4_A CcBCV_FuseCurrentLow1_A CcBCV_FuseCurrentLow2_A CcBCV_FuseCurrentLow3_A CcBCV_FuseCurrentLow4_A CcBCV_FuseHealthThreshold_n CcBCV_FuseProtectDelay1_ms CcBCV_FuseProtectDelay2_ms CcBCV_FuseProtectDelay3_ms CcBCV_FuseProtectDelay4_ms EcBCV_nbrFuseProtectCounter3W /end REF_CHARACTERISTIC
 /begin REF_MEASUREMENT BCV_flgFuseHealthWarning EcBCV_nbrFuseProtectCounter3r /end REF_MEASUREMENT
/end GROUP
/begin GROUP S38_Calculate_LifeTimeCharge "VBU0428Test/VBUSystem/BMS/BCV/BCV/Subsystem/Calculate_Lifetime_Data/Calculate_LifeTimeCharge" /begin REF_MEASUREMENT BCV_AhLifeTimeCharge /end REF_MEASUREMENT /end GROUP
/begin GROUP S38_Calculate_LifeTimeCoulomb "VBU0428Test/VBUSystem/BMS/BCV/BCV/Subsystem/Calculate_Lifetime_Data/Calculate_LifeTimeCoulomb" /begin REF_CHARACTERISTIC SECONDS_PER_HOUR /end REF_CHARACTERISTIC /begin REF_MEASUREMENT LcSOC_AhLifeTimeCoulomb /end REF_MEASUREMENT /end GROUP
/begin GROUP S38_Calculate_LifeTimeDischarge "VBU0428Test/VBUSystem/BMS/BCV/BCV/Subsystem/Calculate_Lifetime_Data/Calculate_LifeTimeDischarge" /begin REF_MEASUREMENT BCV_AhLifeTimeDischarge /end REF_MEASUREMENT /end GROUP
/begin GROUP S38_Calculate_LifeTimeFastcharge "VBU0428Test/VBUSystem/BMS/BCV/BCV/Subsystem/Calculate_Lifetime_Data/Calculate_LifeTimeFastcharge" /begin SUB_GROUP S107_Accumulate_Carry S107_Equal_FASTCHARGE /end SUB_GROUP /begin REF_MEASUREMENT BCV_AhLifeTimeFastcharge /end REF_MEASUREMENT /end GROUP
/begin GROUP S39_DIagnose_OutOfRange_Fault "VBU0428Test/VBUSystem/BMS/BCV/BCV/Subsystem/Diagnose_BCV_Communication_Fault/DIagnose_OutOfRange_Fault"
 /begin REF_CHARACTERISTIC BCV_BATTERY_VOLTAGE_SENSE_OOR_FAULT BCV_LEM_CURRENT_SENSE_OOR_FAULT CbBCV_BatteryCurrentOoR_flg CbBCV_BatteryVoltageOoR_flg CcBCV_BatteryCurrentOoRFaultFIC_n CcBCV_BatteryCurrentOoRFaultPIC_n CcBCV_BatteryCurrentOoR_A CcBCV_BatteryVoltageOoRFaultFIC_n CcBCV_BatteryVoltageOoRFaultPIC_n CcBCV_BatteryVoltageOoRHigh_V CcBCV_BatteryVoltageOoRLow_V /end REF_CHARACTERISTIC
 /begin REF_MEASUREMENT BCV_stBatteryCurrentOoRFault BCV_stBatteryVoltageOoRFault /end REF_MEASUREMENT
/end GROUP
/begin GROUP S40_Diagnose_BatteryBusVoltageMismatch_Fault "VBU0428Test/VBUSystem/BMS/BCV/BCV/Subsystem/Diagnose_BCV_Data_Fault/Diagnose_BatteryBusVoltageMismatch_Fault"
 /begin REF_CHARACTERISTIC BCV_BATTERY_BUS_VOLTAGE_MISMATCH_FAULT CbBCV_BatteryBusVoltageMismatch_flg CcBCV_BatteryBusVoltageMismatchFaultDelta_V CcBCV_BatteryBusVoltageMismatchFaultFIC_n CcBCV_BatteryBusVoltageMismatchFaultPIC_n CcBCV_BatteryBusVoltageMismatchFault_V /end REF_CHARACTERISTIC
 /begin REF_MEASUREMENT BCV_stBatteryBusVoltageMismatchFault /end REF_MEASUREMENT
/end GROUP
/begin GROUP S40_Diagnose_VoltageCurrent_Fault "VBU0428Test/VBUSystem/BMS/BCV/BCV/Subsystem/Diagnose_BCV_Data_Fault/Diagnose_VoltageCurrent_Fault"
 /begin SUB_GROUP S136_EVM_FDC_Handler S136_EVM_FDC_Handler1 S136_EVM_FDC_Handler2 /end SUB_GROUP
 /begin REF_CHARACTERISTIC BCV_BATTERY_OVER_CURRENT_WARNING_FAULT BCV_BATTERY_UNDER_VOLTAGEEVM_FAULT BCV_BATTERY_UNDER_VOLTAGE_FAULT CbBCV_BatteryOverCurrentWarning_flg CbBCV_BatteryOverCurrent_flg CbBCV_BatteryOverVoltageEVMFaultEnable_flg CbBCV_BatteryOverVoltageWarning_flg CbBCV_BatteryOverVoltage_flg CbBCV_BatteryUnderVoltageEVMFaultEnable_flg CbBCV_BatteryUnderVoltage_flg CcBCV_BatteryOverCurrentFaultFIC_n CcBCV_BatteryOverCurrentFaultPIC_n CcBCV_BatteryOverCurrentWarningFaultDelay_ms CcBCV_BatteryOverCurrentWarningFaultFIC_n CcBCV_BatteryOverCurrentWarningFaultPIC_n CcBCV_BatteryOverCurrentWarning_A CcBCV_BatteryOverCurrent_A CcBCV_BatteryOverVoltageEVMFaultFIC_n CcBCV_BatteryOverVoltageEVMFaultPIC_n CcBCV_BatteryOverVoltageEVM_V CcBCV_BatteryOverVoltageFaultFIC_n CcBCV_BatteryOverVoltageFaultPIC_n CcBCV_BatteryOverVoltageWarningFaultDelay_ms CcBCV_BatteryOverVoltageWarningFaultFIC_n CcBCV_BatteryOverVoltageWarningFaultPIC_n CcBCV_BatteryOverVoltageWarning_V CcBCV_BatteryOverVoltage_V CcBCV_BatteryUnderVoltage1_V CcBCV_BatteryUnderVoltage2_V CcBCV_BatteryUnderVoltageEVM1_V CcBCV_BatteryUnderVoltageEVM2_V CcBCV_BatteryUnderVoltageEVMFaultFIC_n CcBCV_BatteryUnderVoltageEVMFaultPIC_n CcBCV_BatteryUnderVoltageFaultFIC_n CcBCV_BatteryUnderVoltageFaultPIC_n CcBCV_BatteryUnderVoltageTemp_C /end REF_CHARACTERISTIC
 /begin REF_MEASUREMENT BCV_stBatteryOverCurrentFault BCV_stBatteryOverCurrentWarningFault BCV_stBatteryOverVoltageEVMFault BCV_stBatteryOverVoltageFault BCV_stBatteryOverVoltageWarningFault BCV_stBatteryUnderVoltageEVMFault BCV_stBatteryUnderVoltageFault /end REF_MEASUREMENT
/end GROUP
/begin GROUP S51_Diagnose_BDM_BCV_Communication_Fault "VBU0428Test/VBUSystem/BMS/BCV/BCV/Subsystem/Monitor_BCV_Performance/Diagnose_BDM_BCV_Communication_Fault" /begin SUB_GROUP S186_Diagnose_BdmOutOfRange_Fault /end SUB_GROUP /end GROUP
/begin GROUP S51_Diagnose_BDM_BCV_Data_Fault "VBU0428Test/VBUSystem/BMS/BCV/BCV/Subsystem/Monitor_BCV_Performance/Diagnose_BDM_BCV_Data_Fault"
 /begin SUB_GROUP S187_Diagnose_BdmBatteryBusVoltageMismatch_Fault S187_Diagnose_BdmVoltageCurrent_Fault /end SUB_GROUP
/end GROUP
/begin GROUP S51_Diagnose_BDM_FastChargeContactorOverCurrentAlarm "VBU0428Test/VBUSystem/BMS/BCV/BCV/Subsystem/Monitor_BCV_Performance/Diagnose_BDM_FastChargeContactorOverCurrentAlarm" /begin SUB_GROUP S188_Equal_FASTCHARGE /end SUB_GROUP /begin REF_CHARACTERISTIC CcBCV_DCContactorOverCurrent_A /end REF_CHARACTERISTIC /end GROUP
/begin GROUP S280_Delay_FallingEdge "VBU0428Test/VBUSystem/BMS/BMM/BMM/Determine_Wakeup_Mode/Determine_Wakeup_Bywire/Delay_FallingEdge" /begin REF_MEASUREMENT BMM_flgWakeupLine /end REF_MEASUREMENT /end GROUP
/begin GROUP S288_DetermineBalance_EnableCondition "VBU0428Test/VBUSystem/BMS/CBL/Subsystem8/Subsystem/Balance_EnableCondition/DetermineBalance_EnableCondition"
 /begin REF_CHARACTERISTIC CbCBL_CellBalanceEnable_flg CbCBL_CellTempCheckEnable_flg CbCBL_IsolationResistanceEnable_flg CcCBL_BalanceStartCellSoc_pct CcCBL_BalanceStartCellTempMaxHysteresis_C CcCBL_BalanceStartCellTempMax_C CcCBL_BalanceStartCellVoltageMinHysteresis_mV CcCBL_BalanceStartCellVoltageMin_mV CcCBL_BalanceStartIsoResistance_Kohm CcCBL_SystemVoltageMaxHysteresis_V CcCBL_SystemVoltageMax_V CcCBL_SystemVoltageMinHysteresis_V CcCBL_SystemVoltageMin_V /end REF_CHARACTERISTIC
 /begin REF_MEASUREMENT LbCBL_flgBalanceEnableCondition /end REF_MEASUREMENT
/end GROUP
/begin GROUP S288_DetermineSOCBalance_EnableCondition "VBU0428Test/VBUSystem/BMS/CBL/Subsystem8/Subsystem/Balance_EnableCondition/DetermineSOCBalance_EnableCondition"
 /begin REF_CHARACTERISTIC CcCBL_SocBalanceChargeCurrentHysteresis_A CcCBL_SocBalanceChargeCurrent_A CcCBL_SocBalanceCurrentCheckTime_s CcCBL_SocBalanceDischargeCurrentHysteresis_A CcCBL_SocBalanceDischargeCurrent_A /end REF_CHARACTERISTIC
 /begin REF_MEASUREMENT CBL_flgSocBalanceEnable /end REF_MEASUREMENT
/end GROUP
/begin GROUP S288_DetermineVoltaageBalance_EnableCondition "VBU0428Test/VBUSystem/BMS/CBL/Subsystem8/Subsystem/Balance_EnableCondition/DetermineVoltaageBalance_EnableCondition"
 /begin REF_CHARACTERISTIC CbCBL_CellBalanceOCVCheckEnable_flg CcCBL_CellBalanceChargeCurrentHysteresis_A CcCBL_CellBalanceChargeCurrent_A CcCBL_CellBalanceCurrentCheckTime_s CcCBL_CellBalanceDischargeCurrentHysteresis_A CcCBL_CellBalanceDischargeCurrent_A /end REF_CHARACTERISTIC
 /begin REF_MEASUREMENT CBL_flgVoltageBalanceEnable /end REF_MEASUREMENT
/end GROUP
/begin GROUP S290_Determin_MinSocCellCapacity "VBU0428Test/VBUSystem/BMS/CBL/Subsystem8/Subsystem/Determine_CSCCellBalanceRequest/Determin_MinSocCellCapacity" /begin REF_MEASUREMENT LcSOH_AhMinSocCellCapacity /end REF_MEASUREMENT /end GROUP
/begin GROUP S290_Determine_CellBalanceNumber "VBU0428Test/VBUSystem/BMS/CBL/Subsystem8/Subsystem/Determine_CSCCellBalanceRequest/Determine_CellBalanceNumber" /begin REF_MEASUREMENT CBL_numCellBalanceNumber /end REF_MEASUREMENT /end GROUP
/begin GROUP S290_Determine_CellBalanceRequest "VBU0428Test/VBUSystem/BMS/CBL/Subsystem8/Subsystem/Determine_CSCCellBalanceRequest/Determine_CellBalanceRequest" /begin SUB_GROUP S317_Cell0 /end SUB_GROUP
 /begin REF_CHARACTERISTIC CcCBL_BalanceStartDeltaSoc_pct CcCBL_BalanceStartDeltaVoltage_mV /end REF_CHARACTERISTIC
 /begin REF_MEASUREMENT CBL_mvBalanceTargetVoltage CBL_pctBalanceTargeSoc /end REF_MEASUREMENT
/end GROUP
/begin GROUP S290_Determine_TotalCellBalanceState "VBU0428Test/VBUSystem/BMS/CBL/Subsystem8/Subsystem/Determine_CSCCellBalanceRequest/Determine_TotalCellBalanceState" /begin REF_MEASUREMENT CBL_flgBalanceStatus /end REF_MEASUREMENT /end GROUP
/begin GROUP S290_Subsystem "VBU0428Test/VBUSystem/BMS/CBL/Subsystem8/Subsystem/Determine_CSCCellBalanceRequest/Subsystem" /begin SUB_GROUP S322_Balance_Fault_Diagnostic1 /end SUB_GROUP
 /begin REF_CHARACTERISTIC CBL_BALANCE_RESPOND_MISNATCH_REQUEST_FAULT CbCBL_CellBalanceRespMismatchReqtFault_flg CcCBL_CellBalanceRespMismatchReqtFIC_n CcCBL_CellBalanceRespMismatchReqtPIC_n /end REF_CHARACTERISTIC
/end GROUP
/begin GROUP S291_LOW_HIGH1 "VBU0428Test/VBUSystem/BMS/CBL/Subsystem8/Subsystem/Override/LOW_HIGH1" /begin REF_MEASUREMENT CBL_tCTMBoardTempMaxORV /end REF_MEASUREMENT /end GROUP
/begin GROUP S291_LOW_HIGH2 "VBU0428Test/VBUSystem/BMS/CBL/Subsystem8/Subsystem/Override/LOW_HIGH2" /begin REF_MEASUREMENT CBL_flgCTMBoardTempValidORV /end REF_MEASUREMENT /end GROUP
/begin GROUP S375_DetermineRatioPEUtoBat "VBU0428Test/VBUSystem/BMS/CTD/Subsystem/Subsystem4/DiagnoseRelayWeld/DetermineRatioPEUtoBat"
 /begin REF_CHARACTERISTIC CcCTD_PEUMessageDataValidDelay_ms CcCTD_PEURVtoBatVThresholdLower_pct CcCTD_PEURVtoBatVThresholdUpper_pct /end REF_CHARACTERISTIC
/end GROUP
/begin GROUP S375_MNC_Weld_Check "VBU0428Test/VBUSystem/BMS/CTD/Subsystem/Subsystem4/DiagnoseRelayWeld/MNC_Weld_Check"
 /begin SUB_GROUP S387_CONTACTOR_STATUS_OPENED1 S387_Determine_Diagnostic_Status S387_Equal_to_LOW1 /end SUB_GROUP
 /begin REF_CHARACTERISTIC CbCTD_MnNegContactorWeldFaultEnable_flg CcCTD_MNCWeldTestEnablePEURVoltageRatio_pct CcCTD_MnNegContactorCloseDeltaVoltage_V CcCTD_MnNegContactorWeldFaultFIC_n CcCTD_MnNegContactorWeldFaultPIC_n /end REF_CHARACTERISTIC
 /begin REF_MEASUREMENT LbCTD_MnNegContactorWeldTestFail_flg /end REF_MEASUREMENT
/end GROUP
/begin GROUP S961_Determine_AhIntegral_SOC "VBU0428Test/VBUSystem/BMS/SOC/Subsystem5/Subsystem/Determine_AhIntegral_SoC/Determine_AhIntegral_SOC" /begin REF_CHARACTERISTIC SECONDS_PER_HOUR /end REF_CHARACTERISTIC /end GROUP
/begin GROUP S966_Determine_BatterySOC_ChangeRate "VBU0428Test/VBUSystem/BMS/SOC/Subsystem5/Subsystem/Determine_Display_SOC/Determine_BatterySOC_ChangeRate" /begin REF_CHARACTERISTIC SECONDS_PER_HOUR /end REF_CHARACTERISTIC /end GROUP
/begin GROUP S3214_DCH_CtrlStateflowPostProcess "VBU0428Test/VBUSystem/VCU /DCH/DCH_Overall/DCH_DCChargeCtrlOverall/DCH_DCChargeCtrlStateflow/DCH_CtrlStateflowPostProcess" /begin REF_CHARACTERISTIC DCH_stChStopChgrErr_SY DCH_stChStopChgrManual_SY /end REF_CHARACTERISTIC /end GROUP
/begin GROUP S3620_Wakeup "VBU0428Test/VBUSystem/VCU /PMM/PMM_Ctrl/LvWakeUp_Ctrl/LvWakeUp_State_Calc/Wakeup" /begin REF_CHARACTERISTIC PMM_tiDlySWReset_C /end REF_CHARACTERISTIC /end GROUP
/begin GROUP S3671_PwrUpRoutine "VBU0428Test/VBUSystem/VCU /PMM/PMM_Ctrl/PwrMod_Ctrl/Routine/PwrUpRoutine"
 /begin REF_CHARACTERISTIC DIAGS_stNRCFail_SY DIAGS_stPsvRespIn_SY DIAGS_stPsvRespNok_SY DIAGS_stPsvRespOk_SY /end REF_CHARACTERISTIC
/end GROUP
/begin GROUP S3671_Routine_PwrDwn "VBU0428Test/VBUSystem/VCU /PMM/PMM_Ctrl/PwrMod_Ctrl/Routine/Routine_PwrDwn"
 /begin REF_CHARACTERISTIC DIAGS_stNRCFail_SY DIAGS_stPsvRespIn_SY DIAGS_stPsvRespNok_SY DIAGS_stPsvRespOk_SY /end REF_CHARACTERISTIC
/end GROUP
/begin GROUP S3671_Rouutine_RActiveDis "VBU0428Test/VBUSystem/VCU /PMM/PMM_Ctrl/PwrMod_Ctrl/Routine/Rouutine_RActiveDis"
 /begin REF_CHARACTERISTIC DIAGS_stNRCFail_SY DIAGS_stPsvRespIn_SY DIAGS_stPsvRespNok_SY DIAGS_stPsvRespOk_SY /end REF_CHARACTERISTIC
/end GROUP
/begin GROUP S3722_SlopeCal "VBU0428Test/VBUSystem/VCU /SPD/SPD/SignalProcessing_10ms/SlopeCal1/SlopeCal" /begin REF_CHARACTERISTIC SYS_stShftPosDrv_SY SYS_stShftPosRev_SY /end REF_CHARACTERISTIC /end GROUP
/begin GROUP S3724_RearWhl "VBU0428Test/VBUSystem/VCU /SPD/SPD/SignalProcessing_10ms/VehDir/RearWhl" /begin REF_CHARACTERISTIC SYS_stShftPosDrv_SY SYS_stShftPosRev_SY /end REF_CHARACTERISTIC /end GROUP
/begin GROUP S3725_Normal_VehSpdCal "VBU0428Test/VBUSystem/VCU /SPD/SPD/SignalProcessing_10ms/VehSpdNorm/Normal_VehSpdCal" /begin REF_CHARACTERISTIC SYS_facRPM2KPH_SY /end REF_CHARACTERISTIC /end GROUP
/begin GROUP S3725_nMotr2vVeh "VBU0428Test/VBUSystem/VCU /SPD/SPD/SignalProcessing_10ms/VehSpdNorm/nMotr2vVeh" /begin REF_CHARACTERISTIC SYS_facRPM2KPH_SY /end REF_CHARACTERISTIC /end GROUP
/begin GROUP S3829_CrpRgnTrqArb "VBU0428Test/VBUSystem/VCU /TQD/TrqDem/TrqDem_DrvTrq_Cal/TrqDem_MinTrq_Cal/CrpRgnTrqArb" /begin REF_CHARACTERISTIC SYS_stShftPosDrv_SY SYS_stShftPosRev_SY /end REF_CHARACTERISTIC /end GROUP
/begin GROUP S4020_FIDTrqLim "VBU0428Test/VBUSystem/VCU /VTQA/Subsystem/MTrqLim/TrqCapacityLim/FIDTrqLim" /begin REF_CHARACTERISTIC MTQL_trqPEURDrvUpLim_C /end REF_CHARACTERISTIC /end GROUP
/begin GROUP S4262_BPD_BrakeSwitchSelect "VBU0428Test/VBUSystem/VCU /VehINP/VehINP_Logic/VehINP_BPD/BPD_BrakeSwitch/BPD_BrakeSwitchSelect" /begin REF_CHARACTERISTIC BPD_stBrkPedPrsNoActv_C /end REF_CHARACTERISTIC /end GROUP
/begin GROUP S4263_DiagBrkPosDft "VBU0428Test/VBUSystem/VCU /VehINP/VehINP_Logic/VehINP_BPD/BPD_BrkSwtPosPlausibilityCheck/DiagBrkPosDft" /begin REF_CHARACTERISTIC BPD_stBrkPedPrsNoActv_C /end REF_CHARACTERISTIC /end GROUP
/begin GROUP S186_Diagnose_BdmOutOfRange_Fault "VBU0428Test/VBUSystem/BMS/BCV/BCV/Subsystem/Monitor_BCV_Performance/Diagnose_BDM_BCV_Communication_Fault/Diagnose_BdmOutOfRange_Fault"
 /begin REF_CHARACTERISTIC BCV_BATTERY_VOLTAGE_SENSE_OOR_FAULT BCV_LEM_CURRENT_SENSE_OOR_FAULT /end REF_CHARACTERISTIC
/end GROUP
/begin GROUP S187_Diagnose_BdmBatteryBusVoltageMismatch_Fault "VBU0428Test/VBUSystem/BMS/BCV/BCV/Subsystem/Monitor_BCV_Performance/Diagnose_BDM_BCV_Data_Fault/Diagnose_BdmBatteryBusVoltageMismatch_Fault" /begin REF_CHARACTERISTIC BCV_BATTERY_BUS_VOLTAGE_MISMATCH_FAULT /end REF_CHARACTERISTIC /end GROUP
/begin GROUP S187_Diagnose_BdmVoltageCurrent_Fault "VBU0428Test/VBUSystem/BMS/BCV/BCV/Subsystem/Monitor_BCV_Performance/Diagnose_BDM_BCV_Data_Fault/Diagnose_BdmVoltageCurrent_Fault" /begin REF_CHARACTERISTIC BCV_BATTERY_UNDER_VOLTAGE_FAULT /end REF_CHARACTERISTIC /end GROUP
/begin GROUP S3593_Disenable "VBU0428Test/VBUSystem/VCU /LVC/LVC/LowVoltageBalanceControl/LVC_DcdcStCtl/RoutineControl/Disenable"
 /begin REF_CHARACTERISTIC DIAGS_stNRCFail_SY DIAGS_stPsvRespIn_SY DIAGS_stPsvRespNok_SY DIAGS_stPsvRespOk_SY LVC_tiSample_SY /end REF_CHARACTERISTIC
/end GROUP
/begin GROUP S3593_Enable "VBU0428Test/VBUSystem/VCU /LVC/LVC/LowVoltageBalanceControl/LVC_DcdcStCtl/RoutineControl/Enable"
 /begin REF_CHARACTERISTIC DIAGS_stNRCFail_SY DIAGS_stPsvRespIn_SY DIAGS_stPsvRespNok_SY DIAGS_stPsvRespOk_SY LVC_tiSample_SY /end REF_CHARACTERISTIC
/end GROUP
/begin GROUP S3925_PulseTrig "VBU0428Test/VBUSystem/VCU /TQO/TQOAll/TQCMP/TQCMP/TrqPulse/PulseTrig" /begin REF_CHARACTERISTIC SYS_stShftPosDrv_SY SYS_stShftPosRev_SY /end REF_CHARACTERISTIC /end GROUP
/begin GROUP S4003_ShftChange "VBU0428Test/VBUSystem/VCU /TQO/TQOAll/TQO/TQO/MotorTorque/ShftChange" /begin REF_CHARACTERISTIC SYS_stShftPosDrv_SY SYS_stShftPosRev_SY /end REF_CHARACTERISTIC /end GROUP
/begin GROUP S4003_Subsystem "VBU0428Test/VBUSystem/VCU /TQO/TQOAll/TQO/TQO/MotorTorque/Subsystem" /begin REF_CHARACTERISTIC SYS_stShftPosDrv_SY SYS_stShftPosRev_SY /end REF_CHARACTERISTIC /end GROUP
/begin GROUP S324_Determine_SocBalanceReq "VBU0428Test/VBUSystem/BMS/CBL/Subsystem8/Subsystem/Determine_CSCCellBalanceRequest/Determine_CellBalanceRequest/Cell0/Determine_SocBalanceReq" /begin REF_CHARACTERISTIC CcCBL_BalanceStartDeltaSoc_pct /end REF_CHARACTERISTIC /end GROUP
/begin GROUP S324_Determine_VoltageBalanceReq "VBU0428Test/VBUSystem/BMS/CBL/Subsystem8/Subsystem/Determine_CSCCellBalanceRequest/Determine_CellBalanceRequest/Cell0/Determine_VoltageBalanceReq" /begin REF_CHARACTERISTIC CcCBL_BalanceStartDeltaVoltage_mV /end REF_CHARACTERISTIC /end GROUP
/begin GROUP S1443_Determine_AhIntegral_Q "VBU0428Test/VBUSystem/BMS/SOH/Subsystem4/Subsystem1/Calculate_Capacity/Calculate_CellCapacity_SlowCharge/Determine_AhIntegral_DeltaQ/Determine_AhIntegral_Q" /begin REF_CHARACTERISTIC SECONDS_PER_HOUR /end REF_CHARACTERISTIC /end GROUP
/begin GROUP S3883_TipinEnaRA "VBU0428Test/VBUSystem/VCU /TQO/TQOAll/Subsystem/TQDMP/RAROTC/ROTCConidtion/TipinEnaRA" /begin REF_CHARACTERISTIC SYS_stShftPosDrv_SY SYS_stShftPosRev_SY /end REF_CHARACTERISTIC /end GROUP
/begin GROUP S3883_TipoutEnaRA "VBU0428Test/VBUSystem/VCU /TQO/TQOAll/Subsystem/TQDMP/RAROTC/ROTCConidtion/TipoutEnaRA" /begin REF_CHARACTERISTIC SYS_stShftPosDrv_SY SYS_stShftPosRev_SY /end REF_CHARACTERISTIC /end GROUP
/begin GROUP S3884_DeltaTrqArb "VBU0428Test/VBUSystem/VCU /TQO/TQOAll/Subsystem/TQDMP/RAROTC/TorqueCal/DeltaTrqArb" /begin REF_CHARACTERISTIC SYS_stShftPosDrv_SY SYS_stShftPosRev_SY /end REF_CHARACTERISTIC /end GROUP
/begin GROUP S3986_AccPdlIdl "VBU0428Test/VBUSystem/VCU /TQO/TQOAll/TQDIS/TQDIS/TrqFilter/DrvLim/AccPdlIdl" /begin REF_CHARACTERISTIC SYS_stShftPosDrv_SY SYS_stShftPosRev_SY /end REF_CHARACTERISTIC /end GROUP
/begin GROUP S3986_Creep "VBU0428Test/VBUSystem/VCU /TQO/TQOAll/TQDIS/TQDIS/TrqFilter/DrvLim/Creep" /begin REF_CHARACTERISTIC SYS_stShftPosDrv_SY SYS_stShftPosRev_SY /end REF_CHARACTERISTIC /end GROUP
/end MODULE
/end PROJECT
