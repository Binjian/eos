ASAP2_VERSION 1 31
/begin PROJECT ProjectName "Project Comment Goes Here"
/begin HEADER "Header Comments go here" /end HEADER
/begin MODULE ModuleName "Module Comment Goes Here"
/begin MOD_COMMON "Mod Common Comment Here" BYTE_ORDER MSB_LAST /end MOD_COMMON
/begin RECORD_LAYOUT Scalar_BOOLEAN FNC_VALUES 1 UBYTE COLUMN_DIR DIRECT /end RECORD_LAYOUT
/begin RECORD_LAYOUT Scalar_UBYTE FNC_VALUES 1 UBYTE COLUMN_DIR DIRECT /end RECORD_LAYOUT
/begin RECORD_LAYOUT Scalar_UWORD FNC_VALUES 1 UWORD COLUMN_DIR DIRECT /end RECORD_LAYOUT
/begin RECORD_LAYOUT Scalar_ULONG FNC_VALUES 1 ULONG COLUMN_DIR DIRECT /end RECORD_LAYOUT
/begin RECORD_LAYOUT Scalar_FLOAT32_IEEE FNC_VALUES 1 FLOAT32_IEEE COLUMN_DIR DIRECT /end RECORD_LAYOUT
/begin RECORD_LAYOUT Lookup1D_X_UWORD AXIS_PTS_X 1 UWORD INDEX_INCR DIRECT /end RECORD_LAYOUT
/begin RECORD_LAYOUT Lookup1D_FLOAT32_IEEE FNC_VALUES 1 FLOAT32_IEEE COLUMN_DIR DIRECT /end RECORD_LAYOUT
/begin RECORD_LAYOUT Lookup1D_X_FLOAT32_IEEE AXIS_PTS_X 1 FLOAT32_IEEE INDEX_INCR DIRECT /end RECORD_LAYOUT
/begin RECORD_LAYOUT Lookup2D_UWORD FNC_VALUES 1 UWORD COLUMN_DIR DIRECT /end RECORD_LAYOUT
/begin RECORD_LAYOUT Lookup2D_X_UWORD AXIS_PTS_X 1 UWORD INDEX_INCR DIRECT /end RECORD_LAYOUT
/begin RECORD_LAYOUT Lookup2D_LONG FNC_VALUES 1 SLONG COLUMN_DIR DIRECT /end RECORD_LAYOUT
/begin RECORD_LAYOUT Lookup2D_X_LONG AXIS_PTS_X 1 SLONG INDEX_INCR DIRECT /end RECORD_LAYOUT
/begin RECORD_LAYOUT Lookup2D_FLOAT32_IEEE FNC_VALUES 1 FLOAT32_IEEE COLUMN_DIR DIRECT /end RECORD_LAYOUT
/begin RECORD_LAYOUT Lookup2D_X_FLOAT32_IEEE AXIS_PTS_X 1 FLOAT32_IEEE INDEX_INCR DIRECT /end RECORD_LAYOUT
/begin RECORD_LAYOUT Lookup2D_FLOAT64_IEEE FNC_VALUES 1 FLOAT64_IEEE COLUMN_DIR DIRECT /end RECORD_LAYOUT
/begin RECORD_LAYOUT Lookup2D_X_FLOAT64_IEEE AXIS_PTS_X 1 FLOAT64_IEEE INDEX_INCR DIRECT /end RECORD_LAYOUT
/begin CHARACTERISTIC TQO_trqLimpModeMax_CUR_v "" CURVE 0x700138ca Lookup1D_FLOAT32_IEEE 0 VBU0513_CM_single_cnt -3.4028234663852886E+38 3.4028234663852886E+38
 /begin AXIS_DESCR COM_AXIS SPD_vVehSpd VBU0513_CM_single_cnt 13 -3.4028234663852886E+38 3.4028234663852886E+38 AXIS_PTS_REF TQO_vAxleMax_CUR_x /end AXIS_DESCR
/end CHARACTERISTIC
/begin AXIS_PTS TQO_vAxleMax_CUR_x "" 0x700138fe SPD_vVehSpd Lookup1D_X_FLOAT32_IEEE 0 VBU0513_CM_single_cnt 13 -3.4028234663852886E+38 3.4028234663852886E+38 /end AXIS_PTS
/begin CHARACTERISTIC TQO_trqBrk_MAP_v "" MAP 0x7001761a Lookup2D_FLOAT32_IEEE 0 VBU0513_CM_single_cnt -3.4028234663852886E+38 3.4028234663852886E+38
 /begin AXIS_DESCR COM_AXIS SPD_vVehSpd VBU0513_CM_single_cnt 13 -3.4028234663852886E+38 3.4028234663852886E+38 AXIS_PTS_REF TQO_vBrk_MAP_y /end AXIS_DESCR
 /begin AXIS_DESCR COM_AXIS NO_INPUT_QUANTITY VBU0513_CM_single_cnt 11 -3.4028234663852886E+38 3.4028234663852886E+38 AXIS_PTS_REF TQO_pctBrk_MAP_x /end AXIS_DESCR
/end CHARACTERISTIC
/begin AXIS_PTS TQO_pctBrk_MAP_x "" 0x70012f9a NO_INPUT_QUANTITY Lookup2D_X_FLOAT32_IEEE 0 VBU0513_CM_single_cnt 11 -3.4028234663852886E+38 3.4028234663852886E+38 /end AXIS_PTS
/begin AXIS_PTS TQO_vBrk_MAP_y "" 0x70013932 SPD_vVehSpd Lookup2D_X_FLOAT32_IEEE 0 VBU0513_CM_single_cnt 13 -3.4028234663852886E+38 3.4028234663852886E+38 /end AXIS_PTS
/begin CHARACTERISTIC APD_tiBrkPlausibility_CUR_v "" CURVE 0x7001414e Lookup1D_FLOAT32_IEEE 0 VBU0513_CM_single_cnt -3.4028234663852886E+38 3.4028234663852886E+38
 /begin AXIS_DESCR COM_AXIS SPD_vVehSpd VBU0513_CM_single_cnt 19 -3.4028234663852886E+38 3.4028234663852886E+38 AXIS_PTS_REF APD_vBrkPlausibility_CUR_x /end AXIS_DESCR
/end CHARACTERISTIC
/begin AXIS_PTS APD_vBrkPlausibility_CUR_x "" 0x7001419a SPD_vVehSpd Lookup1D_X_FLOAT32_IEEE 0 VBU0513_CM_single_cnt 19 -3.4028234663852886E+38 3.4028234663852886E+38 /end AXIS_PTS
/begin CHARACTERISTIC CaSYS_FullChargeOcvMapZ_mV "" MAP 0x70014e1e Lookup2D_FLOAT32_IEEE 0 VBU0513_CM_single_cnt -3.4028234663852886E+38 3.4028234663852886E+38
 /begin AXIS_DESCR COM_AXIS NO_INPUT_QUANTITY VBU0513_CM_single_cnt 3 -3.4028234663852886E+38 3.4028234663852886E+38 AXIS_PTS_REF CaSYS_FullChargeOcvMapY_pct /end AXIS_DESCR
 /begin AXIS_DESCR COM_AXIS NO_INPUT_QUANTITY VBU0513_CM_single_cnt 8 -3.4028234663852886E+38 3.4028234663852886E+38 AXIS_PTS_REF CaSYS_FullChargeOcvMapX_C /end AXIS_DESCR
/end CHARACTERISTIC
/begin AXIS_PTS CaSYS_FullChargeOcvMapX_C "" 0x70012696 NO_INPUT_QUANTITY Lookup2D_X_FLOAT32_IEEE 0 VBU0513_CM_single_cnt 8 -3.4028234663852886E+38 3.4028234663852886E+38 /end AXIS_PTS
/begin AXIS_PTS CaSYS_FullChargeOcvMapY_pct "" 0x70011b58 NO_INPUT_QUANTITY Lookup2D_X_FLOAT32_IEEE 0 VBU0513_CM_single_cnt 3 -3.4028234663852886E+38 3.4028234663852886E+38 /end AXIS_PTS
/begin CHARACTERISTIC CaFCC_FullChargeVoltagePolarizaitonMapZ_mV "" MAP 0x70014d5e Lookup2D_FLOAT32_IEEE 0 VBU0513_CM_single_cnt -3.4028234663852886E+38 3.4028234663852886E+38
 /begin AXIS_DESCR COM_AXIS SOH_pctPackSoh VBU0513_CM_single_cnt 3 -3.4028234663852886E+38 3.4028234663852886E+38 AXIS_PTS_REF CaFCC_FullChargeVoltagePolarizaitonMapY_pct /end AXIS_DESCR
 /begin AXIS_DESCR COM_AXIS NO_INPUT_QUANTITY VBU0513_CM_single_cnt 8 -3.4028234663852886E+38 3.4028234663852886E+38 AXIS_PTS_REF CaFCC_FullChargeVoltagePolarizaitonMapX_C /end AXIS_DESCR
/end CHARACTERISTIC
/begin AXIS_PTS CaFCC_FullChargeVoltagePolarizaitonMapX_C "" 0x70012656 NO_INPUT_QUANTITY Lookup2D_X_FLOAT32_IEEE 0 VBU0513_CM_single_cnt 8 -3.4028234663852886E+38 3.4028234663852886E+38 /end AXIS_PTS
/begin AXIS_PTS CaFCC_FullChargeVoltagePolarizaitonMapY_pct "" 0x70011b40 SOH_pctPackSoh Lookup2D_X_FLOAT32_IEEE 0 VBU0513_CM_single_cnt 3 -3.4028234663852886E+38 3.4028234663852886E+38 /end AXIS_PTS
/begin CHARACTERISTIC CaFCC_FullChargeVoltageDCIRMapZ_mV "" MAP 0x70014c9e Lookup2D_FLOAT32_IEEE 0 VBU0513_CM_single_cnt -3.4028234663852886E+38 3.4028234663852886E+38
 /begin AXIS_DESCR COM_AXIS SOH_pctPackSoh VBU0513_CM_single_cnt 3 -3.4028234663852886E+38 3.4028234663852886E+38 AXIS_PTS_REF CaFCC_FullChargeVoltageDCIRMapY_pct /end AXIS_DESCR
 /begin AXIS_DESCR COM_AXIS NO_INPUT_QUANTITY VBU0513_CM_single_cnt 8 -3.4028234663852886E+38 3.4028234663852886E+38 AXIS_PTS_REF CaFCC_FullChargeVoltageDCIRMapX_C /end AXIS_DESCR
/end CHARACTERISTIC
/begin AXIS_PTS CaFCC_FullChargeVoltageDCIRMapX_C "" 0x70012616 NO_INPUT_QUANTITY Lookup2D_X_FLOAT32_IEEE 0 VBU0513_CM_single_cnt 8 -3.4028234663852886E+38 3.4028234663852886E+38 /end AXIS_PTS
/begin AXIS_PTS CaFCC_FullChargeVoltageDCIRMapY_pct "" 0x70011b28 SOH_pctPackSoh Lookup2D_X_FLOAT32_IEEE 0 VBU0513_CM_single_cnt 3 -3.4028234663852886E+38 3.4028234663852886E+38 /end AXIS_PTS
/begin CHARACTERISTIC CaFCC_FullChargeVoltageSOHAttenuationMapZ_mV "" MAP 0x70014dbe Lookup2D_FLOAT32_IEEE 0 VBU0513_CM_single_cnt -3.4028234663852886E+38 3.4028234663852886E+38
 /begin AXIS_DESCR COM_AXIS SOH_pctPackSoh VBU0513_CM_single_cnt 3 -3.4028234663852886E+38 3.4028234663852886E+38 AXIS_PTS_REF CaFCC_FullChargeVoltageSOHAttenuationMapY_pct /end AXIS_DESCR
 /begin AXIS_DESCR COM_AXIS NO_INPUT_QUANTITY VBU0513_CM_single_cnt 8 -3.4028234663852886E+38 3.4028234663852886E+38 AXIS_PTS_REF CaFCC_FullChargeVoltageSOHAttenuationMapX_C /end AXIS_DESCR
/end CHARACTERISTIC
/begin AXIS_PTS CaFCC_FullChargeVoltageSOHAttenuationMapX_C "" 0x70012676 NO_INPUT_QUANTITY Lookup2D_X_FLOAT32_IEEE 0 VBU0513_CM_single_cnt 8 -3.4028234663852886E+38 3.4028234663852886E+38 /end AXIS_PTS
/begin AXIS_PTS CaFCC_FullChargeVoltageSOHAttenuationMapY_pct "" 0x70011b4c SOH_pctPackSoh Lookup2D_X_FLOAT32_IEEE 0 VBU0513_CM_single_cnt 3 -3.4028234663852886E+38 3.4028234663852886E+38 /end AXIS_PTS
/begin CHARACTERISTIC CaFCC_FullChargeVoltageHysteresisMapZ_mV "" MAP 0x70014cfe Lookup2D_FLOAT32_IEEE 0 VBU0513_CM_single_cnt -3.4028234663852886E+38 3.4028234663852886E+38
 /begin AXIS_DESCR COM_AXIS SOH_pctPackSoh VBU0513_CM_single_cnt 3 -3.4028234663852886E+38 3.4028234663852886E+38 AXIS_PTS_REF CaFCC_FullChargeVoltageHysteresisMapY_pct /end AXIS_DESCR
 /begin AXIS_DESCR COM_AXIS NO_INPUT_QUANTITY VBU0513_CM_single_cnt 8 -3.4028234663852886E+38 3.4028234663852886E+38 AXIS_PTS_REF CaFCC_FullChargeVoltageHysteresisMapX_C /end AXIS_DESCR
/end CHARACTERISTIC
/begin AXIS_PTS CaFCC_FullChargeVoltageHysteresisMapX_C "" 0x70012636 NO_INPUT_QUANTITY Lookup2D_X_FLOAT32_IEEE 0 VBU0513_CM_single_cnt 8 -3.4028234663852886E+38 3.4028234663852886E+38 /end AXIS_PTS
/begin AXIS_PTS CaFCC_FullChargeVoltageHysteresisMapY_pct "" 0x70011b34 SOH_pctPackSoh Lookup2D_X_FLOAT32_IEEE 0 VBU0513_CM_single_cnt 3 -3.4028234663852886E+38 3.4028234663852886E+38 /end AXIS_PTS
/begin CHARACTERISTIC CaSOF_ContinuousChargeMap_v "" MAP 0x7002020a Lookup2D_FLOAT32_IEEE 0 VBU0513_CM_single_i 0.0 200.0
 /begin AXIS_DESCR COM_AXIS SOC_pctCellSocMax VBU0513_CM_single_pct 22 0.0 100.0 AXIS_PTS_REF CaSOF_ContinuousChargeSocMap_y /end AXIS_DESCR
 /begin AXIS_DESCR COM_AXIS NO_INPUT_QUANTITY VBU0513_CM_single_t 22 -40.0 120.0 AXIS_PTS_REF CaSOF_ContinuousChargeTempMap_x /end AXIS_DESCR
/end CHARACTERISTIC
/begin AXIS_PTS CaSOF_ContinuousChargeTempMap_x "" 0x70014ae2 NO_INPUT_QUANTITY Lookup2D_X_FLOAT32_IEEE 0 VBU0513_CM_single_t 22 -40.0 120.0 /end AXIS_PTS
/begin AXIS_PTS CaSOF_ContinuousChargeSocMap_y "" 0x70014a32 SOC_pctCellSocMax Lookup2D_X_FLOAT32_IEEE 0 VBU0513_CM_single_pct 22 0.0 100.0 /end AXIS_PTS
/begin CHARACTERISTIC CaSOF_ContinuousChargeLockedMap_v "" MAP 0x7001fa7a Lookup2D_FLOAT32_IEEE 0 VBU0513_CM_single_i 0.0 200.0
 /begin AXIS_DESCR COM_AXIS NO_INPUT_QUANTITY VBU0513_CM_single_pct 22 0.0 100.0 AXIS_PTS_REF CaSOF_ContinuousChargeSocMap_y /end AXIS_DESCR
 /begin AXIS_DESCR COM_AXIS NO_INPUT_QUANTITY VBU0513_CM_single_t 22 -40.0 120.0 AXIS_PTS_REF CaSOF_ContinuousChargeTempMap_x /end AXIS_DESCR
/end CHARACTERISTIC
/begin CHARACTERISTIC CaSOF_ContinuousChargeEolMap_v "" MAP 0x7001e3ca Lookup2D_FLOAT32_IEEE 0 VBU0513_CM_single_i 0.0 200.0
 /begin AXIS_DESCR COM_AXIS NO_INPUT_QUANTITY VBU0513_CM_single_pct 22 0.0 100.0 AXIS_PTS_REF CaSOF_ContinuousChargeSocMap_y /end AXIS_DESCR
 /begin AXIS_DESCR COM_AXIS NO_INPUT_QUANTITY VBU0513_CM_single_t 22 -40.0 120.0 AXIS_PTS_REF CaSOF_ContinuousChargeTempMap_x /end AXIS_DESCR
/end CHARACTERISTIC
/begin CHARACTERISTIC CaSOF_ContinuousChargeHomoMap_v "" MAP 0x7001eb5a Lookup2D_FLOAT32_IEEE 0 VBU0513_CM_single_i 0.0 200.0
 /begin AXIS_DESCR COM_AXIS SOC_pctCellSocMax VBU0513_CM_single_pct 22 0.0 100.0 AXIS_PTS_REF CaSOF_ContinuousChargeSocMap_y /end AXIS_DESCR
 /begin AXIS_DESCR COM_AXIS NO_INPUT_QUANTITY VBU0513_CM_single_t 22 -40.0 120.0 AXIS_PTS_REF CaSOF_ContinuousChargeTempMap_x /end AXIS_DESCR
/end CHARACTERISTIC
/begin CHARACTERISTIC CaSOF_ContinuousChargeLockedHomoMap_v "" MAP 0x7001f2ea Lookup2D_FLOAT32_IEEE 0 VBU0513_CM_single_i 0.0 200.0
 /begin AXIS_DESCR COM_AXIS NO_INPUT_QUANTITY VBU0513_CM_single_pct 22 0.0 100.0 AXIS_PTS_REF CaSOF_ContinuousChargeSocMap_y /end AXIS_DESCR
 /begin AXIS_DESCR COM_AXIS NO_INPUT_QUANTITY VBU0513_CM_single_t 22 -40.0 120.0 AXIS_PTS_REF CaSOF_ContinuousChargeTempMap_x /end AXIS_DESCR
/end CHARACTERISTIC
/begin CHARACTERISTIC CaSOF_ContinuousChargeFactorMap_v "" MAP 0x70017856 Lookup2D_FLOAT32_IEEE 0 VBU0513_CM_single_i 0.0 1.0
 /begin AXIS_DESCR COM_AXIS SOC_pctCellSocMax VBU0513_CM_single_pct 22 0.0 100.0 AXIS_PTS_REF CaSOF_ContinuousChargeSocMap_y /end AXIS_DESCR
 /begin AXIS_DESCR FIX_AXIS NO_INPUT_QUANTITY VBU0513_CM_uint16 7 0 500 /begin FIX_AXIS_PAR_LIST 0 50 100 200 300 400 500 /end FIX_AXIS_PAR_LIST /end AXIS_DESCR
/end CHARACTERISTIC
/begin CHARACTERISTIC CaSOF_ContinuousDischargeSocTempMapZ_A "" MAP 0x70018dbe Lookup2D_FLOAT32_IEEE 0 VBU0513_CM_single_cnt -3.4028234663852886E+38 3.4028234663852886E+38
 /begin AXIS_DESCR COM_AXIS SOC_pctCellSocMin VBU0513_CM_single_cnt 13 -3.4028234663852886E+38 3.4028234663852886E+38 AXIS_PTS_REF CaSOF_ContinuousDischargeSocTempMapY_pct /end AXIS_DESCR
 /begin AXIS_DESCR COM_AXIS NO_INPUT_QUANTITY VBU0513_CM_single_cnt 14 -3.4028234663852886E+38 3.4028234663852886E+38 AXIS_PTS_REF CaSOF_ContinuousDischargeSocTempMapX_C /end AXIS_DESCR
/end CHARACTERISTIC
/begin AXIS_PTS CaSOF_ContinuousDischargeSocTempMapX_C "" 0x70013a46 NO_INPUT_QUANTITY Lookup2D_X_FLOAT32_IEEE 0 VBU0513_CM_single_cnt 14 -3.4028234663852886E+38 3.4028234663852886E+38 /end AXIS_PTS
/begin AXIS_PTS CaSOF_ContinuousDischargeSocTempMapY_pct "" 0x7001358a SOC_pctCellSocMin Lookup2D_X_FLOAT32_IEEE 0 VBU0513_CM_single_cnt 13 -3.4028234663852886E+38 3.4028234663852886E+38 /end AXIS_PTS
/begin CHARACTERISTIC CaSOF_ContinuousDischargeLockedSocTempMapZ_A "" MAP 0x70018ae6 Lookup2D_FLOAT32_IEEE 0 VBU0513_CM_single_cnt -3.4028234663852886E+38 3.4028234663852886E+38
 /begin AXIS_DESCR COM_AXIS NO_INPUT_QUANTITY VBU0513_CM_single_cnt 13 -3.4028234663852886E+38 3.4028234663852886E+38 AXIS_PTS_REF CaSOF_ContinuousDischargeLockedSocTempMapY_pct /end AXIS_DESCR
 /begin AXIS_DESCR COM_AXIS NO_INPUT_QUANTITY VBU0513_CM_single_cnt 14 -3.4028234663852886E+38 3.4028234663852886E+38 AXIS_PTS_REF CaSOF_ContinuousDischargeLockedSocTempMapX_C /end AXIS_DESCR
/end CHARACTERISTIC
/begin AXIS_PTS CaSOF_ContinuousDischargeLockedSocTempMapX_C "" 0x70013a0e NO_INPUT_QUANTITY Lookup2D_X_FLOAT32_IEEE 0 VBU0513_CM_single_cnt 14 -3.4028234663852886E+38 3.4028234663852886E+38 /end AXIS_PTS
/begin AXIS_PTS CaSOF_ContinuousDischargeLockedSocTempMapY_pct "" 0x70013556 NO_INPUT_QUANTITY Lookup2D_X_FLOAT32_IEEE 0 VBU0513_CM_single_cnt 13 -3.4028234663852886E+38 3.4028234663852886E+38 /end AXIS_PTS
/begin CHARACTERISTIC CaSOF_ContinuousDischargeEolSocTempMapZ_A "" MAP 0x7001880e Lookup2D_FLOAT32_IEEE 0 VBU0513_CM_single_cnt -3.4028234663852886E+38 3.4028234663852886E+38
 /begin AXIS_DESCR COM_AXIS NO_INPUT_QUANTITY VBU0513_CM_single_cnt 13 -3.4028234663852886E+38 3.4028234663852886E+38 AXIS_PTS_REF CaSOF_ContinuousDischargeEolSocTempMapY_pct /end AXIS_DESCR
 /begin AXIS_DESCR COM_AXIS NO_INPUT_QUANTITY VBU0513_CM_single_cnt 14 -3.4028234663852886E+38 3.4028234663852886E+38 AXIS_PTS_REF CaSOF_ContinuousDischargeEolSocTempMapX_C /end AXIS_DESCR
/end CHARACTERISTIC
/begin AXIS_PTS CaSOF_ContinuousDischargeEolSocTempMapX_C "" 0x700139d6 NO_INPUT_QUANTITY Lookup2D_X_FLOAT32_IEEE 0 VBU0513_CM_single_cnt 14 -3.4028234663852886E+38 3.4028234663852886E+38 /end AXIS_PTS
/begin AXIS_PTS CaSOF_ContinuousDischargeEolSocTempMapY_pct "" 0x70013522 NO_INPUT_QUANTITY Lookup2D_X_FLOAT32_IEEE 0 VBU0513_CM_single_cnt 13 -3.4028234663852886E+38 3.4028234663852886E+38 /end AXIS_PTS
/begin CHARACTERISTIC CaSOF_ShortPulseChargeEolSocTempMapZ_A "" MAP 0x70017fba Lookup2D_FLOAT32_IEEE 0 VBU0513_CM_single_cnt -3.4028234663852886E+38 3.4028234663852886E+38
 /begin AXIS_DESCR COM_AXIS NO_INPUT_QUANTITY VBU0513_CM_single_cnt 13 -3.4028234663852886E+38 3.4028234663852886E+38 AXIS_PTS_REF CaSOF_ShortPulseChargeEolSocTempMapY_pct /end AXIS_DESCR
 /begin AXIS_DESCR COM_AXIS NO_INPUT_QUANTITY VBU0513_CM_single_cnt 13 -3.4028234663852886E+38 3.4028234663852886E+38 AXIS_PTS_REF CaSOF_ShortPulseChargeEolSocTempMapX_C /end AXIS_DESCR
/end CHARACTERISTIC
/begin AXIS_PTS CaSOF_ShortPulseChargeEolSocTempMapX_C "" 0x70013626 NO_INPUT_QUANTITY Lookup2D_X_FLOAT32_IEEE 0 VBU0513_CM_single_cnt 13 -3.4028234663852886E+38 3.4028234663852886E+38 /end AXIS_PTS
/begin AXIS_PTS CaSOF_ShortPulseChargeEolSocTempMapY_pct "" 0x7001365a NO_INPUT_QUANTITY Lookup2D_X_FLOAT32_IEEE 0 VBU0513_CM_single_cnt 13 -3.4028234663852886E+38 3.4028234663852886E+38 /end AXIS_PTS
/begin CHARACTERISTIC CaSOF_ShortPulseDischargeSocTempMapZ_A "" MAP 0x70019bf6 Lookup2D_FLOAT32_IEEE 0 VBU0513_CM_single_cnt -3.4028234663852886E+38 3.4028234663852886E+38
 /begin AXIS_DESCR COM_AXIS SOC_pctCellSocMin VBU0513_CM_single_cnt 13 -3.4028234663852886E+38 3.4028234663852886E+38 AXIS_PTS_REF CaSOF_ShortPulseDischargeSocTempMapY_pct /end AXIS_DESCR
 /begin AXIS_DESCR COM_AXIS NO_INPUT_QUANTITY VBU0513_CM_single_cnt 14 -3.4028234663852886E+38 3.4028234663852886E+38 AXIS_PTS_REF CaSOF_ShortPulseDischargeSocTempMapX_C /end AXIS_DESCR
/end CHARACTERISTIC
/begin AXIS_PTS CaSOF_ShortPulseDischargeSocTempMapX_C "" 0x70013b5e NO_INPUT_QUANTITY Lookup2D_X_FLOAT32_IEEE 0 VBU0513_CM_single_cnt 14 -3.4028234663852886E+38 3.4028234663852886E+38 /end AXIS_PTS
/begin AXIS_PTS CaSOF_ShortPulseDischargeSocTempMapY_pct "" 0x700136f6 SOC_pctCellSocMin Lookup2D_X_FLOAT32_IEEE 0 VBU0513_CM_single_cnt 13 -3.4028234663852886E+38 3.4028234663852886E+38 /end AXIS_PTS
/begin CHARACTERISTIC CaSOF_ShortPulseDischargeLockedSocTempMapZ_A "" MAP 0x7001991e Lookup2D_FLOAT32_IEEE 0 VBU0513_CM_single_cnt -3.4028234663852886E+38 3.4028234663852886E+38
 /begin AXIS_DESCR COM_AXIS NO_INPUT_QUANTITY VBU0513_CM_single_cnt 13 -3.4028234663852886E+38 3.4028234663852886E+38 AXIS_PTS_REF CaSOF_ShortPulseDischargeLockedSocTempMapY_pct /end AXIS_DESCR
 /begin AXIS_DESCR COM_AXIS NO_INPUT_QUANTITY VBU0513_CM_single_cnt 14 -3.4028234663852886E+38 3.4028234663852886E+38 AXIS_PTS_REF CaSOF_ShortPulseDischargeLockedSocTempMapX_C /end AXIS_DESCR
/end CHARACTERISTIC
/begin AXIS_PTS CaSOF_ShortPulseDischargeLockedSocTempMapX_C "" 0x70013b26 NO_INPUT_QUANTITY Lookup2D_X_FLOAT32_IEEE 0 VBU0513_CM_single_cnt 14 -3.4028234663852886E+38 3.4028234663852886E+38 /end AXIS_PTS
/begin AXIS_PTS CaSOF_ShortPulseDischargeLockedSocTempMapY_pct "" 0x700136c2 NO_INPUT_QUANTITY Lookup2D_X_FLOAT32_IEEE 0 VBU0513_CM_single_cnt 13 -3.4028234663852886E+38 3.4028234663852886E+38 /end AXIS_PTS
/begin CHARACTERISTIC CaSOF_ShortPulseDischargeEolSocTempMapZ_A "" MAP 0x70019646 Lookup2D_FLOAT32_IEEE 0 VBU0513_CM_single_cnt -3.4028234663852886E+38 3.4028234663852886E+38
 /begin AXIS_DESCR COM_AXIS NO_INPUT_QUANTITY VBU0513_CM_single_cnt 13 -3.4028234663852886E+38 3.4028234663852886E+38 AXIS_PTS_REF CaSOF_ShortPulseDischargeEolSocTempMapY_pct /end AXIS_DESCR
 /begin AXIS_DESCR COM_AXIS NO_INPUT_QUANTITY VBU0513_CM_single_cnt 14 -3.4028234663852886E+38 3.4028234663852886E+38 AXIS_PTS_REF CaSOF_ShortPulseDischargeEolSocTempMapX_C /end AXIS_DESCR
/end CHARACTERISTIC
/begin AXIS_PTS CaSOF_ShortPulseDischargeEolSocTempMapX_C "" 0x70013aee NO_INPUT_QUANTITY Lookup2D_X_FLOAT32_IEEE 0 VBU0513_CM_single_cnt 14 -3.4028234663852886E+38 3.4028234663852886E+38 /end AXIS_PTS
/begin AXIS_PTS CaSOF_ShortPulseDischargeEolSocTempMapY_pct "" 0x7001368e NO_INPUT_QUANTITY Lookup2D_X_FLOAT32_IEEE 0 VBU0513_CM_single_cnt 13 -3.4028234663852886E+38 3.4028234663852886E+38 /end AXIS_PTS
/begin CHARACTERISTIC CaSOF_ContinuousChargeSocTempMapZ_A "" MAP 0x7001d54e Lookup2D_FLOAT32_IEEE 0 VBU0513_CM_single_A 0.0 200.0
 /begin AXIS_DESCR COM_AXIS NO_INPUT_QUANTITY VBU0513_CM_single_pct 22 0.0 100.0 AXIS_PTS_REF CaSOF_ContinuousChargeSocTempMapY_pct /end AXIS_DESCR
 /begin AXIS_DESCR COM_AXIS NO_INPUT_QUANTITY VBU0513_CM_single_t 21 -40.0 120.0 AXIS_PTS_REF CaSOF_ContinuousChargeSocTempMapX_C /end AXIS_DESCR
/end CHARACTERISTIC
/begin AXIS_PTS CaSOF_ContinuousChargeSocTempMapX_C "" 0x700144f2 NO_INPUT_QUANTITY Lookup2D_X_FLOAT32_IEEE 0 VBU0513_CM_single_t 21 -40.0 120.0 /end AXIS_PTS
/begin AXIS_PTS CaSOF_ContinuousChargeSocTempMapY_pct "" 0x70014a8a NO_INPUT_QUANTITY Lookup2D_X_FLOAT32_IEEE 0 VBU0513_CM_single_pct 22 0.0 100.0 /end AXIS_PTS
/begin CHARACTERISTIC CaSOF_FastChargeCurrentDropEOLCellVoltageMapZ_mV "" MAP 0x70014c44 Lookup2D_UWORD 0 VBU0513_CM_uint16_cnt 0.0 65535.0
 /begin AXIS_DESCR COM_AXIS NO_INPUT_QUANTITY VBU0513_CM_single_cnt 5 -3.4028234663852886E+38 3.4028234663852886E+38 AXIS_PTS_REF CaSOF_FastChargeCurrentDropEOLCellVoltageMapY_pct /end AXIS_DESCR
 /begin AXIS_DESCR COM_AXIS NO_INPUT_QUANTITY VBU0513_CM_single_cnt 9 -3.4028234663852886E+38 3.4028234663852886E+38 AXIS_PTS_REF CaSOF_FastChargeCurrentDropEOLCellVoltageMapX_C /end AXIS_DESCR
/end CHARACTERISTIC
/begin AXIS_PTS CaSOF_FastChargeCurrentDropEOLCellVoltageMapX_C "" 0x7001288e NO_INPUT_QUANTITY Lookup2D_X_FLOAT32_IEEE 0 VBU0513_CM_single_cnt 9 -3.4028234663852886E+38 3.4028234663852886E+38 /end AXIS_PTS
/begin AXIS_PTS CaSOF_FastChargeCurrentDropEOLCellVoltageMapY_pct "" 0x70011e12 NO_INPUT_QUANTITY Lookup2D_X_FLOAT32_IEEE 0 VBU0513_CM_single_cnt 5 -3.4028234663852886E+38 3.4028234663852886E+38 /end AXIS_PTS
/begin CHARACTERISTIC CaSOF_FastChargeCurrentDropBOLCellVoltageMapZ_mV "" MAP 0x70014bea Lookup2D_UWORD 0 VBU0513_CM_uint16_cnt 0.0 65535.0
 /begin AXIS_DESCR COM_AXIS NO_INPUT_QUANTITY VBU0513_CM_single_cnt 5 -3.4028234663852886E+38 3.4028234663852886E+38 AXIS_PTS_REF CaSOF_FastChargeCurrentDropBOLCellVoltageMapY_pct /end AXIS_DESCR
 /begin AXIS_DESCR COM_AXIS NO_INPUT_QUANTITY VBU0513_CM_single_cnt 9 -3.4028234663852886E+38 3.4028234663852886E+38 AXIS_PTS_REF CaSOF_FastChargeCurrentDropBOLCellVoltageMapX_C /end AXIS_DESCR
/end CHARACTERISTIC
/begin AXIS_PTS CaSOF_FastChargeCurrentDropBOLCellVoltageMapX_C "" 0x7001286a NO_INPUT_QUANTITY Lookup2D_X_FLOAT32_IEEE 0 VBU0513_CM_single_cnt 9 -3.4028234663852886E+38 3.4028234663852886E+38 /end AXIS_PTS
/begin AXIS_PTS CaSOF_FastChargeCurrentDropBOLCellVoltageMapY_pct "" 0x70011dfe NO_INPUT_QUANTITY Lookup2D_X_FLOAT32_IEEE 0 VBU0513_CM_single_cnt 5 -3.4028234663852886E+38 3.4028234663852886E+38 /end AXIS_PTS
/begin CHARACTERISTIC CaSOH_DecreaseCapacityMapY_pct "" CURVE 0x70011e76 Lookup1D_FLOAT32_IEEE 0 VBU0513_CM_single_cnt -3.4028234663852886E+38 3.4028234663852886E+38
 /begin AXIS_DESCR COM_AXIS NO_INPUT_QUANTITY VBU0513_CM_single_cnt 5 -3.4028234663852886E+38 3.4028234663852886E+38 AXIS_PTS_REF CaSOH_DecreaseCapacityMapX_Ah /end AXIS_DESCR
/end CHARACTERISTIC
/begin AXIS_PTS CaSOH_DecreaseCapacityMapX_Ah "" 0x70011e62 NO_INPUT_QUANTITY Lookup1D_X_FLOAT32_IEEE 0 VBU0513_CM_single_cnt 5 -3.4028234663852886E+38 3.4028234663852886E+38 /end AXIS_PTS
/begin CHARACTERISTIC DSPL_facEnergyFactorSOCUpdate_CUR_v "" CURVE 0x70011f2a Lookup1D_FLOAT32_IEEE 0 VBU0513_CM_single_fac 0.0 1.0
 /begin AXIS_DESCR COM_AXIS NO_INPUT_QUANTITY VBU0513_CM_single_fac 5 0.0 1.0 AXIS_PTS_REF DSPL_facEnergyFactorSOCUpdate_CUR_x /end AXIS_DESCR
/end CHARACTERISTIC
/begin AXIS_PTS DSPL_facEnergyFactorSOCUpdate_CUR_x "" 0x70011f3e NO_INPUT_QUANTITY Lookup1D_X_FLOAT32_IEEE 0 VBU0513_CM_single_fac 5 0.0 1.0 /end AXIS_PTS
/begin CHARACTERISTIC EDIS_pwrDecGradSprt_MAP_v "" MAP 0x7001b1de Lookup2D_FLOAT32_IEEE 0 VBU0513_CM_single_cnt -3.4028234663852886E+38 3.4028234663852886E+38
 /begin AXIS_DESCR COM_AXIS TQO_trqRMotr VBU0513_CM_single_cnt 13 -3.4028234663852886E+38 3.4028234663852886E+38 AXIS_PTS_REF EDIS_trqDecGradSprt_MAP_y /end AXIS_DESCR
 /begin AXIS_DESCR COM_AXIS SPD_vVehSpd VBU0513_CM_single_cnt 17 -3.4028234663852886E+38 3.4028234663852886E+38 AXIS_PTS_REF EDIS_vDecGradSprt_MAP_x /end AXIS_DESCR
/end CHARACTERISTIC
/begin AXIS_PTS EDIS_vDecGradSprt_MAP_x "" 0x70013ea6 SPD_vVehSpd Lookup2D_X_FLOAT32_IEEE 0 VBU0513_CM_single_cnt 17 -3.4028234663852886E+38 3.4028234663852886E+38 /end AXIS_PTS
/begin AXIS_PTS EDIS_trqDecGradSprt_MAP_y "" 0x7001382e TQO_trqRMotr Lookup2D_X_FLOAT32_IEEE 0 VBU0513_CM_single_cnt 13 -3.4028234663852886E+38 3.4028234663852886E+38 /end AXIS_PTS
/begin CHARACTERISTIC EDIS_facMaxBMSDisCh_CUR_v "" CURVE 0x70012b9e Lookup1D_FLOAT32_IEEE 0 VBU0513_CM_single_cnt -3.4028234663852886E+38 3.4028234663852886E+38
 /begin AXIS_DESCR COM_AXIS NO_INPUT_QUANTITY VBU0513_CM_single_cnt 10 -3.4028234663852886E+38 3.4028234663852886E+38 AXIS_PTS_REF EDIS_tMaxBMSDisCh_CUR_x /end AXIS_DESCR
/end CHARACTERISTIC
/begin AXIS_PTS EDIS_tMaxBMSDisCh_CUR_x "" 0x70012c3e NO_INPUT_QUANTITY Lookup1D_X_FLOAT32_IEEE 0 VBU0513_CM_single_cnt 10 -3.4028234663852886E+38 3.4028234663852886E+38 /end AXIS_PTS
/begin CHARACTERISTIC EDIS_facMinBMSDisCh_CUR_v "" CURVE 0x70012bee Lookup1D_FLOAT32_IEEE 0 VBU0513_CM_single_cnt -3.4028234663852886E+38 3.4028234663852886E+38
 /begin AXIS_DESCR COM_AXIS NO_INPUT_QUANTITY VBU0513_CM_single_cnt 10 -3.4028234663852886E+38 3.4028234663852886E+38 AXIS_PTS_REF EDIS_tMinBMSDisCh_CUR_x /end AXIS_DESCR
/end CHARACTERISTIC
/begin AXIS_PTS EDIS_tMinBMSDisCh_CUR_x "" 0x70012c8e NO_INPUT_QUANTITY Lookup1D_X_FLOAT32_IEEE 0 VBU0513_CM_single_cnt 10 -3.4028234663852886E+38 3.4028234663852886E+38 /end AXIS_PTS
/begin CHARACTERISTIC EDIS_facBMSSOCDisCh_CUR_v "" CURVE 0x70012e3a Lookup1D_FLOAT32_IEEE 0 VBU0513_CM_single_cnt -3.4028234663852886E+38 3.4028234663852886E+38
 /begin AXIS_DESCR COM_AXIS NO_INPUT_QUANTITY VBU0513_CM_single_cnt 11 -3.4028234663852886E+38 3.4028234663852886E+38 AXIS_PTS_REF EDIS_pctBMSSOCDisCh_CUR_x /end AXIS_DESCR
/end CHARACTERISTIC
/begin AXIS_PTS EDIS_pctBMSSOCDisCh_CUR_x "" 0x70012f16 NO_INPUT_QUANTITY Lookup1D_X_FLOAT32_IEEE 0 VBU0513_CM_single_cnt 11 -3.4028234663852886E+38 3.4028234663852886E+38 /end AXIS_PTS
/begin CHARACTERISTIC EDIS_facDisChPwrDeltaBaseDiff_CUR_v "" CURVE 0x7001427e Lookup1D_FLOAT32_IEEE 0 VBU0513_CM_single_cnt -3.4028234663852886E+38 3.4028234663852886E+38
 /begin AXIS_DESCR COM_AXIS NO_INPUT_QUANTITY VBU0513_CM_single_cnt 19 -3.4028234663852886E+38 3.4028234663852886E+38 AXIS_PTS_REF EDIS_pwrDisChPwrDeltaBaseDiff_CUR_x /end AXIS_DESCR
/end CHARACTERISTIC
/begin AXIS_PTS EDIS_pwrDisChPwrDeltaBaseDiff_CUR_x "" 0x70014316 NO_INPUT_QUANTITY Lookup1D_X_FLOAT32_IEEE 0 VBU0513_CM_single_cnt 19 -3.4028234663852886E+38 3.4028234663852886E+38 /end AXIS_PTS
/begin CHARACTERISTIC EDIS_pwrSpBaseDchDyn_CUR_v "" CURVE 0x70011d0a Lookup1D_FLOAT32_IEEE 0 VBU0513_CM_single_cnt -3.4028234663852886E+38 3.4028234663852886E+38
 /begin AXIS_DESCR COM_AXIS EDIS_pwrDisChLimDynST VBU0513_CM_single_cnt 4 -3.4028234663852886E+38 3.4028234663852886E+38 AXIS_PTS_REF EDIS_pwrSpBaseDchDyn_CUR_x /end AXIS_DESCR
/end CHARACTERISTIC
/begin AXIS_PTS EDIS_pwrSpBaseDchDyn_CUR_x "" 0x70011d1a EDIS_pwrDisChLimDynST Lookup1D_X_FLOAT32_IEEE 0 VBU0513_CM_single_cnt 4 -3.4028234663852886E+38 3.4028234663852886E+38 /end AXIS_PTS
/begin CHARACTERISTIC TQDIS_pctShftChngLimThres_CUR_v "" CURVE 0x7001240a Lookup1D_FLOAT32_IEEE 0 VBU0513_CM_single_cnt -3.4028234663852886E+38 3.4028234663852886E+38
 /begin AXIS_DESCR COM_AXIS SPD_vVehSpd VBU0513_CM_single_cnt 6 -3.4028234663852886E+38 3.4028234663852886E+38 AXIS_PTS_REF TQDIS_vShftChngLimThres_CUR_x /end AXIS_DESCR
/end CHARACTERISTIC
/begin AXIS_PTS TQDIS_vShftChngLimThres_CUR_x "" 0x70012422 SPD_vVehSpd Lookup1D_X_FLOAT32_IEEE 0 VBU0513_CM_single_cnt 6 -3.4028234663852886E+38 3.4028234663852886E+38 /end AXIS_PTS
/begin CHARACTERISTIC TQDIS_facShftChngLim_CUR_v "" CURVE 0x700123f2 Lookup1D_FLOAT32_IEEE 0 VBU0513_CM_single_cnt -3.4028234663852886E+38 3.4028234663852886E+38
 /begin AXIS_DESCR COM_AXIS SPD_vVehSpd VBU0513_CM_single_cnt 6 -3.4028234663852886E+38 3.4028234663852886E+38 AXIS_PTS_REF TQDIS_vShftChngLim_CUR_x /end AXIS_DESCR
/end CHARACTERISTIC
/begin AXIS_PTS TQDIS_vShftChngLim_CUR_x "" 0x7001243a SPD_vVehSpd Lookup1D_X_FLOAT32_IEEE 0 VBU0513_CM_single_cnt 6 -3.4028234663852886E+38 3.4028234663852886E+38 /end AXIS_PTS
/begin CHARACTERISTIC TQDIS_facShftDR_CUR_v "" CURVE 0x700132ce Lookup1D_FLOAT32_IEEE 0 VBU0513_CM_single_pct 0.0 20.0
 /begin AXIS_DESCR COM_AXIS NO_INPUT_QUANTITY VBU0513_CM_single_Nm 12 0.0 1000.0 AXIS_PTS_REF TQDIS_trqShftDR_CUR_x /end AXIS_DESCR
/end CHARACTERISTIC
/begin AXIS_PTS TQDIS_trqShftDR_CUR_x "" 0x7001335e NO_INPUT_QUANTITY Lookup1D_X_FLOAT32_IEEE 0 VBU0513_CM_single_Nm 12 0.0 1000.0 /end AXIS_PTS
/begin CHARACTERISTIC TQDIS_facAccPedFilter_CUR_v "" CURVE 0x7001207e Lookup1D_FLOAT32_IEEE 0 VBU0513_CM_single_cnt -3.4028234663852886E+38 3.4028234663852886E+38
 /begin AXIS_DESCR COM_AXIS APD_pctAccPedPos VBU0513_CM_single_cnt 5 -3.4028234663852886E+38 3.4028234663852886E+38 AXIS_PTS_REF TQDIS_pctAccPedFilter_CUR_x /end AXIS_DESCR
/end CHARACTERISTIC
/begin AXIS_PTS TQDIS_pctAccPedFilter_CUR_x "" 0x70012092 APD_pctAccPedPos Lookup1D_X_FLOAT32_IEEE 0 VBU0513_CM_single_cnt 5 -3.4028234663852886E+38 3.4028234663852886E+38 /end AXIS_PTS
/begin CHARACTERISTIC TQDIS_facDrvLo_CUR_y "" CURVE 0x70011d2a Lookup1D_FLOAT32_IEEE 0 VBU0513_CM_single_pct 0.0 1.0
 /begin AXIS_DESCR COM_AXIS NO_INPUT_QUANTITY VBU0513_CM_single_kw 4 0.0 150.0 AXIS_PTS_REF TQDIS_pwrDrvLo_CUR_x /end AXIS_DESCR
/end CHARACTERISTIC
/begin AXIS_PTS TQDIS_pwrDrvLo_CUR_x "" 0x70011d5a NO_INPUT_QUANTITY Lookup1D_X_FLOAT32_IEEE 0 VBU0513_CM_single_kw 4 0.0 150.0 /end AXIS_PTS
/begin CHARACTERISTIC TQDIS_facRgnLo_CUR_y "" CURVE 0x70011d3a Lookup1D_FLOAT32_IEEE 0 VBU0513_CM_single_pct 0.0 1.0
 /begin AXIS_DESCR COM_AXIS NO_INPUT_QUANTITY VBU0513_CM_single_kw 4 0.0 150.0 AXIS_PTS_REF TQDIS_pwrRgnLo_CUR_x /end AXIS_DESCR
/end CHARACTERISTIC
/begin AXIS_PTS TQDIS_pwrRgnLo_CUR_x "" 0x70011d6a NO_INPUT_QUANTITY Lookup1D_X_FLOAT32_IEEE 0 VBU0513_CM_single_kw 4 0.0 150.0 /end AXIS_PTS
/begin CHARACTERISTIC TQDIS_facBrkSlpCrp_MAP_v "" MAP 0x7001329e Lookup2D_FLOAT32_IEEE 0 VBU0513_CM_single_cnt -3.4028234663852886E+38 3.4028234663852886E+38
 /begin AXIS_DESCR COM_AXIS SPD_pctSlope VBU0513_CM_single_cnt 3 -3.4028234663852886E+38 3.4028234663852886E+38 AXIS_PTS_REF TQDIS_facSlpCrp_MAP_y /end AXIS_DESCR
 /begin AXIS_DESCR COM_AXIS BPD_pctBrkPos VBU0513_CM_single_cnt 4 -3.4028234663852886E+38 3.4028234663852886E+38 AXIS_PTS_REF TQDIS_pctBrkCrp_MAP_x /end AXIS_DESCR
/end CHARACTERISTIC
/begin AXIS_PTS TQDIS_pctBrkCrp_MAP_x "" 0x70011d4a BPD_pctBrkPos Lookup2D_X_FLOAT32_IEEE 0 VBU0513_CM_single_cnt 4 -3.4028234663852886E+38 3.4028234663852886E+38 /end AXIS_PTS
/begin AXIS_PTS TQDIS_facSlpCrp_MAP_y "" 0x70011bac SPD_pctSlope Lookup2D_X_FLOAT32_IEEE 0 VBU0513_CM_single_cnt 3 -3.4028234663852886E+38 3.4028234663852886E+38 /end AXIS_PTS
/begin CHARACTERISTIC TQDIS_facBrkDec_MAP_v "" MAP 0x700173de Lookup2D_FLOAT32_IEEE 0 VBU0513_CM_single_cnt -3.4028234663852886E+38 3.4028234663852886E+38
 /begin AXIS_DESCR COM_AXIS SPD_vVehSpd VBU0513_CM_single_cnt 13 -3.4028234663852886E+38 3.4028234663852886E+38 AXIS_PTS_REF TQDIS_vBrkDec_MAP_y /end AXIS_DESCR
 /begin AXIS_DESCR COM_AXIS BPD_pctBrkPos VBU0513_CM_single_cnt 11 -3.4028234663852886E+38 3.4028234663852886E+38 AXIS_PTS_REF TQDIS_pctBrkDec_MAP_x /end AXIS_DESCR
/end CHARACTERISTIC
/begin AXIS_PTS TQDIS_pctBrkDec_MAP_x "" 0x70012f42 BPD_pctBrkPos Lookup2D_X_FLOAT32_IEEE 0 VBU0513_CM_single_cnt 11 -3.4028234663852886E+38 3.4028234663852886E+38 /end AXIS_PTS
/begin AXIS_PTS TQDIS_vBrkDec_MAP_y "" 0x70013862 SPD_vVehSpd Lookup2D_X_FLOAT32_IEEE 0 VBU0513_CM_single_cnt 13 -3.4028234663852886E+38 3.4028234663852886E+38 /end AXIS_PTS
/begin CHARACTERISTIC TQDIS_trqCrpBase_MAP_v "" MAP 0x700132fe Lookup2D_FLOAT32_IEEE 0 VBU0513_CM_single_cnt -3.4028234663852886E+38 3.4028234663852886E+38
 /begin AXIS_DESCR COM_AXIS NO_INPUT_QUANTITY VBU0513_CM_single_cnt 3 -3.4028234663852886E+38 3.4028234663852886E+38 AXIS_PTS_REF TQDIS_stCrpBase_MAP_y /end AXIS_DESCR
 /begin AXIS_DESCR COM_AXIS SPD_vVehSpd VBU0513_CM_single_cnt 4 -3.4028234663852886E+38 3.4028234663852886E+38 AXIS_PTS_REF TQDIS_vCrpBase_MAP_x /end AXIS_DESCR
/end CHARACTERISTIC
/begin AXIS_PTS TQDIS_vCrpBase_MAP_x "" 0x70011d8a SPD_vVehSpd Lookup2D_X_FLOAT32_IEEE 0 VBU0513_CM_single_cnt 4 -3.4028234663852886E+38 3.4028234663852886E+38 /end AXIS_PTS
/begin AXIS_PTS TQDIS_stCrpBase_MAP_y "" 0x70011bb8 NO_INPUT_QUANTITY Lookup2D_X_FLOAT32_IEEE 0 VBU0513_CM_single_cnt 3 -3.4028234663852886E+38 3.4028234663852886E+38 /end AXIS_PTS
/begin CHARACTERISTIC TQDIS_trqDecGradECORA_MAP_v "" MAP 0x700156fa Lookup2D_FLOAT32_IEEE 0 VBU0513_CM_single_Nm -500.0 500.0
 /begin AXIS_DESCR COM_AXIS NO_INPUT_QUANTITY VBU0513_CM_single_Nm 12 -3000.0 5000.0 AXIS_PTS_REF TQDIS_trqDecGrad_MAP_y /end AXIS_DESCR
 /begin AXIS_DESCR COM_AXIS SPD_vVehSpd VBU0513_CM_single_kph 7 0.0 140.0 AXIS_PTS_REF TQDIS_vDecGrad_MAP_x /end AXIS_DESCR
/end CHARACTERISTIC
/begin AXIS_PTS TQDIS_vDecGrad_MAP_x "" 0x7001259a SPD_vVehSpd Lookup2D_X_FLOAT32_IEEE 0 VBU0513_CM_single_kph 7 0.0 140.0 /end AXIS_PTS
/begin AXIS_PTS TQDIS_trqDecGrad_MAP_y "" 0x7001332e NO_INPUT_QUANTITY Lookup2D_X_FLOAT32_IEEE 0 VBU0513_CM_single_Nm 12 -3000.0 5000.0 /end AXIS_PTS
/begin CHARACTERISTIC TQDIS_facAccPdlECORA_MAP_v "" MAP 0x7001b552 Lookup2D_FLOAT32_IEEE 0 VBU0513_CM_single_cnt -3.4028234663852886E+38 3.4028234663852886E+38
 /begin AXIS_DESCR COM_AXIS SPD_vVehSpd VBU0513_CM_single_cnt 15 -3.4028234663852886E+38 3.4028234663852886E+38 AXIS_PTS_REF TQDIS_vVehAccPdl_MAP_y /end AXIS_DESCR
 /begin AXIS_DESCR COM_AXIS APD_pctAccPedPos VBU0513_CM_single_cnt 15 -3.4028234663852886E+38 3.4028234663852886E+38 AXIS_PTS_REF TQDIS_pctAccPdl_MAP_x /end AXIS_DESCR
/end CHARACTERISTIC
/begin AXIS_PTS TQDIS_pctAccPdl_MAP_x "" 0x70013d26 APD_pctAccPedPos Lookup2D_X_FLOAT32_IEEE 0 VBU0513_CM_single_cnt 15 -3.4028234663852886E+38 3.4028234663852886E+38 /end AXIS_PTS
/begin AXIS_PTS TQDIS_vVehAccPdl_MAP_y "" 0x70013d62 SPD_vVehSpd Lookup2D_X_FLOAT32_IEEE 0 VBU0513_CM_single_cnt 15 -3.4028234663852886E+38 3.4028234663852886E+38 /end AXIS_PTS
/begin CHARACTERISTIC TQDIS_facAPDTrqECORA_MAP_v "" MAP 0x7001dc86 Lookup2D_FLOAT32_IEEE 0 VBU0513_CM_single_cnt -3.4028234663852886E+38 3.4028234663852886E+38
 /begin AXIS_DESCR COM_AXIS APD_pctAccPedPos VBU0513_CM_single_cnt 15 -3.4028234663852886E+38 3.4028234663852886E+38 AXIS_PTS_REF TQDIS_pctAPDTrq_MAP_y /end AXIS_DESCR
 /begin AXIS_DESCR COM_AXIS NO_INPUT_QUANTITY VBU0513_CM_single_cnt 31 -3.4028234663852886E+38 3.4028234663852886E+38 AXIS_PTS_REF TQDIS_trqAPDTrq_MAP_x /end AXIS_DESCR
/end CHARACTERISTIC
/begin AXIS_PTS TQDIS_trqAPDTrq_MAP_x "" 0x70014f6e NO_INPUT_QUANTITY Lookup2D_X_FLOAT32_IEEE 0 VBU0513_CM_single_cnt 31 -3.4028234663852886E+38 3.4028234663852886E+38 /end AXIS_PTS
/begin AXIS_PTS TQDIS_pctAPDTrq_MAP_y "" 0x70013cea APD_pctAccPedPos Lookup2D_X_FLOAT32_IEEE 0 VBU0513_CM_single_cnt 15 -3.4028234663852886E+38 3.4028234663852886E+38 /end AXIS_PTS
/begin CHARACTERISTIC TQDIS_trqIncGradECORA_MAP_v "" MAP 0x7001c94e Lookup2D_FLOAT32_IEEE 0 VBU0513_CM_single_cnt -3.4028234663852886E+38 3.4028234663852886E+38
 /begin AXIS_DESCR COM_AXIS NO_INPUT_QUANTITY VBU0513_CM_single_cnt 41 -3.4028234663852886E+38 3.4028234663852886E+38 AXIS_PTS_REF TQDIS_trqIncGrad_MAP_y /end AXIS_DESCR
 /begin AXIS_DESCR COM_AXIS SPD_vVehSpd VBU0513_CM_single_cnt 9 -3.4028234663852886E+38 3.4028234663852886E+38 AXIS_PTS_REF TQDIS_vIncGrad_MAP_x /end AXIS_DESCR
/end CHARACTERISTIC
/begin AXIS_PTS TQDIS_vIncGrad_MAP_x "" 0x7001298a SPD_vVehSpd Lookup2D_X_FLOAT32_IEEE 0 VBU0513_CM_single_cnt 9 -3.4028234663852886E+38 3.4028234663852886E+38 /end AXIS_PTS
/begin AXIS_PTS TQDIS_trqIncGrad_MAP_y "" 0x70015106 NO_INPUT_QUANTITY Lookup2D_X_FLOAT32_IEEE 0 VBU0513_CM_single_cnt 41 -3.4028234663852886E+38 3.4028234663852886E+38 /end AXIS_PTS
/begin CHARACTERISTIC TQDMP_facDeltaRPMFAC1_CUR_v "" CURVE 0x700120ce Lookup1D_FLOAT32_IEEE 0 VBU0513_CM_single_cnt -3.4028234663852886E+38 3.4028234663852886E+38
 /begin AXIS_DESCR COM_AXIS NO_INPUT_QUANTITY VBU0513_CM_single_cnt 5 -3.4028234663852886E+38 3.4028234663852886E+38 AXIS_PTS_REF TQDMP_facDeltaRPMFAC1_CUR_x /end AXIS_DESCR
/end CHARACTERISTIC
/begin AXIS_PTS TQDMP_facDeltaRPMFAC1_CUR_x "" 0x700120e2 NO_INPUT_QUANTITY Lookup1D_X_FLOAT32_IEEE 0 VBU0513_CM_single_cnt 5 -3.4028234663852886E+38 3.4028234663852886E+38 /end AXIS_PTS
/begin CHARACTERISTIC CaSOF_VoltageCorrectFactorRegenMapY_n "" CURVE 0x70011e4e Lookup1D_FLOAT32_IEEE 0 VBU0513_CM_single_cnt -3.4028234663852886E+38 3.4028234663852886E+38
 /begin AXIS_DESCR COM_AXIS NO_INPUT_QUANTITY VBU0513_CM_uint16_cnt 5 0.0 65535.0 AXIS_PTS_REF CaSOF_VoltageCorrectFactorRegenMapX_mV /end AXIS_DESCR
/end CHARACTERISTIC
/begin AXIS_PTS CaSOF_VoltageCorrectFactorRegenMapX_mV "" 0x70011b1e NO_INPUT_QUANTITY Lookup1D_X_UWORD 0 VBU0513_CM_uint16_cnt 5 0.0 65535.0 /end AXIS_PTS
/begin CHARACTERISTIC CaSOF_VoltageCorrectFactorDischargeMapY_n "" CURVE 0x70011e3a Lookup1D_FLOAT32_IEEE 0 VBU0513_CM_single_cnt -3.4028234663852886E+38 3.4028234663852886E+38
 /begin AXIS_DESCR COM_AXIS NO_INPUT_QUANTITY VBU0513_CM_uint16_cnt 5 0.0 65535.0 AXIS_PTS_REF CaSOF_VoltageCorrectFactorDischargeMapX_mV /end AXIS_DESCR
/end CHARACTERISTIC
/begin AXIS_PTS CaSOF_VoltageCorrectFactorDischargeMapX_mV "" 0x70011b14 NO_INPUT_QUANTITY Lookup1D_X_UWORD 0 VBU0513_CM_uint16_cnt 5 0.0 65535.0 /end AXIS_PTS
/begin CHARACTERISTIC CaSOF_LowTempDischargeVoltageCorrectFactorMapY_n "" CURVE 0x70011aa2 Lookup1D_FLOAT32_IEEE 0 VBU0513_CM_single_cnt -3.4028234663852886E+38 3.4028234663852886E+38
 /begin AXIS_DESCR COM_AXIS CTM_tCellTempMin VBU0513_CM_single_cnt 2 -3.4028234663852886E+38 3.4028234663852886E+38 AXIS_PTS_REF CaSOF_LowTempDischargeVoltageCorrectFactorMapX_C /end AXIS_DESCR
/end CHARACTERISTIC
/begin AXIS_PTS CaSOF_LowTempDischargeVoltageCorrectFactorMapX_C "" 0x70011a9a CTM_tCellTempMin Lookup1D_X_FLOAT32_IEEE 0 VBU0513_CM_single_cnt 2 -3.4028234663852886E+38 3.4028234663852886E+38 /end AXIS_PTS
/begin CHARACTERISTIC CaSOF_VoltageCorrectFactorChargeMapY_n "" CURVE 0x70011e26 Lookup1D_FLOAT32_IEEE 0 VBU0513_CM_single_cnt -3.4028234663852886E+38 3.4028234663852886E+38
 /begin AXIS_DESCR COM_AXIS NO_INPUT_QUANTITY VBU0513_CM_uint16_cnt 5 0.0 65535.0 AXIS_PTS_REF CaSOF_VoltageCorrectFactorChargeMapX_mV /end AXIS_DESCR
/end CHARACTERISTIC
/begin AXIS_PTS CaSOF_VoltageCorrectFactorChargeMapX_mV "" 0x70011b0a NO_INPUT_QUANTITY Lookup1D_X_UWORD 0 VBU0513_CM_uint16_cnt 5 0.0 65535.0 /end AXIS_PTS
/begin CHARACTERISTIC CaSOF_VoltageCorrectCellVoltMinMapY_V "" CURVE 0x70011cba Lookup1D_FLOAT32_IEEE 0 VBU0513_CM_single_cnt -3.4028234663852886E+38 3.4028234663852886E+38
 /begin AXIS_DESCR COM_AXIS CTM_tCellTempMin VBU0513_CM_single_cnt 4 -3.4028234663852886E+38 3.4028234663852886E+38 AXIS_PTS_REF CaSOF_VoltageCorrectCellVoltMinMapX_C /end AXIS_DESCR
/end CHARACTERISTIC
/begin AXIS_PTS CaSOF_VoltageCorrectCellVoltMinMapX_C "" 0x70011caa CTM_tCellTempMin Lookup1D_X_FLOAT32_IEEE 0 VBU0513_CM_single_cnt 4 -3.4028234663852886E+38 3.4028234663852886E+38 /end AXIS_PTS
/begin CHARACTERISTIC CaSOF_DischargeOcvSocTempMapZ_V "" MAP 0x70019ece Lookup2D_FLOAT32_IEEE 0 VBU0513_CM_single_cnt -3.4028234663852886E+38 3.4028234663852886E+38
 /begin AXIS_DESCR COM_AXIS SOC_pctCellSocMin VBU0513_CM_single_cnt 21 -3.4028234663852886E+38 3.4028234663852886E+38 AXIS_PTS_REF CaSOF_DischargeOcvSocTempMapY_pct /end AXIS_DESCR
 /begin AXIS_DESCR COM_AXIS CTM_tCellTempMin VBU0513_CM_single_cnt 9 -3.4028234663852886E+38 3.4028234663852886E+38 AXIS_PTS_REF CaSOF_DischargeOcvSocTempMapX_C /end AXIS_DESCR
/end CHARACTERISTIC
/begin AXIS_PTS CaSOF_DischargeOcvSocTempMapX_C "" 0x70012846 CTM_tCellTempMin Lookup2D_X_FLOAT32_IEEE 0 VBU0513_CM_single_cnt 9 -3.4028234663852886E+38 3.4028234663852886E+38 /end AXIS_PTS
/begin AXIS_PTS CaSOF_DischargeOcvSocTempMapY_pct "" 0x70014546 SOC_pctCellSocMin Lookup2D_X_FLOAT32_IEEE 0 VBU0513_CM_single_cnt 21 -3.4028234663852886E+38 3.4028234663852886E+38 /end AXIS_PTS
/begin CHARACTERISTIC CaSOF_DischargeDcirSocTempMapZ_mOhm "" MAP 0x700155f2 Lookup2D_FLOAT32_IEEE 0 VBU0513_CM_single_cnt -3.4028234663852886E+38 3.4028234663852886E+38
 /begin AXIS_DESCR COM_AXIS SOC_pctCellSocMin VBU0513_CM_single_cnt 11 -3.4028234663852886E+38 3.4028234663852886E+38 AXIS_PTS_REF CaSOF_DischargeDcirSocTempMapY_pct /end AXIS_DESCR
 /begin AXIS_DESCR COM_AXIS CTM_tCellTempMin VBU0513_CM_single_cnt 6 -3.4028234663852886E+38 3.4028234663852886E+38 AXIS_PTS_REF CaSOF_DischargeDcirSocTempMapX_C /end AXIS_DESCR
/end CHARACTERISTIC
/begin AXIS_PTS CaSOF_DischargeDcirSocTempMapX_C "" 0x700121b2 CTM_tCellTempMin Lookup2D_X_FLOAT32_IEEE 0 VBU0513_CM_single_cnt 6 -3.4028234663852886E+38 3.4028234663852886E+38 /end AXIS_PTS
/begin AXIS_PTS CaSOF_DischargeDcirSocTempMapY_pct "" 0x70012de2 SOC_pctCellSocMin Lookup2D_X_FLOAT32_IEEE 0 VBU0513_CM_single_cnt 11 -3.4028234663852886E+38 3.4028234663852886E+38 /end AXIS_PTS
/begin CHARACTERISTIC CaSOH_UdResisMapZ_mohm "" MAP 0x70016d36 Lookup2D_FLOAT32_IEEE 0 VBU0513_CM_single_cnt -3.4028234663852886E+38 3.4028234663852886E+38
 /begin AXIS_DESCR COM_AXIS NO_INPUT_QUANTITY VBU0513_CM_uint16_cnt 20 0.0 65535.0 AXIS_PTS_REF CaSOH_UdResisMapY_mV /end AXIS_DESCR
 /begin AXIS_DESCR COM_AXIS NO_INPUT_QUANTITY VBU0513_CM_single_cnt 7 -3.4028234663852886E+38 3.4028234663852886E+38 AXIS_PTS_REF CaSOH_UdResisMapX_C /end AXIS_DESCR
/end CHARACTERISTIC
/begin AXIS_PTS CaSOH_UdResisMapX_C "" 0x70012562 NO_INPUT_QUANTITY Lookup2D_X_FLOAT32_IEEE 0 VBU0513_CM_single_cnt 7 -3.4028234663852886E+38 3.4028234663852886E+38 /end AXIS_PTS
/begin AXIS_PTS CaSOH_UdResisMapY_mV "" 0x70012aae NO_INPUT_QUANTITY Lookup2D_X_UWORD 0 VBU0513_CM_uint16_cnt 20 0.0 65535.0 /end AXIS_PTS
/begin CHARACTERISTIC CaSOH_OcvSocMapZ_pct "" MAP 0x7001ab2e Lookup2D_FLOAT32_IEEE 0 VBU0513_CM_single_cnt -3.4028234663852886E+38 3.4028234663852886E+38
 /begin AXIS_DESCR COM_AXIS NO_INPUT_QUANTITY VBU0513_CM_uint16_cnt 23 0.0 65535.0 AXIS_PTS_REF CaSOH_OcvSocMapY_mV /end AXIS_DESCR
 /begin AXIS_DESCR COM_AXIS NO_INPUT_QUANTITY VBU0513_CM_single_cnt 9 -3.4028234663852886E+38 3.4028234663852886E+38 AXIS_PTS_REF CaSOH_OcvSocMapX_C /end AXIS_DESCR
/end CHARACTERISTIC
/begin AXIS_PTS CaSOH_OcvSocMapX_C "" 0x700128b2 NO_INPUT_QUANTITY Lookup2D_X_FLOAT32_IEEE 0 VBU0513_CM_single_cnt 9 -3.4028234663852886E+38 3.4028234663852886E+38 /end AXIS_PTS
/begin AXIS_PTS CaSOH_OcvSocMapY_mV "" 0x70013180 NO_INPUT_QUANTITY Lookup2D_X_UWORD 0 VBU0513_CM_uint16_cnt 23 0.0 65535.0 /end AXIS_PTS
/begin CHARACTERISTIC CaSOF_ChargeCurrentLimitBufferTimeSocTempMapZ_s "" MAP 0x7001825e Lookup2D_FLOAT32_IEEE 0 VBU0513_CM_single_cnt -3.4028234663852886E+38 3.4028234663852886E+38
 /begin AXIS_DESCR COM_AXIS SOC_pctCellSocMax VBU0513_CM_single_cnt 13 -3.4028234663852886E+38 3.4028234663852886E+38 AXIS_PTS_REF CaSOF_ChargeCurrentLimitBufferTimeSocTempMapY_pct /end AXIS_DESCR
 /begin AXIS_DESCR COM_AXIS NO_INPUT_QUANTITY VBU0513_CM_single_cnt 14 -3.4028234663852886E+38 3.4028234663852886E+38 AXIS_PTS_REF CaSOF_ChargeCurrentLimitBufferTimeSocTempMapX_C /end AXIS_DESCR
/end CHARACTERISTIC
/begin AXIS_PTS CaSOF_ChargeCurrentLimitBufferTimeSocTempMapX_C "" 0x70013966 NO_INPUT_QUANTITY Lookup2D_X_FLOAT32_IEEE 0 VBU0513_CM_single_cnt 14 -3.4028234663852886E+38 3.4028234663852886E+38 /end AXIS_PTS
/begin AXIS_PTS CaSOF_ChargeCurrentLimitBufferTimeSocTempMapY_pct "" 0x700134ba SOC_pctCellSocMax Lookup2D_X_FLOAT32_IEEE 0 VBU0513_CM_single_cnt 13 -3.4028234663852886E+38 3.4028234663852886E+38 /end AXIS_PTS
/begin CHARACTERISTIC CaSOF_DischargeCurrentLimitBufferTimeSocTempMapZ_s "" MAP 0x70019096 Lookup2D_FLOAT32_IEEE 0 VBU0513_CM_single_cnt -3.4028234663852886E+38 3.4028234663852886E+38
 /begin AXIS_DESCR COM_AXIS SOC_pctCellSocMin VBU0513_CM_single_cnt 13 -3.4028234663852886E+38 3.4028234663852886E+38 AXIS_PTS_REF CaSOF_DischargeCurrentLimitBufferTimeSocTempMapY_pct /end AXIS_DESCR
 /begin AXIS_DESCR COM_AXIS NO_INPUT_QUANTITY VBU0513_CM_single_cnt 14 -3.4028234663852886E+38 3.4028234663852886E+38 AXIS_PTS_REF CaSOF_DischargeCurrentLimitBufferTimeSocTempMapX_C /end AXIS_DESCR
/end CHARACTERISTIC
/begin AXIS_PTS CaSOF_DischargeCurrentLimitBufferTimeSocTempMapX_C "" 0x70013a7e NO_INPUT_QUANTITY Lookup2D_X_FLOAT32_IEEE 0 VBU0513_CM_single_cnt 14 -3.4028234663852886E+38 3.4028234663852886E+38 /end AXIS_PTS
/begin AXIS_PTS CaSOF_DischargeCurrentLimitBufferTimeSocTempMapY_pct "" 0x700135be SOC_pctCellSocMin Lookup2D_X_FLOAT32_IEEE 0 VBU0513_CM_single_cnt 13 -3.4028234663852886E+38 3.4028234663852886E+38 /end AXIS_PTS
/begin CHARACTERISTIC CaSOF_BuffUseFactorCurrtLTCurrtMapZ_n "" MAP 0x70017d26 Lookup2D_FLOAT32_IEEE 0 VBU0513_CM_single_cnt -3.4028234663852886E+38 3.4028234663852886E+38
 /begin AXIS_DESCR COM_AXIS NO_INPUT_QUANTITY VBU0513_CM_single_cnt 11 -3.4028234663852886E+38 3.4028234663852886E+38 AXIS_PTS_REF CaSOF_BuffUseFactorCurrtLTCurrtMapY_A /end AXIS_DESCR
 /begin AXIS_DESCR COM_AXIS NO_INPUT_QUANTITY VBU0513_CM_single_cnt 15 -3.4028234663852886E+38 3.4028234663852886E+38 AXIS_PTS_REF CaSOF_BuffUseFactorCurrtLTCurrtMapX_A /end AXIS_DESCR
/end CHARACTERISTIC
/begin AXIS_PTS CaSOF_BuffUseFactorCurrtLTCurrtMapX_A "" 0x70013cae NO_INPUT_QUANTITY Lookup2D_X_FLOAT32_IEEE 0 VBU0513_CM_single_cnt 15 -3.4028234663852886E+38 3.4028234663852886E+38 /end AXIS_PTS
/begin AXIS_PTS CaSOF_BuffUseFactorCurrtLTCurrtMapY_A "" 0x70012db6 NO_INPUT_QUANTITY Lookup2D_X_FLOAT32_IEEE 0 VBU0513_CM_single_cnt 11 -3.4028234663852886E+38 3.4028234663852886E+38 /end AXIS_PTS
/begin CHARACTERISTIC CaSOF_BuffUseFactorSocTempMapZ_n "" MAP 0x7001656e Lookup2D_FLOAT32_IEEE 0 VBU0513_CM_single_cnt -3.4028234663852886E+38 3.4028234663852886E+38
 /begin AXIS_DESCR COM_AXIS SOC_pctCellSocMin VBU0513_CM_single_cnt 13 -3.4028234663852886E+38 3.4028234663852886E+38 AXIS_PTS_REF CaSOF_BuffUseFactorSocTempMapY_pct /end AXIS_DESCR
 /begin AXIS_DESCR COM_AXIS NO_INPUT_QUANTITY VBU0513_CM_single_cnt 9 -3.4028234663852886E+38 3.4028234663852886E+38 AXIS_PTS_REF CaSOF_BuffUseFactorSocTempMapX_C /end AXIS_DESCR
/end CHARACTERISTIC
/begin AXIS_PTS CaSOF_BuffUseFactorSocTempMapX_C "" 0x70012822 NO_INPUT_QUANTITY Lookup2D_X_FLOAT32_IEEE 0 VBU0513_CM_single_cnt 9 -3.4028234663852886E+38 3.4028234663852886E+38 /end AXIS_PTS
/begin AXIS_PTS CaSOF_BuffUseFactorSocTempMapY_pct "" 0x70013486 SOC_pctCellSocMin Lookup2D_X_FLOAT32_IEEE 0 VBU0513_CM_single_cnt 13 -3.4028234663852886E+38 3.4028234663852886E+38 /end AXIS_PTS
/begin CHARACTERISTIC APD_facRecoveryFillter_C "" VALUE 0x7001014c Scalar_FLOAT32_IEEE 0 VBU0513_CM_single_cnt -3.4028234663852886E+38 3.4028234663852886E+38 /end CHARACTERISTIC
/begin CHARACTERISTIC APD_pctIdlePedal_C "" VALUE 0x70010168 Scalar_FLOAT32_IEEE 0 VBU0513_CM_single_cnt -3.4028234663852886E+38 3.4028234663852886E+38 /end CHARACTERISTIC
/begin CHARACTERISTIC APD_rBrkPedReleased_C "" VALUE 0x7001016c Scalar_FLOAT32_IEEE 0 VBU0513_CM_single_cnt -3.4028234663852886E+38 3.4028234663852886E+38 /end CHARACTERISTIC
/begin CHARACTERISTIC APD_rBrkPlausibilityEnHi_C "" VALUE 0x70010170 Scalar_FLOAT32_IEEE 0 VBU0513_CM_single_cnt -3.4028234663852886E+38 3.4028234663852886E+38 /end CHARACTERISTIC
/begin CHARACTERISTIC APD_rBrkStickyPressed_C "" VALUE 0x70010174 Scalar_FLOAT32_IEEE 0 VBU0513_CM_single_cnt -3.4028234663852886E+38 3.4028234663852886E+38 /end CHARACTERISTIC
/begin CHARACTERISTIC APD_rBrkStickyThreshold_C "" VALUE 0x70010178 Scalar_FLOAT32_IEEE 0 VBU0513_CM_single_cnt -3.4028234663852886E+38 3.4028234663852886E+38 /end CHARACTERISTIC
/begin CHARACTERISTIC APD_rFullPedalPercent_C "" VALUE 0x7001017c Scalar_FLOAT32_IEEE 0 VBU0513_CM_single_cnt -3.4028234663852886E+38 3.4028234663852886E+38 /end CHARACTERISTIC
/begin CHARACTERISTIC APD_tiFullPedalTime_C "" VALUE 0x70010180 Scalar_FLOAT32_IEEE 0 VBU0513_CM_single_cnt -3.4028234663852886E+38 3.4028234663852886E+38 /end CHARACTERISTIC
/begin CHARACTERISTIC APD_tiSampleTime_C "" VALUE 0x70010184 Scalar_FLOAT32_IEEE 0 VBU0513_CM_single_cnt -3.4028234663852886E+38 3.4028234663852886E+38 /end CHARACTERISTIC
/begin CHARACTERISTIC APD_tiUnStickyTime_C "" VALUE 0x70010188 Scalar_FLOAT32_IEEE 0 VBU0513_CM_single_cnt -3.4028234663852886E+38 3.4028234663852886E+38 /end CHARACTERISTIC
/begin CHARACTERISTIC APD_uFullAngle1_C "" VALUE 0x7001018c Scalar_FLOAT32_IEEE 0 VBU0513_CM_single_cnt -3.4028234663852886E+38 3.4028234663852886E+38 /end CHARACTERISTIC
/begin CHARACTERISTIC APD_uFullAngle2_C "" VALUE 0x70010190 Scalar_FLOAT32_IEEE 0 VBU0513_CM_single_cnt -3.4028234663852886E+38 3.4028234663852886E+38 /end CHARACTERISTIC
/begin CHARACTERISTIC APD_vBrkDftSpeed_C "" VALUE 0x700101ac Scalar_FLOAT32_IEEE 0 VBU0513_CM_single_cnt -3.4028234663852886E+38 3.4028234663852886E+38 /end CHARACTERISTIC
/begin CHARACTERISTIC CaSOF_ShortPulseChargeLockedSocTempMapX_C "" VAL_BLK 0x70014362 Scalar_FLOAT32_IEEE 0 VBU0513_CM_single_C -40.0 120.0 NUMBER 20 /end CHARACTERISTIC
/begin CHARACTERISTIC CaSOF_ShortPulseChargeLockedSocTempMapY_pct "" VAL_BLK 0x70014b3a Scalar_FLOAT32_IEEE 0 VBU0513_CM_single_pct 0.0 100.0 NUMBER 22 /end CHARACTERISTIC
/begin CHARACTERISTIC CaSOF_ShortPulseChargeSocTempMapX_C "" VAL_BLK 0x700143b2 Scalar_FLOAT32_IEEE 0 VBU0513_CM_single_t -40.0 120.0 NUMBER 20 /end CHARACTERISTIC
/begin CHARACTERISTIC CaSOF_ShortPulseChargeSocTempMapY_pct "" VAL_BLK 0x70014b92 Scalar_FLOAT32_IEEE 0 VBU0513_CM_single_pct 0.0 100.0 NUMBER 22 /end CHARACTERISTIC
/begin CHARACTERISTIC CcCBL_BalanceStartDeltaSocHysteresis_pct "" VALUE 0x7001056c Scalar_FLOAT32_IEEE 0 VBU0513_CM_single_cnt -3.4028234663852886E+38 3.4028234663852886E+38 /end CHARACTERISTIC
/begin CHARACTERISTIC CcCBL_ChargeBalanceStartDeltaVoltageHysteresis_mV "" VALUE 0x70010594 Scalar_FLOAT32_IEEE 0 VBU0513_CM_single_cnt -3.4028234663852886E+38 3.4028234663852886E+38 /end CHARACTERISTIC
/begin CHARACTERISTIC CcCTD_MaxAccumulatedHeadLoad_J "" VALUE 0x700105d0 Scalar_FLOAT32_IEEE 0 VBU0513_CM_single_cnt -3.4028234663852886E+38 3.4028234663852886E+38 /end CHARACTERISTIC
/begin CHARACTERISTIC CcFCC_ChargeVoltageOvRValue_V "" VALUE 0x70010720 Scalar_FLOAT32_IEEE 0 VBU0513_CM_single_cnt -3.4028234663852886E+38 3.4028234663852886E+38 /end CHARACTERISTIC
/begin CHARACTERISTIC CcFCC_FullChargePackVoltageDelta_V "" VALUE 0x70010748 Scalar_FLOAT32_IEEE 0 VBU0513_CM_single_cnt -3.4028234663852886E+38 3.4028234663852886E+38 /end CHARACTERISTIC
/begin CHARACTERISTIC CcFCC_FullChargeSocDelta_pct "" VALUE 0x70010758 Scalar_FLOAT32_IEEE 0 VBU0513_CM_single_cnt -3.4028234663852886E+38 3.4028234663852886E+38 /end CHARACTERISTIC
/begin CHARACTERISTIC CcFCC_HomoFullChargeSoc_pct "" VALUE 0x7001075c Scalar_FLOAT32_IEEE 0 VBU0513_CM_single_cnt -3.4028234663852886E+38 3.4028234663852886E+38 /end CHARACTERISTIC
/begin CHARACTERISTIC CcSOC_CurrentStableThresholdRate_pct "" VALUE 0x0000 Scalar_FLOAT32_IEEE 0 VBU0513_CM_single_cnt -3.4028234663852886E+38 3.4028234663852886E+38 /end CHARACTERISTIC
/begin CHARACTERISTIC CcSOC_FastChargePreCorrectionDeltaVolSOC_pct "" VALUE 0x70010850 Scalar_FLOAT32_IEEE 0 VBU0513_CM_single -3.4E+38 3.4E+38 /end CHARACTERISTIC
/begin CHARACTERISTIC CcSOC_FastChargePreCorrectionSOC_pct "" VALUE 0x70010854 Scalar_FLOAT32_IEEE 0 VBU0513_CM_single -3.4E+38 3.4E+38 /end CHARACTERISTIC
/begin CHARACTERISTIC CcSOF_BaseCurrentLimitFactor_pct "" VALUE 0x700108c4 Scalar_FLOAT32_IEEE 0 VBU0513_CM_single_cnt -3.4028234663852886E+38 3.4028234663852886E+38 /end CHARACTERISTIC
/begin CHARACTERISTIC CcSOF_BatteryCurrentLow_A "" VALUE 0x700108c8 Scalar_FLOAT32_IEEE 0 VBU0513_CM_single_cnt -3.4028234663852886E+38 3.4028234663852886E+38 /end CHARACTERISTIC
/begin CHARACTERISTIC CcSOF_BolSoh_pct "" VALUE 0x700108d8 Scalar_FLOAT32_IEEE 0 VBU0513_CM_single_cnt -3.4028234663852886E+38 3.4028234663852886E+38 /end CHARACTERISTIC
/begin CHARACTERISTIC CcSOF_CellDischargeDcirMax_mOhm "" VALUE 0x700108e0 Scalar_FLOAT32_IEEE 0 VBU0513_CM_single_cnt -3.4028234663852886E+38 3.4028234663852886E+38 /end CHARACTERISTIC
/begin CHARACTERISTIC CcSOF_CellDischargeDcirMin_mOhm "" VALUE 0x700108e4 Scalar_FLOAT32_IEEE 0 VBU0513_CM_single_cnt -3.4028234663852886E+38 3.4028234663852886E+38 /end CHARACTERISTIC
/begin CHARACTERISTIC CcSOF_ChargeCurrentLimitViolateBuffer_A "" VALUE 0x700108e8 Scalar_FLOAT32_IEEE 0 VBU0513_CM_single_cnt -3.4028234663852886E+38 3.4028234663852886E+38 /end CHARACTERISTIC
/begin CHARACTERISTIC CcSOF_ChargeVoltageCorrectSlope_n "" VALUE 0x700108f8 Scalar_FLOAT32_IEEE 0 VBU0513_CM_single_cnt -3.4028234663852886E+38 3.4028234663852886E+38 /end CHARACTERISTIC
/begin CHARACTERISTIC CcSOF_ContinuousChargeCurrentLimp_A "" VALUE 0x700108fc Scalar_FLOAT32_IEEE 0 VBU0513_CM_single_cnt -3.4028234663852886E+38 3.4028234663852886E+38 /end CHARACTERISTIC
/begin CHARACTERISTIC CcSOF_ContinuousDischargeCurrentLimp_A "" VALUE 0x70010900 Scalar_FLOAT32_IEEE 0 VBU0513_CM_single_cnt -3.4028234663852886E+38 3.4028234663852886E+38 /end CHARACTERISTIC
/begin CHARACTERISTIC CcSOF_CyclePowerLimitCharge_Kw "" VALUE 0x70010904 Scalar_FLOAT32_IEEE 0 VBU0513_CM_single_cnt -3.4028234663852886E+38 3.4028234663852886E+38 /end CHARACTERISTIC
/begin CHARACTERISTIC CcSOF_CyclePowerLimitLevel1Discharge_Kw "" VALUE 0x70010908 Scalar_FLOAT32_IEEE 0 VBU0513_CM_single_cnt -3.4028234663852886E+38 3.4028234663852886E+38 /end CHARACTERISTIC
/begin CHARACTERISTIC CcSOF_CyclePowerLimitLevel1SOCMax_pct "" VALUE 0x7001090c Scalar_FLOAT32_IEEE 0 VBU0513_CM_single_cnt -3.4028234663852886E+38 3.4028234663852886E+38 /end CHARACTERISTIC
/begin CHARACTERISTIC CcSOF_CyclePowerLimitLevel1SOCMin_pct "" VALUE 0x70010910 Scalar_FLOAT32_IEEE 0 VBU0513_CM_single_cnt -3.4028234663852886E+38 3.4028234663852886E+38 /end CHARACTERISTIC
/begin CHARACTERISTIC CcSOF_CyclePowerLimitLevel2Discharge_Kw "" VALUE 0x70010914 Scalar_FLOAT32_IEEE 0 VBU0513_CM_single_cnt -3.4028234663852886E+38 3.4028234663852886E+38 /end CHARACTERISTIC
/begin CHARACTERISTIC CcSOF_CyclePowerLimitLevel2SOCMax_pct "" VALUE 0x70010918 Scalar_FLOAT32_IEEE 0 VBU0513_CM_single_cnt -3.4028234663852886E+38 3.4028234663852886E+38 /end CHARACTERISTIC
/begin CHARACTERISTIC CcSOF_CyclePowerLimitLevel2SOCMin_pct "" VALUE 0x7001091c Scalar_FLOAT32_IEEE 0 VBU0513_CM_single_cnt -3.4028234663852886E+38 3.4028234663852886E+38 /end CHARACTERISTIC
/begin CHARACTERISTIC CcSOF_CyclePowerLimitLevel3Discharge1_Kw "" VALUE 0x70010920 Scalar_FLOAT32_IEEE 0 VBU0513_CM_single_cnt -3.4028234663852886E+38 3.4028234663852886E+38 /end CHARACTERISTIC
/begin CHARACTERISTIC CcSOF_CyclePowerLimitLevel3Discharge2_Kw "" VALUE 0x70010924 Scalar_FLOAT32_IEEE 0 VBU0513_CM_single_cnt -3.4028234663852886E+38 3.4028234663852886E+38 /end CHARACTERISTIC
/begin CHARACTERISTIC CcSOF_CyclePowerLimitLevel3SOCMax_pct "" VALUE 0x70010928 Scalar_FLOAT32_IEEE 0 VBU0513_CM_single_cnt -3.4028234663852886E+38 3.4028234663852886E+38 /end CHARACTERISTIC
/begin CHARACTERISTIC CcSOF_CyclePowerLimitLevel3SOCMin_pct "" VALUE 0x7001092c Scalar_FLOAT32_IEEE 0 VBU0513_CM_single_cnt -3.4028234663852886E+38 3.4028234663852886E+38 /end CHARACTERISTIC
/begin CHARACTERISTIC CcSOF_CyclePowerLimitMax_Kw "" VALUE 0x70010930 Scalar_FLOAT32_IEEE 0 VBU0513_CM_single_cnt -3.4028234663852886E+38 3.4028234663852886E+38 /end CHARACTERISTIC
/begin CHARACTERISTIC CcSOF_DcirDeltaCurrentMin_A "" VALUE 0x70010934 Scalar_FLOAT32_IEEE 0 VBU0513_CM_single_cnt -3.4028234663852886E+38 3.4028234663852886E+38 /end CHARACTERISTIC
/begin CHARACTERISTIC CcSOF_DischaOverCurFactorSlopeDec_n "" VALUE 0x70010938 Scalar_FLOAT32_IEEE 0 VBU0513_CM_single_cnt -3.4028234663852886E+38 3.4028234663852886E+38 /end CHARACTERISTIC
/begin CHARACTERISTIC CcSOF_DischaOverCurFactorSlopeInc_n "" VALUE 0x7001093c Scalar_FLOAT32_IEEE 0 VBU0513_CM_single_cnt -3.4028234663852886E+38 3.4028234663852886E+38 /end CHARACTERISTIC
/begin CHARACTERISTIC CcSOF_DischargeOverCurrentLimitFactor_n "" VALUE 0x7001094c Scalar_FLOAT32_IEEE 0 VBU0513_CM_single_cnt -3.4028234663852886E+38 3.4028234663852886E+38 /end CHARACTERISTIC
/begin CHARACTERISTIC CcSOF_DischargeOverCurrentThresholdDec_As "" VALUE 0x70010950 Scalar_FLOAT32_IEEE 0 VBU0513_CM_single_cnt -3.4028234663852886E+38 3.4028234663852886E+38 /end CHARACTERISTIC
/begin CHARACTERISTIC CcSOF_DischargeOverCurrentThresholdInc_As "" VALUE 0x70010954 Scalar_FLOAT32_IEEE 0 VBU0513_CM_single_cnt -3.4028234663852886E+38 3.4028234663852886E+38 /end CHARACTERISTIC
/begin CHARACTERISTIC CcSOF_DischargeVolCorCurrentSlopeDec_A "" VALUE 0x7001095c Scalar_FLOAT32_IEEE 0 VBU0513_CM_single_cnt -3.4028234663852886E+38 3.4028234663852886E+38 /end CHARACTERISTIC
/begin CHARACTERISTIC CcSOF_DischargeVolCorCurrentSlopeInc_A "" VALUE 0x70010960 Scalar_FLOAT32_IEEE 0 VBU0513_CM_single_cnt -3.4028234663852886E+38 3.4028234663852886E+38 /end CHARACTERISTIC
/begin CHARACTERISTIC CcSOF_DischargeVoltageCorrectSlopeDec_n "" VALUE 0x70010964 Scalar_FLOAT32_IEEE 0 VBU0513_CM_single_cnt -3.4028234663852886E+38 3.4028234663852886E+38 /end CHARACTERISTIC
/begin CHARACTERISTIC CcSOF_DischargeVoltageCorrectSlopeInc_n "" VALUE 0x70010968 Scalar_FLOAT32_IEEE 0 VBU0513_CM_single_cnt -3.4028234663852886E+38 3.4028234663852886E+38 /end CHARACTERISTIC
/begin CHARACTERISTIC CcSOF_DischargeVoltageCorrectSlope_n "" VALUE 0x7001096c Scalar_FLOAT32_IEEE 0 VBU0513_CM_single_cnt -3.4028234663852886E+38 3.4028234663852886E+38 /end CHARACTERISTIC
/begin CHARACTERISTIC CcSOF_DynamicChargeCurrentLimp_A "" VALUE 0x70010970 Scalar_FLOAT32_IEEE 0 VBU0513_CM_single_cnt -3.4028234663852886E+38 3.4028234663852886E+38 /end CHARACTERISTIC
/begin CHARACTERISTIC CcSOF_DynamicDischargeCurrentLimp_A "" VALUE 0x70010974 Scalar_FLOAT32_IEEE 0 VBU0513_CM_single_cnt -3.4028234663852886E+38 3.4028234663852886E+38 /end CHARACTERISTIC
/begin CHARACTERISTIC CcSOF_EolSoh_pct "" VALUE 0x70010978 Scalar_FLOAT32_IEEE 0 VBU0513_CM_single_cnt -3.4028234663852886E+38 3.4028234663852886E+38 /end CHARACTERISTIC
/begin CHARACTERISTIC CcSOF_FastChargeCellVoltageSOCLimit_pct "" VALUE 0x7001097c Scalar_FLOAT32_IEEE 0 VBU0513_CM_single_cnt -3.4028234663852886E+38 3.4028234663852886E+38 /end CHARACTERISTIC
/begin CHARACTERISTIC CcSOF_FastChargeCurrentStep1_A "" VALUE 0x70010980 Scalar_FLOAT32_IEEE 0 VBU0513_CM_single_cnt -3.4028234663852886E+38 3.4028234663852886E+38 /end CHARACTERISTIC
/begin CHARACTERISTIC CcSOF_FastChargeCurrentStep2_A "" VALUE 0x70010984 Scalar_FLOAT32_IEEE 0 VBU0513_CM_single_cnt -3.4028234663852886E+38 3.4028234663852886E+38 /end CHARACTERISTIC
/begin CHARACTERISTIC CcSOF_FastChargeDisableTempLowerLimit_C "" VALUE 0x70010988 Scalar_FLOAT32_IEEE 0 VBU0513_CM_single_cnt -3.4028234663852886E+38 3.4028234663852886E+38 /end CHARACTERISTIC
/begin CHARACTERISTIC CcSOF_FastChargeDisableTempUpperLimit_C "" VALUE 0x7001098c Scalar_FLOAT32_IEEE 0 VBU0513_CM_single_cnt -3.4028234663852886E+38 3.4028234663852886E+38 /end CHARACTERISTIC
/begin CHARACTERISTIC CcSOF_FastChargeEnableSocLowerLimit_pct "" VALUE 0x70010990 Scalar_FLOAT32_IEEE 0 VBU0513_CM_single_cnt -3.4028234663852886E+38 3.4028234663852886E+38 /end CHARACTERISTIC
/begin CHARACTERISTIC CcSOF_FastChargeEnableSocUpperLimit_pct "" VALUE 0x70010994 Scalar_FLOAT32_IEEE 0 VBU0513_CM_single_cnt -3.4028234663852886E+38 3.4028234663852886E+38 /end CHARACTERISTIC
/begin CHARACTERISTIC CcSOF_FastChargeEnableTempLowerLimit_C "" VALUE 0x70010998 Scalar_FLOAT32_IEEE 0 VBU0513_CM_single_cnt -3.4028234663852886E+38 3.4028234663852886E+38 /end CHARACTERISTIC
/begin CHARACTERISTIC CcSOF_FastChargeRecoverTempUpperLimit_C "" VALUE 0x7001099c Scalar_FLOAT32_IEEE 0 VBU0513_CM_single_cnt -3.4028234663852886E+38 3.4028234663852886E+38 /end CHARACTERISTIC
/begin CHARACTERISTIC CcSOF_FastChargeSOCLimit_pct "" VALUE 0x700109a0 Scalar_FLOAT32_IEEE 0 VBU0513_CM_single_cnt -3.4028234663852886E+38 3.4028234663852886E+38 /end CHARACTERISTIC
/begin CHARACTERISTIC CcSOF_FastChargeSocStep1_pct "" VALUE 0x700109a4 Scalar_FLOAT32_IEEE 0 VBU0513_CM_single_cnt -3.4028234663852886E+38 3.4028234663852886E+38 /end CHARACTERISTIC
/begin CHARACTERISTIC CcSOF_FccOneThirdRateCurtSlope_A "" VALUE 0x700109a8 Scalar_FLOAT32_IEEE 0 VBU0513_CM_single_cnt -3.4028234663852886E+38 3.4028234663852886E+38 /end CHARACTERISTIC
/begin CHARACTERISTIC CcSOF_LowVoltageResetSOC_pct "" VALUE 0x700109c0 Scalar_FLOAT32_IEEE 0 VBU0513_CM_single_cnt -3.4028234663852886E+38 3.4028234663852886E+38 /end CHARACTERISTIC
/begin CHARACTERISTIC CcSOF_LowVoltageSetCurrent_A "" VALUE 0x700109c4 Scalar_FLOAT32_IEEE 0 VBU0513_CM_single_cnt -3.4028234663852886E+38 3.4028234663852886E+38 /end CHARACTERISTIC
/begin CHARACTERISTIC CcSOF_LowVoltageSetSOC_pct "" VALUE 0x700109c8 Scalar_FLOAT32_IEEE 0 VBU0513_CM_single_cnt -3.4028234663852886E+38 3.4028234663852886E+38 /end CHARACTERISTIC
/begin CHARACTERISTIC CcSOF_LowVoltageSetVolt2Delta_mV "" VALUE 0x700109d0 Scalar_FLOAT32_IEEE 0 VBU0513_CM_single_cnt -3.4028234663852886E+38 3.4028234663852886E+38 /end CHARACTERISTIC
/begin CHARACTERISTIC CcSOF_LowVoltageSetVolt2_mV "" VALUE 0x700109d4 Scalar_FLOAT32_IEEE 0 VBU0513_CM_single_cnt -3.4028234663852886E+38 3.4028234663852886E+38 /end CHARACTERISTIC
/begin CHARACTERISTIC CcSOF_LowVoltageSetVolt_mV "" VALUE 0x700109d8 Scalar_FLOAT32_IEEE 0 VBU0513_CM_single_cnt -3.4028234663852886E+38 3.4028234663852886E+38 /end CHARACTERISTIC
/begin CHARACTERISTIC CcSOF_OriginalDcirDispersion_pct "" VALUE 0x700109dc Scalar_FLOAT32_IEEE 0 VBU0513_CM_single_cnt -3.4028234663852886E+38 3.4028234663852886E+38 /end CHARACTERISTIC
/begin CHARACTERISTIC CcSOF_ShortPulseChargeCurrentLimp_A "" VALUE 0x700109e4 Scalar_FLOAT32_IEEE 0 VBU0513_CM_single_cnt -3.4028234663852886E+38 3.4028234663852886E+38 /end CHARACTERISTIC
/begin CHARACTERISTIC CcSOF_ShortPulseDischargeCurrentLimp_A "" VALUE 0x700109e8 Scalar_FLOAT32_IEEE 0 VBU0513_CM_single_cnt -3.4028234663852886E+38 3.4028234663852886E+38 /end CHARACTERISTIC
/begin CHARACTERISTIC CcSOF_SocpDischargeSocDebounce_pct "" VALUE 0x700109f4 Scalar_FLOAT32_IEEE 0 VBU0513_CM_single_cnt -3.4028234663852886E+38 3.4028234663852886E+38 /end CHARACTERISTIC
/begin CHARACTERISTIC CcSOF_StopChargeBattVolt_V "" VALUE 0x700109f8 Scalar_FLOAT32_IEEE 0 VBU0513_CM_single_cnt -3.4028234663852886E+38 3.4028234663852886E+38 /end CHARACTERISTIC
/begin CHARACTERISTIC CcSOF_StopChargeDeltaBattVolt_V "" VALUE 0x700109fc Scalar_FLOAT32_IEEE 0 VBU0513_CM_single_cnt -3.4028234663852886E+38 3.4028234663852886E+38 /end CHARACTERISTIC
/begin CHARACTERISTIC CcSOF_StopChargeDeltaSOC_pct "" VALUE 0x70010a00 Scalar_FLOAT32_IEEE 0 VBU0513_CM_single_cnt -3.4028234663852886E+38 3.4028234663852886E+38 /end CHARACTERISTIC
/begin CHARACTERISTIC CcSOF_StopChargeSOC_pct "" VALUE 0x70010a04 Scalar_FLOAT32_IEEE 0 VBU0513_CM_single_cnt -3.4028234663852886E+38 3.4028234663852886E+38 /end CHARACTERISTIC
/begin CHARACTERISTIC CcSOF_UseCalculatedDcirTemp_C "" VALUE 0x70010a08 Scalar_FLOAT32_IEEE 0 VBU0513_CM_single_cnt -3.4028234663852886E+38 3.4028234663852886E+38 /end CHARACTERISTIC
/begin CHARACTERISTIC CcSOF_VoltageCorrectFactor0_n "" VALUE 0x70010a2c Scalar_FLOAT32_IEEE 0 VBU0513_CM_single_cnt -3.4028234663852886E+38 3.4028234663852886E+38 /end CHARACTERISTIC
/begin CHARACTERISTIC CcSOF_VoltageCorrectFactor1_n "" VALUE 0x70010a30 Scalar_FLOAT32_IEEE 0 VBU0513_CM_single_cnt -3.4028234663852886E+38 3.4028234663852886E+38 /end CHARACTERISTIC
/begin CHARACTERISTIC CcSOF_VoltageCorrectFactor2_n "" VALUE 0x70010a34 Scalar_FLOAT32_IEEE 0 VBU0513_CM_single_cnt -3.4028234663852886E+38 3.4028234663852886E+38 /end CHARACTERISTIC
/begin CHARACTERISTIC CcSOF_VoltageCorrectFactor3_n "" VALUE 0x70010a38 Scalar_FLOAT32_IEEE 0 VBU0513_CM_single_cnt -3.4028234663852886E+38 3.4028234663852886E+38 /end CHARACTERISTIC
/begin CHARACTERISTIC CcSOF_VoltageCorrectFactor4_n "" VALUE 0x70010a3c Scalar_FLOAT32_IEEE 0 VBU0513_CM_single_cnt -3.4028234663852886E+38 3.4028234663852886E+38 /end CHARACTERISTIC
/begin CHARACTERISTIC CcSOH_ChargeResisLowerLimit_mohm "" VALUE 0x70010a64 Scalar_FLOAT32_IEEE 0 VBU0513_CM_single_cnt -3.4028234663852886E+38 3.4028234663852886E+38 /end CHARACTERISTIC
/begin CHARACTERISTIC CcSOH_FastChargeWeighting_pct "" VALUE 0x70010a88 Scalar_FLOAT32_IEEE 0 VBU0513_CM_single_cnt -3.4028234663852886E+38 3.4028234663852886E+38 /end CHARACTERISTIC
/begin CHARACTERISTIC CcSOH_MaxBalancedCapacity_As "" VALUE 0x70010a90 Scalar_FLOAT32_IEEE 0 VBU0513_CM_single_cnt -3.4028234663852886E+38 3.4028234663852886E+38 /end CHARACTERISTIC
/begin CHARACTERISTIC CcSOH_MaxCurrentIntegral_As "" VALUE 0x70010a94 Scalar_FLOAT32_IEEE 0 VBU0513_CM_single_cnt -3.4028234663852886E+38 3.4028234663852886E+38 /end CHARACTERISTIC
/begin CHARACTERISTIC CcSOH_MinBalancedCapacity_As "" VALUE 0x70010a98 Scalar_FLOAT32_IEEE 0 VBU0513_CM_single_cnt -3.4028234663852886E+38 3.4028234663852886E+38 /end CHARACTERISTIC
/begin CHARACTERISTIC CcSOH_MinCurrentIntegral_As "" VALUE 0x70010a9c Scalar_FLOAT32_IEEE 0 VBU0513_CM_single_cnt -3.4028234663852886E+38 3.4028234663852886E+38 /end CHARACTERISTIC
/begin CHARACTERISTIC CcSOH_PulseCurrentThreshold_pct "" VALUE 0x70010aa4 Scalar_FLOAT32_IEEE 0 VBU0513_CM_single_cnt -3.4028234663852886E+38 3.4028234663852886E+38 /end CHARACTERISTIC
/begin CHARACTERISTIC DSPL_facDecRateVldHi_C_Md_Default "" VALUE 0x70010e9c Scalar_FLOAT32_IEEE 0 VBU0513_CM_single_fac 0.0 1.0 /end CHARACTERISTIC
/begin CHARACTERISTIC DSPL_facDecRateVldHi_C_Md_Type1 "" VALUE 0x70010ea0 Scalar_FLOAT32_IEEE 0 VBU0513_CM_single_fac 0.0 1.0 /end CHARACTERISTIC
/begin CHARACTERISTIC DSPL_facDecRateVldHi_C_Md_Type2 "" VALUE 0x70010ea4 Scalar_FLOAT32_IEEE 0 VBU0513_CM_single_fac 0.0 1.0 /end CHARACTERISTIC
/begin CHARACTERISTIC DSPL_facDecRateVldHi_C_Md_Type3 "" VALUE 0x70010ea8 Scalar_FLOAT32_IEEE 0 VBU0513_CM_single_fac 0.0 1.0 /end CHARACTERISTIC
/begin CHARACTERISTIC DSPL_facDecRateVldHi_C_Md_Type4 "" VALUE 0x70010eac Scalar_FLOAT32_IEEE 0 VBU0513_CM_single_fac 0.0 1.0 /end CHARACTERISTIC
/begin CHARACTERISTIC DSPL_facDecRateVldLo_C_Md_Default "" VALUE 0x70010eb0 Scalar_FLOAT32_IEEE 0 VBU0513_CM_single_fac 0.0 1.0 /end CHARACTERISTIC
/begin CHARACTERISTIC DSPL_facDecRateVldLo_C_Md_Type1 "" VALUE 0x70010eb4 Scalar_FLOAT32_IEEE 0 VBU0513_CM_single_fac 0.0 1.0 /end CHARACTERISTIC
/begin CHARACTERISTIC DSPL_facDecRateVldLo_C_Md_Type2 "" VALUE 0x70010eb8 Scalar_FLOAT32_IEEE 0 VBU0513_CM_single_fac 0.0 1.0 /end CHARACTERISTIC
/begin CHARACTERISTIC DSPL_facDecRateVldLo_C_Md_Type3 "" VALUE 0x70010ebc Scalar_FLOAT32_IEEE 0 VBU0513_CM_single_fac 0.0 1.0 /end CHARACTERISTIC
/begin CHARACTERISTIC DSPL_facDecRateVldLo_C_Md_Type4 "" VALUE 0x70010ec0 Scalar_FLOAT32_IEEE 0 VBU0513_CM_single_fac 0.0 1.0 /end CHARACTERISTIC
/begin CHARACTERISTIC DSPL_facEnergyFactorInitHigh_C "" VALUE 0x70010f60 Scalar_FLOAT32_IEEE 0 VBU0513_CM_single_fac 0.0 1.0 /end CHARACTERISTIC
/begin CHARACTERISTIC DSPL_facEnergyFactorInitLow_C "" VALUE 0x70010f64 Scalar_FLOAT32_IEEE 0 VBU0513_CM_single_fac 0.0 1.0 /end CHARACTERISTIC
/begin CHARACTERISTIC DSPL_facEnergyFactorInitMid_C "" VALUE 0x70010f68 Scalar_FLOAT32_IEEE 0 VBU0513_CM_single_fac 0.0 1.0 /end CHARACTERISTIC
/begin CHARACTERISTIC DSPL_facEnergyFactorInit_C "" VALUE 0x70010f6c Scalar_FLOAT32_IEEE 0 VBU0513_CM_single_fac 0.0 1.0 /end CHARACTERISTIC
/begin CHARACTERISTIC DSPL_facEnergyFactorSelfLearnInit_C "" VALUE 0x70010f70 Scalar_FLOAT32_IEEE 0 VBU0513_CM_single_fac 0.0 1.0 /end CHARACTERISTIC
/begin CHARACTERISTIC DSPL_facEnergyFactorTypeInit_C "" VALUE 0x70010f74 Scalar_FLOAT32_IEEE 0 VBU0513_CM_single_fac 0.0 1.0 /end CHARACTERISTIC
/begin CHARACTERISTIC DSPL_facEnergyFactorType_C_Md_Default "" VALUE 0x70010f78 Scalar_FLOAT32_IEEE 0 VBU0513_CM_single_fac 0.0 1.0 /end CHARACTERISTIC
/begin CHARACTERISTIC DSPL_facEnergyFactorType_C_Md_Type1 "" VALUE 0x70010f7c Scalar_FLOAT32_IEEE 0 VBU0513_CM_single_fac 0.0 1.0 /end CHARACTERISTIC
/begin CHARACTERISTIC DSPL_facEnergyFactorType_C_Md_Type2 "" VALUE 0x70010f80 Scalar_FLOAT32_IEEE 0 VBU0513_CM_single_fac 0.0 1.0 /end CHARACTERISTIC
/begin CHARACTERISTIC DSPL_facEnergyFactorType_C_Md_Type3 "" VALUE 0x70010f84 Scalar_FLOAT32_IEEE 0 VBU0513_CM_single_fac 0.0 1.0 /end CHARACTERISTIC
/begin CHARACTERISTIC DSPL_facEnergyFactorType_C_Md_Type4 "" VALUE 0x70010f88 Scalar_FLOAT32_IEEE 0 VBU0513_CM_single_fac 0.0 1.0 /end CHARACTERISTIC
/begin CHARACTERISTIC DSPL_facEnergyFactorUpdateStep_C "" VALUE 0x70010f8c Scalar_FLOAT32_IEEE 0 VBU0513_CM_single_fac 0.0 1.0 /end CHARACTERISTIC
/begin CHARACTERISTIC DSPL_facInitRateSOCFactor_C_Md_Default "" VALUE 0x70010f90 Scalar_FLOAT32_IEEE 0 VBU0513_CM_single_fac 0.0 1.0 /end CHARACTERISTIC
/begin CHARACTERISTIC DSPL_facInitRateSOCFactor_C_Md_Type1 "" VALUE 0x70010f94 Scalar_FLOAT32_IEEE 0 VBU0513_CM_single_fac 0.0 1.0 /end CHARACTERISTIC
/begin CHARACTERISTIC DSPL_facInitRateSOCFactor_C_Md_Type2 "" VALUE 0x70010f98 Scalar_FLOAT32_IEEE 0 VBU0513_CM_single_fac 0.0 1.0 /end CHARACTERISTIC
/begin CHARACTERISTIC DSPL_facInitRateSOCFactor_C_Md_Type3 "" VALUE 0x70010f9c Scalar_FLOAT32_IEEE 0 VBU0513_CM_single_fac 0.0 1.0 /end CHARACTERISTIC
/begin CHARACTERISTIC DSPL_facInitRateSOCFactor_C_Md_Type4 "" VALUE 0x70010fa0 Scalar_FLOAT32_IEEE 0 VBU0513_CM_single_fac 0.0 1.0 /end CHARACTERISTIC
/begin CHARACTERISTIC DSPL_kmDrvRngMax_C_Md_Default "" VALUE 0x70010fc0 Scalar_FLOAT32_IEEE 0 VBU0513_CM_single_km -1.0E+7 1.0E+10 /end CHARACTERISTIC
/begin CHARACTERISTIC DSPL_kmDrvRngMax_C_Md_Type1 "" VALUE 0x70010fc4 Scalar_FLOAT32_IEEE 0 VBU0513_CM_single_km -1.0E+7 1.0E+10 /end CHARACTERISTIC
/begin CHARACTERISTIC DSPL_kmDrvRngMax_C_Md_Type2 "" VALUE 0x70010fc8 Scalar_FLOAT32_IEEE 0 VBU0513_CM_single_km -1.0E+7 1.0E+10 /end CHARACTERISTIC
/begin CHARACTERISTIC DSPL_kmDrvRngMax_C_Md_Type3 "" VALUE 0x70010fcc Scalar_FLOAT32_IEEE 0 VBU0513_CM_single_km -1.0E+7 1.0E+10 /end CHARACTERISTIC
/begin CHARACTERISTIC DSPL_kmDrvRngMax_C_Md_Type4 "" VALUE 0x70010fd0 Scalar_FLOAT32_IEEE 0 VBU0513_CM_single_km -1.0E+7 1.0E+10 /end CHARACTERISTIC
/begin CHARACTERISTIC DSPL_kmEnergyFactorOdoLow_C "" VALUE 0x70010fd8 Scalar_FLOAT32_IEEE 0 VBU0513_CM_single_km 0.0 1.0E+11 /end CHARACTERISTIC
/begin CHARACTERISTIC DSPL_kmEnergyFactorOdoMid_C "" VALUE 0x70010fdc Scalar_FLOAT32_IEEE 0 VBU0513_CM_single_km 0.0 1.0E+11 /end CHARACTERISTIC
/begin CHARACTERISTIC DSPL_kmEnergyFactorOdoZero_C "" VALUE 0x70010fe0 Scalar_FLOAT32_IEEE 0 VBU0513_CM_single_km 0.0 1.0E+11 /end CHARACTERISTIC
/begin CHARACTERISTIC DSPL_kmFullSocRateRng_C_Md_Default "" VALUE 0x70010fe4 Scalar_FLOAT32_IEEE 0 VBU0513_CM_single_km 0.0 1.0E+6 /end CHARACTERISTIC
/begin CHARACTERISTIC DSPL_kmFullSocRateRng_C_Md_Type1 "" VALUE 0x70010fe8 Scalar_FLOAT32_IEEE 0 VBU0513_CM_single_km 0.0 1.0E+6 /end CHARACTERISTIC
/begin CHARACTERISTIC DSPL_kmFullSocRateRng_C_Md_Type2 "" VALUE 0x70010fec Scalar_FLOAT32_IEEE 0 VBU0513_CM_single_km 0.0 1.0E+6 /end CHARACTERISTIC
/begin CHARACTERISTIC DSPL_kmFullSocRateRng_C_Md_Type3 "" VALUE 0x70010ff0 Scalar_FLOAT32_IEEE 0 VBU0513_CM_single_km 0.0 1.0E+6 /end CHARACTERISTIC
/begin CHARACTERISTIC DSPL_kmFullSocRateRng_C_Md_Type4 "" VALUE 0x70010ff4 Scalar_FLOAT32_IEEE 0 VBU0513_CM_single_km 0.0 1.0E+6 /end CHARACTERISTIC
/begin CHARACTERISTIC DSPL_pctBMSSOCUpdateStep_C "" VALUE 0x70011030 Scalar_FLOAT32_IEEE 0 VBU0513_CM_single_pct 0.0 100.0 /end CHARACTERISTIC
/begin CHARACTERISTIC DSPL_pctEnergySOCLearnMax_C "" VALUE 0x70011034 Scalar_FLOAT32_IEEE 0 VBU0513_CM_single_pct 0.0 100.0 /end CHARACTERISTIC
/begin CHARACTERISTIC EDIS_facDecGradSprt_C "" VALUE 0x700110d4 Scalar_FLOAT32_IEEE 0 VBU0513_CM_single_cnt -3.4028234663852886E+38 3.4028234663852886E+38 /end CHARACTERISTIC
/begin CHARACTERISTIC EDIS_numCurrentOverDisChDyn_C "" VALUE 0x700110ec Scalar_FLOAT32_IEEE 0 VBU0513_CM_single_cnt -3.4028234663852886E+38 3.4028234663852886E+38 /end CHARACTERISTIC
/begin CHARACTERISTIC EDIS_numDisChDyn_C "" VALUE 0x700110f0 Scalar_FLOAT32_IEEE 0 VBU0513_CM_single_cnt -3.4028234663852886E+38 3.4028234663852886E+38 /end CHARACTERISTIC
/begin CHARACTERISTIC EDIS_numDisChOverLim_C "" VALUE 0x700110f4 Scalar_FLOAT32_IEEE 0 VBU0513_CM_single_cnt -3.4028234663852886E+38 3.4028234663852886E+38 /end CHARACTERISTIC
/begin CHARACTERISTIC EDIS_numDisChPwrOverCntEEPROMInit_SY "" VALUE 0x700110f8 Scalar_FLOAT32_IEEE 0 VBU0513_CM_single_cnt -3.4028234663852886E+38 3.4028234663852886E+38 /end CHARACTERISTIC
/begin CHARACTERISTIC EDIS_pctAccPedlDchaLo_C "" VALUE 0x700110fc Scalar_FLOAT32_IEEE 0 VBU0513_CM_single_cnt -3.4028234663852886E+38 3.4028234663852886E+38 /end CHARACTERISTIC
/begin CHARACTERISTIC EDIS_pctAccPedlDchaUp_C "" VALUE 0x70011100 Scalar_FLOAT32_IEEE 0 VBU0513_CM_single_cnt -3.4028234663852886E+38 3.4028234663852886E+38 /end CHARACTERISTIC
/begin CHARACTERISTIC EDIS_pctSocDchaLo_C "" VALUE 0x70011114 Scalar_FLOAT32_IEEE 0 VBU0513_CM_single_cnt -3.4028234663852886E+38 3.4028234663852886E+38 /end CHARACTERISTIC
/begin CHARACTERISTIC EDIS_pctSocDchaUp_C "" VALUE 0x70011118 Scalar_FLOAT32_IEEE 0 VBU0513_CM_single_cnt -3.4028234663852886E+38 3.4028234663852886E+38 /end CHARACTERISTIC
/begin CHARACTERISTIC EDIS_pwrBmsDynLTDeltaHi_C "" VALUE 0x7001112c Scalar_FLOAT32_IEEE 0 VBU0513_CM_single_cnt -3.4028234663852886E+38 3.4028234663852886E+38 /end CHARACTERISTIC
/begin CHARACTERISTIC EDIS_pwrBmsDynLTDeltaLo_C "" VALUE 0x70011130 Scalar_FLOAT32_IEEE 0 VBU0513_CM_single_cnt -3.4028234663852886E+38 3.4028234663852886E+38 /end CHARACTERISTIC
/begin CHARACTERISTIC EDIS_pwrDisChDynMore_C "" VALUE 0x70011158 Scalar_FLOAT32_IEEE 0 VBU0513_CM_single_cnt -3.4028234663852886E+38 3.4028234663852886E+38 /end CHARACTERISTIC
/begin CHARACTERISTIC EDIS_pwrDisChOverLim_C "" VALUE 0x7001115c Scalar_FLOAT32_IEEE 0 VBU0513_CM_single_kW 0.0 1000.0 /end CHARACTERISTIC
/begin CHARACTERISTIC EDIS_pwrDisChRed40vLim_C "" VALUE 0x70011160 Scalar_FLOAT32_IEEE 0 VBU0513_CM_single_cnt -3.4028234663852886E+38 3.4028234663852886E+38 /end CHARACTERISTIC
/begin CHARACTERISTIC EDIS_pwrDisChaFilterHi_C "" VALUE 0x70011164 Scalar_FLOAT32_IEEE 0 VBU0513_CM_single_cnt -3.4028234663852886E+38 3.4028234663852886E+38 /end CHARACTERISTIC
/begin CHARACTERISTIC EDIS_pwrDisChaFilterLo_C "" VALUE 0x70011168 Scalar_FLOAT32_IEEE 0 VBU0513_CM_single_cnt -3.4028234663852886E+38 3.4028234663852886E+38 /end CHARACTERISTIC
/begin CHARACTERISTIC EDIS_tBmsMaxTempHi_C "" VALUE 0x700111ac Scalar_FLOAT32_IEEE 0 VBU0513_CM_single_cnt -3.4028234663852886E+38 3.4028234663852886E+38 /end CHARACTERISTIC
/begin CHARACTERISTIC EDIS_tBmsMaxTempLo_C "" VALUE 0x700111b0 Scalar_FLOAT32_IEEE 0 VBU0513_CM_single_cnt -3.4028234663852886E+38 3.4028234663852886E+38 /end CHARACTERISTIC
/begin CHARACTERISTIC EDIS_tBmsMinTempHi_C "" VALUE 0x700111b4 Scalar_FLOAT32_IEEE 0 VBU0513_CM_single_cnt -3.4028234663852886E+38 3.4028234663852886E+38 /end CHARACTERISTIC
/begin CHARACTERISTIC EDIS_tBmsMinTempLo_C "" VALUE 0x700111b8 Scalar_FLOAT32_IEEE 0 VBU0513_CM_single_cnt -3.4028234663852886E+38 3.4028234663852886E+38 /end CHARACTERISTIC
/begin CHARACTERISTIC EDIS_tiOverDisCha_C "" VALUE 0x700111c8 Scalar_FLOAT32_IEEE 0 VBU0513_CM_single_cnt -3.4028234663852886E+38 3.4028234663852886E+38 /end CHARACTERISTIC
/begin CHARACTERISTIC EDIS_vVehSpdDchaLo_C "" VALUE 0x700111d4 Scalar_FLOAT32_IEEE 0 VBU0513_CM_single_cnt -3.4028234663852886E+38 3.4028234663852886E+38 /end CHARACTERISTIC
/begin CHARACTERISTIC EDIS_vVehSpdDchaUp_C "" VALUE 0x700111d8 Scalar_FLOAT32_IEEE 0 VBU0513_CM_single_cnt -3.4028234663852886E+38 3.4028234663852886E+38 /end CHARACTERISTIC
/begin CHARACTERISTIC Gear_cntGearPTimeOut_C "" VALUE 0x70011264 Scalar_FLOAT32_IEEE 0 VBU0513_CM_single_cnt -3.4028234663852886E+38 3.4028234663852886E+38 /end CHARACTERISTIC
/begin CHARACTERISTIC Gear_cntGearPlausibilityDigitalDetect_C "" VALUE 0x70011268 Scalar_FLOAT32_IEEE 0 VBU0513_CM_single_cnt -3.4028234663852886E+38 3.4028234663852886E+38 /end CHARACTERISTIC
/begin CHARACTERISTIC Gear_cntGearPlausibilityDigitalShiftFast_C "" VALUE 0x7001126c Scalar_FLOAT32_IEEE 0 VBU0513_CM_single_cnt -3.4028234663852886E+38 3.4028234663852886E+38 /end CHARACTERISTIC
/begin CHARACTERISTIC Gear_tiDefaultGear2NTime_C "" VALUE 0x70011274 Scalar_FLOAT32_IEEE 0 VBU0513_CM_single_cnt -3.4028234663852886E+38 3.4028234663852886E+38 /end CHARACTERISTIC
/begin CHARACTERISTIC Gear_tiDefaultGear2PTime_C "" VALUE 0x70011278 Scalar_FLOAT32_IEEE 0 VBU0513_CM_single_cnt -3.4028234663852886E+38 3.4028234663852886E+38 /end CHARACTERISTIC
/begin CHARACTERISTIC Gear_tiGearDSustain_C "" VALUE 0x7001127c Scalar_FLOAT32_IEEE 0 VBU0513_CM_single_cnt -3.4028234663852886E+38 3.4028234663852886E+38 /end CHARACTERISTIC
/begin CHARACTERISTIC Gear_tiGearES6DebounceCnt_C "" VALUE 0x70011284 Scalar_FLOAT32_IEEE 0 VBU0513_CM_single_cnt -3.4028234663852886E+38 3.4028234663852886E+38 /end CHARACTERISTIC
/begin CHARACTERISTIC Gear_tiGearInitSustain_C "" VALUE 0x70011288 Scalar_FLOAT32_IEEE 0 VBU0513_CM_single_cnt -3.4028234663852886E+38 3.4028234663852886E+38 /end CHARACTERISTIC
/begin CHARACTERISTIC Gear_tiGearInitTime_C "" VALUE 0x7001128c Scalar_FLOAT32_IEEE 0 VBU0513_CM_single_cnt -3.4028234663852886E+38 3.4028234663852886E+38 /end CHARACTERISTIC
/begin CHARACTERISTIC Gear_tiGearPSustain_C "" VALUE 0x70011290 Scalar_FLOAT32_IEEE 0 VBU0513_CM_single_cnt -3.4028234663852886E+38 3.4028234663852886E+38 /end CHARACTERISTIC
/begin CHARACTERISTIC Gear_tiGearRSustain_C "" VALUE 0x70011298 Scalar_FLOAT32_IEEE 0 VBU0513_CM_single_cnt -3.4028234663852886E+38 3.4028234663852886E+38 /end CHARACTERISTIC
/begin CHARACTERISTIC Gear_tiGearResetHold_C "" VALUE 0x7001129c Scalar_FLOAT32_IEEE 0 VBU0513_CM_single_cnt -3.4028234663852886E+38 3.4028234663852886E+38 /end CHARACTERISTIC
/begin CHARACTERISTIC Gear_tiGearWarningLTES6DebounceCnt_C "" VALUE 0x700112a0 Scalar_FLOAT32_IEEE 0 VBU0513_CM_single_cnt -3.4028234663852886E+38 3.4028234663852886E+38 /end CHARACTERISTIC
/begin CHARACTERISTIC Gear_tiGearWarningSTES6DebounceCnt_C "" VALUE 0x700112a4 Scalar_FLOAT32_IEEE 0 VBU0513_CM_single_cnt -3.4028234663852886E+38 3.4028234663852886E+38 /end CHARACTERISTIC
/begin CHARACTERISTIC Gear_tiInitGear2NTime_C "" VALUE 0x700112a8 Scalar_FLOAT32_IEEE 0 VBU0513_CM_single_cnt -3.4028234663852886E+38 3.4028234663852886E+38 /end CHARACTERISTIC
/begin CHARACTERISTIC Gear_tiInitGear2PTime_C "" VALUE 0x700112ac Scalar_FLOAT32_IEEE 0 VBU0513_CM_single_cnt -3.4028234663852886E+38 3.4028234663852886E+38 /end CHARACTERISTIC
/begin CHARACTERISTIC Gear_tiWarnDelayTime_C "" VALUE 0x700112b8 Scalar_FLOAT32_IEEE 0 VBU0513_CM_single_cnt -3.4028234663852886E+38 3.4028234663852886E+38 /end CHARACTERISTIC
/begin CHARACTERISTIC TQDIS_pctShftChngFullAcc_C "" VALUE 0x700117fc Scalar_FLOAT32_IEEE 0 VBU0513_CM_single_cnt -3.4028234663852886E+38 3.4028234663852886E+38 /end CHARACTERISTIC
/begin CHARACTERISTIC TQDIS_tiShftChngDly_C "" VALUE 0x70011804 Scalar_FLOAT32_IEEE 0 VBU0513_CM_single_cnt -3.4028234663852886E+38 3.4028234663852886E+38 /end CHARACTERISTIC
/begin CHARACTERISTIC TQDIS_trqCreepThd_C "" VALUE 0x70011808 Scalar_FLOAT32_IEEE 0 VBU0513_CM_single_cnt -3.4028234663852886E+38 3.4028234663852886E+38 /end CHARACTERISTIC
/begin CHARACTERISTIC TQDIS_trqShftChngLimThres_C "" VALUE 0x70011824 Scalar_FLOAT32_IEEE 0 VBU0513_CM_single_cnt -3.4028234663852886E+38 3.4028234663852886E+38 /end CHARACTERISTIC
/begin CHARACTERISTIC TQDIS_vVehFilterThd_C "" VALUE 0x70011828 Scalar_FLOAT32_IEEE 0 VBU0513_CM_single_cnt -3.4028234663852886E+38 3.4028234663852886E+38 /end CHARACTERISTIC
/begin CHARACTERISTIC TQDMP_facPhaseSclRA_C "" VALUE 0x7001182c Scalar_FLOAT32_IEEE 0 VBU0513_CM_single_cnt -3.4028234663852886E+38 3.4028234663852886E+38 /end CHARACTERISTIC
/begin CHARACTERISTIC TQDMP_facPhsCmpDenRA_C "" VALUE 0x70011830 Scalar_FLOAT32_IEEE 0 VBU0513_CM_single_cnt -3.4028234663852886E+38 3.4028234663852886E+38 /end CHARACTERISTIC
/begin CHARACTERISTIC TQDMP_facPhsCmpK1RA_C "" VALUE 0x70011834 Scalar_FLOAT32_IEEE 0 VBU0513_CM_single_cnt -3.4028234663852886E+38 3.4028234663852886E+38 /end CHARACTERISTIC
/begin CHARACTERISTIC TQDMP_facPhsCmpNumRA_C "" VALUE 0x70011838 Scalar_FLOAT32_IEEE 0 VBU0513_CM_single_cnt -3.4028234663852886E+38 3.4028234663852886E+38 /end CHARACTERISTIC
/begin CHARACTERISTIC TQDMP_nSpdHldMax2FA_C "" VALUE 0x70011844 Scalar_FLOAT32_IEEE 0 VBU0513_CM_single_cnt -3.4028234663852886E+38 3.4028234663852886E+38 /end CHARACTERISTIC
/begin CHARACTERISTIC TQDMP_nSpdHldMaxFA_C "" VALUE 0x70011848 Scalar_FLOAT32_IEEE 0 VBU0513_CM_single_cnt -3.4028234663852886E+38 3.4028234663852886E+38 /end CHARACTERISTIC
/begin CHARACTERISTIC TQDMP_nSpdHldMin2FA_C "" VALUE 0x7001184c Scalar_FLOAT32_IEEE 0 VBU0513_CM_single_cnt -3.4028234663852886E+38 3.4028234663852886E+38 /end CHARACTERISTIC
/begin CHARACTERISTIC TQDMP_nSpdHldMinFA_C "" VALUE 0x70011850 Scalar_FLOAT32_IEEE 0 VBU0513_CM_single_cnt -3.4028234663852886E+38 3.4028234663852886E+38 /end CHARACTERISTIC
/begin CHARACTERISTIC TQDMP_pctTipInAccPedChgThd_C "" VALUE 0x70011858 Scalar_FLOAT32_IEEE 0 VBU0513_CM_single_cnt -3.4028234663852886E+38 3.4028234663852886E+38 /end CHARACTERISTIC
/begin CHARACTERISTIC TQDMP_pctTipInAccPedEnThdHi_C "" VALUE 0x7001185c Scalar_FLOAT32_IEEE 0 VBU0513_CM_single_cnt -3.4028234663852886E+38 3.4028234663852886E+38 /end CHARACTERISTIC
/begin CHARACTERISTIC TQDMP_pctTipInAccPedEnThdLo_C "" VALUE 0x70011860 Scalar_FLOAT32_IEEE 0 VBU0513_CM_single_cnt -3.4028234663852886E+38 3.4028234663852886E+38 /end CHARACTERISTIC
/begin CHARACTERISTIC TQDMP_pctTipInAccPedTrgThd_C "" VALUE 0x70011864 Scalar_FLOAT32_IEEE 0 VBU0513_CM_single_cnt -3.4028234663852886E+38 3.4028234663852886E+38 /end CHARACTERISTIC
/begin CHARACTERISTIC TQDMP_pctTipOutAccPedChgThd_C "" VALUE 0x70011868 Scalar_FLOAT32_IEEE 0 VBU0513_CM_single_cnt -3.4028234663852886E+38 3.4028234663852886E+38 /end CHARACTERISTIC
/begin CHARACTERISTIC TQDMP_pctTipOutAccPedEnThdHi_C "" VALUE 0x7001186c Scalar_FLOAT32_IEEE 0 VBU0513_CM_single_cnt -3.4028234663852886E+38 3.4028234663852886E+38 /end CHARACTERISTIC
/begin CHARACTERISTIC TQDMP_pctTipOutAccPedEnThdLo_C "" VALUE 0x70011870 Scalar_FLOAT32_IEEE 0 VBU0513_CM_single_cnt -3.4028234663852886E+38 3.4028234663852886E+38 /end CHARACTERISTIC
/begin CHARACTERISTIC TQDMP_pctTipOutAccPedTrgThd_C "" VALUE 0x70011874 Scalar_FLOAT32_IEEE 0 VBU0513_CM_single_cnt -3.4028234663852886E+38 3.4028234663852886E+38 /end CHARACTERISTIC
/begin CHARACTERISTIC TQDMP_tiTipInAct_C "" VALUE 0x7001187c Scalar_FLOAT32_IEEE 0 VBU0513_CM_single_cnt -3.4028234663852886E+38 3.4028234663852886E+38 /end CHARACTERISTIC
/begin CHARACTERISTIC TQDMP_tiTipInDly_C "" VALUE 0x70011880 Scalar_FLOAT32_IEEE 0 VBU0513_CM_single_cnt -3.4028234663852886E+38 3.4028234663852886E+38 /end CHARACTERISTIC
/begin CHARACTERISTIC TQDMP_tiTipOutAct_C "" VALUE 0x70011884 Scalar_FLOAT32_IEEE 0 VBU0513_CM_single_cnt -3.4028234663852886E+38 3.4028234663852886E+38 /end CHARACTERISTIC
/begin CHARACTERISTIC TQDMP_tiTipOutDly_C "" VALUE 0x70011888 Scalar_FLOAT32_IEEE 0 VBU0513_CM_single_cnt -3.4028234663852886E+38 3.4028234663852886E+38 /end CHARACTERISTIC
/begin CHARACTERISTIC TQDMP_tiTrqZeroDly_C "" VALUE 0x7001188c Scalar_FLOAT32_IEEE 0 VBU0513_CM_single_cnt -3.4028234663852886E+38 3.4028234663852886E+38 /end CHARACTERISTIC
/begin CHARACTERISTIC TQDMP_trqAxleMaxRA_C "" VALUE 0x70011890 Scalar_FLOAT32_IEEE 0 VBU0513_CM_single_cnt -3.4028234663852886E+38 3.4028234663852886E+38 /end CHARACTERISTIC
/begin CHARACTERISTIC TQDMP_trqDeadZoneMaxRA_C "" VALUE 0x70011894 Scalar_FLOAT32_IEEE 0 VBU0513_CM_single_cnt -3.4028234663852886E+38 3.4028234663852886E+38 /end CHARACTERISTIC
/begin CHARACTERISTIC TQDMP_trqDeadZoneMinRA_C "" VALUE 0x70011898 Scalar_FLOAT32_IEEE 0 VBU0513_CM_single_cnt -3.4028234663852886E+38 3.4028234663852886E+38 /end CHARACTERISTIC
/begin CHARACTERISTIC TQDMP_trqMaxRA_C "" VALUE 0x700118a0 Scalar_FLOAT32_IEEE 0 VBU0513_CM_single_cnt -3.4028234663852886E+38 3.4028234663852886E+38 /end CHARACTERISTIC
/begin CHARACTERISTIC TQDMP_trqMinRA_C "" VALUE 0x700118a4 Scalar_FLOAT32_IEEE 0 VBU0513_CM_single_cnt -3.4028234663852886E+38 3.4028234663852886E+38 /end CHARACTERISTIC
/begin CHARACTERISTIC TQO_trqRARgnMin_C "" VALUE 0x700118fc Scalar_FLOAT32_IEEE 0 VBU0513_CM_single_cnt -3.4028234663852886E+38 0.0 /end CHARACTERISTIC
/begin CHARACTERISTIC TQO_trqSftyDec_C "" VALUE 0x70011904 Scalar_FLOAT32_IEEE 0 VBU0513_CM_single_cnt -3.4028234663852886E+38 3.4028234663852886E+38 /end CHARACTERISTIC
/begin CHARACTERISTIC Veh_fHVILLe_C "" VALUE 0x700119b8 Scalar_FLOAT32_IEEE 0 VBU0513_CM_single_cnt -3.4028234663852886E+38 3.4028234663852886E+38 /end CHARACTERISTIC
/begin CHARACTERISTIC Veh_fHVILRi_C "" VALUE 0x700119bc Scalar_FLOAT32_IEEE 0 VBU0513_CM_single_cnt -3.4028234663852886E+38 3.4028234663852886E+38 /end CHARACTERISTIC
/begin CHARACTERISTIC Veh_pctHVILLe_C "" VALUE 0x700119d0 Scalar_FLOAT32_IEEE 0 VBU0513_CM_single_cnt -3.4028234663852886E+38 3.4028234663852886E+38 /end CHARACTERISTIC
/begin CHARACTERISTIC Veh_pctHVILRi_C "" VALUE 0x700119d4 Scalar_FLOAT32_IEEE 0 VBU0513_CM_single_cnt -3.4028234663852886E+38 3.4028234663852886E+38 /end CHARACTERISTIC
/begin CHARACTERISTIC Veh_tiVCUHVILDebounceCnt_C "" VALUE 0x700119f4 Scalar_FLOAT32_IEEE 0 VBU0513_CM_single_cnt -3.4028234663852886E+38 3.4028234663852886E+38 /end CHARACTERISTIC
/begin CHARACTERISTIC Veh_tiVehHVILDebounceCnt_C "" VALUE 0x700119f8 Scalar_FLOAT32_IEEE 0 VBU0513_CM_single_cnt -3.4028234663852886E+38 3.4028234663852886E+38 /end CHARACTERISTIC
/begin CHARACTERISTIC Veh_vVehHVILDefaultSpd_C "" VALUE 0x700119fc Scalar_FLOAT32_IEEE 0 VBU0513_CM_single_cnt -3.4028234663852886E+38 3.4028234663852886E+38 /end CHARACTERISTIC
/begin CHARACTERISTIC Veh_vVehHVILDft_C "" VALUE 0x70011a00 Scalar_FLOAT32_IEEE 0 VBU0513_CM_single_cnt -3.4028234663852886E+38 3.4028234663852886E+38 /end CHARACTERISTIC
/begin CHARACTERISTIC CaSOF_BuffUseFactorCurrtLTCurrtMapDimension_n "" VAL_BLK 0x70011a32 Scalar_ULONG 0 VBU0513_CM_uint32_cnt 0.0 4.294967295E+9 NUMBER 2 /end CHARACTERISTIC
/begin CHARACTERISTIC CaSOF_BuffUseFactorSocTempMapDimension_n "" VAL_BLK 0x70011a3a Scalar_ULONG 0 VBU0513_CM_uint32_cnt 0.0 4.294967295E+9 NUMBER 2 /end CHARACTERISTIC
/begin CHARACTERISTIC CaSOF_ChargeCurrentLimitBufferTimeSocTempMapDimension_n "" VAL_BLK 0x70011a42 Scalar_ULONG 0 VBU0513_CM_uint32_cnt 0.0 4.294967295E+9 NUMBER 2 /end CHARACTERISTIC
/begin CHARACTERISTIC CaSOF_ContinuousDischargeEolSocTempMapDimension_n "" VAL_BLK 0x70011a52 Scalar_ULONG 0 VBU0513_CM_uint32_cnt 0.0 4.294967295E+9 NUMBER 2 /end CHARACTERISTIC
/begin CHARACTERISTIC CaSOF_ContinuousDischargeLockedSocTempMapDimension_n "" VAL_BLK 0x70011a5a Scalar_ULONG 0 VBU0513_CM_uint32_cnt 0.0 4.294967295E+9 NUMBER 2 /end CHARACTERISTIC
/begin CHARACTERISTIC CaSOF_ContinuousDischargeSocTempMapDimension_n "" VAL_BLK 0x70011a62 Scalar_ULONG 0 VBU0513_CM_uint32_cnt 0.0 4.294967295E+9 NUMBER 2 /end CHARACTERISTIC
/begin CHARACTERISTIC CaSOF_DischargeCurrentLimitBufferTimeSocTempMapDimension_n "" VAL_BLK 0x70011a6a Scalar_ULONG 0 VBU0513_CM_uint32_cnt 0.0 4.294967295E+9 NUMBER 2 /end CHARACTERISTIC
/begin CHARACTERISTIC CaSOF_DischargeDcirSocTempMapDimension_n "" VAL_BLK 0x70011a72 Scalar_ULONG 0 VBU0513_CM_uint32_cnt 0.0 4.294967295E+9 NUMBER 2 /end CHARACTERISTIC
/begin CHARACTERISTIC CaSOF_DischargeOcvSocTempMapDimension_n "" VAL_BLK 0x70011a7a Scalar_ULONG 0 VBU0513_CM_uint32_cnt 0.0 4.294967295E+9 NUMBER 2 /end CHARACTERISTIC
/begin CHARACTERISTIC CaSOF_FastChargeCurrentDropBOLCellVoltageDimension_n "" VAL_BLK 0x70011a8a Scalar_ULONG 0 VBU0513_CM_uint32_cnt 0.0 4.294967295E+9 NUMBER 2 /end CHARACTERISTIC
/begin CHARACTERISTIC CaSOF_FastChargeCurrentDropEOLCellVoltageDimension_n "" VAL_BLK 0x70011a92 Scalar_ULONG 0 VBU0513_CM_uint32_cnt 0.0 4.294967295E+9 NUMBER 2 /end CHARACTERISTIC
/begin CHARACTERISTIC CaSOF_ShortPulseChargeEolSocTempMapDimension_n "" VAL_BLK 0x70011aaa Scalar_ULONG 0 VBU0513_CM_uint32_cnt 0.0 4.294967295E+9 NUMBER 2 /end CHARACTERISTIC
/begin CHARACTERISTIC CaSOF_ShortPulseChargeLockedSocTempMapDimension_n "" VAL_BLK 0x70011ab2 Scalar_ULONG 0 VBU0513_CM_uint32_cnt 0.0 4.294967295E+9 NUMBER 2 /end CHARACTERISTIC
/begin CHARACTERISTIC CaSOF_ShortPulseChargeSocTempMapDimension_n "" VAL_BLK 0x70011aba Scalar_ULONG 0 VBU0513_CM_uint32_cnt 0.0 4.294967295E+9 NUMBER 2 /end CHARACTERISTIC
/begin CHARACTERISTIC CaSOF_ShortPulseDischargeEolSocTempMapDimension_n "" VAL_BLK 0x70011ac2 Scalar_ULONG 0 VBU0513_CM_uint32_cnt 0.0 4.294967295E+9 NUMBER 2 /end CHARACTERISTIC
/begin CHARACTERISTIC CaSOF_ShortPulseDischargeLockedSocTempMapDimension_n "" VAL_BLK 0x70011aca Scalar_ULONG 0 VBU0513_CM_uint32_cnt 0.0 4.294967295E+9 NUMBER 2 /end CHARACTERISTIC
/begin CHARACTERISTIC CaSOF_ShortPulseDischargeSocTempMapDimension_n "" VAL_BLK 0x70011ad2 Scalar_ULONG 0 VBU0513_CM_uint32_cnt 0.0 4.294967295E+9 NUMBER 2 /end CHARACTERISTIC
/begin CHARACTERISTIC CaSOH_DecreaseCapacityMapDimension_n "" VALUE 0x70010490 Scalar_ULONG 0 VBU0513_CM_uint32_cnt 0.0 4.294967295E+9 /end CHARACTERISTIC
/begin CHARACTERISTIC CaSOH_OcvSocMapDimension_n "" VAL_BLK 0x70011ada Scalar_ULONG 0 VBU0513_CM_uint32_cnt 0.0 4.294967295E+9 NUMBER 2 /end CHARACTERISTIC
/begin CHARACTERISTIC CaSOH_UdResisMapDimension_n "" VAL_BLK 0x70011ae2 Scalar_ULONG 0 VBU0513_CM_uint32_cnt 0.0 4.294967295E+9 NUMBER 2 /end CHARACTERISTIC
/begin CHARACTERISTIC CcSOF_BatteryCycleHomo_n "" VALUE 0x700108cc Scalar_ULONG 0 VBU0513_CM_uint32_cnt 0.0 4.294967295E+9 /end CHARACTERISTIC
/begin CHARACTERISTIC CcSOF_LowVoltageSetTime_s "" VALUE 0x700109cc Scalar_ULONG 0 VBU0513_CM_uint32_cnt 0.0 4.294967295E+9 /end CHARACTERISTIC
/begin CHARACTERISTIC CcSOF_VoltageCorrectCheckInc1_n "" VALUE 0x70010a0c Scalar_ULONG 0 VBU0513_CM_uint32_cnt 0.0 4.294967295E+9 /end CHARACTERISTIC
/begin CHARACTERISTIC CcSOF_VoltageCorrectCheckInc2_n "" VALUE 0x70010a10 Scalar_ULONG 0 VBU0513_CM_uint32_cnt 0.0 4.294967295E+9 /end CHARACTERISTIC
/begin CHARACTERISTIC CcSOF_VoltageCorrectCheckInc3_n "" VALUE 0x70010a14 Scalar_ULONG 0 VBU0513_CM_uint32_cnt 0.0 4.294967295E+9 /end CHARACTERISTIC
/begin CHARACTERISTIC CcSOF_VoltageCorrectCheckInc4_n "" VALUE 0x70010a18 Scalar_ULONG 0 VBU0513_CM_uint32_cnt 0.0 4.294967295E+9 /end CHARACTERISTIC
/begin CHARACTERISTIC CcSOF_VoltageCorrectEnableInc1_n "" VALUE 0x70010a1c Scalar_ULONG 0 VBU0513_CM_uint32_cnt 0.0 4.294967295E+9 /end CHARACTERISTIC
/begin CHARACTERISTIC CcSOF_VoltageCorrectEnableInc2_n "" VALUE 0x70010a20 Scalar_ULONG 0 VBU0513_CM_uint32_cnt 0.0 4.294967295E+9 /end CHARACTERISTIC
/begin CHARACTERISTIC CcSOF_VoltageCorrectEnableInc3_n "" VALUE 0x70010a24 Scalar_ULONG 0 VBU0513_CM_uint32_cnt 0.0 4.294967295E+9 /end CHARACTERISTIC
/begin CHARACTERISTIC CcSOF_VoltageCorrectEnableInc4_n "" VALUE 0x70010a28 Scalar_ULONG 0 VBU0513_CM_uint32_cnt 0.0 4.294967295E+9 /end CHARACTERISTIC
/begin CHARACTERISTIC CcSOH_AfterEdgeFallTime_ms "" VALUE 0x70010a48 Scalar_ULONG 0 VBU0513_CM_uint32_cnt 0.0 4.294967295E+9 /end CHARACTERISTIC
/begin CHARACTERISTIC CcSOH_BeforeEdgeFallTime_ms "" VALUE 0x70010a4c Scalar_ULONG 0 VBU0513_CM_uint32_cnt 0.0 4.294967295E+9 /end CHARACTERISTIC
/begin CHARACTERISTIC CcBCV_BatteryCurrentZeroDriftTime_ms "" VALUE 0x7001002c Scalar_UWORD 0 VBU0513_CM_uint16_cnt 0.0 65535.0 /end CHARACTERISTIC
/begin CHARACTERISTIC CcCBL_BalanceStartDeltaVoltageHysteresis_mV "" VALUE 0x7001004c Scalar_UWORD 0 VBU0513_CM_uint16_cnt 0.0 65535.0 /end CHARACTERISTIC
/begin CHARACTERISTIC CcCBL_CellBalanceCurrentMax_mA "" VALUE 0x70010052 Scalar_UWORD 0 VBU0513_CM_uint16_cnt 0.0 65535.0 /end CHARACTERISTIC
/begin CHARACTERISTIC CcCBL_ChargeBalanceStartDeltaVoltage_mV "" VALUE 0x70010056 Scalar_UWORD 0 VBU0513_CM_uint16_cnt 0.0 65535.0 /end CHARACTERISTIC
/begin CHARACTERISTIC CcFCC_BatteryCapacityCycleHomo_n "" VALUE 0x70010094 Scalar_UWORD 0 VBU0513_CM_uint16_cnt 0.0 65535.0 /end CHARACTERISTIC
/begin CHARACTERISTIC CcFCC_FullChargeOcvDebounceTime_s "" VALUE 0x700100a6 Scalar_UWORD 0 VBU0513_CM_uint16_cnt 0.0 65535.0 /end CHARACTERISTIC
/begin CHARACTERISTIC CcFCC_FullChargeSocDebounceTime_s "" VALUE 0x700100a8 Scalar_UWORD 0 VBU0513_CM_uint16_cnt 0.0 65535.0 /end CHARACTERISTIC
/begin CHARACTERISTIC CcSOC_CurrentStableTime_ms "" VALUE 0x0000 Scalar_UWORD 0 VBU0513_CM_uint16_cnt 0.0 65535.0 /end CHARACTERISTIC
/begin CHARACTERISTIC CcSOC_FastChargePreCorrectionDeltaVolMax_mV "" VALUE 0x700100c2 Scalar_UWORD 0 VBU0513_CM_uint16 0 65535 /end CHARACTERISTIC
/begin CHARACTERISTIC CcSOF_CellVoltageHigh1_mV "" VALUE 0x700100e0 Scalar_UWORD 0 VBU0513_CM_uint16_cnt 0.0 65535.0 /end CHARACTERISTIC
/begin CHARACTERISTIC CcSOF_CellVoltageHigh2_mV "" VALUE 0x700100e2 Scalar_UWORD 0 VBU0513_CM_uint16_cnt 0.0 65535.0 /end CHARACTERISTIC
/begin CHARACTERISTIC CcSOF_CellVoltageHigh3_mV "" VALUE 0x700100e4 Scalar_UWORD 0 VBU0513_CM_uint16_cnt 0.0 65535.0 /end CHARACTERISTIC
/begin CHARACTERISTIC CcSOF_CellVoltageHigh4_mV "" VALUE 0x700100e6 Scalar_UWORD 0 VBU0513_CM_uint16_cnt 0.0 65535.0 /end CHARACTERISTIC
/begin CHARACTERISTIC CcSOF_CellVoltageLow1_mV "" VALUE 0x700100e8 Scalar_UWORD 0 VBU0513_CM_uint16_cnt 0.0 65535.0 /end CHARACTERISTIC
/begin CHARACTERISTIC CcSOF_CellVoltageLow2_mV "" VALUE 0x700100ea Scalar_UWORD 0 VBU0513_CM_uint16_cnt 0.0 65535.0 /end CHARACTERISTIC
/begin CHARACTERISTIC CcSOF_CellVoltageLow3_mV "" VALUE 0x700100ec Scalar_UWORD 0 VBU0513_CM_uint16_cnt 0.0 65535.0 /end CHARACTERISTIC
/begin CHARACTERISTIC CcSOF_CellVoltageLow4_mV "" VALUE 0x700100ee Scalar_UWORD 0 VBU0513_CM_uint16_cnt 0.0 65535.0 /end CHARACTERISTIC
/begin CHARACTERISTIC CcSOF_FccOneThirdCurtSloDelay_ms "" VALUE 0x700100f2 Scalar_UWORD 0 VBU0513_CM_uint16_cnt 0.0 65535.0 /end CHARACTERISTIC
/begin CHARACTERISTIC CcSOF_LowVoltageAbnormalPowerOnDelay_ms "" VALUE 0x700100f8 Scalar_UWORD 0 VBU0513_CM_uint16_cnt 0.0 65535.0 /end CHARACTERISTIC
/begin CHARACTERISTIC CcSOF_LowVoltageSetCurrentDelay_ms "" VALUE 0x700100fc Scalar_UWORD 0 VBU0513_CM_uint16_cnt 0.0 65535.0 /end CHARACTERISTIC
/begin CHARACTERISTIC CcSOF_LowVoltageSetVoltageDelay_ms "" VALUE 0x700100fe Scalar_UWORD 0 VBU0513_CM_uint16_cnt 0.0 65535.0 /end CHARACTERISTIC
/begin CHARACTERISTIC CcSOF_PowerOnOverCurFacSloDelay_ms "" VALUE 0x70010102 Scalar_UWORD 0 VBU0513_CM_uint16_cnt 0.0 65535.0 /end CHARACTERISTIC
/begin CHARACTERISTIC CcSOF_PowerOnVolCorCurtSloDelay_ms "" VALUE 0x70010104 Scalar_UWORD 0 VBU0513_CM_uint16_cnt 0.0 65535.0 /end CHARACTERISTIC
/begin CHARACTERISTIC CcSOF_PowerOnVolCorFacSloDelay_ms "" VALUE 0x70010106 Scalar_UWORD 0 VBU0513_CM_uint16_cnt 0.0 65535.0 /end CHARACTERISTIC
/begin CHARACTERISTIC CcSOF_SocpModeDebounceTime_ms "" VALUE 0x70010108 Scalar_UWORD 0 VBU0513_CM_uint16_cnt 0.0 65535.0 /end CHARACTERISTIC
/begin CHARACTERISTIC CcSOF_StopChargeSOCDebounceTime_s "" VALUE 0x7001010a Scalar_UWORD 0 VBU0513_CM_uint16_cnt 0.0 65535.0 /end CHARACTERISTIC
/begin CHARACTERISTIC CcSOF_StopChargeVoltDebounceTime_s "" VALUE 0x7001010c Scalar_UWORD 0 VBU0513_CM_uint16_cnt 0.0 65535.0 /end CHARACTERISTIC
/begin CHARACTERISTIC CcSYS_FullChargeOcv_mV "" VALUE 0x70010118 Scalar_UWORD 0 VBU0513_CM_uint16_cnt 0.0 65535.0 /end CHARACTERISTIC
/begin CHARACTERISTIC CcTHM_CoolantSensorValidDelayTime_s "" VALUE 0x7001011e Scalar_UWORD 0 VBU0513_CM_uint16_cnt 0.0 65535.0 /end CHARACTERISTIC
/begin CHARACTERISTIC APD_flgFulPedalEnable_C "" VALUE 0x700209a4 Scalar_BOOLEAN 0 VBU0513_CM_boolean_cnt 0.0 1.0 /end CHARACTERISTIC
/begin CHARACTERISTIC CbFCC_ChargeVoltageOvR_flg "" VALUE 0x70020b0a Scalar_BOOLEAN 0 VBU0513_CM_boolean_cnt 0.0 1.0 /end CHARACTERISTIC
/begin CHARACTERISTIC CbSOF_VoltageCorrectLevelEnable_flg "" VALUE 0x70020b23 Scalar_BOOLEAN 0 VBU0513_CM_boolean_cnt 0.0 1.0 /end CHARACTERISTIC
/begin CHARACTERISTIC CbSOF_VoltageTableCorrectUsePredictedCellVoltage_flg "" VALUE 0x70020b24 Scalar_BOOLEAN 0 VBU0513_CM_boolean_cnt 0.0 1.0 /end CHARACTERISTIC
/begin CHARACTERISTIC CcSOF_EnableCalculatedDcir_flg "" VALUE 0x70020c4b Scalar_BOOLEAN 0 VBU0513_CM_boolean_cnt 0.0 1.0 /end CHARACTERISTIC
/begin CHARACTERISTIC CcSOF_UseSohLimitEnable_flg "" VALUE 0x70020c4d Scalar_BOOLEAN 0 VBU0513_CM_boolean_cnt 0.0 1.0 /end CHARACTERISTIC
/begin CHARACTERISTIC DSPL_flgEnergyFactorSelfLearnEn_C "" VALUE 0x70020da0 Scalar_BOOLEAN 0 VBU0513_CM_boolean_flg 0.0 1.0 /end CHARACTERISTIC
/begin CHARACTERISTIC EDIS_flgDisChDynMore_C "" VALUE 0x70020db3 Scalar_BOOLEAN 0 VBU0513_CM_boolean_cnt 0.0 1.0 /end CHARACTERISTIC
/begin CHARACTERISTIC EDIS_flgDisChDynOverride_C "" VALUE 0x70020db4 Scalar_BOOLEAN 0 VBU0513_CM_boolean_cnt 0.0 1.0 /end CHARACTERISTIC
/begin CHARACTERISTIC Gear_flgCurrentGearDisplayInValid_C "" VALUE 0x70020def Scalar_BOOLEAN 0 VBU0513_CM_boolean_cnt 0.0 1.0 /end CHARACTERISTIC
/begin CHARACTERISTIC Gear_flgCurrentGearDisplayValid_C "" VALUE 0x70020df0 Scalar_BOOLEAN 0 VBU0513_CM_boolean_cnt 0.0 1.0 /end CHARACTERISTIC
/begin CHARACTERISTIC Gear_flgDisplayGearValidEn_C "" VALUE 0x70020df1 Scalar_BOOLEAN 0 VBU0513_CM_boolean_cnt 0.0 1.0 /end CHARACTERISTIC
/begin CHARACTERISTIC Gear_flgIntendGearDisplayValid_C "" VALUE 0x70020df5 Scalar_BOOLEAN 0 VBU0513_CM_boolean_cnt 0.0 1.0 /end CHARACTERISTIC
/begin CHARACTERISTIC TQDMP_flgROTCEnRA_C "" VALUE 0x70020efd Scalar_BOOLEAN 0 VBU0513_CM_boolean_cnt 0.0 1.0 /end CHARACTERISTIC
/begin CHARACTERISTIC TQDMP_flgSpdHldOn_C "" VALUE 0x70020efe Scalar_BOOLEAN 0 VBU0513_CM_boolean_cnt 0.0 1.0 /end CHARACTERISTIC
/begin CHARACTERISTIC TQDMP_flgTipInEnaRvs_C "" VALUE 0x70020eff Scalar_BOOLEAN 0 VBU0513_CM_boolean_cnt 0.0 1.0 /end CHARACTERISTIC
/begin CHARACTERISTIC TQDMP_flgTipOutEnaRvs_C "" VALUE 0x70020f00 Scalar_BOOLEAN 0 VBU0513_CM_boolean_cnt 0.0 1.0 /end CHARACTERISTIC
/begin CHARACTERISTIC Veh_flgHVILCaliOvrdVal_C "" VALUE 0x70020f22 Scalar_BOOLEAN 0 VBU0513_CM_boolean_cnt 0.0 1.0 /end CHARACTERISTIC
/begin CHARACTERISTIC Veh_flgHVILCaliOvrd_C "" VALUE 0x70020f23 Scalar_BOOLEAN 0 VBU0513_CM_boolean_cnt 0.0 1.0 /end CHARACTERISTIC
/begin CHARACTERISTIC Veh_flgLowSpdGearChange_C "" VALUE 0x70020f25 Scalar_BOOLEAN 0 VBU0513_CM_boolean_cnt 0.0 1.0 /end CHARACTERISTIC
/begin CHARACTERISTIC APD_stSelectPedal1_C "" VALUE 0x700209a7 Scalar_UBYTE 0 VBU0513_CM_uint8_cnt 0.0 15.0 /end CHARACTERISTIC
/begin CHARACTERISTIC APD_stSelectPedal2_C "" VALUE 0x700209a8 Scalar_UBYTE 0 VBU0513_CM_uint8_cnt 0.0 15.0 /end CHARACTERISTIC
/begin CHARACTERISTIC APD_stSelectPedalDefault_C "" VALUE 0x700209a9 Scalar_UBYTE 0 VBU0513_CM_uint8_cnt 0.0 15.0 /end CHARACTERISTIC
/begin CHARACTERISTIC APD_stSelectPedalMin_C "" VALUE 0x700209aa Scalar_UBYTE 0 VBU0513_CM_uint8_cnt 0.0 15.0 /end CHARACTERISTIC
/begin CHARACTERISTIC APD_stSelectPedalORV "" VALUE 0x700209ab Scalar_UBYTE 0 VBU0513_CM_uint8 0 255 /end CHARACTERISTIC
/begin CHARACTERISTIC CaFCC_FullChargeVoltageDCIRMapDimension_n "" VAL_BLK 0x70020f32 Scalar_UBYTE 0 VBU0513_CM_uint8_cnt 0.0 255.0 NUMBER 2 /end CHARACTERISTIC
/begin CHARACTERISTIC CaFCC_FullChargeVoltageHysteresisMapDimension_n "" VAL_BLK 0x70020f34 Scalar_UBYTE 0 VBU0513_CM_uint8_cnt 0.0 255.0 NUMBER 2 /end CHARACTERISTIC
/begin CHARACTERISTIC CaFCC_FullChargeVoltagePolarizaitonMapDimension_n "" VAL_BLK 0x70020f36 Scalar_UBYTE 0 VBU0513_CM_uint8_cnt 0.0 255.0 NUMBER 2 /end CHARACTERISTIC
/begin CHARACTERISTIC CaFCC_FullChargeVoltageSOHAttenuationMapDimension_n "" VAL_BLK 0x70020f38 Scalar_UBYTE 0 VBU0513_CM_uint8_cnt 0.0 255.0 NUMBER 2 /end CHARACTERISTIC
/begin CHARACTERISTIC CaSYS_FullChargeOcvMapDimension_n "" VAL_BLK 0x70020f40 Scalar_UBYTE 0 VBU0513_CM_uint8_cnt 0.0 255.0 NUMBER 2 /end CHARACTERISTIC
/begin CHARACTERISTIC CcSOF_DcirDelayTimes_n "" VALUE 0x70020c48 Scalar_UBYTE 0 VBU0513_CM_uint8_cnt 0.0 255.0 /end CHARACTERISTIC
/begin CHARACTERISTIC EDIS_stCurrentGearD_C "" VALUE 0x70020dbd Scalar_UBYTE 0 VBU0513_CM_uint8_cnt 0.0 15.0 /end CHARACTERISTIC
/begin CHARACTERISTIC Gear_stDriveIntendGearD_C "" VALUE 0x70020dfe Scalar_UBYTE 0 VBU0513_CM_uint8_cnt 0.0 15.0 /end CHARACTERISTIC
/begin CHARACTERISTIC Gear_stDriveIntendGearInvalid_C "" VALUE 0x70020dff Scalar_UBYTE 0 VBU0513_CM_uint8_cnt 0.0 15.0 /end CHARACTERISTIC
/begin CHARACTERISTIC Gear_stDriveIntendGearNeutral_C "" VALUE 0x70020e00 Scalar_UBYTE 0 VBU0513_CM_uint8_cnt 0.0 15.0 /end CHARACTERISTIC
/begin CHARACTERISTIC Gear_stDriveIntendGearR_C "" VALUE 0x70020e01 Scalar_UBYTE 0 VBU0513_CM_uint8_cnt 0.0 15.0 /end CHARACTERISTIC
/begin CHARACTERISTIC Gear_stGearDValidBit1_C "" VALUE 0x70020e09 Scalar_UBYTE 0 VBU0513_CM_uint8_cnt 0.0 255.0 /end CHARACTERISTIC
/begin CHARACTERISTIC Gear_stGearNValid_C "" VALUE 0x70020e0a Scalar_UBYTE 0 VBU0513_CM_uint8_cnt 0.0 255.0 /end CHARACTERISTIC
/begin CHARACTERISTIC Gear_stGearRValidBit1_C "" VALUE 0x70020e0b Scalar_UBYTE 0 VBU0513_CM_uint8_cnt 0.0 255.0 /end CHARACTERISTIC
/begin CHARACTERISTIC Gear_stIntendGearD_C "" VALUE 0x70020e0d Scalar_UBYTE 0 VBU0513_CM_uint8_cnt 0.0 15.0 /end CHARACTERISTIC
/begin CHARACTERISTIC Gear_stIntendGearN_C "" VALUE 0x70020e0e Scalar_UBYTE 0 VBU0513_CM_uint8_cnt 0.0 15.0 /end CHARACTERISTIC
/begin CHARACTERISTIC Gear_stIntendGearR_C "" VALUE 0x70020e10 Scalar_UBYTE 0 VBU0513_CM_uint8_cnt 0.0 15.0 /end CHARACTERISTIC
/begin CHARACTERISTIC SOF_VOLTAGE_CORRECT_LEVEL1 "" VALUE 0x70020ecc Scalar_UBYTE 0 VBU0513_CM_uint8_cnt 0.0 255.0 /end CHARACTERISTIC
/begin CHARACTERISTIC SOF_VOLTAGE_CORRECT_LEVEL2 "" VALUE 0x70020ecd Scalar_UBYTE 0 VBU0513_CM_uint8_cnt 0.0 255.0 /end CHARACTERISTIC
/begin CHARACTERISTIC SOF_VOLTAGE_CORRECT_LEVEL3 "" VALUE 0x70020ece Scalar_UBYTE 0 VBU0513_CM_uint8_cnt 0.0 255.0 /end CHARACTERISTIC
/begin CHARACTERISTIC SOF_VOLTAGE_CORRECT_LEVEL4 "" VALUE 0x70020ecf Scalar_UBYTE 0 VBU0513_CM_uint8_cnt 0.0 255.0 /end CHARACTERISTIC
/begin CHARACTERISTIC SOF_VOLTAGE_CORRECT_NONE "" VALUE 0x70020ed0 Scalar_UBYTE 0 VBU0513_CM_uint8_cnt 0.0 255.0 /end CHARACTERISTIC
/begin CHARACTERISTIC SYS_stHMIDrvModeSport_SY "" VALUE 0x70020ed7 Scalar_UBYTE 0 VBU0513_CM_uint8_cnt 0.0 255.0 /end CHARACTERISTIC
/begin CHARACTERISTIC Veh_stErr_C "" VALUE 0x70020f2a Scalar_UBYTE 0 VBU0513_CM_uint8_cnt 0.0 15.0 /end CHARACTERISTIC
/begin CHARACTERISTIC Veh_stNoErr_C "" VALUE 0x70020f2e Scalar_UBYTE 0 VBU0513_CM_uint8_cnt 0.0 15.0 /end CHARACTERISTIC
/begin MEASUREMENT Gear_stHWSensor "" ULONG VBU0513_CM_uint32 0 0 0.0 15.0 ECU_ADDRESS 0x9000216e /end MEASUREMENT
/begin MEASUREMENT INP_uBrkPresFlt1 "" FLOAT32_IEEE VBU0513_CM_single 0 0 -3.4E+38 3.4E+38 ECU_ADDRESS 0x9000244e /end MEASUREMENT
/begin MEASUREMENT APD_pctAPDbasic "" FLOAT32_IEEE VBU0513_CM_single 0 0 -3.4E+38 3.4E+38 ECU_ADDRESS 0x90001e36 /end MEASUREMENT
/begin MEASUREMENT MTQL_trqVehSpdDrvLimR "" FLOAT32_IEEE VBU0513_CM_single 0 0 -10000.0 10000.0 ECU_ADDRESS 0x9000219a /end MEASUREMENT
/begin MEASUREMENT TQDMP_pctAccPdlVrtlRA "" FLOAT32_IEEE VBU0513_CM_single 0 0 -3.4E+38 3.4E+38 ECU_ADDRESS 0x9000208e /end MEASUREMENT
/begin MEASUREMENT TQDMP_trqDeltaLPFR "" FLOAT32_IEEE VBU0513_CM_single 0 0 -10000.0 10000.0 ECU_ADDRESS 0x9000209e /end MEASUREMENT
/begin MEASUREMENT TQDMP_trqDeltaR "" FLOAT32_IEEE VBU0513_CM_single 0 0 -10000.0 10000.0 ECU_ADDRESS 0x900020a2 /end MEASUREMENT
/begin MEASUREMENT TQDMP_trqROTCRA "" FLOAT32_IEEE VBU0513_CM_single 0 0 -10000.0 10000.0 ECU_ADDRESS 0x900020aa /end MEASUREMENT
/begin MEASUREMENT TQDMP_trqBumpRA "" FLOAT32_IEEE VBU0513_CM_single 0 0 -10000.0 10000.0 ECU_ADDRESS 0x90002092 /end MEASUREMENT
/begin MEASUREMENT TQO_trqBrkLim "" FLOAT32_IEEE VBU0513_CM_single 0 0 -10000.0 10000.0 ECU_ADDRESS 0x900020d2 /end MEASUREMENT
/begin MEASUREMENT TQO_trqSftyRA "" FLOAT32_IEEE VBU0513_CM_single 0 0 -10000.0 10000.0 ECU_ADDRESS 0x900020da /end MEASUREMENT
/begin MEASUREMENT TQO_facShft "" FLOAT32_IEEE VBU0513_CM_single 0 0 -3.4E+38 3.4E+38 ECU_ADDRESS 0x900020ca /end MEASUREMENT
/begin MEASUREMENT TQDIS_trqCrpBase "" FLOAT32_IEEE VBU0513_CM_single 0 0 -10000.0 10000.0 ECU_ADDRESS 0x90002056 /end MEASUREMENT
/begin MEASUREMENT TQDIS_facBrkSlpCrp "" FLOAT32_IEEE VBU0513_CM_single 0 0 -3.4E+38 3.4E+38 ECU_ADDRESS 0x9000204a /end MEASUREMENT
/begin MEASUREMENT TQDIS_trqCrpIncFilter "" FLOAT32_IEEE VBU0513_CM_single 0 0 -10000.0 10000.0 ECU_ADDRESS 0x9000205e /end MEASUREMENT
/begin MEASUREMENT TQDIS_trqIncBase "" FLOAT32_IEEE VBU0513_CM_single 0 0 -3.4E+38 3.4E+38 ECU_ADDRESS 0x9000251e /end MEASUREMENT
/begin MEASUREMENT TQDIS_facIncGain "" FLOAT32_IEEE VBU0513_CM_single 0 0 -3.4E+38 3.4E+38 ECU_ADDRESS 0x90002542 /end MEASUREMENT
/begin MEASUREMENT TQDIS_trqBase1RADrvIncLim "" FLOAT32_IEEE VBU0513_CM_single 0 0 -3.4E+38 3.4E+38 ECU_ADDRESS 0x90002546 /end MEASUREMENT
/begin MEASUREMENT TQDIS_facAccPedFilter "" FLOAT32_IEEE VBU0513_CM_single 0 0 -3.4E+38 3.4E+38 ECU_ADDRESS 0x9000203e /end MEASUREMENT
/begin MEASUREMENT TQDIS_facUnintdAcc "" FLOAT32_IEEE VBU0513_CM_single 0 0 -3.4E+38 3.4E+38 ECU_ADDRESS 0x90002052 /end MEASUREMENT
/begin MEASUREMENT TQDIS_trqBase2RADrvIncLim "" FLOAT32_IEEE VBU0513_CM_single 0 0 -3.4E+38 3.4E+38 ECU_ADDRESS 0x90002516 /end MEASUREMENT
/begin MEASUREMENT TQDIS_facPwrLo "" FLOAT32_IEEE VBU0513_CM_single 0 0 -3.4E+38 3.4E+38 ECU_ADDRESS 0x9000204e /end MEASUREMENT
/begin MEASUREMENT TQDIS_trqRADrvIncLim "" FLOAT32_IEEE VBU0513_CM_single 0 0 -10000.0 10000.0 ECU_ADDRESS 0x90002072 /end MEASUREMENT
/begin MEASUREMENT TQDIS_trqCrpDecFilter "" FLOAT32_IEEE VBU0513_CM_single 0 0 -10000.0 10000.0 ECU_ADDRESS 0x9000205a /end MEASUREMENT
/begin MEASUREMENT TQDIS_facBrkDec "" FLOAT32_IEEE VBU0513_CM_single 0 0 -3.4E+38 3.4E+38 ECU_ADDRESS 0x90002046 /end MEASUREMENT
/begin MEASUREMENT TQDIS_facBase2RADrvDecLim "" FLOAT32_IEEE VBU0513_CM_single 0 0 -3.4E+38 3.4E+38 ECU_ADDRESS 0x90002042 /end MEASUREMENT
/begin MEASUREMENT TQDIS_trqRADrvDecLim "" FLOAT32_IEEE VBU0513_CM_single 0 0 -10000.0 10000.0 ECU_ADDRESS 0x9000206e /end MEASUREMENT
/begin MEASUREMENT TQDIS_trqDmpRAInit "" FLOAT32_IEEE VBU0513_CM_single 0 0 -10000.0 10000.0 ECU_ADDRESS 0x90002062 /end MEASUREMENT
/begin MEASUREMENT EDIS_pwrDisChLimDynRaw "" FLOAT32_IEEE VBU0513_CM_single 0 0 0.0 1000.0 ECU_ADDRESS 0x9000212a /end MEASUREMENT
/begin MEASUREMENT EDIS_pwrDisChLimSTRaw "" FLOAT32_IEEE VBU0513_CM_single 0 0 0.0 1000.0 ECU_ADDRESS 0x90002132 /end MEASUREMENT
/begin MEASUREMENT EDIS_pwrDisChaDynCold "" FLOAT32_IEEE VBU0513_CM_single 0 0 0.0 1000.0 ECU_ADDRESS 0x9000213a /end MEASUREMENT
/begin MEASUREMENT EDIS_pwrDisChaDynHot "" FLOAT32_IEEE VBU0513_CM_single 0 0 -3.4E+38 3.4E+38 ECU_ADDRESS 0x90001ebe /end MEASUREMENT
/begin MEASUREMENT EDIS_pwrDisChaDynTempCorr "" FLOAT32_IEEE VBU0513_CM_single 0 0 0.0 1000.0 ECU_ADDRESS 0x9000213e /end MEASUREMENT
/begin MEASUREMENT EDIS_pwrDisChLimDynOvrride "" FLOAT32_IEEE VBU0513_CM_single 0 0 -3.4E+38 3.4E+38 ECU_ADDRESS 0x90001eb6 /end MEASUREMENT
/begin MEASUREMENT EDIS_pwrDisChLimDynST "" FLOAT32_IEEE VBU0513_CM_single 0 0 -3.4E+38 3.4E+38 ECU_ADDRESS 0x90001eba /end MEASUREMENT
/begin MEASUREMENT EDIS_facDchDynSp "" FLOAT32_IEEE VBU0513_CM_single 0 0 -3.4E+38 3.4E+38 ECU_ADDRESS 0x90001ea6 /end MEASUREMENT
/begin MEASUREMENT EDIS_pwrDisChSp "" FLOAT32_IEEE VBU0513_CM_single 0 0 0.0 1000.0 ECU_ADDRESS 0x90002136 /end MEASUREMENT
/begin MEASUREMENT EDIS_pwrChLimLTRaw "" FLOAT32_IEEE VBU0513_CM_single 0 0 0.0 1000.0 ECU_ADDRESS 0x90002122 /end MEASUREMENT
/begin MEASUREMENT EDIS_pwrChLimDynRaw "" FLOAT32_IEEE VBU0513_CM_single 0 0 -3.4E+38 3.4E+38 ECU_ADDRESS 0x9000211e /end MEASUREMENT
/begin MEASUREMENT EDIS_pwrDisChLimLTRaw "" FLOAT32_IEEE VBU0513_CM_single 0 0 0.0 1000.0 ECU_ADDRESS 0x9000212e /end MEASUREMENT
/begin MEASUREMENT SOH_AhCellCapacityMin "" FLOAT32_IEEE VBU0513_CM_single 0 0 -3.4E+38 3.4E+38 ECU_ADDRESS 0x900024ea /end MEASUREMENT
/begin MEASUREMENT SOH_AhCellCapacityMax "" FLOAT32_IEEE VBU0513_CM_single 0 0 -3.4E+38 3.4E+38 ECU_ADDRESS 0x900024e6 /end MEASUREMENT
/begin MEASUREMENT SOH_AhCellCapacityAve "" FLOAT32_IEEE VBU0513_CM_single 0 0 -3.4E+38 3.4E+38 ECU_ADDRESS 0x900024e2 /end MEASUREMENT
/begin MEASUREMENT SOF_pctCurrentSOH "" FLOAT32_IEEE VBU0513_CM_single 0 0 -3.4E+38 3.4E+38 ECU_ADDRESS 0x900024d6 /end MEASUREMENT
/begin MEASUREMENT SOF_facContinuousChargeFactor "" FLOAT32_IEEE VBU0513_CM_single 0 0 -3.4E+38 3.4E+38 ECU_ADDRESS 0x9000248a /end MEASUREMENT
/begin MEASUREMENT SOF_iAContinuousChargeCurrentBaseRaw "" FLOAT32_IEEE VBU0513_CM_single 0 0 -3.4E+38 3.4E+38 ECU_ADDRESS 0x9000249a /end MEASUREMENT
/begin MEASUREMENT SOF_iAContinuousChargeCurrentLimitMapBaseNormal "" FLOAT32_IEEE VBU0513_CM_single 0 0 -3.4E+38 3.4E+38 ECU_ADDRESS 0x90001f46 /end MEASUREMENT
/begin MEASUREMENT SOF_iAShortPulseChargeCurrentLimitMapBaseNormal "" FLOAT32_IEEE VBU0513_CM_single 0 0 -3.4E+38 3.4E+38 ECU_ADDRESS 0x90001f86 /end MEASUREMENT
/begin MEASUREMENT SOF_iAShortPulseDischargeCurrentLimitBase "" FLOAT32_IEEE VBU0513_CM_single 0 0 -3.4E+38 3.4E+38 ECU_ADDRESS 0x90001f92 /end MEASUREMENT
/begin MEASUREMENT SOF_iAShortPulseDischargeCurrentLimitFastChrgChk "" FLOAT32_IEEE VBU0513_CM_single 0 0 -3.4E+38 3.4E+38 ECU_ADDRESS 0x90001f96 /end MEASUREMENT
/begin MEASUREMENT SOF_iAContinuousDischargeCurrentLimitFastChrgChk "" FLOAT32_IEEE VBU0513_CM_single 0 0 -3.4E+38 3.4E+38 ECU_ADDRESS 0x90001f52 /end MEASUREMENT
/begin MEASUREMENT SOF_iAShortPulseChargeCurrentLimitFastChrgChk "" FLOAT32_IEEE VBU0513_CM_single 0 0 -3.4E+38 3.4E+38 ECU_ADDRESS 0x90001f82 /end MEASUREMENT
/begin MEASUREMENT SOF_iAContinuousChargeCurrentLimitFastChrgChkRaw "" FLOAT32_IEEE VBU0513_CM_single 0 0 -3.4E+38 3.4E+38 ECU_ADDRESS 0x90001f42 /end MEASUREMENT
/begin MEASUREMENT SOF_iAContinuousChargeCurrentLimitFastChrgChk "" FLOAT32_IEEE VBU0513_CM_single 0 0 -3.4E+38 3.4E+38 ECU_ADDRESS 0x90001f3e /end MEASUREMENT
/begin MEASUREMENT SOF_mohmCellDischargeDcirCalc "" FLOAT32_IEEE VBU0513_CM_single 0 0 -3.4E+38 3.4E+38 ECU_ADDRESS 0x90001fc6 /end MEASUREMENT
/begin MEASUREMENT SOF_iAShortPulseChargeCurrentLimitVltgTarget "" FLOAT32_IEEE VBU0513_CM_single 0 0 -3.4E+38 3.4E+38 ECU_ADDRESS 0x90001f8e /end MEASUREMENT
/begin MEASUREMENT SOF_iAContinuousChargeCurrentLimitVltgTarget "" FLOAT32_IEEE VBU0513_CM_single 0 0 -3.4E+38 3.4E+38 ECU_ADDRESS 0x90001f4e /end MEASUREMENT
/begin MEASUREMENT SOF_iADynamicChargeCurrentLimitVltgTarget "" FLOAT32_IEEE VBU0513_CM_single 0 0 -3.4E+38 3.4E+38 ECU_ADDRESS 0x90001f66 /end MEASUREMENT
/begin MEASUREMENT SOF_iAShortPulseDischargeCurrentLimitVltgTarget "" FLOAT32_IEEE VBU0513_CM_single 0 0 -3.4E+38 3.4E+38 ECU_ADDRESS 0x90001f9e /end MEASUREMENT
/begin MEASUREMENT SOF_iAContinuousDischargeCurrentLimitVltgTarget "" FLOAT32_IEEE VBU0513_CM_single 0 0 -3.4E+38 3.4E+38 ECU_ADDRESS 0x90001f5a /end MEASUREMENT
/begin MEASUREMENT SOF_iADynamicDischargeCurrentLimitVltgBefoTarget "" FLOAT32_IEEE VBU0513_CM_single 0 0 -3.4E+38 3.4E+38 ECU_ADDRESS 0x90001f72 /end MEASUREMENT
/begin MEASUREMENT SOF_iADynamicDischargeCurrentLimitVltgDcirTarget "" FLOAT32_IEEE VBU0513_CM_single 0 0 -3.4E+38 3.4E+38 ECU_ADDRESS 0x90001f76 /end MEASUREMENT
/begin MEASUREMENT SOF_iADynamicDischargeCurrentLimitVltgTarget "" FLOAT32_IEEE VBU0513_CM_single 0 0 -3.4E+38 3.4E+38 ECU_ADDRESS 0x90001f7a /end MEASUREMENT
/begin MEASUREMENT SOF_AsChargeCurrentLimitBufferFull "" FLOAT32_IEEE VBU0513_CM_single 0 0 -3.4E+38 3.4E+38 ECU_ADDRESS 0x90001f2a /end MEASUREMENT
/begin MEASUREMENT SOF_AsChargeCurrentLimitBufferUse "" FLOAT32_IEEE VBU0513_CM_single 0 0 -3.4E+38 3.4E+38 ECU_ADDRESS 0x90001f2e /end MEASUREMENT
/begin MEASUREMENT SOF_iADynamicChargeCurrentLimitFastChrgChk "" FLOAT32_IEEE VBU0513_CM_single 0 0 -3.4E+38 3.4E+38 ECU_ADDRESS 0x90001f5e /end MEASUREMENT
/begin MEASUREMENT SOF_iACalDynamicChgCurLimitFCCChk "" FLOAT32_IEEE VBU0513_CM_single 0 0 -3.4E+38 3.4E+38 ECU_ADDRESS 0x9000248e /end MEASUREMENT
/begin MEASUREMENT SOF_AsDischargeCurrentLimitBufferFull "" FLOAT32_IEEE VBU0513_CM_single 0 0 -3.4E+38 3.4E+38 ECU_ADDRESS 0x90001f32 /end MEASUREMENT
/begin MEASUREMENT SOF_AsDischargeCurrentLimitBufferUse "" FLOAT32_IEEE VBU0513_CM_single 0 0 -3.4E+38 3.4E+38 ECU_ADDRESS 0x90001f36 /end MEASUREMENT
/begin MEASUREMENT SOF_iADynamicDischargeCurrentLimitFastChrgChk "" FLOAT32_IEEE VBU0513_CM_single 0 0 -3.4E+38 3.4E+38 ECU_ADDRESS 0x90001f6a /end MEASUREMENT
/begin MEASUREMENT CTD_jAccumulatedAvaliableHeat "" FLOAT32_IEEE VBU0513_CM_single 0 0 -3.4E+38 3.4E+38 ECU_ADDRESS 0x90002266 /end MEASUREMENT
/begin MEASUREMENT SOF_mvFastChargeCurrentDropCellVoltage "" UWORD VBU0513_CM_uint16 0 0 0 65535 ECU_ADDRESS 0x90002faa /end MEASUREMENT
/begin MEASUREMENT FCC_mvFullChargeCellVoltage "" UWORD VBU0513_CM_uint16 0 0 0 65535 ECU_ADDRESS 0x900039de /end MEASUREMENT
/begin MEASUREMENT FCC_mvFullChargeDisbaleCellVoltage "" UWORD VBU0513_CM_uint16 0 0 0 65535 ECU_ADDRESS 0x900039e0 /end MEASUREMENT
/begin MEASUREMENT APD_stPedalSelect "" UBYTE VBU0513_CM_uint8 0 0 0.0 15.0 ECU_ADDRESS 0x90004090 /end MEASUREMENT
/begin MEASUREMENT CGW_stVehCreepMode "" UBYTE VBU0513_CM_uint8 0 0 0.0 15.0 ECU_ADDRESS 0x90004093 /end MEASUREMENT
/begin MEASUREMENT Gear_stCurrentGear "" UBYTE VBU0513_CM_uint8 0 0 0.0 15.0 ECU_ADDRESS 0x900040a1 /end MEASUREMENT
/begin MEASUREMENT Gear_stTargetGear "" UBYTE VBU0513_CM_uint8 0 0 0.0 15.0 ECU_ADDRESS 0x900040a2 /end MEASUREMENT
/begin MEASUREMENT Gear_stDriveIntendGearRawDigital "" UBYTE VBU0513_CM_uint8 0 0 0.0 15.0 ECU_ADDRESS 0x90004048 /end MEASUREMENT
/begin MEASUREMENT SOF_nbrDischargeVoltageCorrectLevel "" UBYTE VBU0513_CM_uint8 0 0 0 255 ECU_ADDRESS 0x90003fdb /end MEASUREMENT
/begin MEASUREMENT SOF_nbrChargeVoltageCorrectLevel "" UBYTE VBU0513_CM_uint8 0 0 0 255 ECU_ADDRESS 0x90003fda /end MEASUREMENT
/begin MEASUREMENT CTD_stMnPosContactorStuckOpenDiagnosticStatus "" UBYTE VBU0513_CM_uint8 0 0 0 255 ECU_ADDRESS 0x9000410c /end MEASUREMENT
/begin MEASUREMENT CTD_stMnNegContactorStuckOpenDiagnosticStatus "" UBYTE VBU0513_CM_uint8 0 0 0 255 ECU_ADDRESS 0x9000410b /end MEASUREMENT
/begin MEASUREMENT Gear_flgSensorRawReqGearR "" UBYTE VBU0513_CM_boolean 0 0 0.0 1.0 ECU_ADDRESS 0x9000409e /end MEASUREMENT
/begin MEASUREMENT Gear_flgSensorRawReqGearD "" UBYTE VBU0513_CM_boolean 0 0 0.0 1.0 ECU_ADDRESS 0x9000409c /end MEASUREMENT
/begin MEASUREMENT Gear_flgSensorRawReqGearN "" UBYTE VBU0513_CM_boolean 0 0 0.0 1.0 ECU_ADDRESS 0x9000409d /end MEASUREMENT
/begin MEASUREMENT Gear_flgRGearReqRawDigitalAction "" UBYTE VBU0513_CM_boolean 0 0 0.0 1.0 ECU_ADDRESS 0x90004047 /end MEASUREMENT
/begin MEASUREMENT Gear_flgRGearReqRawDigital "" UBYTE VBU0513_CM_boolean 0 0 0.0 1.0 ECU_ADDRESS 0x90004046 /end MEASUREMENT
/begin MEASUREMENT Gear_flgDGearReqRawDigitalAction "" UBYTE VBU0513_CM_boolean 0 0 0.0 1.0 ECU_ADDRESS 0x90004040 /end MEASUREMENT
/begin MEASUREMENT Gear_flgDGearReqRawDigital "" UBYTE VBU0513_CM_boolean 0 0 0.0 1.0 ECU_ADDRESS 0x9000403f /end MEASUREMENT
/begin MEASUREMENT Gear_flgNGearReqRawDigitalAction "" UBYTE VBU0513_CM_boolean 0 0 0 1 ECU_ADDRESS 0x900042a8 /end MEASUREMENT
/begin MEASUREMENT Gear_flgNGearReqRawDigital "" UBYTE VBU0513_CM_boolean 0 0 0 1 ECU_ADDRESS 0x900042a7 /end MEASUREMENT
/begin MEASUREMENT Gear_flgSensorWarningLT "" UBYTE VBU0513_CM_boolean 0 0 0.0 1.0 ECU_ADDRESS 0x9000409f /end MEASUREMENT
/begin MEASUREMENT Gear_flgSensorWarningST "" UBYTE VBU0513_CM_boolean 0 0 0.0 1.0 ECU_ADDRESS 0x900040a0 /end MEASUREMENT
/begin MEASUREMENT Gear_flgGearWarningST "" UBYTE VBU0513_CM_boolean 0 0 0.0 1.0 ECU_ADDRESS 0x9000409a /end MEASUREMENT
/begin MEASUREMENT Gear_flgGearWarningLT "" UBYTE VBU0513_CM_boolean 0 0 0.0 1.0 ECU_ADDRESS 0x90004099 /end MEASUREMENT
/begin MEASUREMENT Gear_flgDftGearWarningDigital "" UBYTE VBU0513_CM_boolean 0 0 0.0 1.0 ECU_ADDRESS 0x90004095 /end MEASUREMENT
/begin MEASUREMENT Gear_flgDftGearPlausibilityDigital "" UBYTE VBU0513_CM_boolean 0 0 0.0 1.0 ECU_ADDRESS 0x90004094 /end MEASUREMENT
/begin MEASUREMENT Gear_flgPlausibilityForce2NDigital "" UBYTE VBU0513_CM_boolean 0 0 0.0 1.0 ECU_ADDRESS 0x9000409b /end MEASUREMENT
/begin MEASUREMENT Gear_flgNGearReq "" UBYTE VBU0513_CM_boolean 0 0 0 1 ECU_ADDRESS 0x900042a6 /end MEASUREMENT
/begin MEASUREMENT Gear_flgBrkPressed4GearR "" UBYTE VBU0513_CM_boolean 0 0 0.0 1.0 ECU_ADDRESS 0x9000403d /end MEASUREMENT
/begin MEASUREMENT Gear_flgGearWarnRNoBrake "" UBYTE VBU0513_CM_boolean 0 0 0.0 1.0 ECU_ADDRESS 0x90004044 /end MEASUREMENT
/begin MEASUREMENT Gear_flgGearWarnRNoReady "" UBYTE VBU0513_CM_boolean 0 0 0.0 1.0 ECU_ADDRESS 0x90004045 /end MEASUREMENT
/begin MEASUREMENT Gear_flgGearWarnD2RFailure "" UBYTE VBU0513_CM_boolean 0 0 0.0 1.0 ECU_ADDRESS 0x90004041 /end MEASUREMENT
/begin MEASUREMENT Gear_flgGearRShiftReq "" UBYTE VBU0513_CM_boolean 0 0 0.0 1.0 ECU_ADDRESS 0x90004097 /end MEASUREMENT
/begin MEASUREMENT Gear_flgBrkPressed4GearD "" UBYTE VBU0513_CM_boolean 0 0 0.0 1.0 ECU_ADDRESS 0x9000403c /end MEASUREMENT
/begin MEASUREMENT Gear_flgGearWarnDNoReady "" UBYTE VBU0513_CM_boolean 0 0 0.0 1.0 ECU_ADDRESS 0x90004042 /end MEASUREMENT
/begin MEASUREMENT Gear_flgGearWarnR2DFailure "" UBYTE VBU0513_CM_boolean 0 0 0.0 1.0 ECU_ADDRESS 0x90004043 /end MEASUREMENT
/begin MEASUREMENT Gear_flgGearDShiftReq "" UBYTE VBU0513_CM_boolean 0 0 0.0 1.0 ECU_ADDRESS 0x90004096 /end MEASUREMENT
/begin MEASUREMENT TQDMP_flgTipInEnaRA "" UBYTE VBU0513_CM_boolean 0 0 0.0 1.0 ECU_ADDRESS 0x90004088 /end MEASUREMENT
/begin MEASUREMENT TQDMP_flgTipOutEnaRA "" UBYTE VBU0513_CM_boolean 0 0 0.0 1.0 ECU_ADDRESS 0x90004089 /end MEASUREMENT
/begin MEASUREMENT TQDMP_flgSpdHldR "" UBYTE VBU0513_CM_boolean 0 0 0.0 1.0 ECU_ADDRESS 0x90004087 /end MEASUREMENT
/begin MEASUREMENT TQDMP_flgROTCActRA "" UBYTE VBU0513_CM_boolean 0 0 0.0 1.0 ECU_ADDRESS 0x90004086 /end MEASUREMENT
/begin MEASUREMENT TQDIS_flgCrp "" UBYTE VBU0513_CM_boolean 0 0 0.0 1.0 ECU_ADDRESS 0x90004085 /end MEASUREMENT
/begin MEASUREMENT EDIS_flgVehSpdLow "" UBYTE VBU0513_CM_boolean 0 0 0.0 1.0 ECU_ADDRESS 0x9000402a /end MEASUREMENT
/begin MEASUREMENT EDIS_flgPowDisChToSTLim "" UBYTE VBU0513_CM_boolean 0 0 0.0 1.0 ECU_ADDRESS 0x90004029 /end MEASUREMENT
/begin MEASUREMENT DCH_flgAPlusWkup "" UBYTE VBU0513_CM_boolean 0 0 0.0 1.0 ECU_ADDRESS 0x90003feb /end MEASUREMENT
/begin MEASUREMENT DCH_flgBmsChAvl "" UBYTE VBU0513_CM_boolean 0 0 0.0 1.0 ECU_ADDRESS 0x90003ff7 /end MEASUREMENT
/begin MEASUREMENT DCH_flgDCChRlyCloseSt "" UBYTE VBU0513_CM_boolean 0 0 0.0 1.0 ECU_ADDRESS 0x90003fff /end MEASUREMENT
/begin MEASUREMENT SOF_flgFastChrgOneThirdRateCurrentLimit "" UBYTE VBU0513_CM_boolean 0 0 0.0 1.0 ECU_ADDRESS 0x90004073 /end MEASUREMENT
/begin MEASUREMENT SOF_flgCellDischargeDcirCalcValid "" UBYTE VBU0513_CM_boolean 0 0 0 1 ECU_ADDRESS 0x90004071 /end MEASUREMENT
/begin MEASUREMENT SOF_flgLowVoltageState "" UBYTE VBU0513_CM_boolean 0 0 0 1 ECU_ADDRESS 0x90004074 /end MEASUREMENT
/begin MEASUREMENT LbSOC_FastChargeCurrentStable_flg "" UBYTE VBU0513_CM_boolean 0 0 0 1 ECU_ADDRESS 0x900042ae /end MEASUREMENT
/begin MEASUREMENT VoltThld_flg "" UBYTE VBU0513_CM_boolean 0 0 0 1 ECU_ADDRESS 0x900042c3 /end MEASUREMENT
/begin MEASUREMENT VoltThld1_flg "" UBYTE VBU0513_CM_boolean 0 0 0 1 ECU_ADDRESS 0x900042c2 /end MEASUREMENT
/begin MEASUREMENT FCC_flgFullChargeCellVoltageCriteria "" UBYTE VBU0513_CM_boolean 0 0 0.0 1.0 ECU_ADDRESS 0x90004036 /end MEASUREMENT
/begin MEASUREMENT FCC_flgFullChargePackVoltageCriteria "" UBYTE VBU0513_CM_boolean 0 0 0.0 1.0 ECU_ADDRESS 0x90004038 /end MEASUREMENT
/begin MEASUREMENT FCC_flgFullChargeSOCCriteria "" UBYTE VBU0513_CM_boolean 0 0 0.0 1.0 ECU_ADDRESS 0x90004039 /end MEASUREMENT
/begin MEASUREMENT FCC_flgComputeResistanceEnable "" UBYTE VBU0513_CM_boolean 0 0 0.0 1.0 ECU_ADDRESS 0x90004032 /end MEASUREMENT
/begin MEASUREMENT FCC_flgComputeResistanceStart "" UBYTE VBU0513_CM_boolean 0 0 0 1 ECU_ADDRESS 0x90004035 /end MEASUREMENT
/begin MEASUREMENT FCC_flgComputeResistancePulseCurrentEnable "" UBYTE VBU0513_CM_boolean 0 0 0.0 1.0 ECU_ADDRESS 0x90004034 /end MEASUREMENT
/begin MEASUREMENT EcSOF_LowVoltageStartTime_s "" ULONG VBU0513_CM_uint32 0 0 0 4294967295 ECU_ADDRESS 0x90001ed2 /end MEASUREMENT
/begin MEASUREMENT EcSOF_LowVoltageState_flg "" UBYTE VBU0513_CM_boolean 0 0 0 1 ECU_ADDRESS 0x9000402b /end MEASUREMENT
/begin COMPU_METHOD VBU0513_CM_single_C "Q = V" RAT_FUNC "%8.6" "C" COEFFS 0 1 0 0 0 1 /end COMPU_METHOD
/begin COMPU_METHOD VBU0513_CM_single_cnt "Q = V" RAT_FUNC "%8.6" "cnt" COEFFS 0 1 0 0 0 1 /end COMPU_METHOD
/begin COMPU_METHOD VBU0513_CM_single_Nm "Q = V" RAT_FUNC "%8.6" "Nm" COEFFS 0 1 0 0 0 1 /end COMPU_METHOD
/begin COMPU_METHOD VBU0513_CM_single_kph "Q = V" RAT_FUNC "%8.6" "kph" COEFFS 0 1 0 0 0 1 /end COMPU_METHOD
/begin COMPU_METHOD VBU0513_CM_uint16_cnt "Q = V" RAT_FUNC "%5.0" "cnt" COEFFS 0 1 0 0 0 1 /end COMPU_METHOD
/begin COMPU_METHOD VBU0513_CM_single_pct "Q = V" RAT_FUNC "%8.6" "pct" COEFFS 0 1 0 0 0 1 /end COMPU_METHOD
/begin COMPU_METHOD VBU0513_CM_single_t "Q = V" RAT_FUNC "%8.6" "t" COEFFS 0 1 0 0 0 1 /end COMPU_METHOD
/begin COMPU_METHOD VBU0513_CM_single_A "Q = V" RAT_FUNC "%8.6" "A" COEFFS 0 1 0 0 0 1 /end COMPU_METHOD
/begin COMPU_METHOD VBU0513_CM_single_fac "Q = V" RAT_FUNC "%8.6" "fac" COEFFS 0 1 0 0 0 1 /end COMPU_METHOD
/begin COMPU_METHOD VBU0513_CM_uint8 "Q = V" RAT_FUNC "%3.0" "" COEFFS 0 1 0 0 0 1 /end COMPU_METHOD
/begin COMPU_METHOD VBU0513_CM_single_km "Q = V" RAT_FUNC "%8.6" "km" COEFFS 0 1 0 0 0 1 /end COMPU_METHOD
/begin COMPU_METHOD VBU0513_CM_single_i "Q = V" RAT_FUNC "%8.6" "i" COEFFS 0 1 0 0 0 1 /end COMPU_METHOD
/begin COMPU_METHOD VBU0513_CM_uint16 "Q = V" RAT_FUNC "%5.0" "" COEFFS 0 1 0 0 0 1 /end COMPU_METHOD
/begin COMPU_METHOD VBU0513_CM_single_kw "Q = V" RAT_FUNC "%8.6" "kw" COEFFS 0 1 0 0 0 1 /end COMPU_METHOD
/begin COMPU_METHOD VBU0513_CM_single "Q = V" RAT_FUNC "%8.6" "" COEFFS 0 1 0 0 0 1 /end COMPU_METHOD
/begin COMPU_METHOD VBU0513_CM_single_kW "Q = V" RAT_FUNC "%8.6" "kW" COEFFS 0 1 0 0 0 1 /end COMPU_METHOD
/begin COMPU_METHOD VBU0513_CM_uint32_cnt "Q = V" RAT_FUNC "%10.0" "cnt" COEFFS 0 1 0 0 0 1 /end COMPU_METHOD
/begin COMPU_METHOD VBU0513_CM_uint32 "Q = V" RAT_FUNC "%10.0" "" COEFFS 0 1 0 0 0 1 /end COMPU_METHOD
/begin COMPU_METHOD VBU0513_CM_boolean_flg "Q = V" RAT_FUNC "%1.0" "flg" COEFFS 0 1 0 0 0 1 /end COMPU_METHOD
/begin COMPU_METHOD VBU0513_CM_boolean_cnt "Q = V" RAT_FUNC "%1.0" "cnt" COEFFS 0 1 0 0 0 1 /end COMPU_METHOD
/begin COMPU_METHOD VBU0513_CM_boolean "Q = V" RAT_FUNC "%1.0" "" COEFFS 0 1 0 0 0 1 /end COMPU_METHOD
/begin COMPU_METHOD VBU0513_CM_uint8_cnt "Q = V" RAT_FUNC "%3.0" "cnt" COEFFS 0 1 0 0 0 1 /end COMPU_METHOD
/begin GROUP S4009_TrqProtect "VBU0513/VBUSystem/VCU /TQO/TQOAll/TQO/TQO/Trq/TrqProtect" /begin SUB_GROUP S4015_DecGradienLimiter /end SUB_GROUP
 /begin REF_CHARACTERISTIC TQO_trqBrk_MAP_v TQO_trqLimpModeMax_CUR_v TQO_trqRARgnMin_C TQO_trqSftyDec_C /end REF_CHARACTERISTIC
 /begin REF_MEASUREMENT TQO_trqSftyRA /end REF_MEASUREMENT
/end GROUP
/begin GROUP S4032_IF_Then_Else1 "VBU0513/VBUSystem/VCU /VTQA/Subsystem/MTrqLim/TrqCapacityLim/VehicleSpeedLim/IF_Then_Else1" /begin REF_MEASUREMENT MTQL_trqVehSpdDrvLimR /end REF_MEASUREMENT /end GROUP
/begin GROUP S4072_BrakeStickyCheck "VBU0513/VBUSystem/VCU /VehINP/VehINP_Logic/APD/APD/Value_Selection/BrakeStickyCheck"
 /begin REF_CHARACTERISTIC APD_rBrkPedReleased_C APD_rBrkPlausibilityEnHi_C APD_rBrkStickyPressed_C APD_rBrkStickyThreshold_C APD_tiBrkPlausibility_CUR_v APD_tiSampleTime_C APD_tiUnStickyTime_C APD_vBrkDftSpeed_C /end REF_CHARACTERISTIC
/end GROUP
/begin GROUP S4072_FullPedal "VBU0513/VBUSystem/VCU /VehINP/VehINP_Logic/APD/APD/Value_Selection/FullPedal"
 /begin REF_CHARACTERISTIC APD_flgFulPedalEnable_C APD_rFullPedalPercent_C APD_stSelectPedal1_C APD_stSelectPedal2_C APD_tiFullPedalTime_C APD_tiSampleTime_C APD_uFullAngle1_C APD_uFullAngle2_C /end REF_CHARACTERISTIC
/end GROUP
/begin GROUP S4072_PedalPercentSelection "VBU0513/VBUSystem/VCU /VehINP/VehINP_Logic/APD/APD/Value_Selection/PedalPercentSelection"
 /begin REF_CHARACTERISTIC APD_facRecoveryFillter_C APD_pctIdlePedal_C APD_stSelectPedal1_C APD_stSelectPedal2_C APD_stSelectPedalDefault_C APD_stSelectPedalMin_C /end REF_CHARACTERISTIC
 /begin REF_MEASUREMENT APD_pctAPDbasic /end REF_MEASUREMENT
/end GROUP
/begin GROUP S4072_PedalSelection "VBU0513/VBUSystem/VCU /VehINP/VehINP_Logic/APD/APD/Value_Selection/PedalSelection"
 /begin REF_CHARACTERISTIC APD_stSelectPedal1_C APD_stSelectPedal2_C APD_stSelectPedalDefault_C APD_stSelectPedalMin_C APD_stSelectPedalORV /end REF_CHARACTERISTIC
 /begin REF_MEASUREMENT APD_stPedalSelect /end REF_MEASUREMENT
/end GROUP
/begin GROUP S4106_Gear4DriveIntend "VBU0513/VBUSystem/VCU /VehINP/VehINP_Logic/GearShift/Gear1/Digital_Gear_D_R/Gear4DriveIntend"
 /begin REF_CHARACTERISTIC Gear_stDriveIntendGearD_C Gear_stDriveIntendGearInvalid_C Gear_stDriveIntendGearNeutral_C Gear_stDriveIntendGearR_C /end REF_CHARACTERISTIC
 /begin REF_MEASUREMENT Gear_stDriveIntendGearRawDigital /end REF_MEASUREMENT
/end GROUP
/begin GROUP S4106_Gear_Bit "VBU0513/VBUSystem/VCU /VehINP/VehINP_Logic/GearShift/Gear1/Digital_Gear_D_R/Gear_Bit" /begin SUB_GROUP S4118_SetBit2 /end SUB_GROUP /end GROUP
/begin GROUP S4106_Gear_DR_Req "VBU0513/VBUSystem/VCU /VehINP/VehINP_Logic/GearShift/Gear1/Digital_Gear_D_R/Gear_DR_Req"
 /begin SUB_GROUP S4119_Turn_On_Delay_Time S4119_Turn_On_Delay_Time1 S4119_Turn_On_Delay_Time2 /end SUB_GROUP
 /begin REF_CHARACTERISTIC Gear_tiGearES6DebounceCnt_C /end REF_CHARACTERISTIC
 /begin REF_MEASUREMENT Gear_flgDGearReqRawDigital Gear_flgNGearReqRawDigital Gear_flgRGearReqRawDigital /end REF_MEASUREMENT
/end GROUP
/begin GROUP S4106_Gear_DR_Warning "VBU0513/VBUSystem/VCU /VehINP/VehINP_Logic/GearShift/Gear1/Digital_Gear_D_R/Gear_DR_Warning" /begin SUB_GROUP S4120_Turn_On_Delay_Time S4120_Turn_On_Delay_Time1 /end SUB_GROUP
 /begin REF_CHARACTERISTIC Gear_tiGearWarningLTES6DebounceCnt_C Gear_tiGearWarningSTES6DebounceCnt_C /end REF_CHARACTERISTIC
 /begin REF_MEASUREMENT Gear_flgDftGearWarningDigital /end REF_MEASUREMENT
/end GROUP
/begin GROUP S4106_Gear_RawReq "VBU0513/VBUSystem/VCU /VehINP/VehINP_Logic/GearShift/Gear1/Digital_Gear_D_R/Gear_RawReq"
 /begin REF_CHARACTERISTIC Gear_stGearDValidBit1_C Gear_stGearNValid_C Gear_stGearRValidBit1_C /end REF_CHARACTERISTIC
 /begin REF_MEASUREMENT Gear_flgSensorRawReqGearD Gear_flgSensorRawReqGearN Gear_flgSensorRawReqGearR Gear_flgSensorWarningLT Gear_flgSensorWarningST /end REF_MEASUREMENT
/end GROUP
/begin GROUP S4106_Gear_Warning "VBU0513/VBUSystem/VCU /VehINP/VehINP_Logic/GearShift/Gear1/Digital_Gear_D_R/Gear_Warning" /begin SUB_GROUP S4122_SR_Flip_Flop1 /end SUB_GROUP
 /begin REF_CHARACTERISTIC Gear_cntGearPlausibilityDigitalDetect_C Gear_cntGearPlausibilityDigitalShiftFast_C /end REF_CHARACTERISTIC
 /begin REF_MEASUREMENT Gear_flgPlausibilityForce2NDigital /end REF_MEASUREMENT
/end GROUP
/begin GROUP S4114_Gear4Reset "VBU0513/VBUSystem/VCU /VehINP/VehINP_Logic/GearShift/Gear1/Gear_Status/Gear4Reset" /begin REF_CHARACTERISTIC Gear_tiGearResetHold_C /end REF_CHARACTERISTIC /end GROUP
/begin GROUP S4114_Gear_CurrentValid "VBU0513/VBUSystem/VCU /VehINP/VehINP_Logic/GearShift/Gear1/Gear_Status/Gear_CurrentValid"
 /begin REF_CHARACTERISTIC Gear_flgCurrentGearDisplayInValid_C Gear_flgCurrentGearDisplayValid_C Gear_flgDisplayGearValidEn_C Gear_flgIntendGearDisplayValid_C /end REF_CHARACTERISTIC
/end GROUP
/begin GROUP S4114_Gear_DGear "VBU0513/VBUSystem/VCU /VehINP/VehINP_Logic/GearShift/Gear1/Gear_Status/Gear_DGear" /begin REF_CHARACTERISTIC Gear_stIntendGearD_C /end REF_CHARACTERISTIC /end GROUP
/begin GROUP S4114_Gear_DefaultGear "VBU0513/VBUSystem/VCU /VehINP/VehINP_Logic/GearShift/Gear1/Gear_Status/Gear_DefaultGear" /begin REF_CHARACTERISTIC Gear_tiDefaultGear2NTime_C Gear_tiDefaultGear2PTime_C /end REF_CHARACTERISTIC /end GROUP
/begin GROUP S4114_Gear_DriverShiftDReq "VBU0513/VBUSystem/VCU /VehINP/VehINP_Logic/GearShift/Gear1/Gear_Status/Gear_DriverShiftDReq" /begin REF_CHARACTERISTIC Veh_flgLowSpdGearChange_C /end REF_CHARACTERISTIC
 /begin REF_MEASUREMENT Gear_flgBrkPressed4GearD Gear_flgGearDShiftReq Gear_flgGearWarnDNoReady Gear_flgGearWarnR2DFailure /end REF_MEASUREMENT
/end GROUP
/begin GROUP S4114_Gear_DriverShiftRReq "VBU0513/VBUSystem/VCU /VehINP/VehINP_Logic/GearShift/Gear1/Gear_Status/Gear_DriverShiftRReq" /begin REF_CHARACTERISTIC Veh_flgLowSpdGearChange_C /end REF_CHARACTERISTIC
 /begin REF_MEASUREMENT Gear_flgBrkPressed4GearR Gear_flgGearRShiftReq Gear_flgGearWarnD2RFailure Gear_flgGearWarnRNoBrake Gear_flgGearWarnRNoReady /end REF_MEASUREMENT
/end GROUP
/begin GROUP S4114_Gear_GearReq "VBU0513/VBUSystem/VCU /VehINP/VehINP_Logic/GearShift/Gear1/Gear_Status/Gear_GearReq" /begin SUB_GROUP S4166_SR_Flip_Flop2 /end SUB_GROUP
 /begin REF_CHARACTERISTIC Gear_tiGearDSustain_C Gear_tiGearInitSustain_C Gear_tiGearPSustain_C Gear_tiGearRSustain_C /end REF_CHARACTERISTIC
/end GROUP
/begin GROUP S4114_Gear_InitGear "VBU0513/VBUSystem/VCU /VehINP/VehINP_Logic/GearShift/Gear1/Gear_Status/Gear_InitGear"
 /begin REF_CHARACTERISTIC Gear_tiGearInitTime_C Gear_tiInitGear2NTime_C Gear_tiInitGear2PTime_C /end REF_CHARACTERISTIC
/end GROUP
/begin GROUP S4114_Gear_PGear "VBU0513/VBUSystem/VCU /VehINP/VehINP_Logic/GearShift/Gear1/Gear_Status/Gear_PGear" /begin REF_CHARACTERISTIC Gear_cntGearPTimeOut_C /end REF_CHARACTERISTIC /end GROUP
/begin GROUP S4114_Gear_PGear1 "VBU0513/VBUSystem/VCU /VehINP/VehINP_Logic/GearShift/Gear1/Gear_Status/Gear_PGear1" /begin REF_CHARACTERISTIC Gear_stIntendGearN_C /end REF_CHARACTERISTIC /end GROUP
/begin GROUP S4114_Gear_Powertrain "VBU0513/VBUSystem/VCU /VehINP/VehINP_Logic/GearShift/Gear1/Gear_Status/Gear_Powertrain" /begin REF_MEASUREMENT Gear_stCurrentGear Gear_stTargetGear /end REF_MEASUREMENT /end GROUP
/begin GROUP S4114_Gear_RGear "VBU0513/VBUSystem/VCU /VehINP/VehINP_Logic/GearShift/Gear1/Gear_Status/Gear_RGear" /begin REF_CHARACTERISTIC Gear_stIntendGearR_C /end REF_CHARACTERISTIC /end GROUP
/begin GROUP S4114_Warning "VBU0513/VBUSystem/VCU /VehINP/VehINP_Logic/GearShift/Gear1/Gear_Status/Warning" /begin REF_CHARACTERISTIC Gear_tiWarnDelayTime_C /end REF_CHARACTERISTIC /end GROUP
/begin GROUP S4224_override_signal1 "VBU0513/VBUSystem/VCU /VehINP/VehINP_Logic/Mode/VehMode/Veh_CreepMode/override_signal1" /begin REF_MEASUREMENT CGW_stVehCreepMode /end REF_MEASUREMENT /end GROUP
/begin GROUP S4270_First_Order_Low_Pass_Filter "VBU0513/VBUSystem/VCU /VehINP/VehINP_Logic/VehINP_BPD/BPD_BrakePercent/BPD_PressBrake/First_Order_Low_Pass_Filter" /begin REF_MEASUREMENT INP_uBrkPresFlt1 /end REF_MEASUREMENT /end GROUP
/begin GROUP S4286_Veh_HVILCheck "VBU0513/VBUSystem/VCU /VehINP/VehINP_Logic/Veh_Status/VehHVIL/HVIL/Veh_HVILCheck"
 /begin REF_CHARACTERISTIC Veh_flgHVILCaliOvrdVal_C Veh_flgHVILCaliOvrd_C Veh_tiVehHVILDebounceCnt_C Veh_vVehHVILDefaultSpd_C Veh_vVehHVILDft_C /end REF_CHARACTERISTIC
/end GROUP
/begin GROUP S4286_Veh_VCUHVIL "VBU0513/VBUSystem/VCU /VehINP/VehINP_Logic/Veh_Status/VehHVIL/HVIL/Veh_VCUHVIL"
 /begin REF_CHARACTERISTIC Veh_fHVILLe_C Veh_fHVILRi_C Veh_pctHVILLe_C Veh_pctHVILRi_C Veh_stErr_C Veh_stNoErr_C Veh_tiVCUHVILDebounceCnt_C /end REF_CHARACTERISTIC
/end GROUP
/begin GROUP S56_Calculate_Current_ZeroDruft "VBU0513/VBUSystem/BMS/BCV/BCV/Subsystem/Calculate_BatteryCurrent/Correct_BatteryCurrent/Calculate_BatteryCurrent_ZeroDrift/Calculate_Current_ZeroDruft" /begin SUB_GROUP S58_Enabled_Subsystem /end SUB_GROUP /begin REF_CHARACTERISTIC CcBCV_BatteryCurrentZeroDriftTime_ms /end REF_CHARACTERISTIC /end GROUP
/begin GROUP S56_Calculate_ExtremeData "VBU0513/VBUSystem/BMS/BCV/BCV/Subsystem/Calculate_BatteryCurrent/Correct_BatteryCurrent/Calculate_BatteryCurrent_ZeroDrift/Calculate_ExtremeData" /begin SUB_GROUP S59_Enabled_Subsystem /end SUB_GROUP /end GROUP
/begin GROUP S192_BigDataMonitor_Handler "VBU0513/VBUSystem/BMS/BCV/BCV/Subsystem/Monitor_BCV_Performance/Diagnose_BDM_BCV_Communication_Fault/Diagnose_BdmOutOfRange_Fault/BigDataMonitor_Handler" /begin SUB_GROUP S193_DetermineFault S193_DetermineFaultCounter /end SUB_GROUP /end GROUP
/begin GROUP S192_BigDataMonitor_Handler1 "VBU0513/VBUSystem/BMS/BCV/BCV/Subsystem/Monitor_BCV_Performance/Diagnose_BDM_BCV_Communication_Fault/Diagnose_BdmOutOfRange_Fault/BigDataMonitor_Handler1" /begin SUB_GROUP S194_DetermineFault S194_DetermineFaultCounter /end SUB_GROUP /end GROUP
/begin GROUP S203_BigDataMonitor_Handler1 "VBU0513/VBUSystem/BMS/BCV/BCV/Subsystem/Monitor_BCV_Performance/Diagnose_BDM_BCV_Data_Fault/Diagnose_BdmBatteryBusVoltageMismatch_Fault/BigDataMonitor_Handler1" /begin SUB_GROUP S205_DetermineFault S205_DetermineFaultCounter /end SUB_GROUP /end GROUP
/begin GROUP S204_BigDataMonitor_Handler "VBU0513/VBUSystem/BMS/BCV/BCV/Subsystem/Monitor_BCV_Performance/Diagnose_BDM_BCV_Data_Fault/Diagnose_BdmVoltageCurrent_Fault/BigDataMonitor_Handler" /begin SUB_GROUP S211_DetermineFault S211_DetermineFaultCounter /end SUB_GROUP /end GROUP
/begin GROUP S204_BigDataMonitor_Handler1 "VBU0513/VBUSystem/BMS/BCV/BCV/Subsystem/Monitor_BCV_Performance/Diagnose_BDM_BCV_Data_Fault/Diagnose_BdmVoltageCurrent_Fault/BigDataMonitor_Handler1" /begin SUB_GROUP S212_DetermineFault S212_DetermineFaultCounter /end SUB_GROUP /end GROUP
/begin GROUP S204_BigDataMonitor_Handler2 "VBU0513/VBUSystem/BMS/BCV/BCV/Subsystem/Monitor_BCV_Performance/Diagnose_BDM_BCV_Data_Fault/Diagnose_BdmVoltageCurrent_Fault/BigDataMonitor_Handler2" /begin SUB_GROUP S213_DetermineFault S213_DetermineFaultCounter /end SUB_GROUP /end GROUP
/begin GROUP S324_Determine_CellBlanceTime "VBU0513/VBUSystem/BMS/CBL/Subsystem8/Subsystem/Determine_CSCCellBalanceRequest/Determine_CellBalanceRequest/Cell0/Determine_CellBlanceTime" /begin REF_CHARACTERISTIC CcCBL_CellBalanceCurrentMax_mA /end REF_CHARACTERISTIC /end GROUP
/begin GROUP S324_Determine_SocBalanceReq "VBU0513/VBUSystem/BMS/CBL/Subsystem8/Subsystem/Determine_CSCCellBalanceRequest/Determine_CellBalanceRequest/Cell0/Determine_SocBalanceReq" /begin REF_CHARACTERISTIC CcCBL_BalanceStartDeltaSocHysteresis_pct /end REF_CHARACTERISTIC /end GROUP
/begin GROUP S324_Determine_VoltageBalanceReq "VBU0513/VBUSystem/BMS/CBL/Subsystem8/Subsystem/Determine_CSCCellBalanceRequest/Determine_CellBalanceRequest/Cell0/Determine_VoltageBalanceReq"
 /begin REF_CHARACTERISTIC CcCBL_BalanceStartDeltaVoltageHysteresis_mV CcCBL_ChargeBalanceStartDeltaVoltageHysteresis_mV CcCBL_ChargeBalanceStartDeltaVoltage_mV /end REF_CHARACTERISTIC
/end GROUP
/begin GROUP S458_Determine_Accumulated_RemainingHeat "VBU0513/VBUSystem/BMS/CTD/Subsystem/Subsystem4/PrechrgProcessMonitoring/Precharge_Thermal_Management/Determine_Precharge_JouleHeat/Determine_Accumulated_RemainingHeat"
 /begin SUB_GROUP S460_Determine_Accumulated_Cooling S460_Determine_Accumulated_RemainingHeat /end SUB_GROUP
/end GROUP
/begin GROUP S480_Determine_Diagnostic_Status "VBU0513/VBUSystem/BMS/CTD/Subsystem/Subsystem4/Stuck_Open_Diagnostic/MNC_Stuck_Open/MNC_Stuck_Open_With_VehicleSpeed/Determine_Diagnostic_Status" /begin REF_MEASUREMENT CTD_stMnNegContactorStuckOpenDiagnosticStatus /end REF_MEASUREMENT /end GROUP
/begin GROUP S504_Determine_Diagnostic_Status "VBU0513/VBUSystem/BMS/CTD/Subsystem/Subsystem4/Stuck_Open_Diagnostic/MPC_Stuck_Open/MPC_Stuck_Open_Without_VehicleSpeed/Determine_Diagnostic_Status" /begin REF_MEASUREMENT CTD_stMnPosContactorStuckOpenDiagnosticStatus /end REF_MEASUREMENT /end GROUP
/begin GROUP S804_Override_Block3 "VBU0513/VBUSystem/BMS/FCC /FCC/Subsystem/Determine_Fastcharge_Request/Charge_Request_Protection/Override_Voltage_Request/Override_Block3" /begin REF_CHARACTERISTIC CbFCC_ChargeVoltageOvR_flg CcFCC_ChargeVoltageOvRValue_V /end REF_CHARACTERISTIC /end GROUP
/begin GROUP S812_Delay_FallingEdge "VBU0513/VBUSystem/BMS/FCC /FCC/Subsystem/Determine_Fastcharge_Request/DetermineComputeResistancePulseCurrent/Determine_ComputeResistanceCondition/Delay_FallingEdge" /begin REF_MEASUREMENT FCC_flgComputeResistancePulseCurrentEnable /end REF_MEASUREMENT /end GROUP
/begin GROUP S812_RS_Flip_Flop "VBU0513/VBUSystem/BMS/FCC /FCC/Subsystem/Determine_Fastcharge_Request/DetermineComputeResistancePulseCurrent/Determine_ComputeResistanceCondition/RS Flip-Flop" /begin REF_MEASUREMENT FCC_flgComputeResistanceEnable /end REF_MEASUREMENT /end GROUP
/begin GROUP S812_S_H "VBU0513/VBUSystem/BMS/FCC /FCC/Subsystem/Determine_Fastcharge_Request/DetermineComputeResistancePulseCurrent/Determine_ComputeResistanceCondition/S&H" /begin REF_MEASUREMENT FCC_flgComputeResistanceStart /end REF_MEASUREMENT /end GROUP
/begin GROUP S841_FullCharge_criteria1 "VBU0513/VBUSystem/BMS/FCC /FCC/Subsystem/Fastcharge_Conditions_Check/Condition_Categorize/Full_Charge_Determination/FullCharge_criteria1"
 /begin REF_CHARACTERISTIC CaFCC_FullChargeVoltageDCIRMapDimension_n CaFCC_FullChargeVoltageDCIRMapZ_mV CaFCC_FullChargeVoltageHysteresisMapDimension_n CaFCC_FullChargeVoltageHysteresisMapZ_mV CaFCC_FullChargeVoltagePolarizaitonMapDimension_n CaFCC_FullChargeVoltagePolarizaitonMapZ_mV CaFCC_FullChargeVoltageSOHAttenuationMapDimension_n CaFCC_FullChargeVoltageSOHAttenuationMapZ_mV CaSYS_FullChargeOcvMapDimension_n CaSYS_FullChargeOcvMapZ_mV CcFCC_FullChargeOcvDebounceTime_s CcSYS_FullChargeOcv_mV /end REF_CHARACTERISTIC
 /begin REF_MEASUREMENT FCC_flgFullChargeCellVoltageCriteria FCC_mvFullChargeCellVoltage FCC_mvFullChargeDisbaleCellVoltage /end REF_MEASUREMENT
/end GROUP
/begin GROUP S841_FullCharge_criteria2 "VBU0513/VBUSystem/BMS/FCC /FCC/Subsystem/Fastcharge_Conditions_Check/Condition_Categorize/Full_Charge_Determination/FullCharge_criteria2"
 /begin REF_CHARACTERISTIC CcFCC_FullChargeOcvDebounceTime_s CcFCC_FullChargePackVoltageDelta_V CcSYS_FullChargeOcv_mV /end REF_CHARACTERISTIC
 /begin REF_MEASUREMENT FCC_flgFullChargePackVoltageCriteria /end REF_MEASUREMENT
/end GROUP
/begin GROUP S841_FullCharge_criteria4 "VBU0513/VBUSystem/BMS/FCC /FCC/Subsystem/Fastcharge_Conditions_Check/Condition_Categorize/Full_Charge_Determination/FullCharge_criteria4"
 /begin REF_CHARACTERISTIC CcFCC_BatteryCapacityCycleHomo_n CcFCC_FullChargeSocDebounceTime_s CcFCC_FullChargeSocDelta_pct CcFCC_HomoFullChargeSoc_pct /end REF_CHARACTERISTIC
 /begin REF_MEASUREMENT FCC_flgFullChargeSOCCriteria /end REF_MEASUREMENT
/end GROUP
/begin GROUP S1055_Determine_CurrentStable_Condition "VBU0513/VBUSystem/BMS/SOC/Subsystem5/Subsystem/Determine_FastChargeCorrection_Soc/FastCharge_DynamicCorrection/FastCharge_DynamicCorrection_Enable/Determine_CurrentStable_Condition" /begin SUB_GROUP S1057_Delay_RisingEdge /end SUB_GROUP
 /begin REF_CHARACTERISTIC CcSOC_CurrentStableThresholdRate_pct CcSOC_CurrentStableTime_ms /end REF_CHARACTERISTIC
/end GROUP
/begin GROUP S1055_VoltThldEdge "VBU0513/VBUSystem/BMS/SOC/Subsystem5/Subsystem/Determine_FastChargeCorrection_Soc/FastCharge_DynamicCorrection/FastCharge_DynamicCorrection_Enable/VoltThldEdge" /begin REF_MEASUREMENT VoltThld_flg /end REF_MEASUREMENT /end GROUP
/begin GROUP S1055_VoltThldEdge1 "VBU0513/VBUSystem/BMS/SOC/Subsystem5/Subsystem/Determine_FastChargeCorrection_Soc/FastCharge_DynamicCorrection/FastCharge_DynamicCorrection_Enable/VoltThldEdge1" /begin REF_MEASUREMENT VoltThld1_flg /end REF_MEASUREMENT /end GROUP
/begin GROUP S1067_FastCharge_PreCorrectionSOC "VBU0513/VBUSystem/BMS/SOC/Subsystem5/Subsystem/Determine_FastChargeCorrection_Soc/FastCharge_PreCorrection/FastCharge_PreCorrectionMain/FastCharge_PreCorrectionSOC" /begin REF_CHARACTERISTIC CcSOC_FastChargePreCorrectionSOC_pct /end REF_CHARACTERISTIC /end GROUP
/begin GROUP S1067_FastCharge_PreCorrectionVoltage "VBU0513/VBUSystem/BMS/SOC/Subsystem5/Subsystem/Determine_FastChargeCorrection_Soc/FastCharge_PreCorrection/FastCharge_PreCorrectionMain/FastCharge_PreCorrectionVoltage" /begin SUB_GROUP S1071_FastCharge_TOCAdjustAllSOC /end SUB_GROUP /begin REF_CHARACTERISTIC CcSOC_FastChargePreCorrectionSOC_pct /end REF_CHARACTERISTIC /end GROUP
/begin GROUP S1205_Power_Limit_Level1_ChargePowerLimit "VBU0513/VBUSystem/BMS/SOF/Subsystem6/Subsystem/Calculate_PowerLimit/Determine_Capacity_Cycle_PowerLimit/Power_Limit_Cycle_Level1/Power_Limit_Level1_ChargePowerLimit"
 /begin REF_CHARACTERISTIC CcSOF_CyclePowerLimitCharge_Kw CcSOF_CyclePowerLimitLevel1SOCMax_pct CcSOF_CyclePowerLimitMax_Kw /end REF_CHARACTERISTIC
/end GROUP
/begin GROUP S1205_Power_Limit_Level1_DischargePowerLimit "VBU0513/VBUSystem/BMS/SOF/Subsystem6/Subsystem/Calculate_PowerLimit/Determine_Capacity_Cycle_PowerLimit/Power_Limit_Cycle_Level1/Power_Limit_Level1_DischargePowerLimit"
 /begin REF_CHARACTERISTIC CcSOF_CyclePowerLimitLevel1Discharge_Kw CcSOF_CyclePowerLimitLevel1SOCMin_pct CcSOF_CyclePowerLimitMax_Kw /end REF_CHARACTERISTIC
/end GROUP
/begin GROUP S1206_Power_Limit_Cycle_Level2_ChargePowerLimit "VBU0513/VBUSystem/BMS/SOF/Subsystem6/Subsystem/Calculate_PowerLimit/Determine_Capacity_Cycle_PowerLimit/Power_Limit_Cycle_Level2/Power_Limit_Cycle_Level2_ChargePowerLimit"
 /begin REF_CHARACTERISTIC CcSOF_CyclePowerLimitCharge_Kw CcSOF_CyclePowerLimitLevel2SOCMax_pct CcSOF_CyclePowerLimitMax_Kw /end REF_CHARACTERISTIC
/end GROUP
/begin GROUP S1206_Power_Limit_Cycle_Level2_DischargePowerLimit "VBU0513/VBUSystem/BMS/SOF/Subsystem6/Subsystem/Calculate_PowerLimit/Determine_Capacity_Cycle_PowerLimit/Power_Limit_Cycle_Level2/Power_Limit_Cycle_Level2_DischargePowerLimit"
 /begin REF_CHARACTERISTIC CcSOF_CyclePowerLimitLevel2Discharge_Kw CcSOF_CyclePowerLimitLevel2SOCMin_pct CcSOF_CyclePowerLimitMax_Kw /end REF_CHARACTERISTIC
/end GROUP
/begin GROUP S1207_Power_Limit_Cycle_Level3_ChargePowerLimit "VBU0513/VBUSystem/BMS/SOF/Subsystem6/Subsystem/Calculate_PowerLimit/Determine_Capacity_Cycle_PowerLimit/Power_Limit_Cycle_Level3/Power_Limit_Cycle_Level3_ChargePowerLimit"
 /begin REF_CHARACTERISTIC CcSOF_CyclePowerLimitCharge_Kw CcSOF_CyclePowerLimitLevel3SOCMax_pct CcSOF_CyclePowerLimitMax_Kw /end REF_CHARACTERISTIC
/end GROUP
/begin GROUP S1207_Power_Limit_Cycle_Level3_DischargePowerLimit "VBU0513/VBUSystem/BMS/SOF/Subsystem6/Subsystem/Calculate_PowerLimit/Determine_Capacity_Cycle_PowerLimit/Power_Limit_Cycle_Level3/Power_Limit_Cycle_Level3_DischargePowerLimit"
 /begin REF_CHARACTERISTIC CcSOF_CyclePowerLimitLevel2SOCMin_pct CcSOF_CyclePowerLimitLevel3Discharge1_Kw CcSOF_CyclePowerLimitLevel3Discharge2_Kw CcSOF_CyclePowerLimitLevel3SOCMin_pct CcSOF_CyclePowerLimitMax_Kw /end REF_CHARACTERISTIC
/end GROUP
/begin GROUP S1215_Determine_SOCP_Condition "VBU0513/VBUSystem/BMS/SOF/Subsystem6/Subsystem/Calculate_PowerLimit/Determine_SOCP_PowerLimit/Determine_ContinuousDischargePowerLimitTarget/Determine_SOCP_Condition"
 /begin REF_CHARACTERISTIC CcSOF_SocpDischargeSocDebounce_pct CcSOF_SocpModeDebounceTime_ms /end REF_CHARACTERISTIC
/end GROUP
/begin GROUP S1216_Determine_SOCP_Condition "VBU0513/VBUSystem/BMS/SOF/Subsystem6/Subsystem/Calculate_PowerLimit/Determine_SOCP_PowerLimit/Determine_DischargePowerLimitTarget/Determine_SOCP_Condition"
 /begin REF_CHARACTERISTIC CcSOF_SocpDischargeSocDebounce_pct CcSOF_SocpModeDebounceTime_ms /end REF_CHARACTERISTIC
/end GROUP
/begin GROUP S1230_Calculate_ContinuousChargeCurrent "VBU0513/VBUSystem/BMS/SOF/Subsystem6/Subsystem/Determine_Currentlimit_Target/Calculate_CurrentLimit_Target/Calculate_CurrentLimit_Base/Calculate_ContinuousChargeCurrent"
 /begin SUB_GROUP S1235_Calculate_Locked_SOC S1235_Calculate_Locked_SOC1 S1235_Calculate_Locked_SOC2 S1235_Calculate_SOH_Current_Limit /end SUB_GROUP
 /begin REF_CHARACTERISTIC CaSOF_ContinuousChargeEolMap_v CaSOF_ContinuousChargeFactorMap_v CaSOF_ContinuousChargeHomoMap_v CaSOF_ContinuousChargeLockedHomoMap_v CaSOF_ContinuousChargeLockedMap_v CaSOF_ContinuousChargeMap_v CcSOF_BaseCurrentLimitFactor_pct CcSOF_BatteryCycleHomo_n CcSOF_UseSohLimitEnable_flg /end REF_CHARACTERISTIC
 /begin REF_MEASUREMENT SOF_facContinuousChargeFactor SOF_iAContinuousChargeCurrentBaseRaw SOF_iAContinuousChargeCurrentLimitMapBaseNormal /end REF_MEASUREMENT
/end GROUP
/begin GROUP S1230_Calculate_ContinuousDischargeCurrent "VBU0513/VBUSystem/BMS/SOF/Subsystem6/Subsystem/Determine_Currentlimit_Target/Calculate_CurrentLimit_Target/Calculate_CurrentLimit_Base/Calculate_ContinuousDischargeCurrent"
 /begin SUB_GROUP S1236_Calculate_Locked_SOC S1236_Calculate_Locked_SOC1 S1236_Calculate_SOH_Current_Limit /end SUB_GROUP
 /begin REF_CHARACTERISTIC CaSOF_ContinuousDischargeEolSocTempMapDimension_n CaSOF_ContinuousDischargeEolSocTempMapZ_A CaSOF_ContinuousDischargeLockedSocTempMapDimension_n CaSOF_ContinuousDischargeLockedSocTempMapZ_A CaSOF_ContinuousDischargeSocTempMapDimension_n CaSOF_ContinuousDischargeSocTempMapZ_A CcSOF_BaseCurrentLimitFactor_pct CcSOF_UseSohLimitEnable_flg /end REF_CHARACTERISTIC
/end GROUP
/begin GROUP S1230_Calculate_ShortPulseChargeCurrent "VBU0513/VBUSystem/BMS/SOF/Subsystem6/Subsystem/Determine_Currentlimit_Target/Calculate_CurrentLimit_Target/Calculate_CurrentLimit_Base/Calculate_ShortPulseChargeCurrent"
 /begin SUB_GROUP S1237_Calculate_Locked_SOC S1237_Calculate_Locked_SOC1 S1237_Calculate_SOH_Current_Limit /end SUB_GROUP
 /begin REF_CHARACTERISTIC CaSOF_ShortPulseChargeEolSocTempMapDimension_n CaSOF_ShortPulseChargeEolSocTempMapZ_A CaSOF_ShortPulseChargeLockedSocTempMapDimension_n CaSOF_ShortPulseChargeLockedSocTempMapX_C CaSOF_ShortPulseChargeLockedSocTempMapY_pct CaSOF_ShortPulseChargeSocTempMapDimension_n CaSOF_ShortPulseChargeSocTempMapX_C CaSOF_ShortPulseChargeSocTempMapY_pct CcSOF_BaseCurrentLimitFactor_pct CcSOF_UseSohLimitEnable_flg /end REF_CHARACTERISTIC
 /begin REF_MEASUREMENT SOF_iAShortPulseChargeCurrentLimitMapBaseNormal /end REF_MEASUREMENT
/end GROUP
/begin GROUP S1230_Calculate_ShortPulseDischargeCurrent "VBU0513/VBUSystem/BMS/SOF/Subsystem6/Subsystem/Determine_Currentlimit_Target/Calculate_CurrentLimit_Target/Calculate_CurrentLimit_Base/Calculate_ShortPulseDischargeCurrent"
 /begin SUB_GROUP S1238_Calculate_Locked_SOC S1238_Calculate_Locked_SOC1 S1238_Calculate_SOH_Current_Limit /end SUB_GROUP
 /begin REF_CHARACTERISTIC CaSOF_ShortPulseDischargeEolSocTempMapDimension_n CaSOF_ShortPulseDischargeEolSocTempMapZ_A CaSOF_ShortPulseDischargeLockedSocTempMapDimension_n CaSOF_ShortPulseDischargeLockedSocTempMapZ_A CaSOF_ShortPulseDischargeSocTempMapDimension_n CaSOF_ShortPulseDischargeSocTempMapZ_A CcSOF_BaseCurrentLimitFactor_pct CcSOF_UseSohLimitEnable_flg /end REF_CHARACTERISTIC
 /begin REF_MEASUREMENT SOF_iAShortPulseDischargeCurrentLimitBase /end REF_MEASUREMENT
/end GROUP
/begin GROUP S1230_Determine_LowVoltageLimitChargeCurrent "VBU0513/VBUSystem/BMS/SOF/Subsystem6/Subsystem/Determine_Currentlimit_Target/Calculate_CurrentLimit_Target/Calculate_CurrentLimit_Base/Determine_LowVoltageLimitChargeCurrent" /begin SUB_GROUP S1241_RS_FlipFlop_EEPROM /end SUB_GROUP
 /begin REF_CHARACTERISTIC CcSOF_LowVoltageAbnormalPowerOnDelay_ms CcSOF_LowVoltageResetSOC_pct CcSOF_LowVoltageSetCurrentDelay_ms CcSOF_LowVoltageSetCurrent_A CcSOF_LowVoltageSetSOC_pct CcSOF_LowVoltageSetTime_s CcSOF_LowVoltageSetVolt2Delta_mV CcSOF_LowVoltageSetVolt2_mV CcSOF_LowVoltageSetVolt_mV CcSOF_LowVoltageSetVoltageDelay_ms /end REF_CHARACTERISTIC
 /begin REF_MEASUREMENT EcSOF_LowVoltageStartTime_s SOF_flgLowVoltageState /end REF_MEASUREMENT
/end GROUP
/begin GROUP S1231_Calculate_Dynamic_ChargeCurrentLimit "VBU0513/VBUSystem/BMS/SOF/Subsystem6/Subsystem/Determine_Currentlimit_Target/Calculate_CurrentLimit_Target/Calculate_Dynamic_CurrentLimit/Calculate_Dynamic_ChargeCurrentLimit"
 /begin SUB_GROUP S1280_Calculate_ChargeCurrentLimit_Buff S1280_Calculate_Dynamic_ChargeCurrentLimit /end SUB_GROUP
/end GROUP
/begin GROUP S1231_Calculate_Dynamic_DischargeCurrentLimit "VBU0513/VBUSystem/BMS/SOF/Subsystem6/Subsystem/Determine_Currentlimit_Target/Calculate_CurrentLimit_Target/Calculate_Dynamic_CurrentLimit/Calculate_Dynamic_DischargeCurrentLimit"
 /begin SUB_GROUP S1281_Calculate_DischargeCurrentLimit_Buff S1281_Calculate_Dynamic_DischargeCurrentLimit /end SUB_GROUP
/end GROUP
/begin GROUP S1232_FastChrgOneThirdRateCurrentLimitCheck "VBU0513/VBUSystem/BMS/SOF/Subsystem6/Subsystem/Determine_Currentlimit_Target/Calculate_CurrentLimit_Target/CurrentLimit_FastCharge_Check/FastChrgOneThirdRateCurrentLimitCheck" /begin SUB_GROUP S1301_FCC_CHARGE_MODE1 S1301_Rate_Limiter_Reset /end SUB_GROUP
 /begin REF_CHARACTERISTIC CaSOF_ContinuousChargeSocTempMapZ_A CaSOF_FastChargeCurrentDropBOLCellVoltageDimension_n CaSOF_FastChargeCurrentDropBOLCellVoltageMapZ_mV CaSOF_FastChargeCurrentDropEOLCellVoltageDimension_n CaSOF_FastChargeCurrentDropEOLCellVoltageMapZ_mV CcSOF_FastChargeCellVoltageSOCLimit_pct CcSOF_FastChargeSOCLimit_pct CcSOF_FccOneThirdCurtSloDelay_ms CcSOF_FccOneThirdRateCurtSlope_A /end REF_CHARACTERISTIC
 /begin REF_MEASUREMENT SOF_flgFastChrgOneThirdRateCurrentLimit SOF_mvFastChargeCurrentDropCellVoltage /end REF_MEASUREMENT
/end GROUP
/begin GROUP S1232_SegmentChargeCheck "VBU0513/VBUSystem/BMS/SOF/Subsystem6/Subsystem/Determine_Currentlimit_Target/Calculate_CurrentLimit_Target/CurrentLimit_FastCharge_Check/SegmentChargeCheck" /begin SUB_GROUP S1302_FCC_CHARGE_MODE1 S1302_FastCharge /end SUB_GROUP
 /begin REF_MEASUREMENT SOF_iAContinuousChargeCurrentLimitFastChrgChkRaw SOF_iAContinuousDischargeCurrentLimitFastChrgChk SOF_iAShortPulseChargeCurrentLimitFastChrgChk SOF_iAShortPulseDischargeCurrentLimitFastChrgChk /end REF_MEASUREMENT
/end GROUP
/begin GROUP S1233_CAT4 "VBU0513/VBUSystem/BMS/SOF/Subsystem6/Subsystem/Determine_Currentlimit_Target/Calculate_CurrentLimit_Target/CurrentLimit_Fault_Correct/CAT4"
 /begin REF_CHARACTERISTIC CcSOF_ContinuousChargeCurrentLimp_A CcSOF_ContinuousDischargeCurrentLimp_A CcSOF_DynamicChargeCurrentLimp_A CcSOF_DynamicDischargeCurrentLimp_A CcSOF_ShortPulseChargeCurrentLimp_A CcSOF_ShortPulseDischargeCurrentLimp_A /end REF_CHARACTERISTIC
/end GROUP
/begin GROUP S1233_Determine_StopCharge_Condition "VBU0513/VBUSystem/BMS/SOF/Subsystem6/Subsystem/Determine_Currentlimit_Target/Calculate_CurrentLimit_Target/CurrentLimit_Fault_Correct/Determine_StopCharge_Condition"
 /begin REF_CHARACTERISTIC CcSOF_StopChargeBattVolt_V CcSOF_StopChargeDeltaBattVolt_V CcSOF_StopChargeDeltaSOC_pct CcSOF_StopChargeSOCDebounceTime_s CcSOF_StopChargeSOC_pct CcSOF_StopChargeVoltDebounceTime_s /end REF_CHARACTERISTIC
/end GROUP
/begin GROUP S1234_Correct_CurrentLimit "VBU0513/VBUSystem/BMS/SOF/Subsystem6/Subsystem/Determine_Currentlimit_Target/Calculate_CurrentLimit_Target/CurrentLimit_Voltage_Correct/Correct_CurrentLimit"
 /begin SUB_GROUP S1337_Calculate_CurrentLimit S1337_Determine_VoltageCorrect_level /end SUB_GROUP
/end GROUP
/begin GROUP S1427_Caculate_WeightingLifeTimeCharge "VBU0513/VBUSystem/BMS/SOH/Subsystem4/Subsystem1/Calculate_Capacity/Calculate_CellCapacity/Caculate_CellCapacity_LifeTimeQ/Caculate_WeightingLifeTimeCharge" /begin REF_CHARACTERISTIC CcSOH_FastChargeWeighting_pct /end REF_CHARACTERISTIC /end GROUP
/begin GROUP S1428_LimittedByNVMvalue "VBU0513/VBUSystem/BMS/SOH/Subsystem4/Subsystem1/Calculate_Capacity/Calculate_CellCapacity/CellCapacity_Limit/LimittedByNVMvalue"
 /begin REF_CHARACTERISTIC CaSOH_DecreaseCapacityMapDimension_n CaSOH_DecreaseCapacityMapY_pct /end REF_CHARACTERISTIC
/end GROUP
/begin GROUP S1429_MMASVC1 "VBU0513/VBUSystem/BMS/SOH/Subsystem4/Subsystem1/Calculate_Capacity/Calculate_CellCapacity/Determine_CellCapacity/MMASVC1" /begin SUB_GROUP S1443_Update_Max_Min /end SUB_GROUP /end GROUP
/begin GROUP S1461_Determine_AhIntegral_Q "VBU0513/VBUSystem/BMS/SOH/Subsystem4/Subsystem1/Calculate_Capacity/Calculate_CellCapacity_SlowCharge/Determine_AhIntegral_DeltaQ/Determine_AhIntegral_Q" /begin SUB_GROUP S1467_Determine_Cell_Balanced_Capacity /end SUB_GROUP
 /begin REF_CHARACTERISTIC CcSOH_MaxBalancedCapacity_As CcSOH_MaxCurrentIntegral_As CcSOH_MinBalancedCapacity_As CcSOH_MinCurrentIntegral_As /end REF_CHARACTERISTIC
/end GROUP
/begin GROUP S1461_Determine_Module_Current "VBU0513/VBUSystem/BMS/SOH/Subsystem4/Subsystem1/Calculate_Capacity/Calculate_CellCapacity_SlowCharge/Determine_AhIntegral_DeltaQ/Determine_Module_Current" /begin SUB_GROUP S1468_CONTACTOR_STATUS_OPENED1 /end SUB_GROUP /end GROUP
/begin GROUP S1463_Determine_Module_Current "VBU0513/VBUSystem/BMS/SOH/Subsystem4/Subsystem1/Calculate_Capacity/Calculate_CellCapacity_SlowCharge/Determine_Soc/Determine_Module_Current" /begin SUB_GROUP S1472_CONTACTOR_STATUS_OPENED1 /end SUB_GROUP /end GROUP
/begin GROUP S1463_Lookup_Table_Cal_Soc "VBU0513/VBUSystem/BMS/SOH/Subsystem4/Subsystem1/Calculate_Capacity/Calculate_CellCapacity_SlowCharge/Determine_Soc/Lookup_Table_Cal_Soc" /begin SUB_GROUP S1473_Cal_Resistance S1473_Cal_Soc /end SUB_GROUP /end GROUP
/begin GROUP S1500_DuringStep_AfterStep_Check "VBU0513/VBUSystem/BMS/SOH/Subsystem4/Subsystem1/Calculate_Resistance/BasicCellResistance_Calculation_Check/BeforStep_DuringStep_AfterStep_Check/DuringStep_AfterStep_Check" /begin REF_CHARACTERISTIC CcSOH_AfterEdgeFallTime_ms CcSOH_BeforeEdgeFallTime_ms /end REF_CHARACTERISTIC /end GROUP
/begin GROUP S1516_Determine_FCCPulseCurrent_Condition "VBU0513/VBUSystem/BMS/SOH/Subsystem4/Subsystem1/Calculate_Resistance/Determine_Condition_Calculate_Pulse_Average_CurrentVoltage/Determine_Condition/Determine_FCCPulseCurrent_Condition" /begin REF_CHARACTERISTIC CcSOH_PulseCurrentThreshold_pct /end REF_CHARACTERISTIC /end GROUP
/begin GROUP S1516_Determine_OBCPulseCurrent_Condition "VBU0513/VBUSystem/BMS/SOH/Subsystem4/Subsystem1/Calculate_Resistance/Determine_Condition_Calculate_Pulse_Average_CurrentVoltage/Determine_Condition/Determine_OBCPulseCurrent_Condition" /begin REF_CHARACTERISTIC CcSOH_PulseCurrentThreshold_pct /end REF_CHARACTERISTIC /end GROUP
/begin GROUP S1558_Determinate_InletTempValidationDelay "VBU0513/VBUSystem/BMS/THM/Subsystem/Subsystem/Calculate_PipeTemperature/Determine_CoolantSensorTemp_Validation/Determine_InletTemp_Validation/Determinate_InletTempValidationDelay" /begin REF_CHARACTERISTIC CcTHM_CoolantSensorValidDelayTime_s /end REF_CHARACTERISTIC /end GROUP
/begin GROUP S1559_Determinate_OutletTempValidationDelay "VBU0513/VBUSystem/BMS/THM/Subsystem/Subsystem/Calculate_PipeTemperature/Determine_CoolantSensorTemp_Validation/Determine_OutletTemp_Validation/Determinate_OutletTempValidationDelay" /begin REF_CHARACTERISTIC CcTHM_CoolantSensorValidDelayTime_s /end REF_CHARACTERISTIC /end GROUP
/begin GROUP S3260_Turn_Off_Delay_Time "VBU0513/VBUSystem/VCU /DCH/DCH_Overall/DCH_DCChargeCtrlOverall/DCH_DCChargeCtrlStateflow/DCH_InputSignalPreProcess/DCH_BMSChAvlDebounce/Turn_Off_Delay_Time" /begin REF_MEASUREMENT DCH_flgBmsChAvl /end REF_MEASUREMENT /end GROUP
/begin GROUP S3261_Turn_Off_Delay_Time2 "VBU0513/VBUSystem/VCU /DCH/DCH_Overall/DCH_DCChargeCtrlOverall/DCH_DCChargeCtrlStateflow/DCH_InputSignalPreProcess/DCH_DCRelayCloseDiagnose/Turn_Off_Delay_Time2" /begin REF_MEASUREMENT DCH_flgDCChRlyCloseSt /end REF_MEASUREMENT /end GROUP
/begin GROUP S3262_Turn_Off_Delay_Time2 "VBU0513/VBUSystem/VCU /DCH/DCH_Overall/DCH_DCChargeCtrlOverall/DCH_DCChargeCtrlStateflow/DCH_InputSignalPreProcess/DCH_VehStateAnalyze/Turn_Off_Delay_Time2" /begin REF_MEASUREMENT DCH_flgAPlusWkup /end REF_MEASUREMENT /end GROUP
/begin GROUP S3370_DSPL_EnergyFactorInit "VBU0513/VBUSystem/VCU /DSPL /DSPL/DriveRange/DSPL_Consumption/DSPL_EnergySelfLearn/DSPL_EnergyFactorCal/DSPL_EnergyFactorInit" /begin SUB_GROUP S3377_SwitchParameter /end SUB_GROUP
 /begin REF_CHARACTERISTIC DSPL_facEnergyFactorInitHigh_C DSPL_facEnergyFactorInitLow_C DSPL_facEnergyFactorInitMid_C DSPL_facEnergyFactorInit_C DSPL_facEnergyFactorTypeInit_C DSPL_kmEnergyFactorOdoLow_C DSPL_kmEnergyFactorOdoMid_C DSPL_kmEnergyFactorOdoZero_C /end REF_CHARACTERISTIC
/end GROUP
/begin GROUP S3370_DSPL_EnergyFactorUpdate "VBU0513/VBUSystem/VCU /DSPL /DSPL/DriveRange/DSPL_Consumption/DSPL_EnergySelfLearn/DSPL_EnergyFactorCal/DSPL_EnergyFactorUpdate"
 /begin REF_CHARACTERISTIC DSPL_facEnergyFactorSOCUpdate_CUR_v DSPL_facEnergyFactorSelfLearnInit_C DSPL_facEnergyFactorUpdateStep_C DSPL_flgEnergyFactorSelfLearnEn_C DSPL_pctBMSSOCUpdateStep_C DSPL_pctEnergySOCLearnMax_C /end REF_CHARACTERISTIC
/end GROUP
/begin GROUP S3445_SwitchParameter "VBU0513/VBUSystem/VCU /DSPL /DSPL/DriveRange/RemainingRange/FullRangeAndSocDeclineFactor/FullRangeCalculation/SwitchParameter"
 /begin REF_CHARACTERISTIC DSPL_kmFullSocRateRng_C_Md_Default DSPL_kmFullSocRateRng_C_Md_Type1 DSPL_kmFullSocRateRng_C_Md_Type2 DSPL_kmFullSocRateRng_C_Md_Type3 DSPL_kmFullSocRateRng_C_Md_Type4 /end REF_CHARACTERISTIC
/end GROUP
/begin GROUP S3447_SwitchParameter "VBU0513/VBUSystem/VCU /DSPL /DSPL/DriveRange/RemainingRange/FullRangeAndSocDeclineFactor/SOCDeclineFactorCalculation/SwitchParameter"
 /begin REF_CHARACTERISTIC DSPL_facInitRateSOCFactor_C_Md_Default DSPL_facInitRateSOCFactor_C_Md_Type1 DSPL_facInitRateSOCFactor_C_Md_Type2 DSPL_facInitRateSOCFactor_C_Md_Type3 DSPL_facInitRateSOCFactor_C_Md_Type4 /end REF_CHARACTERISTIC
/end GROUP
/begin GROUP S3447_SwitchParameter1 "VBU0513/VBUSystem/VCU /DSPL /DSPL/DriveRange/RemainingRange/FullRangeAndSocDeclineFactor/SOCDeclineFactorCalculation/SwitchParameter1"
 /begin REF_CHARACTERISTIC DSPL_facDecRateVldLo_C_Md_Default DSPL_facDecRateVldLo_C_Md_Type1 DSPL_facDecRateVldLo_C_Md_Type2 DSPL_facDecRateVldLo_C_Md_Type3 DSPL_facDecRateVldLo_C_Md_Type4 /end REF_CHARACTERISTIC
/end GROUP
/begin GROUP S3447_SwitchParameter2 "VBU0513/VBUSystem/VCU /DSPL /DSPL/DriveRange/RemainingRange/FullRangeAndSocDeclineFactor/SOCDeclineFactorCalculation/SwitchParameter2"
 /begin REF_CHARACTERISTIC DSPL_facDecRateVldHi_C_Md_Default DSPL_facDecRateVldHi_C_Md_Type1 DSPL_facDecRateVldHi_C_Md_Type2 DSPL_facDecRateVldHi_C_Md_Type3 DSPL_facDecRateVldHi_C_Md_Type4 /end REF_CHARACTERISTIC
/end GROUP
/begin GROUP S3460_SwitchParameter "VBU0513/VBUSystem/VCU /DSPL /DSPL/DriveRange/RemainingRange/SelectDisplayRange/storeRange/SwitchParameter"
 /begin REF_CHARACTERISTIC DSPL_kmDrvRngMax_C_Md_Default DSPL_kmDrvRngMax_C_Md_Type1 DSPL_kmDrvRngMax_C_Md_Type2 DSPL_kmDrvRngMax_C_Md_Type3 DSPL_kmDrvRngMax_C_Md_Type4 /end REF_CHARACTERISTIC
/end GROUP
/begin GROUP S3532_GradientLimiter "VBU0513/VBUSystem/VCU /EDIS/EDIS_Ctrl/battery_power_calculate/charge_power_calculate/ChPowSetPoint/fid_action/GradientLimiter" /begin REF_MEASUREMENT EDIS_pwrChLimDynRaw /end REF_MEASUREMENT /end GROUP
/begin GROUP S3532_GradientLimiter1 "VBU0513/VBUSystem/VCU /EDIS/EDIS_Ctrl/battery_power_calculate/charge_power_calculate/ChPowSetPoint/fid_action/GradientLimiter1" /begin REF_MEASUREMENT EDIS_pwrChLimLTRaw /end REF_MEASUREMENT /end GROUP
/begin GROUP S3547_GradientLimiter "VBU0513/VBUSystem/VCU /EDIS/EDIS_Ctrl/battery_power_calculate/discharge_power_calculate/DchPowSetpiont/fid_action/GradientLimiter" /begin REF_MEASUREMENT EDIS_pwrDisChLimDynRaw /end REF_MEASUREMENT /end GROUP
/begin GROUP S3547_GradientLimiter1 "VBU0513/VBUSystem/VCU /EDIS/EDIS_Ctrl/battery_power_calculate/discharge_power_calculate/DchPowSetpiont/fid_action/GradientLimiter1" /begin REF_MEASUREMENT EDIS_pwrDisChLimLTRaw /end REF_MEASUREMENT /end GROUP
/begin GROUP S3547_GradientLimiter2 "VBU0513/VBUSystem/VCU /EDIS/EDIS_Ctrl/battery_power_calculate/discharge_power_calculate/DchPowSetpiont/fid_action/GradientLimiter2" /begin REF_MEASUREMENT EDIS_pwrDisChLimSTRaw /end REF_MEASUREMENT /end GROUP
/begin GROUP S3548_batt_stpower_overrite "VBU0513/VBUSystem/VCU /EDIS/EDIS_Ctrl/battery_power_calculate/discharge_power_calculate/DchPowSetpiont/setpoint/batt_stpower_overrite" /begin SUB_GROUP S3558_GradientLimiter S3558_Hysteresis_LHC_RLC1 /end SUB_GROUP
 /begin REF_CHARACTERISTIC EDIS_facDecGradSprt_C EDIS_flgDisChDynMore_C EDIS_flgDisChDynOverride_C EDIS_numCurrentOverDisChDyn_C EDIS_numDisChDyn_C EDIS_pctAccPedlDchaLo_C EDIS_pctAccPedlDchaUp_C EDIS_pctSocDchaLo_C EDIS_pctSocDchaUp_C EDIS_pwrBmsDynLTDeltaHi_C EDIS_pwrBmsDynLTDeltaLo_C EDIS_pwrDecGradSprt_MAP_v EDIS_pwrDisChDynMore_C EDIS_pwrDisChaFilterHi_C EDIS_pwrDisChaFilterLo_C EDIS_stCurrentGearD_C EDIS_tBmsMaxTempHi_C EDIS_tBmsMaxTempLo_C EDIS_tBmsMinTempHi_C EDIS_tBmsMinTempLo_C EDIS_tiOverDisCha_C EDIS_vVehSpdDchaLo_C EDIS_vVehSpdDchaUp_C SYS_stHMIDrvModeSport_SY /end REF_CHARACTERISTIC
 /begin REF_MEASUREMENT EDIS_flgPowDisChToSTLim EDIS_pwrDisChLimDynOvrride /end REF_MEASUREMENT
/end GROUP
/begin GROUP S3548_discharge_setpoint "VBU0513/VBUSystem/VCU /EDIS/EDIS_Ctrl/battery_power_calculate/discharge_power_calculate/DchPowSetpiont/setpoint/discharge_setpoint"
 /begin REF_CHARACTERISTIC EDIS_facBMSSOCDisCh_CUR_v EDIS_facDisChPwrDeltaBaseDiff_CUR_v EDIS_facMaxBMSDisCh_CUR_v EDIS_facMinBMSDisCh_CUR_v EDIS_numDisChOverLim_C EDIS_numDisChPwrOverCntEEPROMInit_SY EDIS_pwrDisChOverLim_C EDIS_pwrDisChRed40vLim_C EDIS_pwrSpBaseDchDyn_CUR_v /end REF_CHARACTERISTIC
 /begin REF_MEASUREMENT EDIS_facDchDynSp EDIS_pwrDisChSp /end REF_MEASUREMENT
/end GROUP
/begin GROUP S3549_BattDisChaCold "VBU0513/VBUSystem/VCU /EDIS/EDIS_Ctrl/battery_power_calculate/discharge_power_calculate/DchPowSetpiont/temperature_correction/BattDisChaCold" /begin REF_MEASUREMENT EDIS_pwrDisChaDynCold /end REF_MEASUREMENT /end GROUP
/begin GROUP S3549_BattDisChaHot "VBU0513/VBUSystem/VCU /EDIS/EDIS_Ctrl/battery_power_calculate/discharge_power_calculate/DchPowSetpiont/temperature_correction/BattDisChaHot" /begin REF_MEASUREMENT EDIS_pwrDisChaDynHot /end REF_MEASUREMENT /end GROUP
/begin GROUP S3549_MinSel "VBU0513/VBUSystem/VCU /EDIS/EDIS_Ctrl/battery_power_calculate/discharge_power_calculate/DchPowSetpiont/temperature_correction/MinSel" /begin REF_MEASUREMENT EDIS_pwrDisChaDynTempCorr /end REF_MEASUREMENT /end GROUP
/begin GROUP S3933_BandStopInit "VBU0513/VBUSystem/VCU /TQO/TQOAll/TQDIS/TQDIS/Dmp/DmpFilter/BandStopInit" /begin REF_MEASUREMENT TQDIS_trqDmpRAInit /end REF_MEASUREMENT /end GROUP
/begin GROUP S3943_AccPdlIdl "VBU0513/VBUSystem/VCU /TQO/TQOAll/TQDIS/TQDIS/TrqFilter/DrvLim/AccPdlIdl"
 /begin REF_CHARACTERISTIC TQDIS_facShftChngLim_CUR_v TQDIS_pctShftChngFullAcc_C TQDIS_pctShftChngLimThres_CUR_v TQDIS_tiShftChngDly_C TQDIS_trqShftChngLimThres_C /end REF_CHARACTERISTIC
 /begin REF_MEASUREMENT TQDIS_facUnintdAcc /end REF_MEASUREMENT
/end GROUP
/begin GROUP S3943_Creep "VBU0513/VBUSystem/VCU /TQO/TQOAll/TQDIS/TQDIS/TrqFilter/DrvLim/Creep"
 /begin REF_CHARACTERISTIC TQDIS_facAccPedFilter_CUR_v TQDIS_facBrkDec_MAP_v TQDIS_facBrkSlpCrp_MAP_v TQDIS_facDrvLo_CUR_y TQDIS_facRgnLo_CUR_y TQDIS_facShftDR_CUR_v TQDIS_trqCreepThd_C TQDIS_trqCrpBase_MAP_v TQDIS_vVehFilterThd_C /end REF_CHARACTERISTIC
 /begin REF_MEASUREMENT TQDIS_facAccPedFilter TQDIS_facBrkDec TQDIS_facBrkSlpCrp TQDIS_facPwrLo TQDIS_flgCrp TQDIS_trqCrpBase TQDIS_trqCrpDecFilter TQDIS_trqCrpIncFilter /end REF_MEASUREMENT
/end GROUP
/begin GROUP S3943_RADrvDec "VBU0513/VBUSystem/VCU /TQO/TQOAll/TQDIS/TQDIS/TrqFilter/DrvLim/RADrvDec" /begin REF_CHARACTERISTIC TQDIS_trqDecGradECORA_MAP_v /end REF_CHARACTERISTIC /begin REF_MEASUREMENT TQDIS_facBase2RADrvDecLim TQDIS_trqRADrvDecLim /end REF_MEASUREMENT /end GROUP
/begin GROUP S3943_RADrvInc "VBU0513/VBUSystem/VCU /TQO/TQOAll/TQDIS/TQDIS/TrqFilter/DrvLim/RADrvInc"
 /begin REF_CHARACTERISTIC TQDIS_facAPDTrqECORA_MAP_v TQDIS_facAccPdlECORA_MAP_v TQDIS_trqIncGradECORA_MAP_v /end REF_CHARACTERISTIC
 /begin REF_MEASUREMENT TQDIS_facIncGain TQDIS_trqBase1RADrvIncLim TQDIS_trqBase2RADrvIncLim TQDIS_trqIncBase TQDIS_trqRADrvIncLim /end REF_MEASUREMENT
/end GROUP
/begin GROUP S3972_ConditionRAArb "VBU0513/VBUSystem/VCU /TQO/TQOAll/TQDMP/TQDMP/RAROTC/ROTCConidtion/ConditionRAArb" /begin REF_CHARACTERISTIC TQDMP_flgROTCEnRA_C TQDMP_tiTrqZeroDly_C /end REF_CHARACTERISTIC /begin REF_MEASUREMENT TQDMP_flgROTCActRA /end REF_MEASUREMENT /end GROUP
/begin GROUP S3972_SpeedHoldEnableRA "VBU0513/VBUSystem/VCU /TQO/TQOAll/TQDMP/TQDMP/RAROTC/ROTCConidtion/SpeedHoldEnableRA"
 /begin REF_CHARACTERISTIC TQDMP_flgSpdHldOn_C TQDMP_nSpdHldMax2FA_C TQDMP_nSpdHldMaxFA_C TQDMP_nSpdHldMin2FA_C TQDMP_nSpdHldMinFA_C /end REF_CHARACTERISTIC
 /begin REF_MEASUREMENT TQDMP_flgSpdHldR /end REF_MEASUREMENT
/end GROUP
/begin GROUP S3972_TipInRA "VBU0513/VBUSystem/VCU /TQO/TQOAll/TQDMP/TQDMP/RAROTC/ROTCConidtion/TipInRA"
 /begin REF_CHARACTERISTIC TQDMP_pctTipInAccPedChgThd_C TQDMP_pctTipInAccPedTrgThd_C TQDMP_tiTipInDly_C /end REF_CHARACTERISTIC
/end GROUP
/begin GROUP S3972_TipOutRA "VBU0513/VBUSystem/VCU /TQO/TQOAll/TQDMP/TQDMP/RAROTC/ROTCConidtion/TipOutRA"
 /begin REF_CHARACTERISTIC TQDMP_pctTipOutAccPedChgThd_C TQDMP_pctTipOutAccPedTrgThd_C TQDMP_tiTipOutDly_C /end REF_CHARACTERISTIC
/end GROUP
/begin GROUP S3972_TipinEnaRA "VBU0513/VBUSystem/VCU /TQO/TQOAll/TQDMP/TQDMP/RAROTC/ROTCConidtion/TipinEnaRA" /begin SUB_GROUP S3984_SR_Flip_Flop /end SUB_GROUP
 /begin REF_CHARACTERISTIC TQDMP_flgTipInEnaRvs_C TQDMP_pctTipInAccPedEnThdHi_C TQDMP_pctTipInAccPedEnThdLo_C TQDMP_tiTipInAct_C /end REF_CHARACTERISTIC
/end GROUP
/begin GROUP S3972_TipoutEnaRA "VBU0513/VBUSystem/VCU /TQO/TQOAll/TQDMP/TQDMP/RAROTC/ROTCConidtion/TipoutEnaRA" /begin SUB_GROUP S3985_SR_Flip_Flop /end SUB_GROUP
 /begin REF_CHARACTERISTIC TQDMP_flgTipOutEnaRvs_C TQDMP_pctTipOutAccPedEnThdHi_C TQDMP_pctTipOutAccPedEnThdLo_C TQDMP_tiTipOutAct_C /end REF_CHARACTERISTIC
/end GROUP
/begin GROUP S3972_VrtlRA "VBU0513/VBUSystem/VCU /TQO/TQOAll/TQDMP/TQDMP/RAROTC/ROTCConidtion/VrtlRA" /begin REF_CHARACTERISTIC TQDMP_trqAxleMaxRA_C /end REF_CHARACTERISTIC /begin REF_MEASUREMENT TQDMP_pctAccPdlVrtlRA /end REF_MEASUREMENT /end GROUP
/begin GROUP S3973_CompensationPhase "VBU0513/VBUSystem/VCU /TQO/TQOAll/TQDMP/TQDMP/RAROTC/TorqueCal/CompensationPhase"
 /begin REF_CHARACTERISTIC TQDMP_facPhsCmpDenRA_C TQDMP_facPhsCmpK1RA_C TQDMP_facPhsCmpNumRA_C /end REF_CHARACTERISTIC
 /begin REF_MEASUREMENT TQDMP_trqDeltaLPFR TQDMP_trqDeltaR /end REF_MEASUREMENT
/end GROUP
/begin GROUP S3973_DeltaTrqArb "VBU0513/VBUSystem/VCU /TQO/TQOAll/TQDMP/TQDMP/RAROTC/TorqueCal/DeltaTrqArb" /begin REF_MEASUREMENT TQDMP_trqBumpRA /end REF_MEASUREMENT /end GROUP
/begin GROUP S3973_TorqueLim "VBU0513/VBUSystem/VCU /TQO/TQOAll/TQDMP/TQDMP/RAROTC/TorqueCal/TorqueLim"
 /begin REF_CHARACTERISTIC TQDMP_facDeltaRPMFAC1_CUR_v TQDMP_facPhaseSclRA_C TQDMP_trqDeadZoneMaxRA_C TQDMP_trqDeadZoneMinRA_C TQDMP_trqMaxRA_C TQDMP_trqMinRA_C /end REF_CHARACTERISTIC
 /begin REF_MEASUREMENT TQDMP_trqROTCRA /end REF_MEASUREMENT
/end GROUP
/begin GROUP S4012_GradientLimiter "VBU0513/VBUSystem/VCU /TQO/TQOAll/TQO/TQO/MotorTorque/Subsystem/GradientLimiter" /begin REF_MEASUREMENT TQO_facShft /end REF_MEASUREMENT /end GROUP
/begin GROUP S4015_DecGradienLimiter "VBU0513/VBUSystem/VCU /TQO/TQOAll/TQO/TQO/Trq/TrqProtect/DecGradienLimiter" /begin REF_MEASUREMENT TQO_trqBrkLim /end REF_MEASUREMENT /end GROUP
/begin GROUP S4118_SetBit2 "VBU0513/VBUSystem/VCU /VehINP/VehINP_Logic/GearShift/Gear1/Digital_Gear_D_R/Gear_Bit/SetBit2" /begin REF_MEASUREMENT Gear_stHWSensor /end REF_MEASUREMENT /end GROUP
/begin GROUP S4119_Turn_On_Delay_Time "VBU0513/VBUSystem/VCU /VehINP/VehINP_Logic/GearShift/Gear1/Digital_Gear_D_R/Gear_DR_Req/Turn_On_Delay_Time" /begin REF_MEASUREMENT Gear_flgDGearReqRawDigitalAction /end REF_MEASUREMENT /end GROUP
/begin GROUP S4119_Turn_On_Delay_Time1 "VBU0513/VBUSystem/VCU /VehINP/VehINP_Logic/GearShift/Gear1/Digital_Gear_D_R/Gear_DR_Req/Turn_On_Delay_Time1" /begin REF_MEASUREMENT Gear_flgRGearReqRawDigitalAction /end REF_MEASUREMENT /end GROUP
/begin GROUP S4119_Turn_On_Delay_Time2 "VBU0513/VBUSystem/VCU /VehINP/VehINP_Logic/GearShift/Gear1/Digital_Gear_D_R/Gear_DR_Req/Turn_On_Delay_Time2" /begin REF_MEASUREMENT Gear_flgNGearReqRawDigitalAction /end REF_MEASUREMENT /end GROUP
/begin GROUP S4120_Turn_On_Delay_Time "VBU0513/VBUSystem/VCU /VehINP/VehINP_Logic/GearShift/Gear1/Digital_Gear_D_R/Gear_DR_Warning/Turn_On_Delay_Time" /begin REF_MEASUREMENT Gear_flgGearWarningST /end REF_MEASUREMENT /end GROUP
/begin GROUP S4120_Turn_On_Delay_Time1 "VBU0513/VBUSystem/VCU /VehINP/VehINP_Logic/GearShift/Gear1/Digital_Gear_D_R/Gear_DR_Warning/Turn_On_Delay_Time1" /begin REF_MEASUREMENT Gear_flgGearWarningLT /end REF_MEASUREMENT /end GROUP
/begin GROUP S4122_SR_Flip_Flop1 "VBU0513/VBUSystem/VCU /VehINP/VehINP_Logic/GearShift/Gear1/Digital_Gear_D_R/Gear_Warning/SR_Flip_Flop1" /begin REF_MEASUREMENT Gear_flgDftGearPlausibilityDigital /end REF_MEASUREMENT /end GROUP
/begin GROUP S4166_SR_Flip_Flop2 "VBU0513/VBUSystem/VCU /VehINP/VehINP_Logic/GearShift/Gear1/Gear_Status/Gear_GearReq/SR_Flip_Flop2" /begin REF_MEASUREMENT Gear_flgNGearReq /end REF_MEASUREMENT /end GROUP
/begin GROUP S58_Enabled_Subsystem "VBU0513/VBUSystem/BMS/BCV/BCV/Subsystem/Calculate_BatteryCurrent/Correct_BatteryCurrent/Calculate_BatteryCurrent_ZeroDrift/Calculate_Current_ZeroDruft/Enabled_Subsystem" /begin REF_CHARACTERISTIC CcBCV_BatteryCurrentZeroDriftTime_ms /end REF_CHARACTERISTIC /end GROUP
/begin GROUP S59_Enabled_Subsystem "VBU0513/VBUSystem/BMS/BCV/BCV/Subsystem/Calculate_BatteryCurrent/Correct_BatteryCurrent/Calculate_BatteryCurrent_ZeroDrift/Calculate_ExtremeData/Enabled_Subsystem" /begin SUB_GROUP S64_Calculate_Current_Sum /end SUB_GROUP /end GROUP
/begin GROUP S460_Determine_Accumulated_RemainingHeat "VBU0513/VBUSystem/BMS/CTD/Subsystem/Subsystem4/PrechrgProcessMonitoring/Precharge_Thermal_Management/Determine_Precharge_JouleHeat/Determine_Accumulated_RemainingHeat/Determine_Accumulated_RemainingHeat" /begin REF_CHARACTERISTIC CcCTD_MaxAccumulatedHeadLoad_J /end REF_CHARACTERISTIC /begin REF_MEASUREMENT CTD_jAccumulatedAvaliableHeat /end REF_MEASUREMENT /end GROUP
/begin GROUP S1057_Delay_RisingEdge "VBU0513/VBUSystem/BMS/SOC/Subsystem5/Subsystem/Determine_FastChargeCorrection_Soc/FastCharge_DynamicCorrection/FastCharge_DynamicCorrection_Enable/Determine_CurrentStable_Condition/Delay_RisingEdge" /begin REF_MEASUREMENT LbSOC_FastChargeCurrentStable_flg /end REF_MEASUREMENT /end GROUP
/begin GROUP S1071_FastCharge_TOCAdjustAllSOC "VBU0513/VBUSystem/BMS/SOC/Subsystem5/Subsystem/Determine_FastChargeCorrection_Soc/FastCharge_PreCorrection/FastCharge_PreCorrectionMain/FastCharge_PreCorrectionVoltage/FastCharge_TOCAdjustAllSOC"
 /begin REF_CHARACTERISTIC CcSOC_FastChargePreCorrectionDeltaVolMax_mV CcSOC_FastChargePreCorrectionDeltaVolSOC_pct CcSOC_FastChargePreCorrectionSOC_pct /end REF_CHARACTERISTIC
/end GROUP
/begin GROUP S1235_Calculate_SOH_Current_Limit "VBU0513/VBUSystem/BMS/SOF/Subsystem6/Subsystem/Determine_Currentlimit_Target/Calculate_CurrentLimit_Target/Calculate_CurrentLimit_Base/Calculate_ContinuousChargeCurrent/Calculate_SOH_Current_Limit" /begin REF_CHARACTERISTIC CcSOF_BolSoh_pct CcSOF_EolSoh_pct /end REF_CHARACTERISTIC /begin REF_MEASUREMENT SOF_pctCurrentSOH /end REF_MEASUREMENT /end GROUP
/begin GROUP S1236_Calculate_SOH_Current_Limit "VBU0513/VBUSystem/BMS/SOF/Subsystem6/Subsystem/Determine_Currentlimit_Target/Calculate_CurrentLimit_Target/Calculate_CurrentLimit_Base/Calculate_ContinuousDischargeCurrent/Calculate_SOH_Current_Limit" /begin REF_CHARACTERISTIC CcSOF_BolSoh_pct CcSOF_EolSoh_pct /end REF_CHARACTERISTIC /end GROUP
/begin GROUP S1237_Calculate_SOH_Current_Limit "VBU0513/VBUSystem/BMS/SOF/Subsystem6/Subsystem/Determine_Currentlimit_Target/Calculate_CurrentLimit_Target/Calculate_CurrentLimit_Base/Calculate_ShortPulseChargeCurrent/Calculate_SOH_Current_Limit" /begin REF_CHARACTERISTIC CcSOF_BolSoh_pct CcSOF_EolSoh_pct /end REF_CHARACTERISTIC /end GROUP
/begin GROUP S1238_Calculate_SOH_Current_Limit "VBU0513/VBUSystem/BMS/SOF/Subsystem6/Subsystem/Determine_Currentlimit_Target/Calculate_CurrentLimit_Target/Calculate_CurrentLimit_Base/Calculate_ShortPulseDischargeCurrent/Calculate_SOH_Current_Limit" /begin REF_CHARACTERISTIC CcSOF_BolSoh_pct CcSOF_EolSoh_pct /end REF_CHARACTERISTIC /end GROUP
/begin GROUP S1241_RS_FlipFlop_EEPROM "VBU0513/VBUSystem/BMS/SOF/Subsystem6/Subsystem/Determine_Currentlimit_Target/Calculate_CurrentLimit_Target/Calculate_CurrentLimit_Base/Determine_LowVoltageLimitChargeCurrent/RS_FlipFlop_EEPROM" /begin REF_MEASUREMENT EcSOF_LowVoltageState_flg /end REF_MEASUREMENT /end GROUP
/begin GROUP S1280_Calculate_ChargeCurrentLimit_Buff "VBU0513/VBUSystem/BMS/SOF/Subsystem6/Subsystem/Determine_Currentlimit_Target/Calculate_CurrentLimit_Target/Calculate_Dynamic_CurrentLimit/Calculate_Dynamic_ChargeCurrentLimit/Calculate_ChargeCurrentLimit_Buff"
 /begin SUB_GROUP S1282_Calculate_ChargeCurrentLimitBuffer_Full S1282_Calculate_ChargeCurrentLimitBuffer_Use /end SUB_GROUP
/end GROUP
/begin GROUP S1280_Calculate_Dynamic_ChargeCurrentLimit "VBU0513/VBUSystem/BMS/SOF/Subsystem6/Subsystem/Determine_Currentlimit_Target/Calculate_CurrentLimit_Target/Calculate_Dynamic_CurrentLimit/Calculate_Dynamic_ChargeCurrentLimit/Calculate_Dynamic_ChargeCurrentLimit" /begin SUB_GROUP S1283_Buffer_Used /end SUB_GROUP /begin REF_MEASUREMENT SOF_iACalDynamicChgCurLimitFCCChk /end REF_MEASUREMENT /end GROUP
/begin GROUP S1281_Calculate_DischargeCurrentLimit_Buff "VBU0513/VBUSystem/BMS/SOF/Subsystem6/Subsystem/Determine_Currentlimit_Target/Calculate_CurrentLimit_Target/Calculate_Dynamic_CurrentLimit/Calculate_Dynamic_DischargeCurrentLimit/Calculate_DischargeCurrentLimit_Buff"
 /begin SUB_GROUP S1290_Calculate_DischargeCurrentLimitBuffer_Full S1290_Calculate_DischargeCurrentLimitBuffer_Use /end SUB_GROUP
/end GROUP
/begin GROUP S1281_Calculate_Dynamic_DischargeCurrentLimit "VBU0513/VBUSystem/BMS/SOF/Subsystem6/Subsystem/Determine_Currentlimit_Target/Calculate_CurrentLimit_Target/Calculate_Dynamic_CurrentLimit/Calculate_Dynamic_DischargeCurrentLimit/Calculate_Dynamic_DischargeCurrentLimit" /begin SUB_GROUP S1291_Rate_Limiter /end SUB_GROUP
 /begin REF_CHARACTERISTIC CcSOF_DischargeOverCurrentLimitFactor_n CcSOF_DischargeOverCurrentThresholdDec_As CcSOF_DischargeOverCurrentThresholdInc_As CcSOF_PowerOnOverCurFacSloDelay_ms /end REF_CHARACTERISTIC
 /begin REF_MEASUREMENT SOF_iADynamicDischargeCurrentLimitFastChrgChk /end REF_MEASUREMENT
/end GROUP
/begin GROUP S1301_Rate_Limiter_Reset "VBU0513/VBUSystem/BMS/SOF/Subsystem6/Subsystem/Determine_Currentlimit_Target/Calculate_CurrentLimit_Target/CurrentLimit_FastCharge_Check/FastChrgOneThirdRateCurrentLimitCheck/Rate_Limiter_Reset" /begin REF_MEASUREMENT SOF_iAContinuousChargeCurrentLimitFastChrgChk /end REF_MEASUREMENT /end GROUP
/begin GROUP S1302_FastCharge "VBU0513/VBUSystem/BMS/SOF/Subsystem6/Subsystem/Determine_Currentlimit_Target/Calculate_CurrentLimit_Target/CurrentLimit_FastCharge_Check/SegmentChargeCheck/FastCharge" /begin SUB_GROUP S1310_FastCharge_Calculation /end SUB_GROUP /end GROUP
/begin GROUP S1337_Calculate_CurrentLimit "VBU0513/VBUSystem/BMS/SOF/Subsystem6/Subsystem/Determine_Currentlimit_Target/Calculate_CurrentLimit_Target/CurrentLimit_Voltage_Correct/Correct_CurrentLimit/Calculate_CurrentLimit"
 /begin SUB_GROUP S1339_BatteryVoltageAveCalculate S1339_Calculate_Cell_Discharge_DCIR S1339_Rate_Limiter1 S1339_Rate_Limiter_Reset /end SUB_GROUP
 /begin REF_CHARACTERISTIC CaSOF_DischargeDcirSocTempMapDimension_n CaSOF_DischargeDcirSocTempMapZ_mOhm CaSOF_DischargeOcvSocTempMapDimension_n CaSOF_DischargeOcvSocTempMapZ_V CaSOF_LowTempDischargeVoltageCorrectFactorMapY_n CaSOF_VoltageCorrectCellVoltMinMapY_V CaSOF_VoltageCorrectFactorChargeMapY_n CaSOF_VoltageCorrectFactorDischargeMapY_n CaSOF_VoltageCorrectFactorRegenMapY_n CbSOF_VoltageCorrectLevelEnable_flg CbSOF_VoltageTableCorrectUsePredictedCellVoltage_flg CcSOF_ChargeVoltageCorrectSlope_n CcSOF_DischargeVolCorCurrentSlopeDec_A CcSOF_DischargeVolCorCurrentSlopeInc_A CcSOF_DischargeVoltageCorrectSlope_n CcSOF_EnableCalculatedDcir_flg CcSOF_PowerOnVolCorCurtSloDelay_ms CcSOF_PowerOnVolCorFacSloDelay_ms CcSOF_UseCalculatedDcirTemp_C CcSOF_VoltageCorrectFactor0_n CcSOF_VoltageCorrectFactor1_n CcSOF_VoltageCorrectFactor2_n CcSOF_VoltageCorrectFactor3_n CcSOF_VoltageCorrectFactor4_n /end REF_CHARACTERISTIC
 /begin REF_MEASUREMENT SOF_iAContinuousChargeCurrentLimitVltgTarget SOF_iAContinuousDischargeCurrentLimitVltgTarget SOF_iADynamicChargeCurrentLimitVltgTarget SOF_iADynamicDischargeCurrentLimitVltgBefoTarget SOF_iADynamicDischargeCurrentLimitVltgTarget SOF_iAShortPulseChargeCurrentLimitVltgTarget SOF_iAShortPulseDischargeCurrentLimitVltgTarget /end REF_MEASUREMENT
/end GROUP
/begin GROUP S1337_Determine_VoltageCorrect_level "VBU0513/VBUSystem/BMS/SOF/Subsystem6/Subsystem/Determine_Currentlimit_Target/Calculate_CurrentLimit_Target/CurrentLimit_Voltage_Correct/Correct_CurrentLimit/Determine_VoltageCorrect_level"
 /begin SUB_GROUP S1340_Set_ChargeVoltageCorrect_level1 S1340_Set_ChargeVoltageCorrect_level2 S1340_Set_ChargeVoltageCorrect_level3 S1340_Set_ChargeVoltageCorrect_level4 S1340_Set_DischargeVoltageCorrect_level1 S1340_Set_DischargeVoltageCorrect_level2 S1340_Set_DischargeVoltageCorrect_level3 S1340_Set_DischargeVoltageCorrect_level4 /end SUB_GROUP
 /begin REF_MEASUREMENT SOF_nbrChargeVoltageCorrectLevel SOF_nbrDischargeVoltageCorrectLevel /end REF_MEASUREMENT
/end GROUP
/begin GROUP S1443_Update_Max_Min "VBU0513/VBUSystem/BMS/SOH/Subsystem4/Subsystem1/Calculate_Capacity/Calculate_CellCapacity/Determine_CellCapacity/MMASVC1/Update_Max_Min"
 /begin REF_MEASUREMENT SOH_AhCellCapacityAve SOH_AhCellCapacityMax SOH_AhCellCapacityMin /end REF_MEASUREMENT
/end GROUP
/begin GROUP S1473_Cal_Resistance "VBU0513/VBUSystem/BMS/SOH/Subsystem4/Subsystem1/Calculate_Capacity/Calculate_CellCapacity_SlowCharge/Determine_Soc/Lookup_Table_Cal_Soc/Cal_Resistance"
 /begin REF_CHARACTERISTIC CaSOH_UdResisMapDimension_n CaSOH_UdResisMapZ_mohm CcSOH_ChargeResisLowerLimit_mohm /end REF_CHARACTERISTIC
/end GROUP
/begin GROUP S1473_Cal_Soc "VBU0513/VBUSystem/BMS/SOH/Subsystem4/Subsystem1/Calculate_Capacity/Calculate_CellCapacity_SlowCharge/Determine_Soc/Lookup_Table_Cal_Soc/Cal_Soc" /begin REF_CHARACTERISTIC CaSOH_OcvSocMapDimension_n CaSOH_OcvSocMapZ_pct /end REF_CHARACTERISTIC /end GROUP
/begin GROUP S3377_SwitchParameter "VBU0513/VBUSystem/VCU /DSPL /DSPL/DriveRange/DSPL_Consumption/DSPL_EnergySelfLearn/DSPL_EnergyFactorCal/DSPL_EnergyFactorInit/SwitchParameter"
 /begin REF_CHARACTERISTIC DSPL_facEnergyFactorType_C_Md_Default DSPL_facEnergyFactorType_C_Md_Type1 DSPL_facEnergyFactorType_C_Md_Type2 DSPL_facEnergyFactorType_C_Md_Type3 DSPL_facEnergyFactorType_C_Md_Type4 /end REF_CHARACTERISTIC
/end GROUP
/begin GROUP S3558_GradientLimiter "VBU0513/VBUSystem/VCU /EDIS/EDIS_Ctrl/battery_power_calculate/discharge_power_calculate/DchPowSetpiont/setpoint/batt_stpower_overrite/GradientLimiter" /begin REF_MEASUREMENT EDIS_pwrDisChLimDynST /end REF_MEASUREMENT /end GROUP
/begin GROUP S3558_Hysteresis_LHC_RLC1 "VBU0513/VBUSystem/VCU /EDIS/EDIS_Ctrl/battery_power_calculate/discharge_power_calculate/DchPowSetpiont/setpoint/batt_stpower_overrite/Hysteresis_LHC_RLC1" /begin REF_MEASUREMENT EDIS_flgVehSpdLow /end REF_MEASUREMENT /end GROUP
/begin GROUP S3984_SR_Flip_Flop "VBU0513/VBUSystem/VCU /TQO/TQOAll/TQDMP/TQDMP/RAROTC/ROTCConidtion/TipinEnaRA/SR_Flip_Flop" /begin REF_MEASUREMENT TQDMP_flgTipInEnaRA /end REF_MEASUREMENT /end GROUP
/begin GROUP S3985_SR_Flip_Flop "VBU0513/VBUSystem/VCU /TQO/TQOAll/TQDMP/TQDMP/RAROTC/ROTCConidtion/TipoutEnaRA/SR_Flip_Flop" /begin REF_MEASUREMENT TQDMP_flgTipOutEnaRA /end REF_MEASUREMENT /end GROUP
/begin GROUP S64_Calculate_Current_Sum "VBU0513/VBUSystem/BMS/BCV/BCV/Subsystem/Calculate_BatteryCurrent/Correct_BatteryCurrent/Calculate_BatteryCurrent_ZeroDrift/Calculate_ExtremeData/Enabled_Subsystem/Calculate_Current_Sum" /begin REF_CHARACTERISTIC CcBCV_BatteryCurrentZeroDriftTime_ms /end REF_CHARACTERISTIC /end GROUP
/begin GROUP S1282_Calculate_ChargeCurrentLimitBuffer_Full "VBU0513/VBUSystem/BMS/SOF/Subsystem6/Subsystem/Determine_Currentlimit_Target/Calculate_CurrentLimit_Target/Calculate_Dynamic_CurrentLimit/Calculate_Dynamic_ChargeCurrentLimit/Calculate_ChargeCurrentLimit_Buff/Calculate_ChargeCurrentLimitBuffer_Full"
 /begin REF_CHARACTERISTIC CaSOF_ChargeCurrentLimitBufferTimeSocTempMapDimension_n CaSOF_ChargeCurrentLimitBufferTimeSocTempMapZ_s /end REF_CHARACTERISTIC
 /begin REF_MEASUREMENT SOF_AsChargeCurrentLimitBufferFull /end REF_MEASUREMENT
/end GROUP
/begin GROUP S1282_Calculate_ChargeCurrentLimitBuffer_Use "VBU0513/VBUSystem/BMS/SOF/Subsystem6/Subsystem/Determine_Currentlimit_Target/Calculate_CurrentLimit_Target/Calculate_Dynamic_CurrentLimit/Calculate_Dynamic_ChargeCurrentLimit/Calculate_ChargeCurrentLimit_Buff/Calculate_ChargeCurrentLimitBuffer_Use" /begin REF_CHARACTERISTIC CcSOF_ChargeCurrentLimitViolateBuffer_A /end REF_CHARACTERISTIC /begin REF_MEASUREMENT SOF_AsChargeCurrentLimitBufferUse /end REF_MEASUREMENT /end GROUP
/begin GROUP S1283_Buffer_Used "VBU0513/VBUSystem/BMS/SOF/Subsystem6/Subsystem/Determine_Currentlimit_Target/Calculate_CurrentLimit_Target/Calculate_Dynamic_CurrentLimit/Calculate_Dynamic_ChargeCurrentLimit/Calculate_Dynamic_ChargeCurrentLimit/Buffer_Used" /begin REF_MEASUREMENT SOF_iADynamicChargeCurrentLimitFastChrgChk /end REF_MEASUREMENT /end GROUP
/begin GROUP S1290_Calculate_DischargeCurrentLimitBuffer_Full "VBU0513/VBUSystem/BMS/SOF/Subsystem6/Subsystem/Determine_Currentlimit_Target/Calculate_CurrentLimit_Target/Calculate_Dynamic_CurrentLimit/Calculate_Dynamic_DischargeCurrentLimit/Calculate_DischargeCurrentLimit_Buff/Calculate_DischargeCurrentLimitBuffer_Full"
 /begin REF_CHARACTERISTIC CaSOF_DischargeCurrentLimitBufferTimeSocTempMapDimension_n CaSOF_DischargeCurrentLimitBufferTimeSocTempMapZ_s /end REF_CHARACTERISTIC
 /begin REF_MEASUREMENT SOF_AsDischargeCurrentLimitBufferFull /end REF_MEASUREMENT
/end GROUP
/begin GROUP S1290_Calculate_DischargeCurrentLimitBuffer_Use "VBU0513/VBUSystem/BMS/SOF/Subsystem6/Subsystem/Determine_Currentlimit_Target/Calculate_CurrentLimit_Target/Calculate_Dynamic_CurrentLimit/Calculate_Dynamic_DischargeCurrentLimit/Calculate_DischargeCurrentLimit_Buff/Calculate_DischargeCurrentLimitBuffer_Use"
 /begin REF_CHARACTERISTIC CaSOF_BuffUseFactorCurrtLTCurrtMapDimension_n CaSOF_BuffUseFactorCurrtLTCurrtMapZ_n CaSOF_BuffUseFactorSocTempMapDimension_n CaSOF_BuffUseFactorSocTempMapZ_n /end REF_CHARACTERISTIC
 /begin REF_MEASUREMENT SOF_AsDischargeCurrentLimitBufferUse /end REF_MEASUREMENT
/end GROUP
/begin GROUP S1291_Rate_Limiter "VBU0513/VBUSystem/BMS/SOF/Subsystem6/Subsystem/Determine_Currentlimit_Target/Calculate_CurrentLimit_Target/Calculate_Dynamic_CurrentLimit/Calculate_Dynamic_DischargeCurrentLimit/Calculate_Dynamic_DischargeCurrentLimit/Rate_Limiter"
 /begin REF_CHARACTERISTIC CcSOF_DischaOverCurFactorSlopeDec_n CcSOF_DischaOverCurFactorSlopeInc_n /end REF_CHARACTERISTIC
/end GROUP
/begin GROUP S1310_FastCharge_Calculation "VBU0513/VBUSystem/BMS/SOF/Subsystem6/Subsystem/Determine_Currentlimit_Target/Calculate_CurrentLimit_Target/CurrentLimit_FastCharge_Check/SegmentChargeCheck/FastCharge/FastCharge_Calculation" /begin SUB_GROUP S1312_Determine_FastCharge_Conditions /end SUB_GROUP
 /begin REF_CHARACTERISTIC CcSOF_FastChargeCurrentStep1_A CcSOF_FastChargeCurrentStep2_A CcSOF_FastChargeSocStep1_pct /end REF_CHARACTERISTIC
/end GROUP
/begin GROUP S1339_Calculate_Cell_Discharge_DCIR "VBU0513/VBUSystem/BMS/SOF/Subsystem6/Subsystem/Determine_Currentlimit_Target/Calculate_CurrentLimit_Target/CurrentLimit_Voltage_Correct/Correct_CurrentLimit/Calculate_CurrentLimit/Calculate_Cell_Discharge_DCIR" /begin SUB_GROUP S1342_Calculate_DCIR_Validation S1342_Calculate_Enable /end SUB_GROUP /end GROUP
/begin GROUP S1339_Rate_Limiter1 "VBU0513/VBUSystem/BMS/SOF/Subsystem6/Subsystem/Determine_Currentlimit_Target/Calculate_CurrentLimit_Target/CurrentLimit_Voltage_Correct/Correct_CurrentLimit/Calculate_CurrentLimit/Rate_Limiter1"
 /begin REF_CHARACTERISTIC CcSOF_DischargeVoltageCorrectSlopeDec_n CcSOF_DischargeVoltageCorrectSlopeInc_n /end REF_CHARACTERISTIC
/end GROUP
/begin GROUP S1339_Rate_Limiter_Reset "VBU0513/VBUSystem/BMS/SOF/Subsystem6/Subsystem/Determine_Currentlimit_Target/Calculate_CurrentLimit_Target/CurrentLimit_Voltage_Correct/Correct_CurrentLimit/Calculate_CurrentLimit/Rate_Limiter_Reset" /begin REF_MEASUREMENT SOF_iADynamicDischargeCurrentLimitVltgDcirTarget /end REF_MEASUREMENT /end GROUP
/begin GROUP S1340_Set_ChargeVoltageCorrect_level1 "VBU0513/VBUSystem/BMS/SOF/Subsystem6/Subsystem/Determine_Currentlimit_Target/Calculate_CurrentLimit_Target/CurrentLimit_Voltage_Correct/Correct_CurrentLimit/Determine_VoltageCorrect_level/Set_ChargeVoltageCorrect_level1"
 /begin REF_CHARACTERISTIC CcSOF_CellVoltageHigh1_mV CcSOF_VoltageCorrectCheckInc1_n CcSOF_VoltageCorrectEnableInc1_n SOF_VOLTAGE_CORRECT_LEVEL1 SOF_VOLTAGE_CORRECT_NONE /end REF_CHARACTERISTIC
/end GROUP
/begin GROUP S1340_Set_ChargeVoltageCorrect_level2 "VBU0513/VBUSystem/BMS/SOF/Subsystem6/Subsystem/Determine_Currentlimit_Target/Calculate_CurrentLimit_Target/CurrentLimit_Voltage_Correct/Correct_CurrentLimit/Determine_VoltageCorrect_level/Set_ChargeVoltageCorrect_level2"
 /begin REF_CHARACTERISTIC CcSOF_CellVoltageHigh2_mV CcSOF_VoltageCorrectCheckInc2_n CcSOF_VoltageCorrectEnableInc2_n SOF_VOLTAGE_CORRECT_LEVEL2 SOF_VOLTAGE_CORRECT_NONE /end REF_CHARACTERISTIC
/end GROUP
/begin GROUP S1340_Set_ChargeVoltageCorrect_level3 "VBU0513/VBUSystem/BMS/SOF/Subsystem6/Subsystem/Determine_Currentlimit_Target/Calculate_CurrentLimit_Target/CurrentLimit_Voltage_Correct/Correct_CurrentLimit/Determine_VoltageCorrect_level/Set_ChargeVoltageCorrect_level3"
 /begin REF_CHARACTERISTIC CcSOF_CellVoltageHigh3_mV CcSOF_VoltageCorrectCheckInc3_n CcSOF_VoltageCorrectEnableInc3_n SOF_VOLTAGE_CORRECT_LEVEL3 SOF_VOLTAGE_CORRECT_NONE /end REF_CHARACTERISTIC
/end GROUP
/begin GROUP S1340_Set_ChargeVoltageCorrect_level4 "VBU0513/VBUSystem/BMS/SOF/Subsystem6/Subsystem/Determine_Currentlimit_Target/Calculate_CurrentLimit_Target/CurrentLimit_Voltage_Correct/Correct_CurrentLimit/Determine_VoltageCorrect_level/Set_ChargeVoltageCorrect_level4"
 /begin REF_CHARACTERISTIC CcSOF_BatteryCurrentLow_A CcSOF_CellVoltageHigh4_mV CcSOF_VoltageCorrectCheckInc4_n CcSOF_VoltageCorrectEnableInc4_n SOF_VOLTAGE_CORRECT_LEVEL4 SOF_VOLTAGE_CORRECT_NONE /end REF_CHARACTERISTIC
/end GROUP
/begin GROUP S1340_Set_DischargeVoltageCorrect_level1 "VBU0513/VBUSystem/BMS/SOF/Subsystem6/Subsystem/Determine_Currentlimit_Target/Calculate_CurrentLimit_Target/CurrentLimit_Voltage_Correct/Correct_CurrentLimit/Determine_VoltageCorrect_level/Set_DischargeVoltageCorrect_level1"
 /begin REF_CHARACTERISTIC CcSOF_CellVoltageLow1_mV CcSOF_VoltageCorrectCheckInc1_n CcSOF_VoltageCorrectEnableInc1_n SOF_VOLTAGE_CORRECT_LEVEL1 SOF_VOLTAGE_CORRECT_NONE /end REF_CHARACTERISTIC
/end GROUP
/begin GROUP S1340_Set_DischargeVoltageCorrect_level2 "VBU0513/VBUSystem/BMS/SOF/Subsystem6/Subsystem/Determine_Currentlimit_Target/Calculate_CurrentLimit_Target/CurrentLimit_Voltage_Correct/Correct_CurrentLimit/Determine_VoltageCorrect_level/Set_DischargeVoltageCorrect_level2"
 /begin REF_CHARACTERISTIC CcSOF_CellVoltageLow2_mV CcSOF_VoltageCorrectCheckInc2_n CcSOF_VoltageCorrectEnableInc2_n SOF_VOLTAGE_CORRECT_LEVEL2 SOF_VOLTAGE_CORRECT_NONE /end REF_CHARACTERISTIC
/end GROUP
/begin GROUP S1340_Set_DischargeVoltageCorrect_level3 "VBU0513/VBUSystem/BMS/SOF/Subsystem6/Subsystem/Determine_Currentlimit_Target/Calculate_CurrentLimit_Target/CurrentLimit_Voltage_Correct/Correct_CurrentLimit/Determine_VoltageCorrect_level/Set_DischargeVoltageCorrect_level3"
 /begin REF_CHARACTERISTIC CcSOF_CellVoltageLow3_mV CcSOF_VoltageCorrectCheckInc3_n CcSOF_VoltageCorrectEnableInc3_n SOF_VOLTAGE_CORRECT_LEVEL3 SOF_VOLTAGE_CORRECT_NONE /end REF_CHARACTERISTIC
/end GROUP
/begin GROUP S1340_Set_DischargeVoltageCorrect_level4 "VBU0513/VBUSystem/BMS/SOF/Subsystem6/Subsystem/Determine_Currentlimit_Target/Calculate_CurrentLimit_Target/CurrentLimit_Voltage_Correct/Correct_CurrentLimit/Determine_VoltageCorrect_level/Set_DischargeVoltageCorrect_level4"
 /begin REF_CHARACTERISTIC CcSOF_BatteryCurrentLow_A CcSOF_CellVoltageLow4_mV CcSOF_VoltageCorrectCheckInc4_n CcSOF_VoltageCorrectEnableInc4_n SOF_VOLTAGE_CORRECT_LEVEL4 SOF_VOLTAGE_CORRECT_NONE /end REF_CHARACTERISTIC
/end GROUP
/begin GROUP S1312_Determine_FastCharge_Conditions "VBU0513/VBUSystem/BMS/SOF/Subsystem6/Subsystem/Determine_Currentlimit_Target/Calculate_CurrentLimit_Target/CurrentLimit_FastCharge_Check/SegmentChargeCheck/FastCharge/FastCharge_Calculation/Determine_FastCharge_Conditions" /begin SUB_GROUP S1313_Condition1 S1313_Condition2 S1313_Condition3 /end SUB_GROUP /end GROUP
/begin GROUP S1342_Calculate_DCIR_Validation "VBU0513/VBUSystem/BMS/SOF/Subsystem6/Subsystem/Determine_Currentlimit_Target/Calculate_CurrentLimit_Target/CurrentLimit_Voltage_Correct/Correct_CurrentLimit/Calculate_CurrentLimit/Calculate_Cell_Discharge_DCIR/Calculate_DCIR_Validation"
 /begin REF_CHARACTERISTIC CcSOF_CellDischargeDcirMax_mOhm CcSOF_CellDischargeDcirMin_mOhm CcSOF_OriginalDcirDispersion_pct /end REF_CHARACTERISTIC
 /begin REF_MEASUREMENT SOF_flgCellDischargeDcirCalcValid SOF_mohmCellDischargeDcirCalc /end REF_MEASUREMENT
/end GROUP
/begin GROUP S1342_Calculate_Enable "VBU0513/VBUSystem/BMS/SOF/Subsystem6/Subsystem/Determine_Currentlimit_Target/Calculate_CurrentLimit_Target/CurrentLimit_Voltage_Correct/Correct_CurrentLimit/Calculate_CurrentLimit/Calculate_Cell_Discharge_DCIR/Calculate_Enable" /begin REF_CHARACTERISTIC CcSOF_DcirDelayTimes_n CcSOF_DcirDeltaCurrentMin_A /end REF_CHARACTERISTIC /end GROUP
/begin GROUP S1313_Condition1 "VBU0513/VBUSystem/BMS/SOF/Subsystem6/Subsystem/Determine_Currentlimit_Target/Calculate_CurrentLimit_Target/CurrentLimit_FastCharge_Check/SegmentChargeCheck/FastCharge/FastCharge_Calculation/Determine_FastCharge_Conditions/Condition1"
 /begin REF_CHARACTERISTIC CcSOF_FastChargeDisableTempUpperLimit_C CcSOF_FastChargeEnableSocLowerLimit_pct CcSOF_FastChargeEnableSocUpperLimit_pct CcSOF_FastChargeEnableTempLowerLimit_C /end REF_CHARACTERISTIC
/end GROUP
/begin GROUP S1313_Condition2 "VBU0513/VBUSystem/BMS/SOF/Subsystem6/Subsystem/Determine_Currentlimit_Target/Calculate_CurrentLimit_Target/CurrentLimit_FastCharge_Check/SegmentChargeCheck/FastCharge/FastCharge_Calculation/Determine_FastCharge_Conditions/Condition2"
 /begin REF_CHARACTERISTIC CcSOF_FastChargeEnableSocLowerLimit_pct CcSOF_FastChargeEnableSocUpperLimit_pct CcSOF_FastChargeEnableTempLowerLimit_C CcSOF_FastChargeRecoverTempUpperLimit_C /end REF_CHARACTERISTIC
/end GROUP
/begin GROUP S1313_Condition3 "VBU0513/VBUSystem/BMS/SOF/Subsystem6/Subsystem/Determine_Currentlimit_Target/Calculate_CurrentLimit_Target/CurrentLimit_FastCharge_Check/SegmentChargeCheck/FastCharge/FastCharge_Calculation/Determine_FastCharge_Conditions/Condition3"
 /begin REF_CHARACTERISTIC CcSOF_FastChargeDisableTempLowerLimit_C CcSOF_FastChargeDisableTempUpperLimit_C CcSOF_FastChargeEnableSocLowerLimit_pct CcSOF_FastChargeEnableSocUpperLimit_pct /end REF_CHARACTERISTIC
/end GROUP
/end MODULE
/end PROJECT
