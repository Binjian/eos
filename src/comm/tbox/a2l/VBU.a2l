ASAP2_VERSION 1 31
/begin PROJECT ProjectName "Project Comment Goes Here"
/begin HEADER "Header Comments go here" /end HEADER
/begin MODULE ModuleName "Module Comment Goes Here"
/begin MOD_COMMON "Mod Common Comment Here" BYTE_ORDER MSB_LAST /end MOD_COMMON
/begin RECORD_LAYOUT Scalar_BOOLEAN FNC_VALUES 1 UBYTE COLUMN_DIR DIRECT /end RECORD_LAYOUT
/begin RECORD_LAYOUT Scalar_UBYTE FNC_VALUES 1 UBYTE COLUMN_DIR DIRECT /end RECORD_LAYOUT
/begin RECORD_LAYOUT Scalar_UWORD FNC_VALUES 1 UWORD COLUMN_DIR DIRECT /end RECORD_LAYOUT
/begin RECORD_LAYOUT Scalar_FLOAT32_IEEE FNC_VALUES 1 FLOAT32_IEEE COLUMN_DIR DIRECT /end RECORD_LAYOUT
/begin RECORD_LAYOUT Lookup1D_FLOAT32_IEEE FNC_VALUES 1 FLOAT32_IEEE COLUMN_DIR DIRECT /end RECORD_LAYOUT
/begin RECORD_LAYOUT Lookup1D_X_FLOAT32_IEEE AXIS_PTS_X 1 FLOAT32_IEEE INDEX_INCR DIRECT /end RECORD_LAYOUT
/begin RECORD_LAYOUT Lookup2D_X_WORD AXIS_PTS_X 1 SWORD INDEX_INCR DIRECT /end RECORD_LAYOUT
/begin RECORD_LAYOUT Lookup2D_ULONG FNC_VALUES 1 ULONG COLUMN_DIR DIRECT /end RECORD_LAYOUT
/begin RECORD_LAYOUT Lookup2D_X_ULONG AXIS_PTS_X 1 ULONG INDEX_INCR DIRECT /end RECORD_LAYOUT
/begin RECORD_LAYOUT Lookup2D_LONG FNC_VALUES 1 SLONG COLUMN_DIR DIRECT /end RECORD_LAYOUT
/begin RECORD_LAYOUT Lookup2D_FLOAT32_IEEE FNC_VALUES 1 FLOAT32_IEEE COLUMN_DIR DIRECT /end RECORD_LAYOUT
/begin RECORD_LAYOUT Lookup2D_X_FLOAT32_IEEE AXIS_PTS_X 1 FLOAT32_IEEE INDEX_INCR DIRECT /end RECORD_LAYOUT
/begin CHARACTERISTIC DSPL_facEnergyFactorDeviation_CUR_v "" CURVE 0x70011f42 Lookup1D_FLOAT32_IEEE 0 VBU0428Test_CM_single_fac 0.0 1.0
 /begin AXIS_DESCR COM_AXIS NO_INPUT_QUANTITY VBU0428Test_CM_single_fac 5 0.0 1.0 AXIS_PTS_REF DSPL_facEnergyFactorDeviation_CUR_x /end AXIS_DESCR
/end CHARACTERISTIC
/begin AXIS_PTS DSPL_facEnergyFactorDeviation_CUR_x "" 0x70011f56 NO_INPUT_QUANTITY Lookup1D_X_FLOAT32_IEEE 0 VBU0428Test_CM_single_fac 5 0.0 1.0 /end AXIS_PTS
/begin CHARACTERISTIC DSPL_facRngAmbTempCorr_CUR_v_Md_Default "" CURVE 0x70011f92 Lookup1D_FLOAT32_IEEE 0 VBU0428Test_CM_single_fac 0.0 1.0
 /begin AXIS_DESCR COM_AXIS NO_INPUT_QUANTITY VBU0428Test_CM_single_C 5 -40.0 120.0 AXIS_PTS_REF DSPL_tAmbTempChrg_CUR_x /end AXIS_DESCR
/end CHARACTERISTIC
/begin AXIS_PTS DSPL_tAmbTempChrg_CUR_x "" 0x70011ff6 NO_INPUT_QUANTITY Lookup1D_X_FLOAT32_IEEE 0 VBU0428Test_CM_single_C 5 -40.0 120.0 /end AXIS_PTS
/begin CHARACTERISTIC DSPL_kmRngNEDCMAP_CUR_y_Md_Default "" CURVE 0x70011d0a Lookup1D_FLOAT32_IEEE 0 VBU0428Test_CM_single_km 0.0 1.0E+10
 /begin AXIS_DESCR COM_AXIS NO_INPUT_QUANTITY VBU0428Test_CM_single_pct 4 0.0 1.0E+23 AXIS_PTS_REF DSPL_pctSOCNEDCMAP_CUR_x /end AXIS_DESCR
/end CHARACTERISTIC
/begin AXIS_PTS DSPL_pctSOCNEDCMAP_CUR_x "" 0x70011d1a NO_INPUT_QUANTITY Lookup1D_X_FLOAT32_IEEE 0 VBU0428Test_CM_single_pct 4 0.0 1.0E+23 /end AXIS_PTS
/begin CHARACTERISTIC EDIS_facMaxBMSCh_CUR_v "" CURVE 0x70012a82 Lookup1D_FLOAT32_IEEE 0 VBU0428Test_CM_single_cnt -3.4028234663852886E+38 3.4028234663852886E+38
 /begin AXIS_DESCR COM_AXIS NO_INPUT_QUANTITY VBU0428Test_CM_single_cnt 10 -3.4028234663852886E+38 3.4028234663852886E+38 AXIS_PTS_REF EDIS_tMaxBMSCh_CUR_x /end AXIS_DESCR
/end CHARACTERISTIC
/begin AXIS_PTS EDIS_tMaxBMSCh_CUR_x "" 0x70012b22 NO_INPUT_QUANTITY Lookup1D_X_FLOAT32_IEEE 0 VBU0428Test_CM_single_cnt 10 -3.4028234663852886E+38 3.4028234663852886E+38 /end AXIS_PTS
/begin CHARACTERISTIC EDIS_facMinBMSCh_CUR_v "" CURVE 0x70012ad2 Lookup1D_FLOAT32_IEEE 0 VBU0428Test_CM_single_cnt -3.4028234663852886E+38 3.4028234663852886E+38
 /begin AXIS_DESCR COM_AXIS NO_INPUT_QUANTITY VBU0428Test_CM_single_cnt 10 -3.4028234663852886E+38 3.4028234663852886E+38 AXIS_PTS_REF EDIS_tMinBMSCh_CUR_x /end AXIS_DESCR
/end CHARACTERISTIC
/begin AXIS_PTS EDIS_tMinBMSCh_CUR_x "" 0x70012b72 NO_INPUT_QUANTITY Lookup1D_X_FLOAT32_IEEE 0 VBU0428Test_CM_single_cnt 10 -3.4028234663852886E+38 3.4028234663852886E+38 /end AXIS_PTS
/begin CHARACTERISTIC EDIS_facRgnReqCapDelta_CUR_v "" CURVE 0x70012da6 Lookup1D_FLOAT32_IEEE 0 VBU0428Test_CM_single_cnt -3.4028234663852886E+38 3.4028234663852886E+38
 /begin AXIS_DESCR COM_AXIS NO_INPUT_QUANTITY VBU0428Test_CM_single_cnt 11 -3.4028234663852886E+38 3.4028234663852886E+38 AXIS_PTS_REF EDIS_facRgnReqCapDelta_CUR_x /end AXIS_DESCR
/end CHARACTERISTIC
/begin AXIS_PTS EDIS_facRgnReqCapDelta_CUR_x "" 0x70012dd2 NO_INPUT_QUANTITY Lookup1D_X_FLOAT32_IEEE 0 VBU0428Test_CM_single_cnt 11 -3.4028234663852886E+38 3.4028234663852886E+38 /end AXIS_PTS
/begin CHARACTERISTIC EDIS_facBMSSOCCh_CUR_v "" CURVE 0x7001411a Lookup1D_FLOAT32_IEEE 0 VBU0428Test_CM_single_cnt -3.4028234663852886E+38 3.4028234663852886E+38
 /begin AXIS_DESCR COM_AXIS NO_INPUT_QUANTITY VBU0428Test_CM_single_cnt 19 -3.4028234663852886E+38 3.4028234663852886E+38 AXIS_PTS_REF EDIS_pctBMSSOCCh_CUR_x /end AXIS_DESCR
/end CHARACTERISTIC
/begin AXIS_PTS EDIS_pctBMSSOCCh_CUR_x "" 0x700141b2 NO_INPUT_QUANTITY Lookup1D_X_FLOAT32_IEEE 0 VBU0428Test_CM_single_cnt 19 -3.4028234663852886E+38 3.4028234663852886E+38 /end AXIS_PTS
/begin CHARACTERISTIC EDIS_pwrSpBaseChDyn_CUR_v "" CURVE 0x70011d2a Lookup1D_FLOAT32_IEEE 0 VBU0428Test_CM_single_cnt -3.4028234663852886E+38 3.4028234663852886E+38
 /begin AXIS_DESCR COM_AXIS EDIS_pwrChLimDynRaw VBU0428Test_CM_single_cnt 4 -3.4028234663852886E+38 3.4028234663852886E+38 AXIS_PTS_REF EDIS_pwrSpBaseChDyn_CUR_x /end AXIS_DESCR
/end CHARACTERISTIC
/begin AXIS_PTS EDIS_pwrSpBaseChDyn_CUR_x "" 0x70011d3a EDIS_pwrChLimDynRaw Lookup1D_X_FLOAT32_IEEE 0 VBU0428Test_CM_single_cnt 4 -3.4028234663852886E+38 3.4028234663852886E+38 /end AXIS_PTS
/begin CHARACTERISTIC EDIS_facChPwrDeltaBaseDiff_CUR_v "" CURVE 0x7001452a Lookup1D_FLOAT32_IEEE 0 VBU0428Test_CM_single_cnt -3.4028234663852886E+38 3.4028234663852886E+38
 /begin AXIS_DESCR COM_AXIS NO_INPUT_QUANTITY VBU0428Test_CM_single_cnt 21 -3.4028234663852886E+38 3.4028234663852886E+38 AXIS_PTS_REF EDIS_pwrChPwrDeltaBaseDiff_CUR_x /end AXIS_DESCR
/end CHARACTERISTIC
/begin AXIS_PTS EDIS_pwrChPwrDeltaBaseDiff_CUR_x "" 0x70014626 NO_INPUT_QUANTITY Lookup1D_X_FLOAT32_IEEE 0 VBU0428Test_CM_single_cnt 21 -3.4028234663852886E+38 3.4028234663852886E+38 /end AXIS_PTS
/begin CHARACTERISTIC STC_nSpeedOffset_CUR_v "" CURVE 0x70011b3a Lookup1D_FLOAT32_IEEE 0 VBU0428Test_CM_single_cnt -3.4028234663852886E+38 3.4028234663852886E+38
 /begin AXIS_DESCR COM_AXIS SPD_nRA VBU0428Test_CM_single_cnt 2 -3.4028234663852886E+38 3.4028234663852886E+38 AXIS_PTS_REF STC_nSpeedOffset_CUR_x /end AXIS_DESCR
/end CHARACTERISTIC
/begin AXIS_PTS STC_nSpeedOffset_CUR_x "" 0x70011b42 SPD_nRA Lookup1D_X_FLOAT32_IEEE 0 VBU0428Test_CM_single_cnt 2 -3.4028234663852886E+38 3.4028234663852886E+38 /end AXIS_PTS
/begin CHARACTERISTIC TQCMP_trqDeadZoneRA_CUR_y "" CURVE 0x70012032 Lookup1D_FLOAT32_IEEE 0 VBU0428Test_CM_single_cnt -3.4028234663852886E+38 3.4028234663852886E+38
 /begin AXIS_DESCR COM_AXIS NO_INPUT_QUANTITY VBU0428Test_CM_single_cnt 5 -3.4028234663852886E+38 3.4028234663852886E+38 AXIS_PTS_REF TQCMP_tiDeadZone_CUR_x /end AXIS_DESCR
/end CHARACTERISTIC
/begin AXIS_PTS TQCMP_tiDeadZone_CUR_x "" 0x7001201e NO_INPUT_QUANTITY Lookup1D_X_FLOAT32_IEEE 0 VBU0428Test_CM_single_cnt 5 -3.4028234663852886E+38 3.4028234663852886E+38 /end AXIS_PTS
/begin CHARACTERISTIC TQCMP_facDecSinSpdRA_CUR_y "" CURVE 0x70012412 Lookup1D_FLOAT32_IEEE 0 VBU0428Test_CM_single_cnt -3.4028234663852886E+38 3.4028234663852886E+38
 /begin AXIS_DESCR COM_AXIS SPD_vVehSpd VBU0428Test_CM_single_cnt 7 -3.4028234663852886E+38 3.4028234663852886E+38 AXIS_PTS_REF TQCMP_vDecSinSpdRA_CUR_x /end AXIS_DESCR
/end CHARACTERISTIC
/begin AXIS_PTS TQCMP_vDecSinSpdRA_CUR_x "" 0x7001244a SPD_vVehSpd Lookup1D_X_FLOAT32_IEEE 0 VBU0428Test_CM_single_cnt 7 -3.4028234663852886E+38 3.4028234663852886E+38 /end AXIS_PTS
/begin CHARACTERISTIC TQCMP_facIncSinSpdRA_CUR_y "" CURVE 0x7001242e Lookup1D_FLOAT32_IEEE 0 VBU0428Test_CM_single_cnt -3.4028234663852886E+38 3.4028234663852886E+38
 /begin AXIS_DESCR COM_AXIS SPD_vVehSpd VBU0428Test_CM_single_cnt 7 -3.4028234663852886E+38 3.4028234663852886E+38 AXIS_PTS_REF TQCMP_vIncSinSpdRA_CUR_x /end AXIS_DESCR
/end CHARACTERISTIC
/begin AXIS_PTS TQCMP_vIncSinSpdRA_CUR_x "" 0x70012466 SPD_vVehSpd Lookup1D_X_FLOAT32_IEEE 0 VBU0428Test_CM_single_cnt 7 -3.4028234663852886E+38 3.4028234663852886E+38 /end AXIS_PTS
/begin CHARACTERISTIC TQCMP_trqPulse_CUR_v "" CURVE 0x70012252 Lookup1D_FLOAT32_IEEE 0 VBU0428Test_CM_single_cnt -3.4028234663852886E+38 3.4028234663852886E+38
 /begin AXIS_DESCR COM_AXIS NO_INPUT_QUANTITY VBU0428Test_CM_single_cnt 6 -3.4028234663852886E+38 3.4028234663852886E+38 AXIS_PTS_REF TQCMP_tiPulse_CUR_x /end AXIS_DESCR
/end CHARACTERISTIC
/begin AXIS_PTS TQCMP_tiPulse_CUR_x "" 0x7001223a NO_INPUT_QUANTITY Lookup1D_X_FLOAT32_IEEE 0 VBU0428Test_CM_single_cnt 6 -3.4028234663852886E+38 3.4028234663852886E+38 /end AXIS_PTS
/begin CHARACTERISTIC TQCMP_stPulseRAEna_CUR_v "" CURVE 0x70011bb0 Lookup1D_FLOAT32_IEEE 0 VBU0428Test_CM_single_cnt -3.4028234663852886E+38 3.4028234663852886E+38
 /begin AXIS_DESCR COM_AXIS NO_INPUT_QUANTITY VBU0428Test_CM_single_cnt 3 -3.4028234663852886E+38 3.4028234663852886E+38 AXIS_PTS_REF TQCMP_stDrvMode_CUR_x /end AXIS_DESCR
/end CHARACTERISTIC
/begin AXIS_PTS TQCMP_stDrvMode_CUR_x "" 0x70011ba4 NO_INPUT_QUANTITY Lookup1D_X_FLOAT32_IEEE 0 VBU0428Test_CM_single_cnt 3 -3.4028234663852886E+38 3.4028234663852886E+38 /end AXIS_PTS
/begin CHARACTERISTIC TQDIS_facAccDmpFilterRA_MAP_v "" MAP 0x7001433a Lookup2D_FLOAT32_IEEE 0 VBU0428Test_CM_single_pct 0.0 1.0
 /begin AXIS_DESCR COM_AXIS APD_pctAccPedPos VBU0428Test_CM_single_pct 5 0.0 100.0 AXIS_PTS_REF TQDIS_pctDmpFilter_MAP_y /end AXIS_DESCR
 /begin AXIS_DESCR COM_AXIS NO_INPUT_QUANTITY VBU0428Test_CM_single_cnt 4 0.0 3.0 AXIS_PTS_REF TQDIS_stDmpFilter_MAP_x /end AXIS_DESCR
/end CHARACTERISTIC
/begin AXIS_PTS TQDIS_stDmpFilter_MAP_x "" 0x70011dba NO_INPUT_QUANTITY Lookup2D_X_FLOAT32_IEEE 0 VBU0428Test_CM_single_cnt 4 0.0 3.0 /end AXIS_PTS
/begin AXIS_PTS TQDIS_pctDmpFilter_MAP_y "" 0x7001206e APD_pctAccPedPos Lookup2D_X_FLOAT32_IEEE 0 VBU0428Test_CM_single_pct 5 0.0 100.0 /end AXIS_PTS
/begin CHARACTERISTIC TQDIS_facSpdDmpFilterRA_MAP_v "" MAP 0x7001438a Lookup2D_FLOAT32_IEEE 0 VBU0428Test_CM_single_cnt -3.4028234663852886E+38 3.4028234663852886E+38
 /begin AXIS_DESCR COM_AXIS SPD_vVehSpd VBU0428Test_CM_single_cnt 5 -3.4028234663852886E+38 3.4028234663852886E+38 AXIS_PTS_REF TQDIS_vDmpFilter_MAP_y /end AXIS_DESCR
 /begin AXIS_DESCR COM_AXIS NO_INPUT_QUANTITY VBU0428Test_CM_single_cnt 4 0.0 3.0 AXIS_PTS_REF TQDIS_stDmpFilter_MAP_x /end AXIS_DESCR
/end CHARACTERISTIC
/begin AXIS_PTS TQDIS_vDmpFilter_MAP_y "" 0x70012082 SPD_vVehSpd Lookup2D_X_FLOAT32_IEEE 0 VBU0428Test_CM_single_cnt 5 -3.4028234663852886E+38 3.4028234663852886E+38 /end AXIS_PTS
/begin CHARACTERISTIC TQO_facShftChangeHi_CUR_v "" CURVE 0x700122e2 Lookup1D_FLOAT32_IEEE 0 VBU0428Test_CM_single_cnt -3.4028234663852886E+38 3.4028234663852886E+38
 /begin AXIS_DESCR COM_AXIS NO_INPUT_QUANTITY VBU0428Test_CM_single_cnt 6 -3.4028234663852886E+38 3.4028234663852886E+38 AXIS_PTS_REF TQO_trqShftChange_CUR_x /end AXIS_DESCR
/end CHARACTERISTIC
/begin AXIS_PTS TQO_trqShftChange_CUR_x "" 0x7001232a NO_INPUT_QUANTITY Lookup1D_X_FLOAT32_IEEE 0 VBU0428Test_CM_single_cnt 6 -3.4028234663852886E+38 3.4028234663852886E+38 /end AXIS_PTS
/begin CHARACTERISTIC TQO_facShftChangeLo_CUR_v "" CURVE 0x700122fa Lookup1D_FLOAT32_IEEE 0 VBU0428Test_CM_single_cnt -3.4028234663852886E+38 3.4028234663852886E+38
 /begin AXIS_DESCR COM_AXIS NO_INPUT_QUANTITY VBU0428Test_CM_single_cnt 6 -3.4028234663852886E+38 3.4028234663852886E+38 AXIS_PTS_REF TQO_trqShftChange_CUR_x /end AXIS_DESCR
/end CHARACTERISTIC
/begin CHARACTERISTIC TQO_facShftChangeSlope_CUR_v "" CURVE 0x70012312 Lookup1D_FLOAT32_IEEE 0 VBU0428Test_CM_single_cnt -3.4028234663852886E+38 3.4028234663852886E+38
 /begin AXIS_DESCR COM_AXIS NO_INPUT_QUANTITY VBU0428Test_CM_single_cnt 6 -3.4028234663852886E+38 3.4028234663852886E+38 AXIS_PTS_REF TQO_trqShftChange_CUR_x /end AXIS_DESCR
/end CHARACTERISTIC
/begin CHARACTERISTIC TQO_trqLimpModeMax_CUR_v "" CURVE 0x700137b2 Lookup1D_FLOAT32_IEEE 0 VBU0428Test_CM_single_cnt -3.4028234663852886E+38 3.4028234663852886E+38
 /begin AXIS_DESCR COM_AXIS SPD_vVehSpd VBU0428Test_CM_single_cnt 13 -3.4028234663852886E+38 3.4028234663852886E+38 AXIS_PTS_REF TQO_vAxleMax_CUR_x /end AXIS_DESCR
/end CHARACTERISTIC
/begin AXIS_PTS TQO_vAxleMax_CUR_x "" 0x700137e6 SPD_vVehSpd Lookup1D_X_FLOAT32_IEEE 0 VBU0428Test_CM_single_cnt 13 -3.4028234663852886E+38 3.4028234663852886E+38 /end AXIS_PTS
/begin CHARACTERISTIC TQO_trqBrk_MAP_v "" MAP 0x70017aec Lookup2D_FLOAT32_IEEE 0 VBU0428Test_CM_single_cnt -3.4028234663852886E+38 3.4028234663852886E+38
 /begin AXIS_DESCR COM_AXIS SPD_vVehSpd VBU0428Test_CM_single_cnt 13 -3.4028234663852886E+38 3.4028234663852886E+38 AXIS_PTS_REF TQO_vBrk_MAP_y /end AXIS_DESCR
 /begin AXIS_DESCR COM_AXIS NO_INPUT_QUANTITY VBU0428Test_CM_single_cnt 11 -3.4028234663852886E+38 3.4028234663852886E+38 AXIS_PTS_REF TQO_pctBrk_MAP_x /end AXIS_DESCR
/end CHARACTERISTIC
/begin AXIS_PTS TQO_pctBrk_MAP_x "" 0x70012e82 NO_INPUT_QUANTITY Lookup2D_X_FLOAT32_IEEE 0 VBU0428Test_CM_single_cnt 11 -3.4028234663852886E+38 3.4028234663852886E+38 /end AXIS_PTS
/begin AXIS_PTS TQO_vBrk_MAP_y "" 0x7001381a SPD_vVehSpd Lookup2D_X_FLOAT32_IEEE 0 VBU0428Test_CM_single_cnt 13 -3.4028234663852886E+38 3.4028234663852886E+38 /end AXIS_PTS
/begin CHARACTERISTIC APD_tiBrkPlausibility_CUR_v "" CURVE 0x70014036 Lookup1D_FLOAT32_IEEE 0 VBU0428Test_CM_single_cnt -3.4028234663852886E+38 3.4028234663852886E+38
 /begin AXIS_DESCR COM_AXIS SPD_vVehSpd VBU0428Test_CM_single_cnt 19 -3.4028234663852886E+38 3.4028234663852886E+38 AXIS_PTS_REF APD_vBrkPlausibility_CUR_x /end AXIS_DESCR
/end CHARACTERISTIC
/begin AXIS_PTS APD_vBrkPlausibility_CUR_x "" 0x70014082 SPD_vVehSpd Lookup1D_X_FLOAT32_IEEE 0 VBU0428Test_CM_single_cnt 19 -3.4028234663852886E+38 3.4028234663852886E+38 /end AXIS_PTS
/begin CHARACTERISTIC CaSYS_FullChargeOcvMapZ_mV "" MAP 0x70014d06 Lookup2D_FLOAT32_IEEE 0 VBU0428Test_CM_single_cnt -3.4028234663852886E+38 3.4028234663852886E+38
 /begin AXIS_DESCR COM_AXIS NO_INPUT_QUANTITY VBU0428Test_CM_single_cnt 3 -3.4028234663852886E+38 3.4028234663852886E+38 AXIS_PTS_REF CaSYS_FullChargeOcvMapY_pct /end AXIS_DESCR
 /begin AXIS_DESCR COM_AXIS NO_INPUT_QUANTITY VBU0428Test_CM_single_cnt 8 -3.4028234663852886E+38 3.4028234663852886E+38 AXIS_PTS_REF CaSYS_FullChargeOcvMapX_C /end AXIS_DESCR
/end CHARACTERISTIC
/begin AXIS_PTS CaSYS_FullChargeOcvMapX_C "" 0x7001257e NO_INPUT_QUANTITY Lookup2D_X_FLOAT32_IEEE 0 VBU0428Test_CM_single_cnt 8 -3.4028234663852886E+38 3.4028234663852886E+38 /end AXIS_PTS
/begin AXIS_PTS CaSYS_FullChargeOcvMapY_pct "" 0x70011b98 NO_INPUT_QUANTITY Lookup2D_X_FLOAT32_IEEE 0 VBU0428Test_CM_single_cnt 3 -3.4028234663852886E+38 3.4028234663852886E+38 /end AXIS_PTS
/begin CHARACTERISTIC CaFCC_FullChargeVoltagePolarizaitonMapZ_mV "" MAP 0x70014c46 Lookup2D_FLOAT32_IEEE 0 VBU0428Test_CM_single_cnt -3.4028234663852886E+38 3.4028234663852886E+38
 /begin AXIS_DESCR COM_AXIS SOH_pctPackSoh VBU0428Test_CM_single_cnt 3 -3.4028234663852886E+38 3.4028234663852886E+38 AXIS_PTS_REF CaFCC_FullChargeVoltagePolarizaitonMapY_pct /end AXIS_DESCR
 /begin AXIS_DESCR COM_AXIS NO_INPUT_QUANTITY VBU0428Test_CM_single_cnt 8 -3.4028234663852886E+38 3.4028234663852886E+38 AXIS_PTS_REF CaFCC_FullChargeVoltagePolarizaitonMapX_C /end AXIS_DESCR
/end CHARACTERISTIC
/begin AXIS_PTS CaFCC_FullChargeVoltagePolarizaitonMapX_C "" 0x7001253e NO_INPUT_QUANTITY Lookup2D_X_FLOAT32_IEEE 0 VBU0428Test_CM_single_cnt 8 -3.4028234663852886E+38 3.4028234663852886E+38 /end AXIS_PTS
/begin AXIS_PTS CaFCC_FullChargeVoltagePolarizaitonMapY_pct "" 0x70011b80 SOH_pctPackSoh Lookup2D_X_FLOAT32_IEEE 0 VBU0428Test_CM_single_cnt 3 -3.4028234663852886E+38 3.4028234663852886E+38 /end AXIS_PTS
/begin CHARACTERISTIC CaFCC_FullChargeVoltageDCIRMapZ_mV "" MAP 0x70014b86 Lookup2D_FLOAT32_IEEE 0 VBU0428Test_CM_single_cnt -3.4028234663852886E+38 3.4028234663852886E+38
 /begin AXIS_DESCR COM_AXIS SOH_pctPackSoh VBU0428Test_CM_single_cnt 3 -3.4028234663852886E+38 3.4028234663852886E+38 AXIS_PTS_REF CaFCC_FullChargeVoltageDCIRMapY_pct /end AXIS_DESCR
 /begin AXIS_DESCR COM_AXIS NO_INPUT_QUANTITY VBU0428Test_CM_single_cnt 8 -3.4028234663852886E+38 3.4028234663852886E+38 AXIS_PTS_REF CaFCC_FullChargeVoltageDCIRMapX_C /end AXIS_DESCR
/end CHARACTERISTIC
/begin AXIS_PTS CaFCC_FullChargeVoltageDCIRMapX_C "" 0x700124fe NO_INPUT_QUANTITY Lookup2D_X_FLOAT32_IEEE 0 VBU0428Test_CM_single_cnt 8 -3.4028234663852886E+38 3.4028234663852886E+38 /end AXIS_PTS
/begin AXIS_PTS CaFCC_FullChargeVoltageDCIRMapY_pct "" 0x70011b68 SOH_pctPackSoh Lookup2D_X_FLOAT32_IEEE 0 VBU0428Test_CM_single_cnt 3 -3.4028234663852886E+38 3.4028234663852886E+38 /end AXIS_PTS
/begin CHARACTERISTIC CaFCC_FullChargeVoltageSOHAttenuationMapZ_mV "" MAP 0x70014ca6 Lookup2D_FLOAT32_IEEE 0 VBU0428Test_CM_single_cnt -3.4028234663852886E+38 3.4028234663852886E+38
 /begin AXIS_DESCR COM_AXIS SOH_pctPackSoh VBU0428Test_CM_single_cnt 3 -3.4028234663852886E+38 3.4028234663852886E+38 AXIS_PTS_REF CaFCC_FullChargeVoltageSOHAttenuationMapY_pct /end AXIS_DESCR
 /begin AXIS_DESCR COM_AXIS NO_INPUT_QUANTITY VBU0428Test_CM_single_cnt 8 -3.4028234663852886E+38 3.4028234663852886E+38 AXIS_PTS_REF CaFCC_FullChargeVoltageSOHAttenuationMapX_C /end AXIS_DESCR
/end CHARACTERISTIC
/begin AXIS_PTS CaFCC_FullChargeVoltageSOHAttenuationMapX_C "" 0x7001255e NO_INPUT_QUANTITY Lookup2D_X_FLOAT32_IEEE 0 VBU0428Test_CM_single_cnt 8 -3.4028234663852886E+38 3.4028234663852886E+38 /end AXIS_PTS
/begin AXIS_PTS CaFCC_FullChargeVoltageSOHAttenuationMapY_pct "" 0x70011b8c SOH_pctPackSoh Lookup2D_X_FLOAT32_IEEE 0 VBU0428Test_CM_single_cnt 3 -3.4028234663852886E+38 3.4028234663852886E+38 /end AXIS_PTS
/begin CHARACTERISTIC CaFCC_FullChargeVoltageHysteresisMapZ_mV "" MAP 0x70014be6 Lookup2D_FLOAT32_IEEE 0 VBU0428Test_CM_single_cnt -3.4028234663852886E+38 3.4028234663852886E+38
 /begin AXIS_DESCR COM_AXIS SOH_pctPackSoh VBU0428Test_CM_single_cnt 3 -3.4028234663852886E+38 3.4028234663852886E+38 AXIS_PTS_REF CaFCC_FullChargeVoltageHysteresisMapY_pct /end AXIS_DESCR
 /begin AXIS_DESCR COM_AXIS NO_INPUT_QUANTITY VBU0428Test_CM_single_cnt 8 -3.4028234663852886E+38 3.4028234663852886E+38 AXIS_PTS_REF CaFCC_FullChargeVoltageHysteresisMapX_C /end AXIS_DESCR
/end CHARACTERISTIC
/begin AXIS_PTS CaFCC_FullChargeVoltageHysteresisMapX_C "" 0x7001251e NO_INPUT_QUANTITY Lookup2D_X_FLOAT32_IEEE 0 VBU0428Test_CM_single_cnt 8 -3.4028234663852886E+38 3.4028234663852886E+38 /end AXIS_PTS
/begin AXIS_PTS CaFCC_FullChargeVoltageHysteresisMapY_pct "" 0x70011b74 SOH_pctPackSoh Lookup2D_X_FLOAT32_IEEE 0 VBU0428Test_CM_single_cnt 3 -3.4028234663852886E+38 3.4028234663852886E+38 /end AXIS_PTS
/begin CHARACTERISTIC APD_facRecoveryFillter_C "" VALUE 0x70010144 Scalar_FLOAT32_IEEE 0 VBU0428Test_CM_single_cnt -3.4028234663852886E+38 3.4028234663852886E+38 /end CHARACTERISTIC
/begin CHARACTERISTIC APD_pctIdlePedal_C "" VALUE 0x70010160 Scalar_FLOAT32_IEEE 0 VBU0428Test_CM_single_cnt -3.4028234663852886E+38 3.4028234663852886E+38 /end CHARACTERISTIC
/begin CHARACTERISTIC APD_rBrkPedReleased_C "" VALUE 0x70010164 Scalar_FLOAT32_IEEE 0 VBU0428Test_CM_single_cnt -3.4028234663852886E+38 3.4028234663852886E+38 /end CHARACTERISTIC
/begin CHARACTERISTIC APD_rBrkPlausibilityEnHi_C "" VALUE 0x70010168 Scalar_FLOAT32_IEEE 0 VBU0428Test_CM_single_cnt -3.4028234663852886E+38 3.4028234663852886E+38 /end CHARACTERISTIC
/begin CHARACTERISTIC APD_rBrkStickyPressed_C "" VALUE 0x7001016c Scalar_FLOAT32_IEEE 0 VBU0428Test_CM_single_cnt -3.4028234663852886E+38 3.4028234663852886E+38 /end CHARACTERISTIC
/begin CHARACTERISTIC APD_rBrkStickyThreshold_C "" VALUE 0x70010170 Scalar_FLOAT32_IEEE 0 VBU0428Test_CM_single_cnt -3.4028234663852886E+38 3.4028234663852886E+38 /end CHARACTERISTIC
/begin CHARACTERISTIC APD_rFullPedalPercent_C "" VALUE 0x70010174 Scalar_FLOAT32_IEEE 0 VBU0428Test_CM_single_cnt -3.4028234663852886E+38 3.4028234663852886E+38 /end CHARACTERISTIC
/begin CHARACTERISTIC APD_tiFullPedalTime_C "" VALUE 0x70010178 Scalar_FLOAT32_IEEE 0 VBU0428Test_CM_single_cnt -3.4028234663852886E+38 3.4028234663852886E+38 /end CHARACTERISTIC
/begin CHARACTERISTIC APD_tiSampleTime_C "" VALUE 0x7001017c Scalar_FLOAT32_IEEE 0 VBU0428Test_CM_single_cnt -3.4028234663852886E+38 3.4028234663852886E+38 /end CHARACTERISTIC
/begin CHARACTERISTIC APD_tiUnStickyTime_C "" VALUE 0x70010180 Scalar_FLOAT32_IEEE 0 VBU0428Test_CM_single_cnt -3.4028234663852886E+38 3.4028234663852886E+38 /end CHARACTERISTIC
/begin CHARACTERISTIC APD_uFullAngle1_C "" VALUE 0x70010184 Scalar_FLOAT32_IEEE 0 VBU0428Test_CM_single_cnt -3.4028234663852886E+38 3.4028234663852886E+38 /end CHARACTERISTIC
/begin CHARACTERISTIC APD_uFullAngle2_C "" VALUE 0x70010188 Scalar_FLOAT32_IEEE 0 VBU0428Test_CM_single_cnt -3.4028234663852886E+38 3.4028234663852886E+38 /end CHARACTERISTIC
/begin CHARACTERISTIC APD_vBrkDftSpeed_C "" VALUE 0x700101a4 Scalar_FLOAT32_IEEE 0 VBU0428Test_CM_single_cnt -3.4028234663852886E+38 3.4028234663852886E+38 /end CHARACTERISTIC
/begin CHARACTERISTIC CcCBL_BalanceStartDeltaSocHysteresis_pct "" VALUE 0x70010564 Scalar_FLOAT32_IEEE 0 VBU0428Test_CM_single_cnt -3.4028234663852886E+38 3.4028234663852886E+38 /end CHARACTERISTIC
/begin CHARACTERISTIC CcCBL_ChargeBalanceStartDeltaVoltageHysteresis_mV "" VALUE 0x7001058c Scalar_FLOAT32_IEEE 0 VBU0428Test_CM_single_cnt -3.4028234663852886E+38 3.4028234663852886E+38 /end CHARACTERISTIC
/begin CHARACTERISTIC CcFCC_ChargeVoltageOvRValue_V "" VALUE 0x70010718 Scalar_FLOAT32_IEEE 0 VBU0428Test_CM_single_cnt -3.4028234663852886E+38 3.4028234663852886E+38 /end CHARACTERISTIC
/begin CHARACTERISTIC CcFCC_FullChargePackVoltageDelta_V "" VALUE 0x70010740 Scalar_FLOAT32_IEEE 0 VBU0428Test_CM_single_cnt -3.4028234663852886E+38 3.4028234663852886E+38 /end CHARACTERISTIC
/begin CHARACTERISTIC DCH_iBMSZeroCrntDlyStopCh_C "" VALUE 0x70010c94 Scalar_FLOAT32_IEEE 0 VBU0428Test_CM_single_cnt -3.4028234663852886E+38 3.4028234663852886E+38 /end CHARACTERISTIC
/begin CHARACTERISTIC DCH_iCCSChgCrnt_C "" VALUE 0x70010c98 Scalar_FLOAT32_IEEE 0 VBU0428Test_CM_single_cnt -3.4028234663852886E+38 3.4028234663852886E+38 /end CHARACTERISTIC
/begin CHARACTERISTIC DCH_iOpenDCChRly_C "" VALUE 0x70010cb4 Scalar_FLOAT32_IEEE 0 VBU0428Test_CM_single_cnt -3.4028234663852886E+38 3.4028234663852886E+38 /end CHARACTERISTIC
/begin CHARACTERISTIC DCH_tiAPlusVldDly_C "" VALUE 0x70010d7c Scalar_FLOAT32_IEEE 0 VBU0428Test_CM_single_cnt -3.4028234663852886E+38 3.4028234663852886E+38 /end CHARACTERISTIC
/begin CHARACTERISTIC DCH_tiAplusConfirmT_C "" VALUE 0x70010d80 Scalar_FLOAT32_IEEE 0 VBU0428Test_CM_single_cnt -3.4028234663852886E+38 3.4028234663852886E+38 /end CHARACTERISTIC
/begin CHARACTERISTIC DCH_tiBMSChAvlDly_C "" VALUE 0x70010d90 Scalar_FLOAT32_IEEE 0 VBU0428Test_CM_single_cnt -3.4028234663852886E+38 3.4028234663852886E+38 /end CHARACTERISTIC
/begin CHARACTERISTIC DCH_tiBMSChAvlTrnOffDly_C "" VALUE 0x70010d94 Scalar_FLOAT32_IEEE 0 VBU0428Test_CM_single_cnt -3.4028234663852886E+38 3.4028234663852886E+38 /end CHARACTERISTIC
/begin CHARACTERISTIC DCH_tiCC2ConfirmT_C "" VALUE 0x70010d98 Scalar_FLOAT32_IEEE 0 VBU0428Test_CM_single_cnt -3.4028234663852886E+38 3.4028234663852886E+38 /end CHARACTERISTIC
/begin CHARACTERISTIC DCH_tiCC2OffCnfrm_C "" VALUE 0x70010d9c Scalar_FLOAT32_IEEE 0 VBU0428Test_CM_single_cnt -3.4028234663852886E+38 3.4028234663852886E+38 /end CHARACTERISTIC
/begin CHARACTERISTIC DCH_tiCSTTrigDly_C "" VALUE 0x70010dc0 Scalar_FLOAT32_IEEE 0 VBU0428Test_CM_single_cnt -3.4028234663852886E+38 3.4028234663852886E+38 /end CHARACTERISTIC
/begin CHARACTERISTIC DCH_tiDCChRlyTurnOffConfrmDly_C "" VALUE 0x70010dd4 Scalar_FLOAT32_IEEE 0 VBU0428Test_CM_single_cnt -3.4028234663852886E+38 3.4028234663852886E+38 /end CHARACTERISTIC
/begin CHARACTERISTIC DCH_uDCRlyClosedJudged_C "" VALUE 0x70010e2c Scalar_FLOAT32_IEEE 0 VBU0428Test_CM_single -3.4E+38 3.4E+38 /end CHARACTERISTIC
/begin CHARACTERISTIC DCH_uMaxCCToConn_C "" VALUE 0x70010e34 Scalar_FLOAT32_IEEE 0 VBU0428Test_CM_single_cnt -3.4028234663852886E+38 3.4028234663852886E+38 /end CHARACTERISTIC
/begin CHARACTERISTIC DCH_uMinCCToConn_C "" VALUE 0x70010e38 Scalar_FLOAT32_IEEE 0 VBU0428Test_CM_single_cnt -3.4028234663852886E+38 3.4028234663852886E+38 /end CHARACTERISTIC
/begin CHARACTERISTIC DCH_vMaxSpdLim_C "" VALUE 0x70010e3c Scalar_FLOAT32_IEEE 0 VBU0428Test_CM_single_cnt -3.4028234663852886E+38 3.4028234663852886E+38 /end CHARACTERISTIC
/begin CHARACTERISTIC DCH_vMinSpdLim_C "" VALUE 0x70010e40 Scalar_FLOAT32_IEEE 0 VBU0428Test_CM_single_cnt -3.4028234663852886E+38 3.4028234663852886E+38 /end CHARACTERISTIC
/begin CHARACTERISTIC DIAGS_stPsvResp_SY "" VALUE 0x70010e44 Scalar_FLOAT32_IEEE 0 VBU0428Test_CM_single_cnt -3.4028234663852886E+38 3.4028234663852886E+38 /end CHARACTERISTIC
/begin CHARACTERISTIC DSPL_facBMSEnergyStep1_C "" VALUE 0x70010e48 Scalar_FLOAT32_IEEE 0 VBU0428Test_CM_single_fac 0.0 1.0 /end CHARACTERISTIC
/begin CHARACTERISTIC DSPL_facBMSEnergyStep2_C "" VALUE 0x70010e4c Scalar_FLOAT32_IEEE 0 VBU0428Test_CM_single_fac 0.0 1.0 /end CHARACTERISTIC
/begin CHARACTERISTIC DSPL_facBMSEnergyStep3_C "" VALUE 0x70010e50 Scalar_FLOAT32_IEEE 0 VBU0428Test_CM_single_fac 0.0 1.0 /end CHARACTERISTIC
/begin CHARACTERISTIC DSPL_facBMSEnergyStep4_C "" VALUE 0x70010e54 Scalar_FLOAT32_IEEE 0 VBU0428Test_CM_single_fac 0.0 1.0 /end CHARACTERISTIC
/begin CHARACTERISTIC DSPL_facBMSEnergyStep5_C "" VALUE 0x70010e58 Scalar_FLOAT32_IEEE 0 VBU0428Test_CM_single_fac 0.0 1.0 /end CHARACTERISTIC
/begin CHARACTERISTIC DSPL_facEnergyComsume10kmFactor1_C "" VALUE 0x70010e98 Scalar_FLOAT32_IEEE 0 VBU0428Test_CM_single_fac 0.0 1.0 /end CHARACTERISTIC
/begin CHARACTERISTIC DSPL_facEnergyComsume10kmFactor2_C "" VALUE 0x70010e9c Scalar_FLOAT32_IEEE 0 VBU0428Test_CM_single_fac 0.0 1.0 /end CHARACTERISTIC
/begin CHARACTERISTIC DSPL_facEnergyComsume10kmFactor3_C "" VALUE 0x70010ea0 Scalar_FLOAT32_IEEE 0 VBU0428Test_CM_single_fac 0.0 1.0 /end CHARACTERISTIC
/begin CHARACTERISTIC DSPL_facEnergyComsume10kmFactor4_C "" VALUE 0x70010ea4 Scalar_FLOAT32_IEEE 0 VBU0428Test_CM_single_fac 0.0 1.0 /end CHARACTERISTIC
/begin CHARACTERISTIC DSPL_facEnergyComsume10kmNegFactor_C "" VALUE 0x70010ea8 Scalar_FLOAT32_IEEE 0 VBU0428Test_CM_single_fac 0.0 1.0 /end CHARACTERISTIC
/begin CHARACTERISTIC DSPL_facEnergyComsume10kmPosFactor_C "" VALUE 0x70010eac Scalar_FLOAT32_IEEE 0 VBU0428Test_CM_single_fac 0.0 1.0 /end CHARACTERISTIC
/begin CHARACTERISTIC DSPL_facEnergyComsume10kmStep1_C "" VALUE 0x70010eb0 Scalar_FLOAT32_IEEE 0 VBU0428Test_CM_single_fac 0.0 1.0 /end CHARACTERISTIC
/begin CHARACTERISTIC DSPL_facEnergyComsume10kmStep2_C "" VALUE 0x70010eb4 Scalar_FLOAT32_IEEE 0 VBU0428Test_CM_single_fac 0.0 1.0 /end CHARACTERISTIC
/begin CHARACTERISTIC DSPL_facEnergyComsume10kmStep3_C "" VALUE 0x70010eb8 Scalar_FLOAT32_IEEE 0 VBU0428Test_CM_single_fac 0.0 1.0 /end CHARACTERISTIC
/begin CHARACTERISTIC DSPL_facEnergyComsume50kmCalFilter1_C "" VALUE 0x70010ebc Scalar_FLOAT32_IEEE 0 VBU0428Test_CM_single_fac 0.0 1.0 /end CHARACTERISTIC
/begin CHARACTERISTIC DSPL_facEnergyComsume50kmCalFilter2_C "" VALUE 0x70010ec0 Scalar_FLOAT32_IEEE 0 VBU0428Test_CM_single_fac 0.0 1.0 /end CHARACTERISTIC
/begin CHARACTERISTIC DSPL_facEnergyComsume50kmCalFilter3_C "" VALUE 0x70010ec4 Scalar_FLOAT32_IEEE 0 VBU0428Test_CM_single_fac 0.0 1.0 /end CHARACTERISTIC
/begin CHARACTERISTIC DSPL_facEnergyComsume50kmInitFactor1_C "" VALUE 0x70010ec8 Scalar_FLOAT32_IEEE 0 VBU0428Test_CM_single_fac 0.0 1.0 /end CHARACTERISTIC
/begin CHARACTERISTIC DSPL_facEnergyComsume50kmInitFactor2_C "" VALUE 0x70010ecc Scalar_FLOAT32_IEEE 0 VBU0428Test_CM_single_fac 0.0 1.0 /end CHARACTERISTIC
/begin CHARACTERISTIC DSPL_facEnergyComsume50kmInitFactor3_C "" VALUE 0x70010ed0 Scalar_FLOAT32_IEEE 0 VBU0428Test_CM_single_fac 0.0 1.0 /end CHARACTERISTIC
/begin CHARACTERISTIC DSPL_facEnergyComsume50kmInitFactorDefault_C "" VALUE 0x70010ed4 Scalar_FLOAT32_IEEE 0 VBU0428Test_CM_single_fac 0.0 1.0 /end CHARACTERISTIC
/begin CHARACTERISTIC DSPL_facEnergyComsume50kmInitStep1_C "" VALUE 0x70010ed8 Scalar_FLOAT32_IEEE 0 VBU0428Test_CM_single_fac 0.0 1.0 /end CHARACTERISTIC
/begin CHARACTERISTIC DSPL_facEnergyComsume50kmInitStep2_C "" VALUE 0x70010edc Scalar_FLOAT32_IEEE 0 VBU0428Test_CM_single_fac 0.0 1.0 /end CHARACTERISTIC
/begin CHARACTERISTIC DSPL_facEnergyComsume50kmInitStep3_C "" VALUE 0x70010ee0 Scalar_FLOAT32_IEEE 0 VBU0428Test_CM_single_fac 0.0 1.0 /end CHARACTERISTIC
/begin CHARACTERISTIC DSPL_facEnergyComsumeCalFilter10_C "" VALUE 0x70010ee4 Scalar_FLOAT32_IEEE 0 VBU0428Test_CM_single_fac 0.0 1.0 /end CHARACTERISTIC
/begin CHARACTERISTIC DSPL_facEnergyComsumeCalFilter11_C "" VALUE 0x70010ee8 Scalar_FLOAT32_IEEE 0 VBU0428Test_CM_single_fac 0.0 1.0 /end CHARACTERISTIC
/begin CHARACTERISTIC DSPL_facEnergyComsumeCalFilter1_C "" VALUE 0x70010eec Scalar_FLOAT32_IEEE 0 VBU0428Test_CM_single_fac 0.0 1.0 /end CHARACTERISTIC
/begin CHARACTERISTIC DSPL_facEnergyComsumeCalFilter2_C "" VALUE 0x70010ef0 Scalar_FLOAT32_IEEE 0 VBU0428Test_CM_single_fac 0.0 1.0 /end CHARACTERISTIC
/begin CHARACTERISTIC DSPL_facEnergyComsumeCalFilter3_C "" VALUE 0x70010ef4 Scalar_FLOAT32_IEEE 0 VBU0428Test_CM_single_fac 0.0 1.0 /end CHARACTERISTIC
/begin CHARACTERISTIC DSPL_facEnergyComsumeCalFilter4_C "" VALUE 0x70010ef8 Scalar_FLOAT32_IEEE 0 VBU0428Test_CM_single_fac 0.0 1.0 /end CHARACTERISTIC
/begin CHARACTERISTIC DSPL_facEnergyComsumeCalFilter5_C "" VALUE 0x70010efc Scalar_FLOAT32_IEEE 0 VBU0428Test_CM_single_fac 0.0 1.0 /end CHARACTERISTIC
/begin CHARACTERISTIC DSPL_facEnergyComsumeCalFilter6_C "" VALUE 0x70010f00 Scalar_FLOAT32_IEEE 0 VBU0428Test_CM_single_fac 0.0 1.0 /end CHARACTERISTIC
/begin CHARACTERISTIC DSPL_facEnergyComsumeCalFilter7_C "" VALUE 0x70010f04 Scalar_FLOAT32_IEEE 0 VBU0428Test_CM_single_fac 0.0 1.0 /end CHARACTERISTIC
/begin CHARACTERISTIC DSPL_facEnergyComsumeCalFilter8_C "" VALUE 0x70010f08 Scalar_FLOAT32_IEEE 0 VBU0428Test_CM_single_fac 0.0 1.0 /end CHARACTERISTIC
/begin CHARACTERISTIC DSPL_facEnergyComsumeCalFilter9_C "" VALUE 0x70010f0c Scalar_FLOAT32_IEEE 0 VBU0428Test_CM_single_fac 0.0 1.0 /end CHARACTERISTIC
/begin CHARACTERISTIC DSPL_facEnergyComsumeDownMin_C "" VALUE 0x70010f10 Scalar_FLOAT32_IEEE 0 VBU0428Test_CM_single_fac 0.0 1.0 /end CHARACTERISTIC
/begin CHARACTERISTIC DSPL_facEnergyComsumeInitFactor1_C "" VALUE 0x70010f14 Scalar_FLOAT32_IEEE 0 VBU0428Test_CM_single_fac 0.0 1.0 /end CHARACTERISTIC
/begin CHARACTERISTIC DSPL_facEnergyComsumeInitFactor2_C "" VALUE 0x70010f18 Scalar_FLOAT32_IEEE 0 VBU0428Test_CM_single_fac 0.0 1.0 /end CHARACTERISTIC
/begin CHARACTERISTIC DSPL_facEnergyComsumeInitFactor3_C "" VALUE 0x70010f1c Scalar_FLOAT32_IEEE 0 VBU0428Test_CM_single_fac 0.0 1.0 /end CHARACTERISTIC
/begin CHARACTERISTIC DSPL_facEnergyComsumeInitFactorDefault_C "" VALUE 0x70010f20 Scalar_FLOAT32_IEEE 0 VBU0428Test_CM_single_fac 0.0 1.0 /end CHARACTERISTIC
/begin CHARACTERISTIC DSPL_facEnergyComsumeInitStep1_C "" VALUE 0x70010f24 Scalar_FLOAT32_IEEE 0 VBU0428Test_CM_single_fac 0.0 1.0 /end CHARACTERISTIC
/begin CHARACTERISTIC DSPL_facEnergyComsumeInitStep2_C "" VALUE 0x70010f28 Scalar_FLOAT32_IEEE 0 VBU0428Test_CM_single_fac 0.0 1.0 /end CHARACTERISTIC
/begin CHARACTERISTIC DSPL_facEnergyComsumeInitStep3_C "" VALUE 0x70010f2c Scalar_FLOAT32_IEEE 0 VBU0428Test_CM_single_fac 0.0 1.0 /end CHARACTERISTIC
/begin CHARACTERISTIC DSPL_facEnergyComsumeUPMax_C "" VALUE 0x70010f30 Scalar_FLOAT32_IEEE 0 VBU0428Test_CM_single_fac 0.0 1.0 /end CHARACTERISTIC
/begin CHARACTERISTIC DSPL_kmChrgDownStepMin_C "" VALUE 0x70010f88 Scalar_FLOAT32_IEEE 0 VBU0428Test_CM_single_km -1.0E+7 1.0E+10 /end CHARACTERISTIC
/begin CHARACTERISTIC DSPL_kmChrgUpStepMax_C "" VALUE 0x70010f8c Scalar_FLOAT32_IEEE 0 VBU0428Test_CM_single_km -1.0E+7 1.0E+10 /end CHARACTERISTIC
/begin CHARACTERISTIC DSPL_kmDrvRngStepMax_C "" VALUE 0x70010fa8 Scalar_FLOAT32_IEEE 0 VBU0428Test_CM_single_km -1.0E+7 1.0E+10 /end CHARACTERISTIC
/begin CHARACTERISTIC DSPL_kmRange10kmCalCell_C "" VALUE 0x70010fcc Scalar_FLOAT32_IEEE 0 VBU0428Test_CM_single_km 0.0 1.0E+11 /end CHARACTERISTIC
/begin CHARACTERISTIC DSPL_kmRange50kmCalCell_C "" VALUE 0x70010fd0 Scalar_FLOAT32_IEEE 0 VBU0428Test_CM_single_km 0.0 1.0E+11 /end CHARACTERISTIC
/begin CHARACTERISTIC DSPL_kmRemainingRangeDisplayStep_C "" VALUE 0x70010fd4 Scalar_FLOAT32_IEEE 0 VBU0428Test_CM_single_km 0.0 1.0E+23 /end CHARACTERISTIC
/begin CHARACTERISTIC DSPL_numSOCJump_C "" VALUE 0x70010fdc Scalar_FLOAT32_IEEE 0 VBU0428Test_CM_single_cnt 0.0 1.0E+15 /end CHARACTERISTIC
/begin CHARACTERISTIC DSPL_pctBMSEnergyStep1_C "" VALUE 0x70010fe8 Scalar_FLOAT32_IEEE 0 VBU0428Test_CM_single_pct 0.0 100.0 /end CHARACTERISTIC
/begin CHARACTERISTIC DSPL_pctBMSEnergyStep2_C "" VALUE 0x70010fec Scalar_FLOAT32_IEEE 0 VBU0428Test_CM_single_pct 0.0 100.0 /end CHARACTERISTIC
/begin CHARACTERISTIC DSPL_pctBMSEnergyStep3_C "" VALUE 0x70010ff0 Scalar_FLOAT32_IEEE 0 VBU0428Test_CM_single_pct 0.0 100.0 /end CHARACTERISTIC
/begin CHARACTERISTIC DSPL_pctBMSEnergyStep4_C "" VALUE 0x70010ff4 Scalar_FLOAT32_IEEE 0 VBU0428Test_CM_single_pct 0.0 100.0 /end CHARACTERISTIC
/begin CHARACTERISTIC DSPL_pctBMSEnergyStep5_C "" VALUE 0x70010ff8 Scalar_FLOAT32_IEEE 0 VBU0428Test_CM_single_pct 0.0 100.0 /end CHARACTERISTIC
/begin CHARACTERISTIC DSPL_pctBMSEnergyStep6_C "" VALUE 0x70010ffc Scalar_FLOAT32_IEEE 0 VBU0428Test_CM_single_pct 0.0 100.0 /end CHARACTERISTIC
/begin CHARACTERISTIC DSPL_pctBMSSOCMinStep_C "" VALUE 0x70011000 Scalar_FLOAT32_IEEE 0 VBU0428Test_CM_single_pct 0.0 100.0 /end CHARACTERISTIC
/begin CHARACTERISTIC DSPL_pctSOCFullChrg_C "" VALUE 0x7001100c Scalar_FLOAT32_IEEE 0 VBU0428Test_CM_single_pct 0.0 100.0 /end CHARACTERISTIC
/begin CHARACTERISTIC DSPL_pctSOCJumpHi_C "" VALUE 0x70011010 Scalar_FLOAT32_IEEE 0 VBU0428Test_CM_single_pct 0.0 100.0 /end CHARACTERISTIC
/begin CHARACTERISTIC DSPL_pctSOCJumpLo_C "" VALUE 0x70011014 Scalar_FLOAT32_IEEE 0 VBU0428Test_CM_single_pct 0.0 100.0 /end CHARACTERISTIC
/begin CHARACTERISTIC DSPL_pctSocFull_C "" VALUE 0x70011018 Scalar_FLOAT32_IEEE 0 VBU0428Test_CM_single_pct 0.0 100.0 /end CHARACTERISTIC
/begin CHARACTERISTIC DSPL_pwrVehicleDrivePowerMoving_C "" VALUE 0x70011024 Scalar_FLOAT32_IEEE 0 VBU0428Test_CM_single_cnt 0.0 1.0E+18 /end CHARACTERISTIC
/begin CHARACTERISTIC DSPL_pwrVehicleDrivePowerStandstill_C "" VALUE 0x70011028 Scalar_FLOAT32_IEEE 0 VBU0428Test_CM_single_cnt 0.0 1.0E+18 /end CHARACTERISTIC
/begin CHARACTERISTIC DSPL_tiBmsSocFullDelay_C "" VALUE 0x70011034 Scalar_FLOAT32_IEEE 0 VBU0428Test_CM_single_s 0.0 1.0E+23 /end CHARACTERISTIC
/begin CHARACTERISTIC DSPL_tiBmsSocVldDelay_C "" VALUE 0x70011038 Scalar_FLOAT32_IEEE 0 VBU0428Test_CM_single_s 0.0 1.0E+23 /end CHARACTERISTIC
/begin CHARACTERISTIC DSPL_tiBmsSocZeroDelay_C "" VALUE 0x7001103c Scalar_FLOAT32_IEEE 0 VBU0428Test_CM_single_s 0.0 1.0E+23 /end CHARACTERISTIC
/begin CHARACTERISTIC DSPL_tiDelayTimeChrgFallingEdge_C "" VALUE 0x70011044 Scalar_FLOAT32_IEEE 0 VBU0428Test_CM_single_s 0.0 1.0E+23 /end CHARACTERISTIC
/begin CHARACTERISTIC DSPL_tiEnergyCalTrigleDelay_C "" VALUE 0x7001105c Scalar_FLOAT32_IEEE 0 VBU0428Test_CM_single_s 0.0 1.0E+23 /end CHARACTERISTIC
/begin CHARACTERISTIC DSPL_tiSOCJumpDelay_C "" VALUE 0x70011074 Scalar_FLOAT32_IEEE 0 VBU0428Test_CM_single_s 0.0 1.0E+23 /end CHARACTERISTIC
/begin CHARACTERISTIC EDIS_facVehSpd2MotSpd_C "" VALUE 0x700110b0 Scalar_FLOAT32_IEEE 0 VBU0428Test_CM_single_cnt -3.4028234663852886E+38 3.4028234663852886E+38 /end CHARACTERISTIC
/begin CHARACTERISTIC EDIS_numChOverLim_C "" VALUE 0x700110b8 Scalar_FLOAT32_IEEE 0 VBU0428Test_CM_single_cnt -3.4028234663852886E+38 3.4028234663852886E+38 /end CHARACTERISTIC
/begin CHARACTERISTIC EDIS_numChPwrOverCntEEPROMInit_SY "" VALUE 0x700110bc Scalar_FLOAT32_IEEE 0 VBU0428Test_CM_single_cnt -3.4028234663852886E+38 3.4028234663852886E+38 /end CHARACTERISTIC
/begin CHARACTERISTIC EDIS_pwrChRed40vLim_C "" VALUE 0x70011108 Scalar_FLOAT32_IEEE 0 VBU0428Test_CM_single_cnt -3.4028234663852886E+38 3.4028234663852886E+38 /end CHARACTERISTIC
/begin CHARACTERISTIC EDIS_pwrOfflineChDyn_C "" VALUE 0x70011154 Scalar_FLOAT32_IEEE 0 VBU0428Test_CM_single_kW -3.4028234663852886E+38 3.4028234663852886E+38 /end CHARACTERISTIC
/begin CHARACTERISTIC EDIS_pwrOfflineChLT_C "" VALUE 0x70011158 Scalar_FLOAT32_IEEE 0 VBU0428Test_CM_single_kW -3.4028234663852886E+38 3.4028234663852886E+38 /end CHARACTERISTIC
/begin CHARACTERISTIC EDIS_pwrOfflineDisChDyn_C "" VALUE 0x7001115c Scalar_FLOAT32_IEEE 0 VBU0428Test_CM_single_kW 0.0 1000.0 /end CHARACTERISTIC
/begin CHARACTERISTIC EDIS_pwrOfflineDisChLT_C "" VALUE 0x70011160 Scalar_FLOAT32_IEEE 0 VBU0428Test_CM_single_kW 0.0 1000.0 /end CHARACTERISTIC
/begin CHARACTERISTIC EDIS_pwrOfflineDisChST_C "" VALUE 0x70011164 Scalar_FLOAT32_IEEE 0 VBU0428Test_CM_single_kW 0.0 1000.0 /end CHARACTERISTIC
/begin CHARACTERISTIC EDIS_pwrOfflineDownStep_C "" VALUE 0x70011168 Scalar_FLOAT32_IEEE 0 VBU0428Test_CM_single_kW -1000.0 1000.0 /end CHARACTERISTIC
/begin CHARACTERISTIC EDIS_pwrOfflineUpStep_C "" VALUE 0x7001116c Scalar_FLOAT32_IEEE 0 VBU0428Test_CM_single_kW -1000.0 1000.0 /end CHARACTERISTIC
/begin CHARACTERISTIC EDIS_pwrOnlineDownStep_C "" VALUE 0x70011170 Scalar_FLOAT32_IEEE 0 VBU0428Test_CM_single_kW -1000.0 1000.0 /end CHARACTERISTIC
/begin CHARACTERISTIC EDIS_pwrOnlineUpStep_C "" VALUE 0x70011174 Scalar_FLOAT32_IEEE 0 VBU0428Test_CM_single_kW -1000.0 1000.0 /end CHARACTERISTIC
/begin CHARACTERISTIC EDIS_tiBattOverChrg_C "" VALUE 0x70011190 Scalar_FLOAT32_IEEE 0 VBU0428Test_CM_single_cnt -3.4028234663852886E+38 3.4028234663852886E+38 /end CHARACTERISTIC
/begin CHARACTERISTIC EDIS_wChOverEnrgLim_C "" VALUE 0x700111b0 Scalar_FLOAT32_IEEE 0 VBU0428Test_CM_single_cnt -3.4028234663852886E+38 3.4028234663852886E+38 /end CHARACTERISTIC
/begin CHARACTERISTIC Gear_cntGearPTimeOut_C "" VALUE 0x70011238 Scalar_FLOAT32_IEEE 0 VBU0428Test_CM_single_cnt -3.4028234663852886E+38 3.4028234663852886E+38 /end CHARACTERISTIC
/begin CHARACTERISTIC Gear_cntGearPlausibilityDigitalDetect_C "" VALUE 0x7001123c Scalar_FLOAT32_IEEE 0 VBU0428Test_CM_single_cnt -3.4028234663852886E+38 3.4028234663852886E+38 /end CHARACTERISTIC
/begin CHARACTERISTIC Gear_cntGearPlausibilityDigitalShiftFast_C "" VALUE 0x70011240 Scalar_FLOAT32_IEEE 0 VBU0428Test_CM_single_cnt -3.4028234663852886E+38 3.4028234663852886E+38 /end CHARACTERISTIC
/begin CHARACTERISTIC Gear_tiDefaultGear2NTime_C "" VALUE 0x70011248 Scalar_FLOAT32_IEEE 0 VBU0428Test_CM_single_cnt -3.4028234663852886E+38 3.4028234663852886E+38 /end CHARACTERISTIC
/begin CHARACTERISTIC Gear_tiDefaultGear2PTime_C "" VALUE 0x7001124c Scalar_FLOAT32_IEEE 0 VBU0428Test_CM_single_cnt -3.4028234663852886E+38 3.4028234663852886E+38 /end CHARACTERISTIC
/begin CHARACTERISTIC Gear_tiGearDSustain_C "" VALUE 0x70011250 Scalar_FLOAT32_IEEE 0 VBU0428Test_CM_single_cnt -3.4028234663852886E+38 3.4028234663852886E+38 /end CHARACTERISTIC
/begin CHARACTERISTIC Gear_tiGearES6DebounceCnt_C "" VALUE 0x70011258 Scalar_FLOAT32_IEEE 0 VBU0428Test_CM_single_cnt -3.4028234663852886E+38 3.4028234663852886E+38 /end CHARACTERISTIC
/begin CHARACTERISTIC Gear_tiGearInitSustain_C "" VALUE 0x7001125c Scalar_FLOAT32_IEEE 0 VBU0428Test_CM_single_cnt -3.4028234663852886E+38 3.4028234663852886E+38 /end CHARACTERISTIC
/begin CHARACTERISTIC Gear_tiGearInitTime_C "" VALUE 0x70011260 Scalar_FLOAT32_IEEE 0 VBU0428Test_CM_single_cnt -3.4028234663852886E+38 3.4028234663852886E+38 /end CHARACTERISTIC
/begin CHARACTERISTIC Gear_tiGearPSustain_C "" VALUE 0x70011264 Scalar_FLOAT32_IEEE 0 VBU0428Test_CM_single_cnt -3.4028234663852886E+38 3.4028234663852886E+38 /end CHARACTERISTIC
/begin CHARACTERISTIC Gear_tiGearRSustain_C "" VALUE 0x7001126c Scalar_FLOAT32_IEEE 0 VBU0428Test_CM_single_cnt -3.4028234663852886E+38 3.4028234663852886E+38 /end CHARACTERISTIC
/begin CHARACTERISTIC Gear_tiGearResetHold_C "" VALUE 0x70011270 Scalar_FLOAT32_IEEE 0 VBU0428Test_CM_single_cnt -3.4028234663852886E+38 3.4028234663852886E+38 /end CHARACTERISTIC
/begin CHARACTERISTIC Gear_tiGearWarningLTES6DebounceCnt_C "" VALUE 0x70011274 Scalar_FLOAT32_IEEE 0 VBU0428Test_CM_single_cnt -3.4028234663852886E+38 3.4028234663852886E+38 /end CHARACTERISTIC
/begin CHARACTERISTIC Gear_tiGearWarningSTES6DebounceCnt_C "" VALUE 0x70011278 Scalar_FLOAT32_IEEE 0 VBU0428Test_CM_single_cnt -3.4028234663852886E+38 3.4028234663852886E+38 /end CHARACTERISTIC
/begin CHARACTERISTIC Gear_tiInitGear2NTime_C "" VALUE 0x7001127c Scalar_FLOAT32_IEEE 0 VBU0428Test_CM_single_cnt -3.4028234663852886E+38 3.4028234663852886E+38 /end CHARACTERISTIC
/begin CHARACTERISTIC Gear_tiInitGear2PTime_C "" VALUE 0x70011280 Scalar_FLOAT32_IEEE 0 VBU0428Test_CM_single_cnt -3.4028234663852886E+38 3.4028234663852886E+38 /end CHARACTERISTIC
/begin CHARACTERISTIC Gear_tiWarnDelayTime_C "" VALUE 0x7001128c Scalar_FLOAT32_IEEE 0 VBU0428Test_CM_single_cnt -3.4028234663852886E+38 3.4028234663852886E+38 /end CHARACTERISTIC
/begin CHARACTERISTIC LVC_stDcDcFailure_SY "" VALUE 0x7001136c Scalar_FLOAT32_IEEE 0 VBU0428Test_CM_single_cnt -3.4028234663852886E+38 3.4028234663852886E+38 /end CHARACTERISTIC
/begin CHARACTERISTIC LVC_stDcDcStandby_SY "" VALUE 0x0000 Scalar_FLOAT32_IEEE 0 VBU0428Test_CM_single_cnt -3.4028234663852886E+38 3.4028234663852886E+38 /end CHARACTERISTIC
/begin CHARACTERISTIC LVC_stDcDcWorking_SY "" VALUE 0x0000 Scalar_FLOAT32_IEEE 0 VBU0428Test_CM_single_cnt -3.4028234663852886E+38 3.4028234663852886E+38 /end CHARACTERISTIC
/begin CHARACTERISTIC LVC_tiWaitForOk_C "" VALUE 0x70011398 Scalar_FLOAT32_IEEE 0 VBU0428Test_CM_single_cnt -3.4028234663852886E+38 3.4028234663852886E+38 /end CHARACTERISTIC
/begin CHARACTERISTIC PMM_tiDlyIgnOff_C "" VALUE 0x70011550 Scalar_FLOAT32_IEEE 0 VBU0428Test_CM_single_cnt -3.4028234663852886E+38 3.4028234663852886E+38 /end CHARACTERISTIC
/begin CHARACTERISTIC PMM_tiDlyNMWkup_C "" VALUE 0x7001155c Scalar_FLOAT32_IEEE 0 VBU0428Test_CM_single_cnt -3.4028234663852886E+38 3.4028234663852886E+38 /end CHARACTERISTIC
/begin CHARACTERISTIC PMM_tiDlyPEUDCVltg_C "" VALUE 0x70011564 Scalar_FLOAT32_IEEE 0 VBU0428Test_CM_single_cnt -3.4028234663852886E+38 3.4028234663852886E+38 /end CHARACTERISTIC
/begin CHARACTERISTIC PMM_tiDlyVCUStpNMAbnrml_C "" VALUE 0x7001157c Scalar_FLOAT32_IEEE 0 VBU0428Test_CM_single_cnt -3.4028234663852886E+38 3.4028234663852886E+38 /end CHARACTERISTIC
/begin CHARACTERISTIC PMM_tiDlyVCUStpNMNrml_C "" VALUE 0x70011580 Scalar_FLOAT32_IEEE 0 VBU0428Test_CM_single_cnt -3.4028234663852886E+38 3.4028234663852886E+38 /end CHARACTERISTIC
/begin CHARACTERISTIC PMM_tiDlyWaitNMStp_C "" VALUE 0x70011588 Scalar_FLOAT32_IEEE 0 VBU0428Test_CM_single_cnt -3.4028234663852886E+38 3.4028234663852886E+38 /end CHARACTERISTIC
/begin CHARACTERISTIC STC_nDeltaSpdThd_C "" VALUE 0x70011620 Scalar_FLOAT32_IEEE 0 VBU0428Test_CM_single_cnt -3.4028234663852886E+38 3.4028234663852886E+38 /end CHARACTERISTIC
/begin CHARACTERISTIC STC_pctAccPedPosResetPI_C "" VALUE 0x70011624 Scalar_FLOAT32_IEEE 0 VBU0428Test_CM_single_cnt -3.4028234663852886E+38 3.4028234663852886E+38 /end CHARACTERISTIC
/begin CHARACTERISTIC STC_trqRgnPIResetThd_C "" VALUE 0x70011628 Scalar_FLOAT32_IEEE 0 VBU0428Test_CM_single_Nm -3.4028234663852886E+38 3.4028234663852886E+38 /end CHARACTERISTIC
/begin CHARACTERISTIC STC_trqRgnPISetThd_C "" VALUE 0x7001162c Scalar_FLOAT32_IEEE 0 VBU0428Test_CM_single_Nm -3.4028234663852886E+38 3.4028234663852886E+38 /end CHARACTERISTIC
/begin CHARACTERISTIC STC_trqRgnRAMax_C "" VALUE 0x70011630 Scalar_FLOAT32_IEEE 0 VBU0428Test_CM_single_Nm -3.4028234663852886E+38 3.4028234663852886E+38 /end CHARACTERISTIC
/begin CHARACTERISTIC TQCMP_pBrkCrpOffThd_C "" VALUE 0x70011690 Scalar_FLOAT32_IEEE 0 VBU0428Test_CM_single_cnt -3.4028234663852886E+38 3.4028234663852886E+38 /end CHARACTERISTIC
/begin CHARACTERISTIC TQCMP_tiPulseThd_C "" VALUE 0x70011694 Scalar_FLOAT32_IEEE 0 VBU0428Test_CM_single_cnt -3.4028234663852886E+38 3.4028234663852886E+38 /end CHARACTERISTIC
/begin CHARACTERISTIC TQCMP_tiSinResetRA_C "" VALUE 0x70011698 Scalar_FLOAT32_IEEE 0 VBU0428Test_CM_single_cnt -3.4028234663852886E+38 3.4028234663852886E+38 /end CHARACTERISTIC
/begin CHARACTERISTIC TQCMP_trqDecRASinHi_C "" VALUE 0x7001169c Scalar_FLOAT32_IEEE 0 VBU0428Test_CM_single_Nm -3.4028234663852886E+38 3.4028234663852886E+38 /end CHARACTERISTIC
/begin CHARACTERISTIC TQCMP_trqDecRASinLo_C "" VALUE 0x700116a0 Scalar_FLOAT32_IEEE 0 VBU0428Test_CM_single_Nm -3.4028234663852886E+38 3.4028234663852886E+38 /end CHARACTERISTIC
/begin CHARACTERISTIC TQCMP_trqDecRATarSinHi_C "" VALUE 0x700116a4 Scalar_FLOAT32_IEEE 0 VBU0428Test_CM_single_Nm -3.4028234663852886E+38 3.4028234663852886E+38 /end CHARACTERISTIC
/begin CHARACTERISTIC TQCMP_trqDecRATarSinLo_C "" VALUE 0x700116a8 Scalar_FLOAT32_IEEE 0 VBU0428Test_CM_single_Nm -3.4028234663852886E+38 3.4028234663852886E+38 /end CHARACTERISTIC
/begin CHARACTERISTIC TQCMP_trqDecSinOffsetRA_C "" VALUE 0x700116ac Scalar_FLOAT32_IEEE 0 VBU0428Test_CM_single_Nm -3.4028234663852886E+38 3.4028234663852886E+38 /end CHARACTERISTIC
/begin CHARACTERISTIC TQCMP_trqIncRASinHi_C "" VALUE 0x700116b0 Scalar_FLOAT32_IEEE 0 VBU0428Test_CM_single_Nm -3.4028234663852886E+38 3.4028234663852886E+38 /end CHARACTERISTIC
/begin CHARACTERISTIC TQCMP_trqIncRASinLo_C "" VALUE 0x700116b4 Scalar_FLOAT32_IEEE 0 VBU0428Test_CM_single_Nm -3.4028234663852886E+38 3.4028234663852886E+38 /end CHARACTERISTIC
/begin CHARACTERISTIC TQCMP_trqIncRATarSinHi_C "" VALUE 0x700116b8 Scalar_FLOAT32_IEEE 0 VBU0428Test_CM_single_Nm -3.4028234663852886E+38 3.4028234663852886E+38 /end CHARACTERISTIC
/begin CHARACTERISTIC TQCMP_trqIncRATarSinLo_C "" VALUE 0x700116bc Scalar_FLOAT32_IEEE 0 VBU0428Test_CM_single_Nm -3.4028234663852886E+38 3.4028234663852886E+38 /end CHARACTERISTIC
/begin CHARACTERISTIC TQCMP_trqIncSinOffsetRA_C "" VALUE 0x700116c0 Scalar_FLOAT32_IEEE 0 VBU0428Test_CM_single_Nm -3.4028234663852886E+38 3.4028234663852886E+38 /end CHARACTERISTIC
/begin CHARACTERISTIC TQDIS_facDenRA2_CUR_x "" VAL_BLK 0x70011bbc Scalar_FLOAT32_IEEE 0 VBU0428Test_CM_single_cnt -3.4028234663852886E+38 3.4028234663852886E+38 NUMBER 3 /end CHARACTERISTIC
/begin CHARACTERISTIC TQDIS_facDenRA_CUR_x "" VAL_BLK 0x70011bc8 Scalar_FLOAT32_IEEE 0 VBU0428Test_CM_single_cnt -3.4028234663852886E+38 3.4028234663852886E+38 NUMBER 3 /end CHARACTERISTIC
/begin CHARACTERISTIC TQDIS_facNumRA2_CUR_x "" VAL_BLK 0x70011bd4 Scalar_FLOAT32_IEEE 0 VBU0428Test_CM_single_cnt -3.4028234663852886E+38 3.4028234663852886E+38 NUMBER 3 /end CHARACTERISTIC
/begin CHARACTERISTIC TQDIS_facNumRA_CUR_x "" VAL_BLK 0x70011be0 Scalar_FLOAT32_IEEE 0 VBU0428Test_CM_single_cnt -3.4028234663852886E+38 3.4028234663852886E+38 NUMBER 3 /end CHARACTERISTIC
/begin CHARACTERISTIC TQDIS_tiSWResetDly_C "" VALUE 0x700117bc Scalar_FLOAT32_IEEE 0 VBU0428Test_CM_single_cnt -3.4028234663852886E+38 3.4028234663852886E+38 /end CHARACTERISTIC
/begin CHARACTERISTIC TQDIS_trqDecBrk_C "" VALUE 0x700117c8 Scalar_FLOAT32_IEEE 0 VBU0428Test_CM_single_cnt -3.4028234663852886E+38 3.4028234663852886E+38 /end CHARACTERISTIC
/begin CHARACTERISTIC TQDIS_trqDmpDeadZone_C "" VALUE 0x700117d0 Scalar_FLOAT32_IEEE 0 VBU0428Test_CM_single_cnt -3.4028234663852886E+38 3.4028234663852886E+38 /end CHARACTERISTIC
/begin CHARACTERISTIC TQDIS_trqIncBrk_C "" VALUE 0x700117d4 Scalar_FLOAT32_IEEE 0 VBU0428Test_CM_single_cnt -3.4028234663852886E+38 3.4028234663852886E+38 /end CHARACTERISTIC
/begin CHARACTERISTIC TQDIS_trqNumDenThdRABrkRgn_C "" VALUE 0x700117dc Scalar_FLOAT32_IEEE 0 VBU0428Test_CM_single_cnt -3.4028234663852886E+38 3.4028234663852886E+38 /end CHARACTERISTIC
/begin CHARACTERISTIC TQDIS_trqNumDenThdRA_C "" VALUE 0x700117e0 Scalar_FLOAT32_IEEE 0 VBU0428Test_CM_single_cnt -3.4028234663852886E+38 3.4028234663852886E+38 /end CHARACTERISTIC
/begin CHARACTERISTIC TQDIS_trqRADecMax_C "" VALUE 0x700117e4 Scalar_FLOAT32_IEEE 0 VBU0428Test_CM_single_cnt -3.4028234663852886E+38 3.4028234663852886E+38 /end CHARACTERISTIC
/begin CHARACTERISTIC TQDIS_trqRADecMin_C "" VALUE 0x700117e8 Scalar_FLOAT32_IEEE 0 VBU0428Test_CM_single_cnt -3.4028234663852886E+38 3.4028234663852886E+38 /end CHARACTERISTIC
/begin CHARACTERISTIC TQDIS_trqRAIncMax_C "" VALUE 0x700117ec Scalar_FLOAT32_IEEE 0 VBU0428Test_CM_single_cnt -3.4028234663852886E+38 3.4028234663852886E+38 /end CHARACTERISTIC
/begin CHARACTERISTIC TQDIS_trqRAIncMin_C "" VALUE 0x700117f0 Scalar_FLOAT32_IEEE 0 VBU0428Test_CM_single_cnt -3.4028234663852886E+38 3.4028234663852886E+38 /end CHARACTERISTIC
/begin CHARACTERISTIC TQDMP_facDenRA_CUR_x "" VAL_BLK 0x70011c04 Scalar_FLOAT32_IEEE 0 VBU0428Test_CM_single_cnt -3.4028234663852886E+38 3.4028234663852886E+38 NUMBER 3 /end CHARACTERISTIC
/begin CHARACTERISTIC TQDMP_facNumRA_CUR_x "" VAL_BLK 0x70011c10 Scalar_FLOAT32_IEEE 0 VBU0428Test_CM_single_cnt -3.4028234663852886E+38 3.4028234663852886E+38 NUMBER 3 /end CHARACTERISTIC
/begin CHARACTERISTIC TQDMP_facRAV2N_C "" VALUE 0x7001180c Scalar_FLOAT32_IEEE 0 VBU0428Test_CM_single_cnt -3.4028234663852886E+38 3.4028234663852886E+38 /end CHARACTERISTIC
/begin CHARACTERISTIC TQDMP_nRPMHysRA_C "" VALUE 0x70011810 Scalar_FLOAT32_IEEE 0 VBU0428Test_CM_single_cnt -3.4028234663852886E+38 3.4028234663852886E+38 /end CHARACTERISTIC
/begin CHARACTERISTIC TQDMP_pctDmpDisbThd_C "" VALUE 0x70011824 Scalar_FLOAT32_IEEE 0 VBU0428Test_CM_single_cnt -3.4028234663852886E+38 3.4028234663852886E+38 /end CHARACTERISTIC
/begin CHARACTERISTIC TQDMP_tiCalcChgLeadFilRA_C "" VALUE 0x70011848 Scalar_FLOAT32_IEEE 0 VBU0428Test_CM_single_cnt -3.4028234663852886E+38 3.4028234663852886E+38 /end CHARACTERISTIC
/begin CHARACTERISTIC TQDMP_trqDmpEnaThdRA_C "" VALUE 0x7001186c Scalar_FLOAT32_IEEE 0 VBU0428Test_CM_single_cnt -3.4028234663852886E+38 3.4028234663852886E+38 /end CHARACTERISTIC
/begin CHARACTERISTIC TQDMP_trqNumDenThdRA_C "" VALUE 0x70011878 Scalar_FLOAT32_IEEE 0 VBU0428Test_CM_single_cnt -3.4028234663852886E+38 3.4028234663852886E+38 /end CHARACTERISTIC
/begin CHARACTERISTIC TQO_ti10ms_SY "" VALUE 0x70011914 Scalar_FLOAT32_IEEE 0 VBU0428Test_CM_single_cnt -3.4028234663852886E+38 3.4028234663852886E+38 /end CHARACTERISTIC
/begin CHARACTERISTIC TQO_trqPTMax_C "" VALUE 0x70011920 Scalar_FLOAT32_IEEE 0 VBU0428Test_CM_single_cnt -3.4028234663852886E+38 3.4028234663852886E+38 /end CHARACTERISTIC
/begin CHARACTERISTIC TQO_trqRARgnMin_C "" VALUE 0x70011924 Scalar_FLOAT32_IEEE 0 VBU0428Test_CM_single_cnt -3.4028234663852886E+38 0.0 /end CHARACTERISTIC
/begin CHARACTERISTIC TQO_trqSftyDec_C "" VALUE 0x7001192c Scalar_FLOAT32_IEEE 0 VBU0428Test_CM_single_cnt -3.4028234663852886E+38 3.4028234663852886E+38 /end CHARACTERISTIC
/begin CHARACTERISTIC Veh_fHVILLe_C "" VALUE 0x700119e0 Scalar_FLOAT32_IEEE 0 VBU0428Test_CM_single_cnt -3.4028234663852886E+38 3.4028234663852886E+38 /end CHARACTERISTIC
/begin CHARACTERISTIC Veh_fHVILRi_C "" VALUE 0x700119e4 Scalar_FLOAT32_IEEE 0 VBU0428Test_CM_single_cnt -3.4028234663852886E+38 3.4028234663852886E+38 /end CHARACTERISTIC
/begin CHARACTERISTIC Veh_pctHVILLe_C "" VALUE 0x700119f8 Scalar_FLOAT32_IEEE 0 VBU0428Test_CM_single_cnt -3.4028234663852886E+38 3.4028234663852886E+38 /end CHARACTERISTIC
/begin CHARACTERISTIC Veh_pctHVILRi_C "" VALUE 0x700119fc Scalar_FLOAT32_IEEE 0 VBU0428Test_CM_single_cnt -3.4028234663852886E+38 3.4028234663852886E+38 /end CHARACTERISTIC
/begin CHARACTERISTIC Veh_tiVCUHVILDebounceCnt_C "" VALUE 0x70011a1c Scalar_FLOAT32_IEEE 0 VBU0428Test_CM_single_cnt -3.4028234663852886E+38 3.4028234663852886E+38 /end CHARACTERISTIC
/begin CHARACTERISTIC Veh_tiVehHVILDebounceCnt_C "" VALUE 0x70011a20 Scalar_FLOAT32_IEEE 0 VBU0428Test_CM_single_cnt -3.4028234663852886E+38 3.4028234663852886E+38 /end CHARACTERISTIC
/begin CHARACTERISTIC Veh_vVehHVILDefaultSpd_C "" VALUE 0x70011a24 Scalar_FLOAT32_IEEE 0 VBU0428Test_CM_single_cnt -3.4028234663852886E+38 3.4028234663852886E+38 /end CHARACTERISTIC
/begin CHARACTERISTIC Veh_vVehHVILDft_C "" VALUE 0x70011a28 Scalar_FLOAT32_IEEE 0 VBU0428Test_CM_single_cnt -3.4028234663852886E+38 3.4028234663852886E+38 /end CHARACTERISTIC
/begin CHARACTERISTIC CcBCV_BatteryCurrentZeroDriftTime_ms "" VALUE 0x7001002c Scalar_UWORD 0 VBU0428Test_CM_uint16_cnt 0.0 65535.0 /end CHARACTERISTIC
/begin CHARACTERISTIC CcCBL_BalanceStartDeltaVoltageHysteresis_mV "" VALUE 0x7001004c Scalar_UWORD 0 VBU0428Test_CM_uint16_cnt 0.0 65535.0 /end CHARACTERISTIC
/begin CHARACTERISTIC CcCBL_CellBalanceCurrentMax_mA "" VALUE 0x70010052 Scalar_UWORD 0 VBU0428Test_CM_uint16_cnt 0.0 65535.0 /end CHARACTERISTIC
/begin CHARACTERISTIC CcCBL_ChargeBalanceStartDeltaVoltage_mV "" VALUE 0x70010056 Scalar_UWORD 0 VBU0428Test_CM_uint16_cnt 0.0 65535.0 /end CHARACTERISTIC
/begin CHARACTERISTIC CcFCC_FullChargeOcvDebounceTime_s "" VALUE 0x700100a6 Scalar_UWORD 0 VBU0428Test_CM_uint16_cnt 0.0 65535.0 /end CHARACTERISTIC
/begin CHARACTERISTIC CcSYS_FullChargeOcv_mV "" VALUE 0x70010110 Scalar_UWORD 0 VBU0428Test_CM_uint16_cnt 0.0 65535.0 /end CHARACTERISTIC
/begin CHARACTERISTIC APD_flgFulPedalEnable_C "" VALUE 0x70021f02 Scalar_BOOLEAN 0 VBU0428Test_CM_boolean_cnt 0.0 1.0 /end CHARACTERISTIC
/begin CHARACTERISTIC CbFCC_ChargeVoltageOvR_flg "" VALUE 0x70022056 Scalar_BOOLEAN 0 VBU0428Test_CM_boolean_cnt 0.0 1.0 /end CHARACTERISTIC
/begin CHARACTERISTIC DCH_flgAllowNGearCh_C "" VALUE 0x700221fd Scalar_BOOLEAN 0 VBU0428Test_CM_boolean_cnt 0.0 1.0 /end CHARACTERISTIC
/begin CHARACTERISTIC EDIS_flgOverPwrLimNum_C "" VALUE 0x70022304 Scalar_BOOLEAN 0 VBU0428Test_CM_boolean_cnt 0.0 1.0 /end CHARACTERISTIC
/begin CHARACTERISTIC EDIS_flgUseEEPROMStroeVal_C "" VALUE 0x70022308 Scalar_BOOLEAN 0 VBU0428Test_CM_boolean_cnt 0.0 1.0 /end CHARACTERISTIC
/begin CHARACTERISTIC EDIS_flgUsePowSpPredict_C "" VALUE 0x70022309 Scalar_BOOLEAN 0 VBU0428Test_CM_boolean_cnt 0.0 1.0 /end CHARACTERISTIC
/begin CHARACTERISTIC Gear_flgCurrentGearDisplayInValid_C "" VALUE 0x7002233c Scalar_BOOLEAN 0 VBU0428Test_CM_boolean_cnt 0.0 1.0 /end CHARACTERISTIC
/begin CHARACTERISTIC Gear_flgCurrentGearDisplayValid_C "" VALUE 0x7002233d Scalar_BOOLEAN 0 VBU0428Test_CM_boolean_cnt 0.0 1.0 /end CHARACTERISTIC
/begin CHARACTERISTIC Gear_flgDisplayGearValidEn_C "" VALUE 0x7002233e Scalar_BOOLEAN 0 VBU0428Test_CM_boolean_cnt 0.0 1.0 /end CHARACTERISTIC
/begin CHARACTERISTIC Gear_flgIntendGearDisplayValid_C "" VALUE 0x70022342 Scalar_BOOLEAN 0 VBU0428Test_CM_boolean_cnt 0.0 1.0 /end CHARACTERISTIC
/begin CHARACTERISTIC PMM_flgVCUStpNMOvrdSwt_C "" VALUE 0x700223dd Scalar_BOOLEAN 0 VBU0428Test_CM_boolean_cnt 0.0 1.0 /end CHARACTERISTIC
/begin CHARACTERISTIC PMM_flgVCUStpNMOvrdVal_C "" VALUE 0x700223de Scalar_BOOLEAN 0 VBU0428Test_CM_boolean_cnt 0.0 1.0 /end CHARACTERISTIC
/begin CHARACTERISTIC STC_flgRgnPIEna_C "" VALUE 0x70022422 Scalar_BOOLEAN 0 VBU0428Test_CM_boolean_cnt 0.0 1.0 /end CHARACTERISTIC
/begin CHARACTERISTIC TQARB_flgTrqCompSwitch_C "" VALUE 0x70022443 Scalar_BOOLEAN 0 VBU0428Test_CM_boolean 0 1 /end CHARACTERISTIC
/begin CHARACTERISTIC TQDIS_flgABSDislFilter_C "" VALUE 0x7002244a Scalar_BOOLEAN 0 VBU0428Test_CM_boolean_cnt 0.0 1.0 /end CHARACTERISTIC
/begin CHARACTERISTIC TQDIS_flgDmpFilterRA2_C "" VALUE 0x7002244b Scalar_BOOLEAN 0 VBU0428Test_CM_boolean_cnt 0.0 1.0 /end CHARACTERISTIC
/begin CHARACTERISTIC TQDMP_flgLowFilterDnRA_C "" VALUE 0x7002244e Scalar_BOOLEAN 0 VBU0428Test_CM_boolean_cnt 0.0 1.0 /end CHARACTERISTIC
/begin CHARACTERISTIC TQDMP_flgRAVCUDmpEna_C "" VALUE 0x7002244f Scalar_BOOLEAN 0 VBU0428Test_CM_boolean_cnt 0.0 1.0 /end CHARACTERISTIC
/begin CHARACTERISTIC Veh_flgHVILCaliOvrdVal_C "" VALUE 0x70022478 Scalar_BOOLEAN 0 VBU0428Test_CM_boolean_cnt 0.0 1.0 /end CHARACTERISTIC
/begin CHARACTERISTIC Veh_flgHVILCaliOvrd_C "" VALUE 0x70022479 Scalar_BOOLEAN 0 VBU0428Test_CM_boolean_cnt 0.0 1.0 /end CHARACTERISTIC
/begin CHARACTERISTIC Veh_flgLowSpdGearChange_C "" VALUE 0x7002247b Scalar_BOOLEAN 0 VBU0428Test_CM_boolean_cnt 0.0 1.0 /end CHARACTERISTIC
/begin CHARACTERISTIC APD_stSelectPedal1_C "" VALUE 0x70021f05 Scalar_UBYTE 0 VBU0428Test_CM_uint8_cnt 0.0 15.0 /end CHARACTERISTIC
/begin CHARACTERISTIC APD_stSelectPedal2_C "" VALUE 0x70021f06 Scalar_UBYTE 0 VBU0428Test_CM_uint8_cnt 0.0 15.0 /end CHARACTERISTIC
/begin CHARACTERISTIC APD_stSelectPedalDefault_C "" VALUE 0x70021f07 Scalar_UBYTE 0 VBU0428Test_CM_uint8_cnt 0.0 15.0 /end CHARACTERISTIC
/begin CHARACTERISTIC APD_stSelectPedalMin_C "" VALUE 0x70021f08 Scalar_UBYTE 0 VBU0428Test_CM_uint8_cnt 0.0 15.0 /end CHARACTERISTIC
/begin CHARACTERISTIC APD_stSelectPedalORV "" VALUE 0x70021f09 Scalar_UBYTE 0 VBU0428Test_CM_uint8 0 255 /end CHARACTERISTIC
/begin CHARACTERISTIC CaFCC_FullChargeVoltageDCIRMapDimension_n "" VAL_BLK 0x70022488 Scalar_UBYTE 0 VBU0428Test_CM_uint8_cnt 0.0 255.0 NUMBER 2 /end CHARACTERISTIC
/begin CHARACTERISTIC CaFCC_FullChargeVoltageHysteresisMapDimension_n "" VAL_BLK 0x7002248a Scalar_UBYTE 0 VBU0428Test_CM_uint8_cnt 0.0 255.0 NUMBER 2 /end CHARACTERISTIC
/begin CHARACTERISTIC CaFCC_FullChargeVoltagePolarizaitonMapDimension_n "" VAL_BLK 0x7002248c Scalar_UBYTE 0 VBU0428Test_CM_uint8_cnt 0.0 255.0 NUMBER 2 /end CHARACTERISTIC
/begin CHARACTERISTIC CaFCC_FullChargeVoltageSOHAttenuationMapDimension_n "" VAL_BLK 0x7002248e Scalar_UBYTE 0 VBU0428Test_CM_uint8_cnt 0.0 255.0 NUMBER 2 /end CHARACTERISTIC
/begin CHARACTERISTIC CaSYS_FullChargeOcvMapDimension_n "" VAL_BLK 0x70022496 Scalar_UBYTE 0 VBU0428Test_CM_uint8_cnt 0.0 255.0 NUMBER 2 /end CHARACTERISTIC
/begin CHARACTERISTIC DCH_stBEM00TOutMSK_SY "" VALUE 0x70022288 Scalar_UBYTE 0 VBU0428Test_CM_uint8_cnt 0.0 255.0 /end CHARACTERISTIC
/begin CHARACTERISTIC DCH_stBEMAATOutMSK_SY "" VALUE 0x70022289 Scalar_UBYTE 0 VBU0428Test_CM_uint8_cnt 0.0 255.0 /end CHARACTERISTIC
/begin CHARACTERISTIC DCH_stBEMChCapTOutMSK_SY "" VALUE 0x7002228a Scalar_UBYTE 0 VBU0428Test_CM_uint8_cnt 0.0 255.0 /end CHARACTERISTIC
/begin CHARACTERISTIC DCH_stBEMChRdyTOutMSK_SY "" VALUE 0x7002228c Scalar_UBYTE 0 VBU0428Test_CM_uint8_cnt 0.0 255.0 /end CHARACTERISTIC
/begin CHARACTERISTIC DCH_stBEMChStTOutMSK_SY "" VALUE 0x7002228e Scalar_UBYTE 0 VBU0428Test_CM_uint8_cnt 0.0 255.0 /end CHARACTERISTIC
/begin CHARACTERISTIC DCH_stBEMChgrStopTOutMSK_SY "" VALUE 0x70022290 Scalar_UBYTE 0 VBU0428Test_CM_uint8_cnt 0.0 255.0 /end CHARACTERISTIC
/begin CHARACTERISTIC DCH_stBEMStatsDataTOutMSK_SY "" VALUE 0x70022294 Scalar_UBYTE 0 VBU0428Test_CM_uint8_cnt 0.0 255.0 /end CHARACTERISTIC
/begin CHARACTERISTIC DCH_stBMSChCmpt_SY "" VALUE 0x70022296 Scalar_UBYTE 0 VBU0428Test_CM_uint8_cnt 0.0 255.0 /end CHARACTERISTIC
/begin CHARACTERISTIC DCH_stCDCStopCharging_SY "" VALUE 0x7002229e Scalar_UBYTE 0 VBU0428Test_CM_uint8_cnt 0.0 255.0 /end CHARACTERISTIC
/begin CHARACTERISTIC DCH_stCurrDismatchErrMSK_SY "" VALUE 0x700222aa Scalar_UBYTE 0 VBU0428Test_CM_uint8_cnt 0.0 255.0 /end CHARACTERISTIC
/begin CHARACTERISTIC DCH_stEnergNotTrnsmtFultMSK_SY "" VALUE 0x700222ac Scalar_UBYTE 0 VBU0428Test_CM_uint8_cnt 0.0 255.0 /end CHARACTERISTIC
/begin CHARACTERISTIC DCH_stFaultStopMSK_SY "" VALUE 0x700222ad Scalar_UBYTE 0 VBU0428Test_CM_uint8_cnt 0.0 255.0 /end CHARACTERISTIC
/begin CHARACTERISTIC DCH_stKeyRaw_SY "" VALUE 0x700222b3 Scalar_UBYTE 0 VBU0428Test_CM_uint8_cnt 0.0 255.0 /end CHARACTERISTIC
/begin CHARACTERISTIC DCH_stNGear_SY "" VALUE 0x700222b5 Scalar_UBYTE 0 VBU0428Test_CM_uint8_cnt 0.0 255.0 /end CHARACTERISTIC
/begin CHARACTERISTIC DCH_stOtherStaStpFultMSK_SY "" VALUE 0x700222b9 Scalar_UBYTE 0 VBU0428Test_CM_uint8_cnt 0.0 255.0 /end CHARACTERISTIC
/begin CHARACTERISTIC DCH_stPGear_SY "" VALUE 0x700222ba Scalar_UBYTE 0 VBU0428Test_CM_uint8_cnt 0.0 255.0 /end CHARACTERISTIC
/begin CHARACTERISTIC DCH_stStaCntorFultMSK_SY "" VALUE 0x700222be Scalar_UBYTE 0 VBU0428Test_CM_uint8_cnt 0.0 255.0 /end CHARACTERISTIC
/begin CHARACTERISTIC DCH_stStaEmergStpFultMSK_SY "" VALUE 0x700222bf Scalar_UBYTE 0 VBU0428Test_CM_uint8_cnt 0.0 255.0 /end CHARACTERISTIC
/begin CHARACTERISTIC DCH_stStaIntOverTempFultMSK_SY "" VALUE 0x700222c0 Scalar_UBYTE 0 VBU0428Test_CM_uint8_cnt 0.0 255.0 /end CHARACTERISTIC
/begin CHARACTERISTIC DCH_stStaOverTempFaultMSK_SY "" VALUE 0x700222c1 Scalar_UBYTE 0 VBU0428Test_CM_uint8_cnt 0.0 255.0 /end CHARACTERISTIC
/begin CHARACTERISTIC DCH_stStaStopCondReachMSK_SY "" VALUE 0x700222c2 Scalar_UBYTE 0 VBU0428Test_CM_uint8_cnt 0.0 255.0 /end CHARACTERISTIC
/begin CHARACTERISTIC DCH_stSysIsoCriticalFault_SY "" VALUE 0x700222d4 Scalar_UBYTE 0 VBU0428Test_CM_uint8_cnt 0.0 255.0 /end CHARACTERISTIC
/begin CHARACTERISTIC DCH_stVehIsoCriticalFault_SY "" VALUE 0x700222d6 Scalar_UBYTE 0 VBU0428Test_CM_uint8_cnt 0.0 255.0 /end CHARACTERISTIC
/begin CHARACTERISTIC DCH_stVehSoftwUpdate_SY "" VALUE 0x700222d7 Scalar_UBYTE 0 VBU0428Test_CM_uint8_cnt 0.0 255.0 /end CHARACTERISTIC
/begin CHARACTERISTIC DCH_stVoltAbnormalErrMSK_SY "" VALUE 0x700222d8 Scalar_UBYTE 0 VBU0428Test_CM_uint8_cnt 0.0 255.0 /end CHARACTERISTIC
/begin CHARACTERISTIC DSPL_stEnergyConsumptionCaled_C "" VALUE 0x700222f6 Scalar_UBYTE 0 VBU0428Test_CM_uint8_cnt 0.0 255.0 /end CHARACTERISTIC
/begin CHARACTERISTIC DSPL_stEnergyConsumptionProcess_C "" VALUE 0x700222f7 Scalar_UBYTE 0 VBU0428Test_CM_uint8_cnt 0.0 255.0 /end CHARACTERISTIC
/begin CHARACTERISTIC Gear_stDriveIntendGearD_C "" VALUE 0x7002234b Scalar_UBYTE 0 VBU0428Test_CM_uint8_cnt 0.0 15.0 /end CHARACTERISTIC
/begin CHARACTERISTIC Gear_stDriveIntendGearInvalid_C "" VALUE 0x7002234c Scalar_UBYTE 0 VBU0428Test_CM_uint8_cnt 0.0 15.0 /end CHARACTERISTIC
/begin CHARACTERISTIC Gear_stDriveIntendGearNeutral_C "" VALUE 0x7002234d Scalar_UBYTE 0 VBU0428Test_CM_uint8_cnt 0.0 15.0 /end CHARACTERISTIC
/begin CHARACTERISTIC Gear_stDriveIntendGearR_C "" VALUE 0x7002234e Scalar_UBYTE 0 VBU0428Test_CM_uint8_cnt 0.0 15.0 /end CHARACTERISTIC
/begin CHARACTERISTIC Gear_stGearDValidBit1_C "" VALUE 0x70022356 Scalar_UBYTE 0 VBU0428Test_CM_uint8_cnt 0.0 255.0 /end CHARACTERISTIC
/begin CHARACTERISTIC Gear_stGearNValid_C "" VALUE 0x70022357 Scalar_UBYTE 0 VBU0428Test_CM_uint8_cnt 0.0 255.0 /end CHARACTERISTIC
/begin CHARACTERISTIC Gear_stGearRValidBit1_C "" VALUE 0x70022358 Scalar_UBYTE 0 VBU0428Test_CM_uint8_cnt 0.0 255.0 /end CHARACTERISTIC
/begin CHARACTERISTIC Gear_stIntendGearD_C "" VALUE 0x7002235a Scalar_UBYTE 0 VBU0428Test_CM_uint8_cnt 0.0 15.0 /end CHARACTERISTIC
/begin CHARACTERISTIC Gear_stIntendGearN_C "" VALUE 0x7002235b Scalar_UBYTE 0 VBU0428Test_CM_uint8_cnt 0.0 15.0 /end CHARACTERISTIC
/begin CHARACTERISTIC Gear_stIntendGearR_C "" VALUE 0x7002235d Scalar_UBYTE 0 VBU0428Test_CM_uint8_cnt 0.0 15.0 /end CHARACTERISTIC
/begin CHARACTERISTIC PMM_stAPlushld_SY "" VALUE 0x700223e7 Scalar_UBYTE 0 VBU0428Test_CM_uint8_cnt 0.0 255.0 /end CHARACTERISTIC
/begin CHARACTERISTIC Veh_stErr_C "" VALUE 0x70022480 Scalar_UBYTE 0 VBU0428Test_CM_uint8_cnt 0.0 15.0 /end CHARACTERISTIC
/begin CHARACTERISTIC Veh_stNoErr_C "" VALUE 0x70022484 Scalar_UBYTE 0 VBU0428Test_CM_uint8_cnt 0.0 15.0 /end CHARACTERISTIC
/begin MEASUREMENT AVAS_SoftwareVersion "" ULONG VBU0428Test_CM_uint32 0 0 0 4294967295 ECU_ADDRESS 0x6003bf02 /end MEASUREMENT
/begin MEASUREMENT T_BOXGPS_Latitude "" ULONG VBU0428Test_CM_ufix28 0 0 0 2.68435455E+8 ECU_ADDRESS 0x6003bfda /end MEASUREMENT
/begin MEASUREMENT T_BOXGPS_Longitude "" ULONG VBU0428Test_CM_ufix28 0 0 0 2.68435455E+8 ECU_ADDRESS 0x6003bfde /end MEASUREMENT
/begin MEASUREMENT IC_VehOdometer "" ULONG VBU0428Test_CM_ufix24 0 0 0 1.6777215E+7 ECU_ADDRESS 0x6003bf8e /end MEASUREMENT
/begin MEASUREMENT INP_uBrkPresFlt1 "" FLOAT32_IEEE VBU0428Test_CM_single 0 0 -3.4E+38 3.4E+38 ECU_ADDRESS 0x90000154 /end MEASUREMENT
/begin MEASUREMENT SPD_vFA "" FLOAT32_IEEE VBU0428Test_CM_single 0 0 -3.4E+38 3.4E+38 ECU_ADDRESS 0x6003bc82 /end MEASUREMENT
/begin MEASUREMENT SPD_vRA "" FLOAT32_IEEE VBU0428Test_CM_single 0 0 -3.4E+38 3.4E+38 ECU_ADDRESS 0x6003bc8a /end MEASUREMENT
/begin MEASUREMENT SPD_vVehSpd "" FLOAT32_IEEE VBU0428Test_CM_single 0 0 -3.4E+38 3.4E+38 ECU_ADDRESS 0x6003bc8e /end MEASUREMENT
/begin MEASUREMENT APD_pctAPDbasic "" FLOAT32_IEEE VBU0428Test_CM_single 0 0 -3.4E+38 3.4E+38 ECU_ADDRESS 0x6003bace /end MEASUREMENT
/begin MEASUREMENT MTQL_trqVehSpdDrvLimR "" FLOAT32_IEEE VBU0428Test_CM_single 0 0 -10000.0 10000.0 ECU_ADDRESS 0x6003be5e /end MEASUREMENT
/begin MEASUREMENT TQDMP_trqDmpRA "" FLOAT32_IEEE VBU0428Test_CM_single 0 0 -10000.0 10000.0 ECU_ADDRESS 0x6003bd66 /end MEASUREMENT
/begin MEASUREMENT TQDMP_dnMotrR "" FLOAT32_IEEE VBU0428Test_CM_single 0 0 -3.4E+38 3.4E+38 ECU_ADDRESS 0x6003bd4a /end MEASUREMENT
/begin MEASUREMENT TQDMP_trqCompRA0 "" FLOAT32_IEEE VBU0428Test_CM_single 0 0 -10000.0 10000.0 ECU_ADDRESS 0x6003bd5a /end MEASUREMENT
/begin MEASUREMENT TQO_trqSftyRA "" FLOAT32_IEEE VBU0428Test_CM_single 0 0 -10000.0 10000.0 ECU_ADDRESS 0x6003bd9e /end MEASUREMENT
/begin MEASUREMENT TQO_facShftChangeLo "" FLOAT32_IEEE VBU0428Test_CM_single 0 0 0.0 1.0 ECU_ADDRESS 0x6003bd92 /end MEASUREMENT
/begin MEASUREMENT TQDIS_trqRMotrDir "" FLOAT32_IEEE VBU0428Test_CM_single 0 0 -10000.0 10000.0 ECU_ADDRESS 0x6003bd42 /end MEASUREMENT
/begin MEASUREMENT TQO_trqRMotr "" FLOAT32_IEEE VBU0428Test_CM_single 0 0 -10000.0 10000.0 ECU_ADDRESS 0x6003bd9a /end MEASUREMENT
/begin MEASUREMENT TQARB_trqPreFnlRA "" FLOAT32_IEEE VBU0428Test_CM_single 0 0 -10000.0 10000.0 ECU_ADDRESS 0x6003bcc2 /end MEASUREMENT
/begin MEASUREMENT TQARB_trqPreDisPropRA "" FLOAT32_IEEE VBU0428Test_CM_single 0 0 -10000.0 10000.0 ECU_ADDRESS 0x6003bcba /end MEASUREMENT
/begin MEASUREMENT TQARB_trqPreDisRgnRA "" FLOAT32_IEEE VBU0428Test_CM_single 0 0 -10000.0 10000.0 ECU_ADDRESS 0x6003bcbe /end MEASUREMENT
/begin MEASUREMENT STC_trqRgnPIRA "" FLOAT32_IEEE VBU0428Test_CM_single 0 0 -10000.0 10000.0 ECU_ADDRESS 0x6003bc9e /end MEASUREMENT
/begin MEASUREMENT TQCMP_trqSinFnlRA "" FLOAT32_IEEE VBU0428Test_CM_single 0 0 -10000.0 10000.0 ECU_ADDRESS 0x6003bcc6 /end MEASUREMENT
/begin MEASUREMENT TQDIS_trqRAIncLim "" FLOAT32_IEEE VBU0428Test_CM_single 0 0 -10000.0 10000.0 ECU_ADDRESS 0x6003bd32 /end MEASUREMENT
/begin MEASUREMENT TQDIS_trqRADecLim "" FLOAT32_IEEE VBU0428Test_CM_single 0 0 -10000.0 10000.0 ECU_ADDRESS 0x6003bd26 /end MEASUREMENT
/begin MEASUREMENT TQDIS_trqFltRA "" FLOAT32_IEEE VBU0428Test_CM_single 0 0 -10000.0 10000.0 ECU_ADDRESS 0x6003bd12 /end MEASUREMENT
/begin MEASUREMENT TQDIS_trqDmpRA0 "" FLOAT32_IEEE VBU0428Test_CM_single 0 0 -10000.0 10000.0 ECU_ADDRESS 0x6003bd02 /end MEASUREMENT
/begin MEASUREMENT TQDIS_trqDmpRA1 "" FLOAT32_IEEE VBU0428Test_CM_single 0 0 -10000.0 10000.0 ECU_ADDRESS 0x6003bd06 /end MEASUREMENT
/begin MEASUREMENT TQDIS_trqBrkRgnRALim "" FLOAT32_IEEE VBU0428Test_CM_single 0 0 -10000.0 10000.0 ECU_ADDRESS 0x6003bcea /end MEASUREMENT
/begin MEASUREMENT TQDIS_trqBrkRgnFilterRA "" FLOAT32_IEEE VBU0428Test_CM_single 0 0 -10000.0 10000.0 ECU_ADDRESS 0x6003bce6 /end MEASUREMENT
/begin MEASUREMENT TQDIS_trqDmpRA2 "" FLOAT32_IEEE VBU0428Test_CM_single 0 0 -10000.0 10000.0 ECU_ADDRESS 0x6003bd0a /end MEASUREMENT
/begin MEASUREMENT TQDIS_trqPreDisCstRgnReqRA "" FLOAT32_IEEE VBU0428Test_CM_single 0 0 -10000.0 10000.0 ECU_ADDRESS 0x6003bd1a /end MEASUREMENT
/begin MEASUREMENT TQDIS_trqCstRgnFnlRA "" FLOAT32_IEEE VBU0428Test_CM_single 0 0 -10000.0 10000.0 ECU_ADDRESS 0x6003bcfe /end MEASUREMENT
/begin MEASUREMENT EDIS_pwrDownStep "" FLOAT32_IEEE VBU0428Test_CM_single 0 0 -1000.0 1000.0 ECU_ADDRESS 0x6003be06 /end MEASUREMENT
/begin MEASUREMENT EDIS_pwrUpStep "" FLOAT32_IEEE VBU0428Test_CM_single 0 0 -1000.0 1000.0 ECU_ADDRESS 0x6003be2e /end MEASUREMENT
/begin MEASUREMENT EDIS_pwrDownStepCh "" FLOAT32_IEEE VBU0428Test_CM_single 0 0 -3.4E+38 3.4E+38 ECU_ADDRESS 0x6003bb5a /end MEASUREMENT
/begin MEASUREMENT EDIS_pwrUpStepCh "" FLOAT32_IEEE VBU0428Test_CM_single 0 0 -3.4E+38 3.4E+38 ECU_ADDRESS 0x6003bb62 /end MEASUREMENT
/begin MEASUREMENT EDIS_pwrDrvPwrLimFilter "" FLOAT32_IEEE VBU0428Test_CM_single 0 0 0.0 1000.0 ECU_ADDRESS 0x6003be0e /end MEASUREMENT
/begin MEASUREMENT EDIS_pwrChDynSp "" FLOAT32_IEEE VBU0428Test_CM_single 0 0 -3.4E+38 3.4E+38 ECU_ADDRESS 0x6003bb46 /end MEASUREMENT
/begin MEASUREMENT EDIS_pwrChSp "" FLOAT32_IEEE VBU0428Test_CM_single 0 0 -3.4E+38 3.4E+38 ECU_ADDRESS 0x6003bb4a /end MEASUREMENT
/begin MEASUREMENT PEUR_uDCRlyOutsideVltg "" FLOAT32_IEEE VBU0428Test_CM_single 0 0 -3.4E+38 3.4E+38 ECU_ADDRESS 0x9000016c /end MEASUREMENT
/begin MEASUREMENT BCU_vWhlRL "" FLOAT32_IEEE VBU0428Test_CM_single 0 0 -3.4E+38 3.4E+38 ECU_ADDRESS 0x6003bf06 /end MEASUREMENT
/begin MEASUREMENT BCU_vWhlRR "" FLOAT32_IEEE VBU0428Test_CM_single 0 0 -3.4E+38 3.4E+38 ECU_ADDRESS 0x6003bf0a /end MEASUREMENT
/begin MEASUREMENT PEUR_stActvDisCh "" FLOAT32_IEEE VBU0428Test_CM_single 0 0 -3.4E+38 3.4E+38 ECU_ADDRESS 0x6003bfba /end MEASUREMENT
/begin MEASUREMENT PEUR_nMotr "" FLOAT32_IEEE VBU0428Test_CM_single 0 0 -3.4E+38 3.4E+38 ECU_ADDRESS 0x6003bfb6 /end MEASUREMENT
/begin MEASUREMENT PEUR_iCalcDC "" FLOAT32_IEEE VBU0428Test_CM_single 0 0 -1000.0 1000.0 ECU_ADDRESS 0x6003bbae /end MEASUREMENT
/begin MEASUREMENT VCT_uMaximumPermitChargeCellVoltage "" FLOAT32_IEEE VBU0428Test_CM_single 0 0 -3.4E+38 3.4E+38 ECU_ADDRESS 0x900000d8 /end MEASUREMENT
/begin MEASUREMENT VCT_iABMSDischgCurrentLimit "" FLOAT32_IEEE VBU0428Test_CM_single 0 0 -3.4E+38 3.4E+38 ECU_ADDRESS 0x6003bff6 /end MEASUREMENT
/begin MEASUREMENT VCT_uBMSVoltageLimitMax "" FLOAT32_IEEE VBU0428Test_CM_single 0 0 -3.4E+38 3.4E+38 ECU_ADDRESS 0x900000cc /end MEASUREMENT
/begin MEASUREMENT VCT_uBMSVoltageLimitMin "" FLOAT32_IEEE VBU0428Test_CM_single 0 0 -3.4E+38 3.4E+38 ECU_ADDRESS 0x900000d0 /end MEASUREMENT
/begin MEASUREMENT VCT_iABMSPackCrnt "" FLOAT32_IEEE VBU0428Test_CM_single 0 0 -3.4E+38 3.4E+38 ECU_ADDRESS 0x6003bffa /end MEASUREMENT
/begin MEASUREMENT VCT_uBMSPackVoltage "" FLOAT32_IEEE VBU0428Test_CM_single 0 0 -3.4E+38 3.4E+38 ECU_ADDRESS 0x900000c8 /end MEASUREMENT
/begin MEASUREMENT VCT_pctBMSSOC "" FLOAT32_IEEE VBU0428Test_CM_single 0 0 -3.4E+38 3.4E+38 ECU_ADDRESS 0x90000078 /end MEASUREMENT
/begin MEASUREMENT VCT_numBMSRollingCounter225 "" FLOAT32_IEEE VBU0428Test_CM_single 0 0 -3.4E+38 3.4E+38 ECU_ADDRESS 0x90000068 /end MEASUREMENT
/begin MEASUREMENT VCT_pctBMSCustomerUsageSOC "" FLOAT32_IEEE VBU0428Test_CM_single 0 0 -3.4E+38 3.4E+38 ECU_ADDRESS 0x90000070 /end MEASUREMENT
/begin MEASUREMENT VCT_tBMSTemperatureMax "" FLOAT32_IEEE VBU0428Test_CM_single 0 0 -3.4E+38 3.4E+38 ECU_ADDRESS 0x90000098 /end MEASUREMENT
/begin MEASUREMENT VCT_tBMSTemperatureMin "" FLOAT32_IEEE VBU0428Test_CM_single 0 0 -3.4E+38 3.4E+38 ECU_ADDRESS 0x9000009c /end MEASUREMENT
/begin MEASUREMENT VCT_tBMSInletWaterTemp "" FLOAT32_IEEE VBU0428Test_CM_single 0 0 -3.4E+38 3.4E+38 ECU_ADDRESS 0x90000084 /end MEASUREMENT
/begin MEASUREMENT VCT_tBMSOutletWaterTemp "" FLOAT32_IEEE VBU0428Test_CM_single 0 0 -3.4E+38 3.4E+38 ECU_ADDRESS 0x90000090 /end MEASUREMENT
/begin MEASUREMENT VCT_tBMSTemperatureAverage "" FLOAT32_IEEE VBU0428Test_CM_single 0 0 -3.4E+38 3.4E+38 ECU_ADDRESS 0x90000094 /end MEASUREMENT
/begin MEASUREMENT VCT_tBMSCellTempStandardDeviation "" FLOAT32_IEEE VBU0428Test_CM_single 0 0 -3.4E+38 3.4E+38 ECU_ADDRESS 0x9000007c /end MEASUREMENT
/begin MEASUREMENT VCT_tBMSInletTempRequest "" FLOAT32_IEEE VBU0428Test_CM_single 0 0 -3.4E+38 3.4E+38 ECU_ADDRESS 0x90000080 /end MEASUREMENT
/begin MEASUREMENT VCT_iAMaximumChargingCurrent "" FLOAT32_IEEE VBU0428Test_CM_single 0 0 -3.4E+38 3.4E+38 ECU_ADDRESS 0x90000040 /end MEASUREMENT
/begin MEASUREMENT VCT_kWhBatteryNomalCapacity "" FLOAT32_IEEE VBU0428Test_CM_single 0 0 -3.4E+38 3.4E+38 ECU_ADDRESS 0x90000224 /end MEASUREMENT
/begin MEASUREMENT VCT_uMaximumChargingVoltage "" FLOAT32_IEEE VBU0428Test_CM_single 0 0 -3.4E+38 3.4E+38 ECU_ADDRESS 0x900000d4 /end MEASUREMENT
/begin MEASUREMENT VCT_tMaximumPermitTemp "" FLOAT32_IEEE VBU0428Test_CM_single 0 0 -3.4E+38 3.4E+38 ECU_ADDRESS 0x900000a0 /end MEASUREMENT
/begin MEASUREMENT VCT_HVBattStopDchaThd_pct "" FLOAT32_IEEE VBU0428Test_CM_single 0 0 -3.4E+38 3.4E+38 ECU_ADDRESS 0x6003bfe6 /end MEASUREMENT
/begin MEASUREMENT VCT_numBMSRollingCounterAF "" FLOAT32_IEEE VBU0428Test_CM_single 0 0 -3.4E+38 3.4E+38 ECU_ADDRESS 0x9000006c /end MEASUREMENT
/begin MEASUREMENT AVAS_HardwareVersion "" UWORD VBU0428Test_CM_uint16 0 0 0 65535 ECU_ADDRESS 0x9000149e /end MEASUREMENT
/begin MEASUREMENT ACCompActSpeed "" UWORD VBU0428Test_CM_uint16 0 0 0 65535 ECU_ADDRESS 0x9000149c /end MEASUREMENT
/begin MEASUREMENT FCC_mvFullChargeCellVoltage "" UWORD VBU0428Test_CM_uint16 0 0 0 65535 ECU_ADDRESS 0x900016e6 /end MEASUREMENT
/begin MEASUREMENT FCC_mvFullChargeDisbaleCellVoltage "" UWORD VBU0428Test_CM_uint16 0 0 0 65535 ECU_ADDRESS 0x900016e8 /end MEASUREMENT
/begin MEASUREMENT EPS_Steering_Angle "" UWORD VBU0428Test_CM_ufix16_Sp1_Bn1080 0 0 -1080.0 5473.5 ECU_ADDRESS 0x90001644 /end MEASUREMENT
/begin MEASUREMENT EPS_TORque_Motor "" UWORD VBU0428Test_CM_ufix16_Sp001_Bn20 0 0 -20.0 45.535 ECU_ADDRESS 0x90001646 /end MEASUREMENT
/begin MEASUREMENT DragForce "" UWORD VBU0428Test_CM_ufix16_En3 0 0 0 8191.875 ECU_ADDRESS 0x90001642 /end MEASUREMENT
/begin MEASUREMENT MCU_MotorSpeed "" UWORD VBU0428Test_CM_ufix16_Bn30000 0 0 -30000.0 35535.0 ECU_ADDRESS 0x9000168e /end MEASUREMENT
/begin MEASUREMENT MCU_AllowMaxTorque "" UWORD VBU0428Test_CM_ufix14_Sp1_Bn450 0 0 -450.0 1188.3000000000002 ECU_ADDRESS 0x90001686 /end MEASUREMENT
/begin MEASUREMENT MCU_MotorTorque "" UWORD VBU0428Test_CM_ufix14_Sp1_Bn450 0 0 -450.0 1188.3000000000002 ECU_ADDRESS 0x90001690 /end MEASUREMENT
/begin MEASUREMENT ABS_WheelSpeed_RL "" UWORD VBU0428Test_CM_ufix13_Sp05625 0 0 0 460.74375000000003 ECU_ADDRESS 0x90001498 /end MEASUREMENT
/begin MEASUREMENT ABS_WheelSpeed_RR "" UWORD VBU0428Test_CM_ufix13_Sp05625 0 0 0 460.74375000000003 ECU_ADDRESS 0x9000149a /end MEASUREMENT
/begin MEASUREMENT ABS_WheelSpeed_FL "" UWORD VBU0428Test_CM_ufix13_Sp05625 0 0 0 460.74375000000003 ECU_ADDRESS 0x90001494 /end MEASUREMENT
/begin MEASUREMENT ABS_WheelSpeed_FR "" UWORD VBU0428Test_CM_ufix13_Sp05625 0 0 0 460.74375000000003 ECU_ADDRESS 0x90001496 /end MEASUREMENT
/begin MEASUREMENT ABS_VehicleSpeed "" UWORD VBU0428Test_CM_ufix13_Sp05625 0 0 0 460.74375000000003 ECU_ADDRESS 0x9000148a /end MEASUREMENT
/begin MEASUREMENT DCDCOutputCurrent "" UWORD VBU0428Test_CM_ufix12_Sp1 0 0 0 409.5 ECU_ADDRESS 0x9000163e /end MEASUREMENT
/begin MEASUREMENT MCU_CalDCCurrent "" UWORD VBU0428Test_CM_ufix12 0 0 0 4095.0 ECU_ADDRESS 0x90001688 /end MEASUREMENT
/begin MEASUREMENT DCDCOutputVoltage "" UWORD VBU0428Test_CM_ufix10_Sp1 0 0 0 102.30000000000001 ECU_ADDRESS 0x90001640 /end MEASUREMENT
/begin MEASUREMENT DCDCInputVoltage "" UWORD VBU0428Test_CM_ufix10 0 0 0 1023.0 ECU_ADDRESS 0x9000163c /end MEASUREMENT
/begin MEASUREMENT ABS_WheelSpeedPlusCounter_FL "" UWORD VBU0428Test_CM_ufix10 0 0 0 1023.0 ECU_ADDRESS 0x9000148c /end MEASUREMENT
/begin MEASUREMENT ABS_WheelSpeedPlusCounter_FR "" UWORD VBU0428Test_CM_ufix10 0 0 0 1023.0 ECU_ADDRESS 0x9000148e /end MEASUREMENT
/begin MEASUREMENT ABS_WheelSpeedPlusCounter_RL "" UWORD VBU0428Test_CM_ufix10 0 0 0 1023.0 ECU_ADDRESS 0x90001490 /end MEASUREMENT
/begin MEASUREMENT ABS_WheelSpeedPlusCounter_RR "" UWORD VBU0428Test_CM_ufix10 0 0 0 1023.0 ECU_ADDRESS 0x90001492 /end MEASUREMENT
/begin MEASUREMENT MCU_DCRelayOutSideVoltage "" UWORD VBU0428Test_CM_ufix10 0 0 0 1023.0 ECU_ADDRESS 0x9000168a /end MEASUREMENT
/begin MEASUREMENT MCU_DC_BUSVoltage "" UWORD VBU0428Test_CM_ufix10 0 0 0 1023.0 ECU_ADDRESS 0x9000168c /end MEASUREMENT
/begin MEASUREMENT APD_stPedalSelect "" UBYTE VBU0428Test_CM_uint8 0 0 0.0 15.0 ECU_ADDRESS 0x90001d60 /end MEASUREMENT
/begin MEASUREMENT CGW_stVehCreepMode "" UBYTE VBU0428Test_CM_uint8 0 0 0.0 15.0 ECU_ADDRESS 0x90001d63 /end MEASUREMENT
/begin MEASUREMENT Gear_stCurrentGear "" UBYTE VBU0428Test_CM_uint8 0 0 0.0 15.0 ECU_ADDRESS 0x90001d71 /end MEASUREMENT
/begin MEASUREMENT Gear_stTargetGear "" UBYTE VBU0428Test_CM_uint8 0 0 0.0 15.0 ECU_ADDRESS 0x90001d72 /end MEASUREMENT
/begin MEASUREMENT Gear_stDriveIntendGearRawDigital "" UBYTE VBU0428Test_CM_uint8 0 0 0.0 15.0 ECU_ADDRESS 0x90001d1f /end MEASUREMENT
/begin MEASUREMENT LVC_stDCDCEnaResp "" UBYTE VBU0428Test_CM_uint8 0 0 0.0 255.0 ECU_ADDRESS 0x90001d2f /end MEASUREMENT
/begin MEASUREMENT LVC_stDCDCDisblResp "" UBYTE VBU0428Test_CM_uint8 0 0 0.0 255.0 ECU_ADDRESS 0x90001d2e /end MEASUREMENT
/begin MEASUREMENT CDC_stRgnMode "" UBYTE VBU0428Test_CM_uint8 0 0 0 255 ECU_ADDRESS 0x90001f94 /end MEASUREMENT
/begin MEASUREMENT CDC_stDrvMode "" UBYTE VBU0428Test_CM_uint8 0 0 0 255 ECU_ADDRESS 0x90001f67 /end MEASUREMENT
/begin MEASUREMENT CDC_checksum "" UBYTE VBU0428Test_CM_uint8 0 0 0 255 ECU_ADDRESS 0x90001dcd /end MEASUREMENT
/begin MEASUREMENT ABS_Checksum "" UBYTE VBU0428Test_CM_uint8 0 0 0 255 ECU_ADDRESS 0x90001d89 /end MEASUREMENT
/begin MEASUREMENT MCU_checksum "" UBYTE VBU0428Test_CM_uint8 0 0 0 255 ECU_ADDRESS 0x90001e78 /end MEASUREMENT
/begin MEASUREMENT EPS_ECU_msg_counter "" UBYTE VBU0428Test_CM_uint8 0 0 0 255 ECU_ADDRESS 0x90001e08 /end MEASUREMENT
/begin MEASUREMENT VCT_stBMSIfBmsSocSet "" UBYTE VBU0428Test_CM_uint8 0 0 0 255 ECU_ADDRESS 0x90001f02 /end MEASUREMENT
/begin MEASUREMENT VCT_stBMSIfPackVoltageSet "" UBYTE VBU0428Test_CM_uint8 0 0 0 255 ECU_ADDRESS 0x90001f04 /end MEASUREMENT
/begin MEASUREMENT VCT_stBMSIfCellVoltageSet "" UBYTE VBU0428Test_CM_uint8 0 0 0 255 ECU_ADDRESS 0x90001f03 /end MEASUREMENT
/begin MEASUREMENT VCT_stBMSHvIsolation "" UBYTE VBU0428Test_CM_uint8 0 0 0 255 ECU_ADDRESS 0x90001f01 /end MEASUREMENT
/begin MEASUREMENT VCT_stBMSConnectorOvertemp "" UBYTE VBU0428Test_CM_uint8 0 0 0 255 ECU_ADDRESS 0x90001efb /end MEASUREMENT
/begin MEASUREMENT VCT_stBMSChrgConnOvertemp "" UBYTE VBU0428Test_CM_uint8 0 0 0 255 ECU_ADDRESS 0x90001efa /end MEASUREMENT
/begin MEASUREMENT VCT_stBMSChrgConnError "" UBYTE VBU0428Test_CM_uint8 0 0 0 255 ECU_ADDRESS 0x90001ef9 /end MEASUREMENT
/begin MEASUREMENT VCT_stBMSPackOverTemp "" UBYTE VBU0428Test_CM_uint8 0 0 0 255 ECU_ADDRESS 0x90001f08 /end MEASUREMENT
/begin MEASUREMENT VCT_stBMSHvConectorError "" UBYTE VBU0428Test_CM_uint8 0 0 0 255 ECU_ADDRESS 0x90001f00 /end MEASUREMENT
/begin MEASUREMENT VCT_stBMSOtherError "" UBYTE VBU0428Test_CM_uint8 0 0 0 255 ECU_ADDRESS 0x90001f06 /end MEASUREMENT
/begin MEASUREMENT VCT_stBMSOverCurrent "" UBYTE VBU0428Test_CM_uint8 0 0 0 255 ECU_ADDRESS 0x90001f07 /end MEASUREMENT
/begin MEASUREMENT VCT_stBMSVolMismatch "" UBYTE VBU0428Test_CM_uint8 0 0 0 255 ECU_ADDRESS 0x90001f0c /end MEASUREMENT
/begin MEASUREMENT VCT_stBMSIsolationLevel "" UBYTE VBU0428Test_CM_uint8 0 0 0 255 ECU_ADDRESS 0x90001f05 /end MEASUREMENT
/begin MEASUREMENT VCT_stBMSFaultCat "" UBYTE VBU0428Test_CM_uint8 0 0 0 255 ECU_ADDRESS 0x90001efe /end MEASUREMENT
/begin MEASUREMENT VCT_stBMSFaultLvl "" UBYTE VBU0428Test_CM_uint8 0 0 0 255 ECU_ADDRESS 0x90001eff /end MEASUREMENT
/begin MEASUREMENT VCT_stBMSContactorState "" UBYTE VBU0428Test_CM_uint8 0 0 0 255 ECU_ADDRESS 0x90001efc /end MEASUREMENT
/begin MEASUREMENT VCT_stInhibitPrechargeCause "" UBYTE VBU0428Test_CM_uint8 0 0 0 255 ECU_ADDRESS 0x90001f24 /end MEASUREMENT
/begin MEASUREMENT VCT_stBMSSts "" UBYTE VBU0428Test_CM_uint8 0 0 0 255 ECU_ADDRESS 0x90001f0b /end MEASUREMENT
/begin MEASUREMENT VCT_numBMSMaxVoltageSubSysNumber "" UBYTE VBU0428Test_CM_uint8 0 0 0 255 ECU_ADDRESS 0x90001eef /end MEASUREMENT
/begin MEASUREMENT VCT_numBMSMinimumCellVoltageNumber "" UBYTE VBU0428Test_CM_uint8 0 0 0 255 ECU_ADDRESS 0x90001ef4 /end MEASUREMENT
/begin MEASUREMENT VCT_numBMSMinVoltageSubSysNumber "" UBYTE VBU0428Test_CM_uint8 0 0 0 255 ECU_ADDRESS 0x90001ef3 /end MEASUREMENT
/begin MEASUREMENT VCT_numBMSMaxTempSubSysNumber "" UBYTE VBU0428Test_CM_uint8 0 0 0 255 ECU_ADDRESS 0x90001eee /end MEASUREMENT
/begin MEASUREMENT VCT_numBMSMinTempSubSysNumber "" UBYTE VBU0428Test_CM_uint8 0 0 0 255 ECU_ADDRESS 0x90001ef2 /end MEASUREMENT
/begin MEASUREMENT VCT_stBMSCellVoltageOverUnder "" UBYTE VBU0428Test_CM_uint8 0 0 0 255 ECU_ADDRESS 0x90001ef7 /end MEASUREMENT
/begin MEASUREMENT VCT_stBMSDCChargeCurrentOverUnder "" UBYTE VBU0428Test_CM_uint8 0 0 0 255 ECU_ADDRESS 0x90001efd /end MEASUREMENT
/begin MEASUREMENT VCT_stBatteryTempOver "" UBYTE VBU0428Test_CM_uint8 0 0 0 255 ECU_ADDRESS 0x90001f13 /end MEASUREMENT
/begin MEASUREMENT VCT_stBatteryOutputConnectorState "" UBYTE VBU0428Test_CM_uint8 0 0 0 255 ECU_ADDRESS 0x90001f11 /end MEASUREMENT
/begin MEASUREMENT VCT_stDCChargingPermitStatus "" UBYTE VBU0428Test_CM_uint8 0 0 0 255 ECU_ADDRESS 0x90001f23 /end MEASUREMENT
/begin MEASUREMENT VCT_stBetteryPckVoltOverAlarm "" UBYTE VBU0428Test_CM_uint8 0 0 0 255 ECU_ADDRESS 0x90001f19 /end MEASUREMENT
/begin MEASUREMENT VCT_stBetteryPckVoltUnderAlarm "" UBYTE VBU0428Test_CM_uint8 0 0 0 255 ECU_ADDRESS 0x90001f1a /end MEASUREMENT
/begin MEASUREMENT VCT_stBatteryConsistencyAlarm "" UBYTE VBU0428Test_CM_uint8 0 0 0 255 ECU_ADDRESS 0x90001f10 /end MEASUREMENT
/begin MEASUREMENT VCT_stBetteryCellVolHighAlarm "" UBYTE VBU0428Test_CM_uint8 0 0 0 255 ECU_ADDRESS 0x90001f17 /end MEASUREMENT
/begin MEASUREMENT VCT_stBetteryCellVolLowAlarm "" UBYTE VBU0428Test_CM_uint8 0 0 0 255 ECU_ADDRESS 0x90001f18 /end MEASUREMENT
/begin MEASUREMENT VCT_stSOCJumpAlarm "" UBYTE VBU0428Test_CM_uint8 0 0 0 255 ECU_ADDRESS 0x90001f25 /end MEASUREMENT
/begin MEASUREMENT VCT_stSOCJumpReason "" UBYTE VBU0428Test_CM_uint8 0 0 0 255 ECU_ADDRESS 0x90001f26 /end MEASUREMENT
/begin MEASUREMENT VCT_stBatteryTypeDismatchAlarm "" UBYTE VBU0428Test_CM_uint8 0 0 0 255 ECU_ADDRESS 0x90001f14 /end MEASUREMENT
/begin MEASUREMENT CTD_stMnPosContactorStuckOpenDiagnosticStatus "" UBYTE VBU0428Test_CM_uint8 0 0 0 255 ECU_ADDRESS 0x90001ddc /end MEASUREMENT
/begin MEASUREMENT CTD_stMnNegContactorStuckOpenDiagnosticStatus "" UBYTE VBU0428Test_CM_uint8 0 0 0 255 ECU_ADDRESS 0x90001ddb /end MEASUREMENT
/begin MEASUREMENT EPS_Torque_Steering "" UBYTE VBU0428Test_CM_ufix8_Sp1_Bn12p8 0 0 -12.8 12.7 ECU_ADDRESS 0x90001e1a /end MEASUREMENT
/begin MEASUREMENT DCDCInputCurrent "" UBYTE VBU0428Test_CM_ufix8_Sp1 0 0 0 25.5 ECU_ADDRESS 0x90001ded /end MEASUREMENT
/begin MEASUREMENT ACCompCurrent "" UBYTE VBU0428Test_CM_ufix8_Sp1 0 0 0 25.5 ECU_ADDRESS 0x90001d97 /end MEASUREMENT
/begin MEASUREMENT ACCompVoltage "" UBYTE VBU0428Test_CM_ufix8_E2 0 0 0 1020.0 ECU_ADDRESS 0x90001d99 /end MEASUREMENT
/begin MEASUREMENT MCU_UVWMaxCurrent "" UBYTE VBU0428Test_CM_ufix8_E2 0 0 0 1020.0 ECU_ADDRESS 0x90001e77 /end MEASUREMENT
/begin MEASUREMENT EPS_steering_angle_spd "" UBYTE VBU0428Test_CM_ufix8_E2 0 0 0 1020.0 ECU_ADDRESS 0x90001e1b /end MEASUREMENT
/begin MEASUREMENT MCU_IGBTMaxTemperature "" UBYTE VBU0428Test_CM_ufix8_Bn40 0 0 -40.0 215.0 ECU_ADDRESS 0x90001e66 /end MEASUREMENT
/begin MEASUREMENT MCU_IPM_Temperature "" UBYTE VBU0428Test_CM_ufix8_Bn40 0 0 -40.0 215.0 ECU_ADDRESS 0x90001e6b /end MEASUREMENT
/begin MEASUREMENT MCU_MotorTemperature "" UBYTE VBU0428Test_CM_ufix8_Bn40 0 0 -40.0 215.0 ECU_ADDRESS 0x90001e70 /end MEASUREMENT
/begin MEASUREMENT DCDCTemperature "" UBYTE VBU0428Test_CM_ufix8_Bn40 0 0 -40.0 215.0 ECU_ADDRESS 0x90001df3 /end MEASUREMENT
/begin MEASUREMENT T_BOXTime_Year "" UBYTE VBU0428Test_CM_ufix8_B2000 0 0 2000.0 2255.0 ECU_ADDRESS 0x90001ea8 /end MEASUREMENT
/begin MEASUREMENT CheckSum "" UBYTE VBU0428Test_CM_ufix7 0 0 0 127.0 ECU_ADDRESS 0x90001de8 /end MEASUREMENT
/begin MEASUREMENT T_BOXTime_Min "" UBYTE VBU0428Test_CM_ufix6 0 0 0 63.0 ECU_ADDRESS 0x90001ea5 /end MEASUREMENT
/begin MEASUREMENT T_BOXTime_Sec "" UBYTE VBU0428Test_CM_ufix6 0 0 0 63.0 ECU_ADDRESS 0x90001ea7 /end MEASUREMENT
/begin MEASUREMENT T_BOXTime_Day "" UBYTE VBU0428Test_CM_ufix5_B1 0 0 1.0 32.0 ECU_ADDRESS 0x90001ea3 /end MEASUREMENT
/begin MEASUREMENT T_BOXTime_Hour "" UBYTE VBU0428Test_CM_ufix5 0 0 0 31.0 ECU_ADDRESS 0x90001ea4 /end MEASUREMENT
/begin MEASUREMENT T_BOXTime_Month "" UBYTE VBU0428Test_CM_ufix4_B1 0 0 1.0 16.0 ECU_ADDRESS 0x90001ea6 /end MEASUREMENT
/begin MEASUREMENT DCDCrollingcounter "" UBYTE VBU0428Test_CM_ufix4 0 0 0 15.0 ECU_ADDRESS 0x90001df7 /end MEASUREMENT
/begin MEASUREMENT CDC_rollingcounter "" UBYTE VBU0428Test_CM_ufix4 0 0 0 15.0 ECU_ADDRESS 0x90001dce /end MEASUREMENT
/begin MEASUREMENT ABS_Rolling_Counter "" UBYTE VBU0428Test_CM_ufix4 0 0 0 15.0 ECU_ADDRESS 0x90001d8c /end MEASUREMENT
/begin MEASUREMENT MCU_rollingcounter "" UBYTE VBU0428Test_CM_ufix4 0 0 0 15.0 ECU_ADDRESS 0x90001e79 /end MEASUREMENT
/begin MEASUREMENT EPS_ECU_MODE_CONT "" UBYTE VBU0428Test_CM_ufix4 0 0 0 15.0 ECU_ADDRESS 0x90001e07 /end MEASUREMENT
/begin MEASUREMENT EPB_Control_Mode "" UBYTE VBU0428Test_CM_ufix4 0 0 0 15.0 ECU_ADDRESS 0x90001dfa /end MEASUREMENT
/begin MEASUREMENT EPB_Fault_Level "" UBYTE VBU0428Test_CM_ufix4 0 0 0 15.0 ECU_ADDRESS 0x90001dfb /end MEASUREMENT
/begin MEASUREMENT EPB_state "" UBYTE VBU0428Test_CM_ufix4 0 0 0 15.0 ECU_ADDRESS 0x90001e00 /end MEASUREMENT
/begin MEASUREMENT Rollingcounter "" UBYTE VBU0428Test_CM_ufix4 0 0 0 15.0 ECU_ADDRESS 0x90001e9c /end MEASUREMENT
/begin MEASUREMENT DCDCWorkstatus "" UBYTE VBU0428Test_CM_ufix2 0 0 0 3.0 ECU_ADDRESS 0x90001df6 /end MEASUREMENT
/begin MEASUREMENT CDC_DriveMode "" UBYTE VBU0428Test_CM_ufix2 0 0 0 3.0 ECU_ADDRESS 0x90001dc9 /end MEASUREMENT
/begin MEASUREMENT CDC_RegenMode "" UBYTE VBU0428Test_CM_ufix2 0 0 0 3.0 ECU_ADDRESS 0x90001dcb /end MEASUREMENT
/begin MEASUREMENT CDC_TowMode "" UBYTE VBU0428Test_CM_ufix2 0 0 0 3.0 ECU_ADDRESS 0x90001dcc /end MEASUREMENT
/begin MEASUREMENT BCM_Automatic_headlight_gear "" UBYTE VBU0428Test_CM_ufix2 0 0 0 3.0 ECU_ADDRESS 0x90001da5 /end MEASUREMENT
/begin MEASUREMENT BCM_Automatic_wiper_gear "" UBYTE VBU0428Test_CM_ufix2 0 0 0 3.0 ECU_ADDRESS 0x90001da6 /end MEASUREMENT
/begin MEASUREMENT BCM_Day_Light_Status "" UBYTE VBU0428Test_CM_ufix2 0 0 0 3.0 ECU_ADDRESS 0x90001da8 /end MEASUREMENT
/begin MEASUREMENT BCM_FrontFogLight "" UBYTE VBU0428Test_CM_ufix2 0 0 0 3.0 ECU_ADDRESS 0x90001daa /end MEASUREMENT
/begin MEASUREMENT BCM_HI_Wiper_Status "" UBYTE VBU0428Test_CM_ufix2 0 0 0 3.0 ECU_ADDRESS 0x90001dab /end MEASUREMENT
/begin MEASUREMENT BCM_HighBeam "" UBYTE VBU0428Test_CM_ufix2 0 0 0 3.0 ECU_ADDRESS 0x90001dac /end MEASUREMENT
/begin MEASUREMENT BCM_LeftTurnLightStatus "" UBYTE VBU0428Test_CM_ufix2 0 0 0 3.0 ECU_ADDRESS 0x90001daf /end MEASUREMENT
/begin MEASUREMENT BCM_LowBeam "" UBYTE VBU0428Test_CM_ufix2 0 0 0 3.0 ECU_ADDRESS 0x90001db0 /end MEASUREMENT
/begin MEASUREMENT BCM_Low_Wiper_Status "" UBYTE VBU0428Test_CM_ufix2 0 0 0 3.0 ECU_ADDRESS 0x90001db1 /end MEASUREMENT
/begin MEASUREMENT BCM_Park_Light_Status "" UBYTE VBU0428Test_CM_ufix2 0 0 0 3.0 ECU_ADDRESS 0x90001db2 /end MEASUREMENT
/begin MEASUREMENT BCM_RearFogLight "" UBYTE VBU0428Test_CM_ufix2 0 0 0 3.0 ECU_ADDRESS 0x90001db4 /end MEASUREMENT
/begin MEASUREMENT BCM_RightTurnLightStatus "" UBYTE VBU0428Test_CM_ufix2 0 0 0 3.0 ECU_ADDRESS 0x90001db6 /end MEASUREMENT
/begin MEASUREMENT ACCompStatus "" UBYTE VBU0428Test_CM_ufix2 0 0 0 3.0 ECU_ADDRESS 0x90001d98 /end MEASUREMENT
/begin MEASUREMENT ABS_WheelSpeed_RL_Status "" UBYTE VBU0428Test_CM_ufix2 0 0 0 3.0 ECU_ADDRESS 0x90001d94 /end MEASUREMENT
/begin MEASUREMENT ABS_WheelSpeed_RR_Status "" UBYTE VBU0428Test_CM_ufix2 0 0 0 3.0 ECU_ADDRESS 0x90001d95 /end MEASUREMENT
/begin MEASUREMENT ABS_WheelSpeed_FL_Status "" UBYTE VBU0428Test_CM_ufix2 0 0 0 3.0 ECU_ADDRESS 0x90001d92 /end MEASUREMENT
/begin MEASUREMENT ABS_WheelSpeed_FR_Status "" UBYTE VBU0428Test_CM_ufix2 0 0 0 3.0 ECU_ADDRESS 0x90001d93 /end MEASUREMENT
/begin MEASUREMENT MCU_FaultLevel "" UBYTE VBU0428Test_CM_ufix2 0 0 0 3.0 ECU_ADDRESS 0x90001e62 /end MEASUREMENT
/begin MEASUREMENT MCU_ActiveRelease "" UBYTE VBU0428Test_CM_ufix2 0 0 0 3.0 ECU_ADDRESS 0x90001e5b /end MEASUREMENT
/begin MEASUREMENT MCU_MotorMode "" UBYTE VBU0428Test_CM_ufix2 0 0 0 3.0 ECU_ADDRESS 0x90001e6d /end MEASUREMENT
/begin MEASUREMENT EPB_Key_Err "" UBYTE VBU0428Test_CM_ufix2 0 0 0 3.0 ECU_ADDRESS 0x90001dfc /end MEASUREMENT
/begin MEASUREMENT EPB_Key_Sta "" UBYTE VBU0428Test_CM_ufix2 0 0 0 3.0 ECU_ADDRESS 0x90001dfd /end MEASUREMENT
/begin MEASUREMENT EPB_PSensor_Err "" UBYTE VBU0428Test_CM_ufix2 0 0 0 3.0 ECU_ADDRESS 0x90001dfe /end MEASUREMENT
/begin MEASUREMENT EPB_SolValve_ErrInd "" UBYTE VBU0428Test_CM_ufix2 0 0 0 3.0 ECU_ADDRESS 0x90001dff /end MEASUREMENT
/begin MEASUREMENT IGN "" UBYTE VBU0428Test_CM_ufix2 0 0 0 3.0 ECU_ADDRESS 0x90001e3d /end MEASUREMENT
/begin MEASUREMENT Park_LED_Sta "" UBYTE VBU0428Test_CM_ufix2 0 0 0 3.0 ECU_ADDRESS 0x90001e8c /end MEASUREMENT
/begin MEASUREMENT DCDCEnableFeedback "" UBYTE VBU0428Test_CM_ufix1 0 0 0 1.0 ECU_ADDRESS 0x90001dec /end MEASUREMENT
/begin MEASUREMENT CDC_CreepOnOff "" UBYTE VBU0428Test_CM_ufix1 0 0 0 1.0 ECU_ADDRESS 0x90001dc8 /end MEASUREMENT
/begin MEASUREMENT CDC_GoNotifierOnOff "" UBYTE VBU0428Test_CM_ufix1 0 0 0 1.0 ECU_ADDRESS 0x90001dca /end MEASUREMENT
/begin MEASUREMENT BCM_Brake_Light_Status "" UBYTE VBU0428Test_CM_ufix1 0 0 0 1.0 ECU_ADDRESS 0x90001da7 /end MEASUREMENT
/begin MEASUREMENT BCM_DoorStatus "" UBYTE VBU0428Test_CM_ufix1 0 0 0 1.0 ECU_ADDRESS 0x90001da9 /end MEASUREMENT
/begin MEASUREMENT BCM_Horn_Status "" UBYTE VBU0428Test_CM_ufix1 0 0 0 1.0 ECU_ADDRESS 0x90001dad /end MEASUREMENT
/begin MEASUREMENT BCM_IG1_Power "" UBYTE VBU0428Test_CM_ufix1 0 0 0 1.0 ECU_ADDRESS 0x90001dae /end MEASUREMENT
/begin MEASUREMENT BCM_Prak_Switch_Status "" UBYTE VBU0428Test_CM_ufix1 0 0 0 1.0 ECU_ADDRESS 0x90001db3 /end MEASUREMENT
/begin MEASUREMENT BCM_Reversing_Switch_Status "" UBYTE VBU0428Test_CM_ufix1 0 0 0 1.0 ECU_ADDRESS 0x90001db5 /end MEASUREMENT
/begin MEASUREMENT BCM_Wash_Motor_Status "" UBYTE VBU0428Test_CM_ufix1 0 0 0 1.0 ECU_ADDRESS 0x90001db7 /end MEASUREMENT
/begin MEASUREMENT AVAS_WorkingStatus "" UBYTE VBU0428Test_CM_ufix1 0 0 0 1.0 ECU_ADDRESS 0x90001da3 /end MEASUREMENT
/begin MEASUREMENT ACComFault "" UBYTE VBU0428Test_CM_ufix1 0 0 0 1.0 ECU_ADDRESS 0x90001d96 /end MEASUREMENT
/begin MEASUREMENT ACOverCurrent "" UBYTE VBU0428Test_CM_ufix1 0 0 0 1.0 ECU_ADDRESS 0x90001d9a /end MEASUREMENT
/begin MEASUREMENT ACOverVoltage "" UBYTE VBU0428Test_CM_ufix1 0 0 0 1.0 ECU_ADDRESS 0x90001d9b /end MEASUREMENT
/begin MEASUREMENT ACOver_current_FreqReduction "" UBYTE VBU0428Test_CM_ufix1 0 0 0 1.0 ECU_ADDRESS 0x90001d9c /end MEASUREMENT
/begin MEASUREMENT ACSpeedFault "" UBYTE VBU0428Test_CM_ufix1 0 0 0 1.0 ECU_ADDRESS 0x90001d9d /end MEASUREMENT
/begin MEASUREMENT ACStandby_overvoltage "" UBYTE VBU0428Test_CM_ufix1 0 0 0 1.0 ECU_ADDRESS 0x90001d9e /end MEASUREMENT
/begin MEASUREMENT ACStandby_undervoltage "" UBYTE VBU0428Test_CM_ufix1 0 0 0 1.0 ECU_ADDRESS 0x90001d9f /end MEASUREMENT
/begin MEASUREMENT ACUnderVoltage "" UBYTE VBU0428Test_CM_ufix1 0 0 0 1.0 ECU_ADDRESS 0x90001da0 /end MEASUREMENT
/begin MEASUREMENT ABS_WheelSpeedPlusCounter_FL_inv "" UBYTE VBU0428Test_CM_ufix1 0 0 0 1.0 ECU_ADDRESS 0x90001d8e /end MEASUREMENT
/begin MEASUREMENT ABS_WheelSpeedPlusCounter_FR_inv "" UBYTE VBU0428Test_CM_ufix1 0 0 0 1.0 ECU_ADDRESS 0x90001d8f /end MEASUREMENT
/begin MEASUREMENT ABS_WheelSpeedPlusCounter_RL_inv "" UBYTE VBU0428Test_CM_ufix1 0 0 0 1.0 ECU_ADDRESS 0x90001d90 /end MEASUREMENT
/begin MEASUREMENT ABS_WheelSpeedPlusCounter_RR_inv "" UBYTE VBU0428Test_CM_ufix1 0 0 0 1.0 ECU_ADDRESS 0x90001d91 /end MEASUREMENT
/begin MEASUREMENT MCU_BusOverVoltage "" UBYTE VBU0428Test_CM_ufix1 0 0 0 1.0 ECU_ADDRESS 0x90001e5c /end MEASUREMENT
/begin MEASUREMENT MCU_BusUnderVoltage "" UBYTE VBU0428Test_CM_ufix1 0 0 0 1.0 ECU_ADDRESS 0x90001e5d /end MEASUREMENT
/begin MEASUREMENT MCU_CAN_Fault "" UBYTE VBU0428Test_CM_ufix1 0 0 0 1.0 ECU_ADDRESS 0x90001e5e /end MEASUREMENT
/begin MEASUREMENT MCU_CPLD_Status "" UBYTE VBU0428Test_CM_ufix1 0 0 0 1.0 ECU_ADDRESS 0x90001e5f /end MEASUREMENT
/begin MEASUREMENT MCU_Drive_Downarm_failure "" UBYTE VBU0428Test_CM_ufix1 0 0 0 1.0 ECU_ADDRESS 0x90001e60 /end MEASUREMENT
/begin MEASUREMENT MCU_Drive_Uparm_failure "" UBYTE VBU0428Test_CM_ufix1 0 0 0 1.0 ECU_ADDRESS 0x90001e61 /end MEASUREMENT
/begin MEASUREMENT MCU_HallFault "" UBYTE VBU0428Test_CM_ufix1 0 0 0 1.0 ECU_ADDRESS 0x90001e63 /end MEASUREMENT
/begin MEASUREMENT MCU_Hardware_OverVoltage "" UBYTE VBU0428Test_CM_ufix1 0 0 0 1.0 ECU_ADDRESS 0x90001e64 /end MEASUREMENT
/begin MEASUREMENT MCU_Hardware_UnderVoltage "" UBYTE VBU0428Test_CM_ufix1 0 0 0 1.0 ECU_ADDRESS 0x90001e65 /end MEASUREMENT
/begin MEASUREMENT MCU_IGBT_Junction_overTem_limit "" UBYTE VBU0428Test_CM_ufix1 0 0 0 1.0 ECU_ADDRESS 0x90001e67 /end MEASUREMENT
/begin MEASUREMENT MCU_IGBT_NTC_overTem_limit "" UBYTE VBU0428Test_CM_ufix1 0 0 0 1.0 ECU_ADDRESS 0x90001e68 /end MEASUREMENT
/begin MEASUREMENT MCU_IGBTfault "" UBYTE VBU0428Test_CM_ufix1 0 0 0 1.0 ECU_ADDRESS 0x90001e69 /end MEASUREMENT
/begin MEASUREMENT MCU_IGBToverheat "" UBYTE VBU0428Test_CM_ufix1 0 0 0 1.0 ECU_ADDRESS 0x90001e6a /end MEASUREMENT
/begin MEASUREMENT MCU_MotorOverheat "" UBYTE VBU0428Test_CM_ufix1 0 0 0 1.0 ECU_ADDRESS 0x90001e6e /end MEASUREMENT
/begin MEASUREMENT MCU_Motor_overTem_limit "" UBYTE VBU0428Test_CM_ufix1 0 0 0 1.0 ECU_ADDRESS 0x90001e71 /end MEASUREMENT
/begin MEASUREMENT MCU_OutputFault "" UBYTE VBU0428Test_CM_ufix1 0 0 0 1.0 ECU_ADDRESS 0x90001e72 /end MEASUREMENT
/begin MEASUREMENT MCU_OverCurrent "" UBYTE VBU0428Test_CM_ufix1 0 0 0 1.0 ECU_ADDRESS 0x90001e73 /end MEASUREMENT
/begin MEASUREMENT MCU_OverSpeed "" UBYTE VBU0428Test_CM_ufix1 0 0 0 1.0 ECU_ADDRESS 0x90001e74 /end MEASUREMENT
/begin MEASUREMENT MCU_Radiator_overTem_limit "" UBYTE VBU0428Test_CM_ufix1 0 0 0 1.0 ECU_ADDRESS 0x90001e75 /end MEASUREMENT
/begin MEASUREMENT MCU_ResolverFault "" UBYTE VBU0428Test_CM_ufix1 0 0 0 1.0 ECU_ADDRESS 0x90001e76 /end MEASUREMENT
/begin MEASUREMENT MCU_MotorHillHold "" UBYTE VBU0428Test_CM_ufix1 0 0 0 1.0 ECU_ADDRESS 0x90001e6c /end MEASUREMENT
/begin MEASUREMENT MCU_MotorSpeedValid "" UBYTE VBU0428Test_CM_ufix1 0 0 0 1.0 ECU_ADDRESS 0x90001e6f /end MEASUREMENT
/begin MEASUREMENT IC_BrakeDisWarning "" UBYTE VBU0428Test_CM_ufix1 0 0 0 1.0 ECU_ADDRESS 0x90001e3a /end MEASUREMENT
/begin MEASUREMENT IC_BrakeFluidWarning "" UBYTE VBU0428Test_CM_ufix1 0 0 0 1.0 ECU_ADDRESS 0x90001e3b /end MEASUREMENT
/begin MEASUREMENT IC_SeatbeltUnlock "" UBYTE VBU0428Test_CM_ufix1 0 0 0 1.0 ECU_ADDRESS 0x90001e3c /end MEASUREMENT
/begin MEASUREMENT EPS_AMismathcR "" UBYTE VBU0428Test_CM_ufix1 0 0 0 1.0 ECU_ADDRESS 0x90001e01 /end MEASUREMENT
/begin MEASUREMENT EPS_ASteeringAngleOutRange "" UBYTE VBU0428Test_CM_ufix1 0 0 0 1.0 ECU_ADDRESS 0x90001e02 /end MEASUREMENT
/begin MEASUREMENT EPS_CAN_BUS_OFF "" UBYTE VBU0428Test_CM_ufix1 0 0 0 1.0 ECU_ADDRESS 0x90001e03 /end MEASUREMENT
/begin MEASUREMENT EPS_CurrentOverDevition "" UBYTE VBU0428Test_CM_ufix1 0 0 0 1.0 ECU_ADDRESS 0x90001e04 /end MEASUREMENT
/begin MEASUREMENT EPS_ECUCaliFail "" UBYTE VBU0428Test_CM_ufix1 0 0 0 1.0 ECU_ADDRESS 0x90001e05 /end MEASUREMENT
/begin MEASUREMENT EPS_ECUCurrentSensorInvalid "" UBYTE VBU0428Test_CM_ufix1 0 0 0 1.0 ECU_ADDRESS 0x90001e06 /end MEASUREMENT
/begin MEASUREMENT EPS_InvalidSpeed "" UBYTE VBU0428Test_CM_ufix1 0 0 0 1.0 ECU_ADDRESS 0x90001e09 /end MEASUREMENT
/begin MEASUREMENT EPS_LVOverVoltage "" UBYTE VBU0428Test_CM_ufix1 0 0 0 1.0 ECU_ADDRESS 0x90001e0a /end MEASUREMENT
/begin MEASUREMENT EPS_LVUnderVoltage "" UBYTE VBU0428Test_CM_ufix1 0 0 0 1.0 ECU_ADDRESS 0x90001e0b /end MEASUREMENT
/begin MEASUREMENT EPS_MotorCurrentinvalid "" UBYTE VBU0428Test_CM_ufix1 0 0 0 1.0 ECU_ADDRESS 0x90001e0c /end MEASUREMENT
/begin MEASUREMENT EPS_MotorDriverCircurtFail "" UBYTE VBU0428Test_CM_ufix1 0 0 0 1.0 ECU_ADDRESS 0x90001e0d /end MEASUREMENT
/begin MEASUREMENT EPS_MotorPoSensorFault "" UBYTE VBU0428Test_CM_ufix1 0 0 0 1.0 ECU_ADDRESS 0x90001e0e /end MEASUREMENT
/begin MEASUREMENT EPS_PTReadyLostFrame "" UBYTE VBU0428Test_CM_ufix1 0 0 0 1.0 ECU_ADDRESS 0x90001e0f /end MEASUREMENT
/begin MEASUREMENT EPS_RSteeringAngleOutRange "" UBYTE VBU0428Test_CM_ufix1 0 0 0 1.0 ECU_ADDRESS 0x90001e10 /end MEASUREMENT
/begin MEASUREMENT EPS_RelayFail "" UBYTE VBU0428Test_CM_ufix1 0 0 0 1.0 ECU_ADDRESS 0x90001e11 /end MEASUREMENT
/begin MEASUREMENT EPS_SpeedLose "" UBYTE VBU0428Test_CM_ufix1 0 0 0 1.0 ECU_ADDRESS 0x90001e12 /end MEASUREMENT
/begin MEASUREMENT EPS_SpeedOut "" UBYTE VBU0428Test_CM_ufix1 0 0 0 1.0 ECU_ADDRESS 0x90001e13 /end MEASUREMENT
/begin MEASUREMENT EPS_T1T2Mismatch "" UBYTE VBU0428Test_CM_ufix1 0 0 0 1.0 ECU_ADDRESS 0x90001e14 /end MEASUREMENT
/begin MEASUREMENT EPS_T1TorqueOutRange "" UBYTE VBU0428Test_CM_ufix1 0 0 0 1.0 ECU_ADDRESS 0x90001e15 /end MEASUREMENT
/begin MEASUREMENT EPS_T2TorqueOutRange "" UBYTE VBU0428Test_CM_ufix1 0 0 0 1.0 ECU_ADDRESS 0x90001e16 /end MEASUREMENT
/begin MEASUREMENT EPS_TemOverHigh "" UBYTE VBU0428Test_CM_ufix1 0 0 0 1.0 ECU_ADDRESS 0x90001e17 /end MEASUREMENT
/begin MEASUREMENT EPS_TemOverLow "" UBYTE VBU0428Test_CM_ufix1 0 0 0 1.0 ECU_ADDRESS 0x90001e18 /end MEASUREMENT
/begin MEASUREMENT EPS_TorqueSensorVoltError "" UBYTE VBU0428Test_CM_ufix1 0 0 0 1.0 ECU_ADDRESS 0x90001e19 /end MEASUREMENT
/begin MEASUREMENT Communication "" UBYTE VBU0428Test_CM_ufix1 0 0 0 1.0 ECU_ADDRESS 0x90001dea /end MEASUREMENT
/begin MEASUREMENT DCDCDeriting "" UBYTE VBU0428Test_CM_ufix1 0 0 0 1.0 ECU_ADDRESS 0x90001deb /end MEASUREMENT
/begin MEASUREMENT DCDCOverHeat "" UBYTE VBU0428Test_CM_ufix1 0 0 0 1.0 ECU_ADDRESS 0x90001dee /end MEASUREMENT
/begin MEASUREMENT DCDCOverInputCurrent "" UBYTE VBU0428Test_CM_ufix1 0 0 0 1.0 ECU_ADDRESS 0x90001def /end MEASUREMENT
/begin MEASUREMENT DCDCOverInputVoltage "" UBYTE VBU0428Test_CM_ufix1 0 0 0 1.0 ECU_ADDRESS 0x90001df0 /end MEASUREMENT
/begin MEASUREMENT DCDCOverOutputCurrent "" UBYTE VBU0428Test_CM_ufix1 0 0 0 1.0 ECU_ADDRESS 0x90001df1 /end MEASUREMENT
/begin MEASUREMENT DCDCOverOutputVoltage "" UBYTE VBU0428Test_CM_ufix1 0 0 0 1.0 ECU_ADDRESS 0x90001df2 /end MEASUREMENT
/begin MEASUREMENT DCDCUnderInputVoltage "" UBYTE VBU0428Test_CM_ufix1 0 0 0 1.0 ECU_ADDRESS 0x90001df4 /end MEASUREMENT
/begin MEASUREMENT DCDCUnderOutputVoltage "" UBYTE VBU0428Test_CM_ufix1 0 0 0 1.0 ECU_ADDRESS 0x90001df5 /end MEASUREMENT
/begin MEASUREMENT ABS_Active "" UBYTE VBU0428Test_CM_ufix1 0 0 0 1.0 ECU_ADDRESS 0x90001d88 /end MEASUREMENT
/begin MEASUREMENT ABS_EBDFailed "" UBYTE VBU0428Test_CM_ufix1 0 0 0 1.0 ECU_ADDRESS 0x90001d8a /end MEASUREMENT
/begin MEASUREMENT ABS_Failed "" UBYTE VBU0428Test_CM_ufix1 0 0 0 1.0 ECU_ADDRESS 0x90001d8b /end MEASUREMENT
/begin MEASUREMENT ABS_VehicleSpeedValid "" UBYTE VBU0428Test_CM_ufix1 0 0 0 1.0 ECU_ADDRESS 0x90001d8d /end MEASUREMENT
/begin MEASUREMENT EBD_Active "" UBYTE VBU0428Test_CM_ufix1 0 0 0 1.0 ECU_ADDRESS 0x90001df9 /end MEASUREMENT
/begin MEASUREMENT SPD_flgRARvs "" UBYTE VBU0428Test_CM_boolean 0 0 0.0 1.0 ECU_ADDRESS 0x90001d4e /end MEASUREMENT
/begin MEASUREMENT Gear_flgSensorRawReqGearR "" UBYTE VBU0428Test_CM_boolean 0 0 0.0 1.0 ECU_ADDRESS 0x90001d6e /end MEASUREMENT
/begin MEASUREMENT Gear_flgSensorRawReqGearD "" UBYTE VBU0428Test_CM_boolean 0 0 0.0 1.0 ECU_ADDRESS 0x90001d6c /end MEASUREMENT
/begin MEASUREMENT Gear_flgSensorRawReqGearN "" UBYTE VBU0428Test_CM_boolean 0 0 0.0 1.0 ECU_ADDRESS 0x90001d6d /end MEASUREMENT
/begin MEASUREMENT Gear_flgRGearReqRawDigital "" UBYTE VBU0428Test_CM_boolean 0 0 0.0 1.0 ECU_ADDRESS 0x90001d1d /end MEASUREMENT
/begin MEASUREMENT Gear_flgDGearReqRawDigital "" UBYTE VBU0428Test_CM_boolean 0 0 0.0 1.0 ECU_ADDRESS 0x90001d16 /end MEASUREMENT
/begin MEASUREMENT Gear_flgNGearReqRawDigital "" UBYTE VBU0428Test_CM_boolean 0 0 0 1 ECU_ADDRESS 0x90001f77 /end MEASUREMENT
/begin MEASUREMENT Gear_flgSensorWarningLT "" UBYTE VBU0428Test_CM_boolean 0 0 0.0 1.0 ECU_ADDRESS 0x90001d6f /end MEASUREMENT
/begin MEASUREMENT Gear_flgSensorWarningST "" UBYTE VBU0428Test_CM_boolean 0 0 0.0 1.0 ECU_ADDRESS 0x90001d70 /end MEASUREMENT
/begin MEASUREMENT Gear_flgDftGearWarningDigital "" UBYTE VBU0428Test_CM_boolean 0 0 0.0 1.0 ECU_ADDRESS 0x90001d65 /end MEASUREMENT
/begin MEASUREMENT Gear_flgPlausibilityForce2NDigital "" UBYTE VBU0428Test_CM_boolean 0 0 0.0 1.0 ECU_ADDRESS 0x90001d6b /end MEASUREMENT
/begin MEASUREMENT Gear_flgBrkPressed4GearR "" UBYTE VBU0428Test_CM_boolean 0 0 0.0 1.0 ECU_ADDRESS 0x90001d14 /end MEASUREMENT
/begin MEASUREMENT Gear_flgGearWarnRNoBrake "" UBYTE VBU0428Test_CM_boolean 0 0 0.0 1.0 ECU_ADDRESS 0x90001d1b /end MEASUREMENT
/begin MEASUREMENT Gear_flgGearWarnRNoReady "" UBYTE VBU0428Test_CM_boolean 0 0 0.0 1.0 ECU_ADDRESS 0x90001d1c /end MEASUREMENT
/begin MEASUREMENT Gear_flgGearWarnD2RFailure "" UBYTE VBU0428Test_CM_boolean 0 0 0.0 1.0 ECU_ADDRESS 0x90001d18 /end MEASUREMENT
/begin MEASUREMENT Gear_flgGearRShiftReq "" UBYTE VBU0428Test_CM_boolean 0 0 0.0 1.0 ECU_ADDRESS 0x90001d67 /end MEASUREMENT
/begin MEASUREMENT Gear_flgBrkPressed4GearD "" UBYTE VBU0428Test_CM_boolean 0 0 0.0 1.0 ECU_ADDRESS 0x90001d13 /end MEASUREMENT
/begin MEASUREMENT Gear_flgGearWarnDNoReady "" UBYTE VBU0428Test_CM_boolean 0 0 0.0 1.0 ECU_ADDRESS 0x90001d19 /end MEASUREMENT
/begin MEASUREMENT Gear_flgGearWarnR2DFailure "" UBYTE VBU0428Test_CM_boolean 0 0 0.0 1.0 ECU_ADDRESS 0x90001d1a /end MEASUREMENT
/begin MEASUREMENT Gear_flgGearDShiftReq "" UBYTE VBU0428Test_CM_boolean 0 0 0.0 1.0 ECU_ADDRESS 0x90001d66 /end MEASUREMENT
/begin MEASUREMENT TQO_flgShftRD "" UBYTE VBU0428Test_CM_boolean 0 0 0.0 1.0 ECU_ADDRESS 0x90001d5d /end MEASUREMENT
/begin MEASUREMENT TQCMP_flgPulseTrig "" UBYTE VBU0428Test_CM_boolean 0 0 0.0 1.0 ECU_ADDRESS 0x90001d53 /end MEASUREMENT
/begin MEASUREMENT TQCMP_flgShftOn "" UBYTE VBU0428Test_CM_boolean 0 0 0.0 1.0 ECU_ADDRESS 0x90001d54 /end MEASUREMENT
/begin MEASUREMENT PMM_flgInitToHVRlyClReq "" UBYTE VBU0428Test_CM_boolean 0 0 0 1 ECU_ADDRESS 0x90001d81 /end MEASUREMENT
/begin MEASUREMENT PMM_flgOffLoadToACTst "" UBYTE VBU0428Test_CM_boolean 0 0 0 1 ECU_ADDRESS 0x90001d82 /end MEASUREMENT
/begin MEASUREMENT DCH_flgBmsChCrntOver "" UBYTE VBU0428Test_CM_boolean 0 0 0.0 1.0 ECU_ADDRESS 0x90001ccf /end MEASUREMENT
/begin MEASUREMENT DCH_flgBmsIsoCriticalFault "" UBYTE VBU0428Test_CM_boolean 0 0 0.0 1.0 ECU_ADDRESS 0x90001cd0 /end MEASUREMENT
/begin MEASUREMENT DCH_flgStopForManual "" UBYTE VBU0428Test_CM_boolean 0 0 0.0 1.0 ECU_ADDRESS 0x90001cef /end MEASUREMENT
/begin MEASUREMENT DCH_flgBMSChCmpt "" UBYTE VBU0428Test_CM_boolean 0 0 0.0 1.0 ECU_ADDRESS 0x90001cc8 /end MEASUREMENT
/begin MEASUREMENT DCH_flgHalfConn "" UBYTE VBU0428Test_CM_boolean 0 0 0.0 1.0 ECU_ADDRESS 0x90001cde /end MEASUREMENT
/begin MEASUREMENT DCH_flgCC2Conn "" UBYTE VBU0428Test_CM_boolean 0 0 0.0 1.0 ECU_ADDRESS 0x90001cd1 /end MEASUREMENT
/begin MEASUREMENT PEUR_flgtrqActVld "" UBYTE VBU0428Test_CM_boolean 0 0 0.0 1.0 ECU_ADDRESS 0x90001d39 /end MEASUREMENT
/begin MEASUREMENT PEUR_flgMotrHillHld "" UBYTE VBU0428Test_CM_boolean 0 0 0.0 1.0 ECU_ADDRESS 0x90001d37 /end MEASUREMENT
/begin MEASUREMENT VCT_flgBMSBalanceStatus "" UBYTE VBU0428Test_CM_boolean 0 0 0 1 ECU_ADDRESS 0x90001edc /end MEASUREMENT
/begin MEASUREMENT VCT_stBMSChargeState "" UBYTE VBU0428Test_CM_boolean 0 0 0 1 ECU_ADDRESS 0x90001ef8 /end MEASUREMENT
/begin MEASUREMENT VCT_flgChargeCurrentDerate "" UBYTE VBU0428Test_CM_boolean 0 0 0 1 ECU_ADDRESS 0x90001eeb /end MEASUREMENT
/begin MEASUREMENT VCT_flgHVBattSOCLowCrit "" UBYTE VBU0428Test_CM_boolean 0 0 0 1 ECU_ADDRESS 0x90001eec /end MEASUREMENT
/begin MEASUREMENT VCT_flgChargeAvailable "" UBYTE VBU0428Test_CM_boolean 0 0 0 1 ECU_ADDRESS 0x90001eea /end MEASUREMENT
/begin MEASUREMENT VCT_flgHVBattSOCLowWarn "" UBYTE VBU0428Test_CM_boolean 0 0 0 1 ECU_ADDRESS 0x90001eed /end MEASUREMENT
/begin MEASUREMENT VCT_flgBMSESSInletTempMask "" UBYTE VBU0428Test_CM_boolean 0 0 0 1 ECU_ADDRESS 0x90001ee0 /end MEASUREMENT
/begin MEASUREMENT VCT_flgBMSESSOutletTempMask "" UBYTE VBU0428Test_CM_boolean 0 0 0 1 ECU_ADDRESS 0x90001ee2 /end MEASUREMENT
/begin MEASUREMENT VCT_flgBMSHVShutdownReq "" UBYTE VBU0428Test_CM_boolean 0 0 0 1 ECU_ADDRESS 0x90001ee4 /end MEASUREMENT
/begin MEASUREMENT VCT_flgBMSESSInletTempValidity "" UBYTE VBU0428Test_CM_boolean 0 0 0 1 ECU_ADDRESS 0x90001ee1 /end MEASUREMENT
/begin MEASUREMENT VCT_flgBMSESSOutletTempValidity "" UBYTE VBU0428Test_CM_boolean 0 0 0 1 ECU_ADDRESS 0x90001ee3 /end MEASUREMENT
/begin MEASUREMENT VCT_flgBMSTempMaxValidity "" UBYTE VBU0428Test_CM_boolean 0 0 0 1 ECU_ADDRESS 0x90001ee6 /end MEASUREMENT
/begin MEASUREMENT VCT_flgBMSTempAverageValidity "" UBYTE VBU0428Test_CM_boolean 0 0 0 1 ECU_ADDRESS 0x90001ee5 /end MEASUREMENT
/begin MEASUREMENT VCT_flgBMSTempMinValidity "" UBYTE VBU0428Test_CM_boolean 0 0 0 1 ECU_ADDRESS 0x90001ee7 /end MEASUREMENT
/begin MEASUREMENT VCT_flgBMSTempRequestValid "" UBYTE VBU0428Test_CM_boolean 0 0 0 1 ECU_ADDRESS 0x90001ee8 /end MEASUREMENT
/begin MEASUREMENT FCC_flgFullChargeCellVoltageCriteria "" UBYTE VBU0428Test_CM_boolean 0 0 0.0 1.0 ECU_ADDRESS 0x90001d0d /end MEASUREMENT
/begin MEASUREMENT FCC_flgFullChargePackVoltageCriteria "" UBYTE VBU0428Test_CM_boolean 0 0 0.0 1.0 ECU_ADDRESS 0x90001d0f /end MEASUREMENT
/begin MEASUREMENT FCC_flgComputeResistanceEnable "" UBYTE VBU0428Test_CM_boolean 0 0 0.0 1.0 ECU_ADDRESS 0x90001d09 /end MEASUREMENT
/begin MEASUREMENT FCC_flgComputeResistanceStart "" UBYTE VBU0428Test_CM_boolean 0 0 0 1 ECU_ADDRESS 0x90001d0c /end MEASUREMENT
/begin MEASUREMENT FCC_flgComputeResistancePulseCurrentEnable "" UBYTE VBU0428Test_CM_boolean 0 0 0.0 1.0 ECU_ADDRESS 0x90001d0b /end MEASUREMENT
/begin COMPU_METHOD VBU0428Test_CM_single_C "Q = V" RAT_FUNC "%8.6" "C" COEFFS 0 1 0 0 0 1 /end COMPU_METHOD
/begin COMPU_METHOD VBU0428Test_CM_single_cnt "Q = V" RAT_FUNC "%8.6" "cnt" COEFFS 0 1 0 0 0 1 /end COMPU_METHOD
/begin COMPU_METHOD VBU0428Test_CM_uint16_cnt "Q = V" RAT_FUNC "%5.0" "cnt" COEFFS 0 1 0 0 0 1 /end COMPU_METHOD
/begin COMPU_METHOD VBU0428Test_CM_single_Nm "Q = V" RAT_FUNC "%8.6" "Nm" COEFFS 0 1 0 0 0 1 /end COMPU_METHOD
/begin COMPU_METHOD VBU0428Test_CM_single_pct "Q = V" RAT_FUNC "%8.6" "pct" COEFFS 0 1 0 0 0 1 /end COMPU_METHOD
/begin COMPU_METHOD VBU0428Test_CM_single_fac "Q = V" RAT_FUNC "%8.6" "fac" COEFFS 0 1 0 0 0 1 /end COMPU_METHOD
/begin COMPU_METHOD VBU0428Test_CM_uint8 "Q = V" RAT_FUNC "%3.0" "" COEFFS 0 1 0 0 0 1 /end COMPU_METHOD
/begin COMPU_METHOD VBU0428Test_CM_single_km "Q = V" RAT_FUNC "%8.6" "km" COEFFS 0 1 0 0 0 1 /end COMPU_METHOD
/begin COMPU_METHOD VBU0428Test_CM_uint16 "Q = V" RAT_FUNC "%5.0" "" COEFFS 0 1 0 0 0 1 /end COMPU_METHOD
/begin COMPU_METHOD VBU0428Test_CM_single "Q = V" RAT_FUNC "%8.6" "" COEFFS 0 1 0 0 0 1 /end COMPU_METHOD
/begin COMPU_METHOD VBU0428Test_CM_single_s "Q = V" RAT_FUNC "%8.6" "s" COEFFS 0 1 0 0 0 1 /end COMPU_METHOD
/begin COMPU_METHOD VBU0428Test_CM_single_kW "Q = V" RAT_FUNC "%8.6" "kW" COEFFS 0 1 0 0 0 1 /end COMPU_METHOD
/begin COMPU_METHOD VBU0428Test_CM_uint32 "Q = V" RAT_FUNC "%10.0" "" COEFFS 0 1 0 0 0 1 /end COMPU_METHOD
/begin COMPU_METHOD VBU0428Test_CM_boolean_cnt "Q = V" RAT_FUNC "%1.0" "cnt" COEFFS 0 1 0 0 0 1 /end COMPU_METHOD
/begin COMPU_METHOD VBU0428Test_CM_boolean "Q = V" RAT_FUNC "%1.0" "" COEFFS 0 1 0 0 0 1 /end COMPU_METHOD
/begin COMPU_METHOD VBU0428Test_CM_uint8_cnt "Q = V" RAT_FUNC "%3.0" "cnt" COEFFS 0 1 0 0 0 1 /end COMPU_METHOD
/begin COMPU_METHOD VBU0428Test_CM_ufix28 "Q = V/1.000000" RAT_FUNC "%10.0" "" COEFFS 0 1.000000 0.000000 0 0 1.000000 /end COMPU_METHOD
/begin COMPU_METHOD VBU0428Test_CM_ufix24 "Q = V/1.000000" RAT_FUNC "%10.0" "" COEFFS 0 1.000000 0.000000 0 0 1.000000 /end COMPU_METHOD
/begin COMPU_METHOD VBU0428Test_CM_ufix16_Sp1_Bn1080 "Q = (V+1080.000000)*10.000000" RAT_FUNC "%0.6" "" COEFFS 0 10.000000 10800.000000 0 0 1.000000 /end COMPU_METHOD
/begin COMPU_METHOD VBU0428Test_CM_ufix16_Sp001_Bn20 "Q = (V+20.000000)*1000.000000" RAT_FUNC "%0.6" "" COEFFS 0 1000.000000 20000.000000 0 0 1.000000 /end COMPU_METHOD
/begin COMPU_METHOD VBU0428Test_CM_ufix16_En3 "Q = V*8.000000" RAT_FUNC "%7.3" "" COEFFS 0 8.000000 0.000000 0 0 1.000000 /end COMPU_METHOD
/begin COMPU_METHOD VBU0428Test_CM_ufix16_Bn30000 "Q = (V+30000.000000)/1.000000" RAT_FUNC "%0.6" "" COEFFS 0 1.000000 30000.000000 0 0 1.000000 /end COMPU_METHOD
/begin COMPU_METHOD VBU0428Test_CM_ufix14_Sp1_Bn450 "Q = (V+450.000000)*10.000000" RAT_FUNC "%0.6" "" COEFFS 0 10.000000 4500.000000 0 0 1.000000 /end COMPU_METHOD
/begin COMPU_METHOD VBU0428Test_CM_ufix13_Sp05625 "Q = V*17.777778" RAT_FUNC "%0.6" "" COEFFS 0 17.777778 0.000000 0 0 1.000000 /end COMPU_METHOD
/begin COMPU_METHOD VBU0428Test_CM_ufix12_Sp1 "Q = V*10.000000" RAT_FUNC "%0.6" "" COEFFS 0 10.000000 0.000000 0 0 1.000000 /end COMPU_METHOD
/begin COMPU_METHOD VBU0428Test_CM_ufix12 "Q = V/1.000000" RAT_FUNC "%5.0" "" COEFFS 0 1.000000 0.000000 0 0 1.000000 /end COMPU_METHOD
/begin COMPU_METHOD VBU0428Test_CM_ufix10_Sp1 "Q = V*10.000000" RAT_FUNC "%0.6" "" COEFFS 0 10.000000 0.000000 0 0 1.000000 /end COMPU_METHOD
/begin COMPU_METHOD VBU0428Test_CM_ufix10 "Q = V/1.000000" RAT_FUNC "%5.0" "" COEFFS 0 1.000000 0.000000 0 0 1.000000 /end COMPU_METHOD
/begin COMPU_METHOD VBU0428Test_CM_ufix8_Sp1_Bn12p8 "Q = (V+12.800000)*10.000000" RAT_FUNC "%0.6" "" COEFFS 0 10.000000 128.000000 0 0 1.000000 /end COMPU_METHOD
/begin COMPU_METHOD VBU0428Test_CM_ufix8_Sp1 "Q = V*10.000000" RAT_FUNC "%0.6" "" COEFFS 0 10.000000 0.000000 0 0 1.000000 /end COMPU_METHOD
/begin COMPU_METHOD VBU0428Test_CM_ufix8_E2 "Q = V/4.000000" RAT_FUNC "%3.0" "" COEFFS 0 1.000000 0.000000 0 0 4.000000 /end COMPU_METHOD
/begin COMPU_METHOD VBU0428Test_CM_ufix8_Bn40 "Q = (V+40.000000)/1.000000" RAT_FUNC "%0.6" "" COEFFS 0 1.000000 40.000000 0 0 1.000000 /end COMPU_METHOD
/begin COMPU_METHOD VBU0428Test_CM_ufix8_B2000 "Q = (V-2000.000000)/1.000000" RAT_FUNC "%0.6" "" COEFFS 0 1.000000 -2000.000000 0 0 1.000000 /end COMPU_METHOD
/begin COMPU_METHOD VBU0428Test_CM_ufix7 "Q = V/1.000000" RAT_FUNC "%3.0" "" COEFFS 0 1.000000 0.000000 0 0 1.000000 /end COMPU_METHOD
/begin COMPU_METHOD VBU0428Test_CM_ufix6 "Q = V/1.000000" RAT_FUNC "%3.0" "" COEFFS 0 1.000000 0.000000 0 0 1.000000 /end COMPU_METHOD
/begin COMPU_METHOD VBU0428Test_CM_ufix5_B1 "Q = (V-1.000000)/1.000000" RAT_FUNC "%0.6" "" COEFFS 0 1.000000 -1.000000 0 0 1.000000 /end COMPU_METHOD
/begin COMPU_METHOD VBU0428Test_CM_ufix5 "Q = V/1.000000" RAT_FUNC "%3.0" "" COEFFS 0 1.000000 0.000000 0 0 1.000000 /end COMPU_METHOD
/begin COMPU_METHOD VBU0428Test_CM_ufix4_B1 "Q = (V-1.000000)/1.000000" RAT_FUNC "%0.6" "" COEFFS 0 1.000000 -1.000000 0 0 1.000000 /end COMPU_METHOD
/begin COMPU_METHOD VBU0428Test_CM_ufix4 "Q = V/1.000000" RAT_FUNC "%3.0" "" COEFFS 0 1.000000 0.000000 0 0 1.000000 /end COMPU_METHOD
/begin COMPU_METHOD VBU0428Test_CM_ufix2 "Q = V/1.000000" RAT_FUNC "%3.0" "" COEFFS 0 1.000000 0.000000 0 0 1.000000 /end COMPU_METHOD
/begin COMPU_METHOD VBU0428Test_CM_ufix1 "Q = V/1.000000" RAT_FUNC "%3.0" "" COEFFS 0 1.000000 0.000000 0 0 1.000000 /end COMPU_METHOD
/begin GROUP S1668_LOW_HIGH13 "VBU0428Test/VBUSystem/BMS/VCT/Subsystem/Subsystem/Determine_BMS_VCU_272/Override/LOW_HIGH13" /begin REF_MEASUREMENT VCT_stSOCJumpReason /end REF_MEASUREMENT /end GROUP
/begin GROUP S1668_LOW_HIGH14 "VBU0428Test/VBUSystem/BMS/VCT/Subsystem/Subsystem/Determine_BMS_VCU_272/Override/LOW_HIGH14" /begin REF_MEASUREMENT VCT_stBatteryTypeDismatchAlarm /end REF_MEASUREMENT /end GROUP
/begin GROUP S1668_LOW_HIGH16 "VBU0428Test/VBUSystem/BMS/VCT/Subsystem/Subsystem/Determine_BMS_VCU_272/Override/LOW_HIGH16" /begin REF_MEASUREMENT VCT_stBetteryCellVolLowAlarm /end REF_MEASUREMENT /end GROUP
/begin GROUP S1668_LOW_HIGH17 "VBU0428Test/VBUSystem/BMS/VCT/Subsystem/Subsystem/Determine_BMS_VCU_272/Override/LOW_HIGH17" /begin REF_MEASUREMENT VCT_stSOCJumpAlarm /end REF_MEASUREMENT /end GROUP
/begin GROUP S1668_LOW_HIGH18 "VBU0428Test/VBUSystem/BMS/VCT/Subsystem/Subsystem/Determine_BMS_VCU_272/Override/LOW_HIGH18" /begin REF_MEASUREMENT VCT_stBetteryCellVolHighAlarm /end REF_MEASUREMENT /end GROUP
/begin GROUP S1668_LOW_HIGH2 "VBU0428Test/VBUSystem/BMS/VCT/Subsystem/Subsystem/Determine_BMS_VCU_272/Override/LOW_HIGH2" /begin REF_MEASUREMENT VCT_stBMSDCChargeCurrentOverUnder /end REF_MEASUREMENT /end GROUP
/begin GROUP S1668_LOW_HIGH3 "VBU0428Test/VBUSystem/BMS/VCT/Subsystem/Subsystem/Determine_BMS_VCU_272/Override/LOW_HIGH3" /begin REF_MEASUREMENT VCT_stBMSCellVoltageOverUnder /end REF_MEASUREMENT /end GROUP
/begin GROUP S1668_LOW_HIGH4 "VBU0428Test/VBUSystem/BMS/VCT/Subsystem/Subsystem/Determine_BMS_VCU_272/Override/LOW_HIGH4" /begin REF_MEASUREMENT VCT_stBatteryTempOver /end REF_MEASUREMENT /end GROUP
/begin GROUP S1668_LOW_HIGH5 "VBU0428Test/VBUSystem/BMS/VCT/Subsystem/Subsystem/Determine_BMS_VCU_272/Override/LOW_HIGH5" /begin REF_MEASUREMENT VCT_stBatteryOutputConnectorState /end REF_MEASUREMENT /end GROUP
/begin GROUP S1668_LOW_HIGH6 "VBU0428Test/VBUSystem/BMS/VCT/Subsystem/Subsystem/Determine_BMS_VCU_272/Override/LOW_HIGH6" /begin REF_MEASUREMENT VCT_stDCChargingPermitStatus /end REF_MEASUREMENT /end GROUP
/begin GROUP S1668_LOW_HIGH7 "VBU0428Test/VBUSystem/BMS/VCT/Subsystem/Subsystem/Determine_BMS_VCU_272/Override/LOW_HIGH7" /begin REF_MEASUREMENT VCT_stBetteryPckVoltUnderAlarm /end REF_MEASUREMENT /end GROUP
/begin GROUP S1668_LOW_HIGH8 "VBU0428Test/VBUSystem/BMS/VCT/Subsystem/Subsystem/Determine_BMS_VCU_272/Override/LOW_HIGH8" /begin REF_MEASUREMENT VCT_stBatteryConsistencyAlarm /end REF_MEASUREMENT /end GROUP
/begin GROUP S1668_LOW_HIGH9 "VBU0428Test/VBUSystem/BMS/VCT/Subsystem/Subsystem/Determine_BMS_VCU_272/Override/LOW_HIGH9" /begin REF_MEASUREMENT VCT_stBetteryPckVoltOverAlarm /end REF_MEASUREMENT /end GROUP
/begin GROUP S1713_LOW_HIGH1 "VBU0428Test/VBUSystem/BMS/VCT/Subsystem/Subsystem/Determine_BMS_VCU_273/Override/LOW_HIGH1" /begin REF_MEASUREMENT VCT_numBMSMaxTempSubSysNumber /end REF_MEASUREMENT /end GROUP
/begin GROUP S1713_LOW_HIGH2 "VBU0428Test/VBUSystem/BMS/VCT/Subsystem/Subsystem/Determine_BMS_VCU_273/Override/LOW_HIGH2" /begin REF_MEASUREMENT VCT_numBMSMinTempSubSysNumber /end REF_MEASUREMENT /end GROUP
/begin GROUP S1713_LOW_HIGH3 "VBU0428Test/VBUSystem/BMS/VCT/Subsystem/Subsystem/Determine_BMS_VCU_273/Override/LOW_HIGH3" /begin REF_MEASUREMENT VCT_numBMSMaxVoltageSubSysNumber /end REF_MEASUREMENT /end GROUP
/begin GROUP S1713_LOW_HIGH4 "VBU0428Test/VBUSystem/BMS/VCT/Subsystem/Subsystem/Determine_BMS_VCU_273/Override/LOW_HIGH4" /begin REF_MEASUREMENT VCT_numBMSMinimumCellVoltageNumber /end REF_MEASUREMENT /end GROUP
/begin GROUP S1713_LOW_HIGH5 "VBU0428Test/VBUSystem/BMS/VCT/Subsystem/Subsystem/Determine_BMS_VCU_273/Override/LOW_HIGH5" /begin REF_MEASUREMENT VCT_numBMSMinVoltageSubSysNumber /end REF_MEASUREMENT /end GROUP
/begin GROUP S1724_LOW_HIGH1 "VBU0428Test/VBUSystem/BMS/VCT/Subsystem/Subsystem/Determine_BMS_VCU_34/Override/LOW_HIGH1" /begin REF_MEASUREMENT VCT_stInhibitPrechargeCause /end REF_MEASUREMENT /end GROUP
/begin GROUP S1724_LOW_HIGH2 "VBU0428Test/VBUSystem/BMS/VCT/Subsystem/Subsystem/Determine_BMS_VCU_34/Override/LOW_HIGH2" /begin REF_MEASUREMENT VCT_stBMSContactorState /end REF_MEASUREMENT /end GROUP
/begin GROUP S1724_LOW_HIGH3 "VBU0428Test/VBUSystem/BMS/VCT/Subsystem/Subsystem/Determine_BMS_VCU_34/Override/LOW_HIGH3" /begin REF_MEASUREMENT VCT_stBMSSts /end REF_MEASUREMENT /end GROUP
/begin GROUP S1724_LOW_HIGH5 "VBU0428Test/VBUSystem/BMS/VCT/Subsystem/Subsystem/Determine_BMS_VCU_34/Override/LOW_HIGH5" /begin REF_MEASUREMENT VCT_numBMSRollingCounterAF /end REF_MEASUREMENT /end GROUP
/begin GROUP S1730_LOW_HIGH1 "VBU0428Test/VBUSystem/BMS/VCT/Subsystem/Subsystem/Determine_BMS_VCU_372/Override/LOW_HIGH1" /begin REF_MEASUREMENT VCT_kWhBatteryNomalCapacity /end REF_MEASUREMENT /end GROUP
/begin GROUP S1730_LOW_HIGH16 "VBU0428Test/VBUSystem/BMS/VCT/Subsystem/Subsystem/Determine_BMS_VCU_372/Override/LOW_HIGH16" /begin REF_MEASUREMENT VCT_iAMaximumChargingCurrent /end REF_MEASUREMENT /end GROUP
/begin GROUP S1730_LOW_HIGH2 "VBU0428Test/VBUSystem/BMS/VCT/Subsystem/Subsystem/Determine_BMS_VCU_372/Override/LOW_HIGH2" /begin REF_MEASUREMENT VCT_uMaximumChargingVoltage /end REF_MEASUREMENT /end GROUP
/begin GROUP S1730_LOW_HIGH3 "VBU0428Test/VBUSystem/BMS/VCT/Subsystem/Subsystem/Determine_BMS_VCU_372/Override/LOW_HIGH3" /begin REF_MEASUREMENT VCT_tMaximumPermitTemp /end REF_MEASUREMENT /end GROUP
/begin GROUP S1730_LOW_HIGH4 "VBU0428Test/VBUSystem/BMS/VCT/Subsystem/Subsystem/Determine_BMS_VCU_372/Override/LOW_HIGH4" /begin REF_MEASUREMENT VCT_HVBattStopDchaThd_pct /end REF_MEASUREMENT /end GROUP
/begin GROUP S1739_LOW_HIGH1 "VBU0428Test/VBUSystem/BMS/VCT/Subsystem/Subsystem/Determine_BMS_VCU_373/Override/LOW_HIGH1" /begin REF_MEASUREMENT VCT_tBMSTemperatureMin /end REF_MEASUREMENT /end GROUP
/begin GROUP S1739_LOW_HIGH10 "VBU0428Test/VBUSystem/BMS/VCT/Subsystem/Subsystem/Determine_BMS_VCU_373/Override/LOW_HIGH10" /begin REF_MEASUREMENT VCT_flgBMSTempMaxValidity /end REF_MEASUREMENT /end GROUP
/begin GROUP S1739_LOW_HIGH11 "VBU0428Test/VBUSystem/BMS/VCT/Subsystem/Subsystem/Determine_BMS_VCU_373/Override/LOW_HIGH11" /begin REF_MEASUREMENT VCT_flgBMSTempAverageValidity /end REF_MEASUREMENT /end GROUP
/begin GROUP S1739_LOW_HIGH12 "VBU0428Test/VBUSystem/BMS/VCT/Subsystem/Subsystem/Determine_BMS_VCU_373/Override/LOW_HIGH12" /begin REF_MEASUREMENT VCT_flgBMSTempMinValidity /end REF_MEASUREMENT /end GROUP
/begin GROUP S1739_LOW_HIGH13 "VBU0428Test/VBUSystem/BMS/VCT/Subsystem/Subsystem/Determine_BMS_VCU_373/Override/LOW_HIGH13" /begin REF_MEASUREMENT VCT_tBMSCellTempStandardDeviation /end REF_MEASUREMENT /end GROUP
/begin GROUP S1739_LOW_HIGH14 "VBU0428Test/VBUSystem/BMS/VCT/Subsystem/Subsystem/Determine_BMS_VCU_373/Override/LOW_HIGH14" /begin REF_MEASUREMENT VCT_tBMSInletTempRequest /end REF_MEASUREMENT /end GROUP
/begin GROUP S1739_LOW_HIGH15 "VBU0428Test/VBUSystem/BMS/VCT/Subsystem/Subsystem/Determine_BMS_VCU_373/Override/LOW_HIGH15" /begin REF_MEASUREMENT VCT_flgBMSTempRequestValid /end REF_MEASUREMENT /end GROUP
/begin GROUP S1739_LOW_HIGH17 "VBU0428Test/VBUSystem/BMS/VCT/Subsystem/Subsystem/Determine_BMS_VCU_373/Override/LOW_HIGH17" /begin REF_MEASUREMENT VCT_tBMSTemperatureMax /end REF_MEASUREMENT /end GROUP
/begin GROUP S1739_LOW_HIGH2 "VBU0428Test/VBUSystem/BMS/VCT/Subsystem/Subsystem/Determine_BMS_VCU_373/Override/LOW_HIGH2" /begin REF_MEASUREMENT VCT_tBMSInletWaterTemp /end REF_MEASUREMENT /end GROUP
/begin GROUP S1739_LOW_HIGH3 "VBU0428Test/VBUSystem/BMS/VCT/Subsystem/Subsystem/Determine_BMS_VCU_373/Override/LOW_HIGH3" /begin REF_MEASUREMENT VCT_tBMSOutletWaterTemp /end REF_MEASUREMENT /end GROUP
/begin GROUP S1739_LOW_HIGH4 "VBU0428Test/VBUSystem/BMS/VCT/Subsystem/Subsystem/Determine_BMS_VCU_373/Override/LOW_HIGH4" /begin REF_MEASUREMENT VCT_flgBMSESSInletTempMask /end REF_MEASUREMENT /end GROUP
/begin GROUP S1739_LOW_HIGH5 "VBU0428Test/VBUSystem/BMS/VCT/Subsystem/Subsystem/Determine_BMS_VCU_373/Override/LOW_HIGH5" /begin REF_MEASUREMENT VCT_tBMSTemperatureAverage /end REF_MEASUREMENT /end GROUP
/begin GROUP S1739_LOW_HIGH6 "VBU0428Test/VBUSystem/BMS/VCT/Subsystem/Subsystem/Determine_BMS_VCU_373/Override/LOW_HIGH6" /begin REF_MEASUREMENT VCT_flgBMSESSOutletTempMask /end REF_MEASUREMENT /end GROUP
/begin GROUP S1739_LOW_HIGH7 "VBU0428Test/VBUSystem/BMS/VCT/Subsystem/Subsystem/Determine_BMS_VCU_373/Override/LOW_HIGH7" /begin REF_MEASUREMENT VCT_flgBMSHVShutdownReq /end REF_MEASUREMENT /end GROUP
/begin GROUP S1739_LOW_HIGH8 "VBU0428Test/VBUSystem/BMS/VCT/Subsystem/Subsystem/Determine_BMS_VCU_373/Override/LOW_HIGH8" /begin REF_MEASUREMENT VCT_flgBMSESSInletTempValidity /end REF_MEASUREMENT /end GROUP
/begin GROUP S1739_LOW_HIGH9 "VBU0428Test/VBUSystem/BMS/VCT/Subsystem/Subsystem/Determine_BMS_VCU_373/Override/LOW_HIGH9" /begin REF_MEASUREMENT VCT_flgBMSESSOutletTempValidity /end REF_MEASUREMENT /end GROUP
/begin GROUP S1758_LOW_HIGH1 "VBU0428Test/VBUSystem/BMS/VCT/Subsystem/Subsystem/Determine_BMS_VCU_AC/Override/LOW_HIGH1" /begin REF_MEASUREMENT VCT_stBMSFaultCat /end REF_MEASUREMENT /end GROUP
/begin GROUP S1758_LOW_HIGH10 "VBU0428Test/VBUSystem/BMS/VCT/Subsystem/Subsystem/Determine_BMS_VCU_AC/Override/LOW_HIGH10" /begin REF_MEASUREMENT VCT_pctBMSCustomerUsageSOC /end REF_MEASUREMENT /end GROUP
/begin GROUP S1758_LOW_HIGH17 "VBU0428Test/VBUSystem/BMS/VCT/Subsystem/Subsystem/Determine_BMS_VCU_AC/Override/LOW_HIGH17" /begin REF_MEASUREMENT VCT_iABMSPackCrnt /end REF_MEASUREMENT /end GROUP
/begin GROUP S1758_LOW_HIGH2 "VBU0428Test/VBUSystem/BMS/VCT/Subsystem/Subsystem/Determine_BMS_VCU_AC/Override/LOW_HIGH2" /begin REF_MEASUREMENT VCT_stBMSFaultLvl /end REF_MEASUREMENT /end GROUP
/begin GROUP S1758_LOW_HIGH3 "VBU0428Test/VBUSystem/BMS/VCT/Subsystem/Subsystem/Determine_BMS_VCU_AC/Override/LOW_HIGH3" /begin REF_MEASUREMENT VCT_uBMSPackVoltage /end REF_MEASUREMENT /end GROUP
/begin GROUP S1758_LOW_HIGH4 "VBU0428Test/VBUSystem/BMS/VCT/Subsystem/Subsystem/Determine_BMS_VCU_AC/Override/LOW_HIGH4" /begin REF_MEASUREMENT VCT_pctBMSSOC /end REF_MEASUREMENT /end GROUP
/begin GROUP S1758_LOW_HIGH5 "VBU0428Test/VBUSystem/BMS/VCT/Subsystem/Subsystem/Determine_BMS_VCU_AC/Override/LOW_HIGH5" /begin REF_MEASUREMENT VCT_flgHVBattSOCLowCrit /end REF_MEASUREMENT /end GROUP
/begin GROUP S1758_LOW_HIGH7 "VBU0428Test/VBUSystem/BMS/VCT/Subsystem/Subsystem/Determine_BMS_VCU_AC/Override/LOW_HIGH7" /begin REF_MEASUREMENT VCT_flgChargeAvailable /end REF_MEASUREMENT /end GROUP
/begin GROUP S1758_LOW_HIGH8 "VBU0428Test/VBUSystem/BMS/VCT/Subsystem/Subsystem/Determine_BMS_VCU_AC/Override/LOW_HIGH8" /begin REF_MEASUREMENT VCT_numBMSRollingCounter225 /end REF_MEASUREMENT /end GROUP
/begin GROUP S1758_LOW_HIGH9 "VBU0428Test/VBUSystem/BMS/VCT/Subsystem/Subsystem/Determine_BMS_VCU_AC/Override/LOW_HIGH9" /begin REF_MEASUREMENT VCT_flgHVBattSOCLowWarn /end REF_MEASUREMENT /end GROUP
/begin GROUP S1771_LOW_HIGH17 "VBU0428Test/VBUSystem/BMS/VCT/Subsystem/Subsystem/Determine_BMS_VCU_AD/Override/LOW_HIGH17" /begin REF_MEASUREMENT VCT_iABMSDischgCurrentLimit /end REF_MEASUREMENT /end GROUP
/begin GROUP S1771_LOW_HIGH2 "VBU0428Test/VBUSystem/BMS/VCT/Subsystem/Subsystem/Determine_BMS_VCU_AD/Override/LOW_HIGH2" /begin REF_MEASUREMENT VCT_flgBMSBalanceStatus /end REF_MEASUREMENT /end GROUP
/begin GROUP S1771_LOW_HIGH3 "VBU0428Test/VBUSystem/BMS/VCT/Subsystem/Subsystem/Determine_BMS_VCU_AD/Override/LOW_HIGH3" /begin REF_MEASUREMENT VCT_uBMSVoltageLimitMax /end REF_MEASUREMENT /end GROUP
/begin GROUP S1771_LOW_HIGH4 "VBU0428Test/VBUSystem/BMS/VCT/Subsystem/Subsystem/Determine_BMS_VCU_AD/Override/LOW_HIGH4" /begin REF_MEASUREMENT VCT_stBMSIsolationLevel /end REF_MEASUREMENT /end GROUP
/begin GROUP S1771_LOW_HIGH5 "VBU0428Test/VBUSystem/BMS/VCT/Subsystem/Subsystem/Determine_BMS_VCU_AD/Override/LOW_HIGH5" /begin REF_MEASUREMENT VCT_stBMSChargeState /end REF_MEASUREMENT /end GROUP
/begin GROUP S1771_LOW_HIGH6 "VBU0428Test/VBUSystem/BMS/VCT/Subsystem/Subsystem/Determine_BMS_VCU_AD/Override/LOW_HIGH6" /begin REF_MEASUREMENT VCT_uBMSVoltageLimitMin /end REF_MEASUREMENT /end GROUP
/begin GROUP S1771_LOW_HIGH7 "VBU0428Test/VBUSystem/BMS/VCT/Subsystem/Subsystem/Determine_BMS_VCU_AD/Override/LOW_HIGH7" /begin REF_MEASUREMENT VCT_flgChargeCurrentDerate /end REF_MEASUREMENT /end GROUP
/begin GROUP S1783_LOW_HIGH1 "VBU0428Test/VBUSystem/BMS/VCT/Subsystem/Subsystem/Determine_BMS_VCU_AE/Override/LOW_HIGH1" /begin REF_MEASUREMENT VCT_stBMSIfPackVoltageSet /end REF_MEASUREMENT /end GROUP
/begin GROUP S1783_LOW_HIGH10 "VBU0428Test/VBUSystem/BMS/VCT/Subsystem/Subsystem/Determine_BMS_VCU_AE/Override/LOW_HIGH10" /begin REF_MEASUREMENT VCT_stBMSOverCurrent /end REF_MEASUREMENT /end GROUP
/begin GROUP S1783_LOW_HIGH11 "VBU0428Test/VBUSystem/BMS/VCT/Subsystem/Subsystem/Determine_BMS_VCU_AE/Override/LOW_HIGH11" /begin REF_MEASUREMENT VCT_uMaximumPermitChargeCellVoltage /end REF_MEASUREMENT /end GROUP
/begin GROUP S1783_LOW_HIGH12 "VBU0428Test/VBUSystem/BMS/VCT/Subsystem/Subsystem/Determine_BMS_VCU_AE/Override/LOW_HIGH12" /begin REF_MEASUREMENT VCT_stBMSVolMismatch /end REF_MEASUREMENT /end GROUP
/begin GROUP S1783_LOW_HIGH17 "VBU0428Test/VBUSystem/BMS/VCT/Subsystem/Subsystem/Determine_BMS_VCU_AE/Override/LOW_HIGH17" /begin REF_MEASUREMENT VCT_stBMSIfBmsSocSet /end REF_MEASUREMENT /end GROUP
/begin GROUP S1783_LOW_HIGH2 "VBU0428Test/VBUSystem/BMS/VCT/Subsystem/Subsystem/Determine_BMS_VCU_AE/Override/LOW_HIGH2" /begin REF_MEASUREMENT VCT_stBMSIfCellVoltageSet /end REF_MEASUREMENT /end GROUP
/begin GROUP S1783_LOW_HIGH3 "VBU0428Test/VBUSystem/BMS/VCT/Subsystem/Subsystem/Determine_BMS_VCU_AE/Override/LOW_HIGH3" /begin REF_MEASUREMENT VCT_stBMSHvIsolation /end REF_MEASUREMENT /end GROUP
/begin GROUP S1783_LOW_HIGH4 "VBU0428Test/VBUSystem/BMS/VCT/Subsystem/Subsystem/Determine_BMS_VCU_AE/Override/LOW_HIGH4" /begin REF_MEASUREMENT VCT_stBMSConnectorOvertemp /end REF_MEASUREMENT /end GROUP
/begin GROUP S1783_LOW_HIGH5 "VBU0428Test/VBUSystem/BMS/VCT/Subsystem/Subsystem/Determine_BMS_VCU_AE/Override/LOW_HIGH5" /begin REF_MEASUREMENT VCT_stBMSChrgConnError /end REF_MEASUREMENT /end GROUP
/begin GROUP S1783_LOW_HIGH6 "VBU0428Test/VBUSystem/BMS/VCT/Subsystem/Subsystem/Determine_BMS_VCU_AE/Override/LOW_HIGH6" /begin REF_MEASUREMENT VCT_stBMSChrgConnOvertemp /end REF_MEASUREMENT /end GROUP
/begin GROUP S1783_LOW_HIGH7 "VBU0428Test/VBUSystem/BMS/VCT/Subsystem/Subsystem/Determine_BMS_VCU_AE/Override/LOW_HIGH7" /begin REF_MEASUREMENT VCT_stBMSPackOverTemp /end REF_MEASUREMENT /end GROUP
/begin GROUP S1783_LOW_HIGH8 "VBU0428Test/VBUSystem/BMS/VCT/Subsystem/Subsystem/Determine_BMS_VCU_AE/Override/LOW_HIGH8" /begin REF_MEASUREMENT VCT_stBMSHvConectorError /end REF_MEASUREMENT /end GROUP
/begin GROUP S1783_LOW_HIGH9 "VBU0428Test/VBUSystem/BMS/VCT/Subsystem/Subsystem/Determine_BMS_VCU_AE/Override/LOW_HIGH9" /begin REF_MEASUREMENT VCT_stBMSOtherError /end REF_MEASUREMENT /end GROUP
/begin GROUP S2085_override_signal "VBU0428Test/VBUSystem/HALIn/PTCAN/Subsystem/20ms/ABS_0x79/Input_CAN_Signal_No_Range_Check/override_signal" /begin REF_MEASUREMENT BCU_vWhlRL /end REF_MEASUREMENT /end GROUP
/begin GROUP S2087_override_signal "VBU0428Test/VBUSystem/HALIn/PTCAN/Subsystem/20ms/ABS_0x79/Input_CAN_Signal_No_Range_Check2/override_signal" /begin REF_MEASUREMENT BCU_vWhlRR /end REF_MEASUREMENT /end GROUP
/begin GROUP S2169_override_signal "VBU0428Test/VBUSystem/HALIn/PTCAN/Subsystem/20ms/MCU_205/Input_CAN_Signal_No_Range_Check1/override_signal" /begin REF_MEASUREMENT PEUR_flgtrqActVld /end REF_MEASUREMENT /end GROUP
/begin GROUP S2171_override_signal "VBU0428Test/VBUSystem/HALIn/PTCAN/Subsystem/20ms/MCU_205/Input_CAN_Signal_No_Range_Check3/override_signal" /begin REF_MEASUREMENT PEUR_flgMotrHillHld /end REF_MEASUREMENT /end GROUP
/begin GROUP S2172_override_signal "VBU0428Test/VBUSystem/HALIn/PTCAN/Subsystem/20ms/MCU_205/Input_CAN_Signal_No_Range_Check4/override_signal" /begin REF_MEASUREMENT PEUR_stActvDisCh /end REF_MEASUREMENT /end GROUP
/begin GROUP S2173_override_signal "VBU0428Test/VBUSystem/HALIn/PTCAN/Subsystem/20ms/MCU_205/Input_CAN_Signal_No_Range_Check5/override_signal" /begin REF_MEASUREMENT PEUR_nMotr /end REF_MEASUREMENT /end GROUP
/begin GROUP S2175_override_signal "VBU0428Test/VBUSystem/HALIn/PTCAN/Subsystem/20ms/MCU_205/Input_CAN_Signal_No_Range_Check7/override_signal" /begin REF_MEASUREMENT PEUR_iCalcDC /end REF_MEASUREMENT /end GROUP
/begin GROUP S2263_override_signal "VBU0428Test/VBUSystem/HALIn/PTCAN/Subsystem/50ms/MCU_305/Input_CAN_Signal_No_Range_Check/override_signal" /begin REF_MEASUREMENT PEUR_uDCRlyOutsideVltg /end REF_MEASUREMENT /end GROUP
/begin GROUP S2400_ABS_VehicleSpeedAndStatus "VBU0428Test/VBUSystem/HALIn/PTCAN/Subsystem/CanMsgUnpack/MsgRxData_Unpack1/CanRxData_Unpack/ABS_VehicleSpeedAndStatus"
 /begin REF_MEASUREMENT ABS_Active ABS_EBDFailed ABS_Failed ABS_VehicleSpeed ABS_VehicleSpeedValid EBD_Active /end REF_MEASUREMENT
/end GROUP
/begin GROUP S2402_DCDC_VCU_509 "VBU0428Test/VBUSystem/HALIn/PTCAN/Subsystem/CanMsgUnpack/MsgRxData_Unpack10/CanRxData_Unpack/DCDC_VCU_509"
 /begin REF_MEASUREMENT DCDCDeriting DCDCOverHeat DCDCOverInputCurrent DCDCOverInputVoltage DCDCOverOutputCurrent DCDCOverOutputVoltage DCDCTemperature DCDCUnderInputVoltage DCDCUnderOutputVoltage /end REF_MEASUREMENT
/end GROUP
/begin GROUP S2404_EPB_State "VBU0428Test/VBUSystem/HALIn/PTCAN/Subsystem/CanMsgUnpack/MsgRxData_Unpack11/CanRxData_Unpack/EPB_State"
 /begin REF_MEASUREMENT CheckSum Communication DragForce EPB_Control_Mode EPB_Fault_Level EPB_Key_Err EPB_Key_Sta EPB_PSensor_Err EPB_SolValve_ErrInd EPB_state IGN Park_LED_Sta Rollingcounter /end REF_MEASUREMENT
/end GROUP
/begin GROUP S2406_EPS_DM1 "VBU0428Test/VBUSystem/HALIn/PTCAN/Subsystem/CanMsgUnpack/MsgRxData_Unpack12/CanRxData_Unpack/EPS_DM1"
 /begin REF_MEASUREMENT EPS_AMismathcR EPS_ASteeringAngleOutRange EPS_CAN_BUS_OFF EPS_CurrentOverDevition EPS_ECUCaliFail EPS_ECUCurrentSensorInvalid EPS_InvalidSpeed EPS_LVOverVoltage EPS_LVUnderVoltage EPS_MotorCurrentinvalid EPS_MotorDriverCircurtFail EPS_MotorPoSensorFault EPS_PTReadyLostFrame EPS_RSteeringAngleOutRange EPS_RelayFail EPS_SpeedLose EPS_SpeedOut EPS_T1T2Mismatch EPS_T1TorqueOutRange EPS_T2TorqueOutRange EPS_TemOverHigh EPS_TemOverLow EPS_TorqueSensorVoltError /end REF_MEASUREMENT
/end GROUP
/begin GROUP S2408_EPS_FEEDBACK_STA "VBU0428Test/VBUSystem/HALIn/PTCAN/Subsystem/CanMsgUnpack/MsgRxData_Unpack13/CanRxData_Unpack/EPS_FEEDBACK_STA"
 /begin REF_MEASUREMENT EPS_ECU_MODE_CONT EPS_ECU_msg_counter EPS_Steering_Angle EPS_TORque_Motor EPS_Torque_Steering EPS_steering_angle_spd /end REF_MEASUREMENT
/end GROUP
/begin GROUP S2410_IC_401 "VBU0428Test/VBUSystem/HALIn/PTCAN/Subsystem/CanMsgUnpack/MsgRxData_Unpack14/CanRxData_Unpack/IC_401"
 /begin REF_MEASUREMENT IC_BrakeDisWarning IC_BrakeFluidWarning IC_SeatbeltUnlock IC_VehOdometer /end REF_MEASUREMENT
/end GROUP
/begin GROUP S2412_MCU_205 "VBU0428Test/VBUSystem/HALIn/PTCAN/Subsystem/CanMsgUnpack/MsgRxData_Unpack15/CanRxData_Unpack/MCU_205"
 /begin REF_MEASUREMENT MCU_ActiveRelease MCU_CalDCCurrent MCU_MotorHillHold MCU_MotorMode MCU_MotorSpeed MCU_MotorSpeedValid MCU_MotorTorque MCU_checksum MCU_rollingcounter /end REF_MEASUREMENT
/end GROUP
/begin GROUP S2414_MCU_305 "VBU0428Test/VBUSystem/HALIn/PTCAN/Subsystem/CanMsgUnpack/MsgRxData_Unpack16/CanRxData_Unpack/MCU_305"
 /begin REF_MEASUREMENT MCU_AllowMaxTorque MCU_DCRelayOutSideVoltage MCU_DC_BUSVoltage /end REF_MEASUREMENT
/end GROUP
/begin GROUP S2416_MCU_405 "VBU0428Test/VBUSystem/HALIn/PTCAN/Subsystem/CanMsgUnpack/MsgRxData_Unpack17/CanRxData_Unpack/MCU_405"
 /begin REF_MEASUREMENT MCU_IGBTMaxTemperature MCU_IPM_Temperature MCU_MotorTemperature MCU_UVWMaxCurrent /end REF_MEASUREMENT
/end GROUP
/begin GROUP S2418_MCU_505 "VBU0428Test/VBUSystem/HALIn/PTCAN/Subsystem/CanMsgUnpack/MsgRxData_Unpack18/CanRxData_Unpack/MCU_505"
 /begin REF_MEASUREMENT MCU_BusOverVoltage MCU_BusUnderVoltage MCU_CAN_Fault MCU_CPLD_Status MCU_Drive_Downarm_failure MCU_Drive_Uparm_failure MCU_FaultLevel MCU_HallFault MCU_Hardware_OverVoltage MCU_Hardware_UnderVoltage MCU_IGBT_Junction_overTem_limit MCU_IGBT_NTC_overTem_limit MCU_IGBTfault MCU_IGBToverheat MCU_MotorOverheat MCU_Motor_overTem_limit MCU_OutputFault MCU_OverCurrent MCU_OverSpeed MCU_Radiator_overTem_limit MCU_ResolverFault /end REF_MEASUREMENT
/end GROUP
/begin GROUP S2420_T_BOX_510 "VBU0428Test/VBUSystem/HALIn/PTCAN/Subsystem/CanMsgUnpack/MsgRxData_Unpack19/CanRxData_Unpack/T_BOX_510" /begin REF_MEASUREMENT T_BOXGPS_Latitude T_BOXGPS_Longitude /end REF_MEASUREMENT /end GROUP
/begin GROUP S2422_ABS_WheelSpeed_Front_Whl "VBU0428Test/VBUSystem/HALIn/PTCAN/Subsystem/CanMsgUnpack/MsgRxData_Unpack2/CanRxData_Unpack/ABS_WheelSpeed_Front_Whl"
 /begin REF_MEASUREMENT ABS_Checksum ABS_Rolling_Counter ABS_WheelSpeed_FL ABS_WheelSpeed_FL_Status ABS_WheelSpeed_FR ABS_WheelSpeed_FR_Status /end REF_MEASUREMENT
/end GROUP
/begin GROUP S2424_T_BOX_511 "VBU0428Test/VBUSystem/HALIn/PTCAN/Subsystem/CanMsgUnpack/MsgRxData_Unpack20/CanRxData_Unpack/T_BOX_511"
 /begin REF_MEASUREMENT T_BOXTime_Day T_BOXTime_Hour T_BOXTime_Min T_BOXTime_Month T_BOXTime_Sec T_BOXTime_Year /end REF_MEASUREMENT
/end GROUP
/begin GROUP S2426_ABS_WheelSpeed_PulseCounter "VBU0428Test/VBUSystem/HALIn/PTCAN/Subsystem/CanMsgUnpack/MsgRxData_Unpack3/CanRxData_Unpack/ABS_WheelSpeed_PulseCounter"
 /begin REF_MEASUREMENT ABS_WheelSpeedPlusCounter_FL ABS_WheelSpeedPlusCounter_FL_inv ABS_WheelSpeedPlusCounter_FR ABS_WheelSpeedPlusCounter_FR_inv ABS_WheelSpeedPlusCounter_RL ABS_WheelSpeedPlusCounter_RL_inv ABS_WheelSpeedPlusCounter_RR ABS_WheelSpeedPlusCounter_RR_inv /end REF_MEASUREMENT
/end GROUP
/begin GROUP S2428_ABS_WheelSpeed_Rear_Whl "VBU0428Test/VBUSystem/HALIn/PTCAN/Subsystem/CanMsgUnpack/MsgRxData_Unpack4/CanRxData_Unpack/ABS_WheelSpeed_Rear_Whl"
 /begin REF_MEASUREMENT ABS_WheelSpeed_RL ABS_WheelSpeed_RL_Status ABS_WheelSpeed_RR ABS_WheelSpeed_RR_Status /end REF_MEASUREMENT
/end GROUP
/begin GROUP S2430_AC_VCU "VBU0428Test/VBUSystem/HALIn/PTCAN/Subsystem/CanMsgUnpack/MsgRxData_Unpack5/CanRxData_Unpack/AC_VCU"
 /begin REF_MEASUREMENT ACComFault ACCompActSpeed ACCompCurrent ACCompStatus ACCompVoltage ACOverCurrent ACOverVoltage ACOver_current_FreqReduction ACSpeedFault ACStandby_overvoltage ACStandby_undervoltage ACUnderVoltage /end REF_MEASUREMENT
/end GROUP
/begin GROUP S2432_AVAS "VBU0428Test/VBUSystem/HALIn/PTCAN/Subsystem/CanMsgUnpack/MsgRxData_Unpack6/CanRxData_Unpack/AVAS"
 /begin REF_MEASUREMENT AVAS_HardwareVersion AVAS_SoftwareVersion AVAS_WorkingStatus /end REF_MEASUREMENT
/end GROUP
/begin GROUP S2434_BCM_VCU "VBU0428Test/VBUSystem/HALIn/PTCAN/Subsystem/CanMsgUnpack/MsgRxData_Unpack7/CanRxData_Unpack/BCM_VCU"
 /begin REF_MEASUREMENT BCM_Automatic_headlight_gear BCM_Automatic_wiper_gear BCM_Brake_Light_Status BCM_Day_Light_Status BCM_DoorStatus BCM_FrontFogLight BCM_HI_Wiper_Status BCM_HighBeam BCM_Horn_Status BCM_IG1_Power BCM_LeftTurnLightStatus BCM_LowBeam BCM_Low_Wiper_Status BCM_Park_Light_Status BCM_Prak_Switch_Status BCM_RearFogLight BCM_Reversing_Switch_Status BCM_RightTurnLightStatus BCM_Wash_Motor_Status /end REF_MEASUREMENT
/end GROUP
/begin GROUP S2436_CDC_VCU "VBU0428Test/VBUSystem/HALIn/PTCAN/Subsystem/CanMsgUnpack/MsgRxData_Unpack8/CanRxData_Unpack/CDC_VCU"
 /begin REF_MEASUREMENT CDC_CreepOnOff CDC_DriveMode CDC_GoNotifierOnOff CDC_RegenMode CDC_TowMode CDC_checksum CDC_rollingcounter /end REF_MEASUREMENT
/end GROUP
/begin GROUP S2438_DCDC_VCU_303 "VBU0428Test/VBUSystem/HALIn/PTCAN/Subsystem/CanMsgUnpack/MsgRxData_Unpack9/CanRxData_Unpack/DCDC_VCU_303"
 /begin REF_MEASUREMENT DCDCEnableFeedback DCDCInputCurrent DCDCInputVoltage DCDCOutputCurrent DCDCOutputVoltage DCDCWorkstatus DCDCrollingcounter /end REF_MEASUREMENT
/end GROUP
/begin GROUP S2634_override_signal "VBU0428Test/VBUSystem/HALIn/PTCAN/Subsystem/Subsystem4/CDC_220/Input_CAN_Signal_No_Range_Check3/override_signal" /begin REF_MEASUREMENT CDC_stRgnMode /end REF_MEASUREMENT /end GROUP
/begin GROUP S2635_override_signal "VBU0428Test/VBUSystem/HALIn/PTCAN/Subsystem/Subsystem4/CDC_220/Input_CAN_Signal_No_Range_Check4/override_signal" /begin REF_MEASUREMENT CDC_stDrvMode /end REF_MEASUREMENT /end GROUP
/begin GROUP S3229_DCH_BMSChAvlDebounce "VBU0428Test/VBUSystem/VCU /DCH/DCH_Overall/DCH_DCChargeCtrlOverall/DCH_DCChargeCtrlStateflow/DCH_InputSignalPreProcess/DCH_BMSChAvlDebounce" /begin SUB_GROUP S3233_Turn_Off_Delay_Time /end SUB_GROUP /begin REF_CHARACTERISTIC DCH_tiBMSChAvlDly_C DCH_tiBMSChAvlTrnOffDly_C /end REF_CHARACTERISTIC /end GROUP
/begin GROUP S3229_DCH_DCRelayCloseDiagnose "VBU0428Test/VBUSystem/VCU /DCH/DCH_Overall/DCH_DCChargeCtrlOverall/DCH_DCChargeCtrlStateflow/DCH_InputSignalPreProcess/DCH_DCRelayCloseDiagnose" /begin SUB_GROUP S3234_Turn_Off_Delay_Time2 /end SUB_GROUP /begin REF_CHARACTERISTIC DCH_tiDCChRlyTurnOffConfrmDly_C DCH_uDCRlyClosedJudged_C /end REF_CHARACTERISTIC /end GROUP
/begin GROUP S3229_DCH_VehStateAnalyze "VBU0428Test/VBUSystem/VCU /DCH/DCH_Overall/DCH_DCChargeCtrlOverall/DCH_DCChargeCtrlStateflow/DCH_InputSignalPreProcess/DCH_VehStateAnalyze" /begin SUB_GROUP S3235_Turn_Off_Delay_Time2 /end SUB_GROUP
 /begin REF_CHARACTERISTIC DCH_tiAPlusVldDly_C DCH_tiAplusConfirmT_C DCH_tiCC2ConfirmT_C DCH_uMaxCCToConn_C DCH_uMinCCToConn_C DCH_vMaxSpdLim_C DCH_vMinSpdLim_C /end REF_CHARACTERISTIC
 /begin REF_MEASUREMENT DCH_flgCC2Conn /end REF_MEASUREMENT
/end GROUP
/begin GROUP S3230_DCH_BMSErrorDetect "VBU0428Test/VBUSystem/VCU /DCH/DCH_Overall/DCH_DCChargeCtrlOverall/DCH_DCChargeCtrlStateflow/DCH_SignalPreProcessForStateflow/DCH_BMSErrorDetect" /begin REF_CHARACTERISTIC DCH_stSysIsoCriticalFault_SY DCH_stVehIsoCriticalFault_SY /end REF_CHARACTERISTIC /begin REF_MEASUREMENT DCH_flgBmsChCrntOver DCH_flgBmsIsoCriticalFault /end REF_MEASUREMENT /end GROUP
/begin GROUP S3230_DCH_ChargeStopCalc "VBU0428Test/VBUSystem/VCU /DCH/DCH_Overall/DCH_DCChargeCtrlOverall/DCH_DCChargeCtrlStateflow/DCH_SignalPreProcessForStateflow/DCH_ChargeStopCalc"
 /begin REF_CHARACTERISTIC DCH_stBMSChCmpt_SY DCH_stCDCStopCharging_SY DCH_stVehSoftwUpdate_SY /end REF_CHARACTERISTIC
 /begin REF_MEASUREMENT DCH_flgBMSChCmpt DCH_flgStopForManual /end REF_MEASUREMENT
/end GROUP
/begin GROUP S3230_DCH_ChgerZeroCurrentDiagnose "VBU0428Test/VBUSystem/VCU /DCH/DCH_Overall/DCH_DCChargeCtrlOverall/DCH_DCChargeCtrlStateflow/DCH_SignalPreProcessForStateflow/DCH_ChgerZeroCurrentDiagnose" /begin REF_CHARACTERISTIC DCH_iBMSZeroCrntDlyStopCh_C DCH_iCCSChgCrnt_C /end REF_CHARACTERISTIC /end GROUP
/begin GROUP S3230_DCH_ChgrAvlDiagnose "VBU0428Test/VBUSystem/VCU /DCH/DCH_Overall/DCH_DCChargeCtrlOverall/DCH_DCChargeCtrlStateflow/DCH_SignalPreProcessForStateflow/DCH_ChgrAvlDiagnose"
 /begin REF_CHARACTERISTIC DCH_flgAllowNGearCh_C DCH_stNGear_SY DCH_stPGear_SY DCH_stVehSoftwUpdate_SY /end REF_CHARACTERISTIC
 /begin REF_MEASUREMENT DCH_flgHalfConn /end REF_MEASUREMENT
/end GROUP
/begin GROUP S3230_DCH_OpenPDURelayValid "VBU0428Test/VBUSystem/VCU /DCH/DCH_Overall/DCH_DCChargeCtrlOverall/DCH_DCChargeCtrlStateflow/DCH_SignalPreProcessForStateflow/DCH_OpenPDURelayValid" /begin REF_CHARACTERISTIC DCH_iOpenDCChRly_C DCH_tiCC2OffCnfrm_C /end REF_CHARACTERISTIC /end GROUP
/begin GROUP S3273_DCH_BSTOrCSTTrigger "VBU0428Test/VBUSystem/VCU /DCH/DCH_Overall/DCH_DCChargeCtrlOverall/DCH_EepromStore/DCH_ChargeStopErrDiagnose/DCH_BSTOrCSTTrigger" /begin REF_CHARACTERISTIC DCH_tiCSTTrigDly_C /end REF_CHARACTERISTIC /end GROUP
/begin GROUP S3274_BEM_EEPROM "VBU0428Test/VBUSystem/VCU /DCH/DCH_Overall/DCH_DCChargeCtrlOverall/DCH_EepromStore/DCH_ChargeTimeOutDiagnose/BEM_EEPROM"
 /begin REF_CHARACTERISTIC DCH_stBEM00TOutMSK_SY DCH_stBEMAATOutMSK_SY DCH_stBEMChCapTOutMSK_SY DCH_stBEMChRdyTOutMSK_SY DCH_stBEMChStTOutMSK_SY DCH_stBEMChgrStopTOutMSK_SY DCH_stBEMStatsDataTOutMSK_SY DCH_stKeyRaw_SY /end REF_CHARACTERISTIC
/end GROUP
/begin GROUP S3275_CSTTrigDly "VBU0428Test/VBUSystem/VCU /DCH/DCH_Overall/DCH_DCChargeCtrlOverall/DCH_EepromStore/DataConvertandCSTEEPROM/CSTTrigDly" /begin REF_CHARACTERISTIC DCH_tiCSTTrigDly_C /end REF_CHARACTERISTIC /end GROUP
/begin GROUP S3275_CST_EEPROM "VBU0428Test/VBUSystem/VCU /DCH/DCH_Overall/DCH_DCChargeCtrlOverall/DCH_EepromStore/DataConvertandCSTEEPROM/CST_EEPROM"
 /begin REF_CHARACTERISTIC DCH_stCurrDismatchErrMSK_SY DCH_stEnergNotTrnsmtFultMSK_SY DCH_stFaultStopMSK_SY DCH_stKeyRaw_SY DCH_stOtherStaStpFultMSK_SY DCH_stStaCntorFultMSK_SY DCH_stStaEmergStpFultMSK_SY DCH_stStaIntOverTempFultMSK_SY DCH_stStaOverTempFaultMSK_SY DCH_stStaStopCondReachMSK_SY DCH_stVoltAbnormalErrMSK_SY /end REF_CHARACTERISTIC
/end GROUP
/begin GROUP S3339_DSPL_EnergyComsumptionCal "VBU0428Test/VBUSystem/VCU /DSPL /DSPL/DriveRange/DSPL_Consumption/DSPL_EnergySelfLearn/DSPL_EnergyComsumptionCal" /begin REF_CHARACTERISTIC DSPL_pctBMSSOCMinStep_C /end REF_CHARACTERISTIC /end GROUP
/begin GROUP S3339_DSPL_EnergyFactorCal "VBU0428Test/VBUSystem/VCU /DSPL /DSPL/DriveRange/DSPL_Consumption/DSPL_EnergySelfLearn/DSPL_EnergyFactorCal" /begin SUB_GROUP S3343_DSPL_EnergyFactorInit S3343_DSPL_EnergyFactorUpdate /end SUB_GROUP /end GROUP
/begin GROUP S3339_DSPL_EnergyRemainingCal "VBU0428Test/VBUSystem/VCU /DSPL /DSPL/DriveRange/DSPL_Consumption/DSPL_EnergySelfLearn/DSPL_EnergyRemainingCal"
 /begin REF_CHARACTERISTIC DSPL_facBMSEnergyStep1_C DSPL_facBMSEnergyStep2_C DSPL_facBMSEnergyStep3_C DSPL_facBMSEnergyStep4_C DSPL_facBMSEnergyStep5_C DSPL_pctBMSEnergyStep1_C DSPL_pctBMSEnergyStep2_C DSPL_pctBMSEnergyStep3_C DSPL_pctBMSEnergyStep4_C DSPL_pctBMSEnergyStep5_C DSPL_pctBMSEnergyStep6_C /end REF_CHARACTERISTIC
/end GROUP
/begin GROUP S3340_Comsumption "VBU0428Test/VBUSystem/VCU /DSPL /DSPL/DriveRange/DSPL_Consumption/Range10kmConsumption/Comsumption"
 /begin REF_CHARACTERISTIC DSPL_facEnergyComsume10kmFactor1_C DSPL_facEnergyComsume10kmFactor2_C DSPL_facEnergyComsume10kmFactor3_C DSPL_facEnergyComsume10kmFactor4_C DSPL_facEnergyComsume10kmNegFactor_C DSPL_facEnergyComsume10kmPosFactor_C DSPL_facEnergyComsume10kmStep1_C DSPL_facEnergyComsume10kmStep2_C DSPL_facEnergyComsume10kmStep3_C DSPL_facEnergyComsumeCalFilter10_C DSPL_facEnergyComsumeCalFilter11_C DSPL_facEnergyComsumeCalFilter1_C DSPL_facEnergyComsumeCalFilter2_C DSPL_facEnergyComsumeCalFilter3_C DSPL_facEnergyComsumeCalFilter4_C DSPL_facEnergyComsumeCalFilter5_C DSPL_facEnergyComsumeCalFilter6_C DSPL_facEnergyComsumeCalFilter7_C DSPL_facEnergyComsumeCalFilter8_C DSPL_facEnergyComsumeCalFilter9_C DSPL_facEnergyComsumeDownMin_C DSPL_facEnergyComsumeInitFactor1_C DSPL_facEnergyComsumeInitFactor2_C DSPL_facEnergyComsumeInitFactor3_C DSPL_facEnergyComsumeInitFactorDefault_C DSPL_facEnergyComsumeInitStep1_C DSPL_facEnergyComsumeInitStep2_C DSPL_facEnergyComsumeInitStep3_C DSPL_facEnergyComsumeUPMax_C DSPL_facEnergyFactorDeviation_CUR_v DSPL_kmRange10kmCalCell_C DSPL_pwrVehicleDrivePowerMoving_C DSPL_pwrVehicleDrivePowerStandstill_C DSPL_stEnergyConsumptionCaled_C DSPL_stEnergyConsumptionProcess_C DSPL_tiEnergyCalTrigleDelay_C /end REF_CHARACTERISTIC
/end GROUP
/begin GROUP S3340_DSPLRange10kmCondition "VBU0428Test/VBUSystem/VCU /DSPL /DSPL/DriveRange/DSPL_Consumption/Range10kmConsumption/DSPLRange10kmCondition" /begin REF_CHARACTERISTIC DSPL_kmRange10kmCalCell_C /end REF_CHARACTERISTIC /end GROUP
/begin GROUP S3341_DSPLRange50kmComsumptionCal "VBU0428Test/VBUSystem/VCU /DSPL /DSPL/DriveRange/DSPL_Consumption/Range50kmConsumption/DSPLRange50kmComsumptionCal"
 /begin REF_CHARACTERISTIC DSPL_facEnergyComsume50kmCalFilter1_C DSPL_facEnergyComsume50kmCalFilter2_C DSPL_facEnergyComsume50kmCalFilter3_C DSPL_facEnergyComsume50kmInitFactor1_C DSPL_facEnergyComsume50kmInitFactor2_C DSPL_facEnergyComsume50kmInitFactor3_C DSPL_facEnergyComsume50kmInitFactorDefault_C DSPL_facEnergyComsume50kmInitStep1_C DSPL_facEnergyComsume50kmInitStep2_C DSPL_facEnergyComsume50kmInitStep3_C DSPL_facEnergyComsumeDownMin_C DSPL_facEnergyComsumeUPMax_C DSPL_kmRange50kmCalCell_C DSPL_pwrVehicleDrivePowerMoving_C DSPL_pwrVehicleDrivePowerStandstill_C DSPL_stEnergyConsumptionCaled_C DSPL_stEnergyConsumptionProcess_C DSPL_tiEnergyCalTrigleDelay_C /end REF_CHARACTERISTIC
/end GROUP
/begin GROUP S3341_DSPLRange50kmCondition "VBU0428Test/VBUSystem/VCU /DSPL /DSPL/DriveRange/DSPL_Consumption/Range50kmConsumption/DSPLRange50kmCondition" /begin REF_CHARACTERISTIC DSPL_kmRange50kmCalCell_C /end REF_CHARACTERISTIC /end GROUP
/begin GROUP S3392_FullRangeCalculation "VBU0428Test/VBUSystem/VCU /DSPL /DSPL/DriveRange/RemainingRange/FullRangeAndSocDeclineFactor/FullRangeCalculation" /begin SUB_GROUP S3418_SwitchParameter /end SUB_GROUP
 /begin REF_CHARACTERISTIC DSPL_facRngAmbTempCorr_CUR_v_Md_Default DSPL_kmRngNEDCMAP_CUR_y_Md_Default DSPL_pctSocFull_C /end REF_CHARACTERISTIC
/end GROUP
/begin GROUP S3392_SOCDecRate "VBU0428Test/VBUSystem/VCU /DSPL /DSPL/DriveRange/RemainingRange/FullRangeAndSocDeclineFactor/SOCDecRate" /begin REF_CHARACTERISTIC DSPL_kmDrvRngStepMax_C /end REF_CHARACTERISTIC /end GROUP
/begin GROUP S3392_SOCDeclineFactorCalculation "VBU0428Test/VBUSystem/VCU /DSPL /DSPL/DriveRange/RemainingRange/FullRangeAndSocDeclineFactor/SOCDeclineFactorCalculation"
 /begin SUB_GROUP S3420_SwitchParameter S3420_SwitchParameter1 S3420_SwitchParameter2 /end SUB_GROUP
 /begin REF_CHARACTERISTIC DSPL_facRngAmbTempCorr_CUR_v_Md_Default DSPL_tiDelayTimeChrgFallingEdge_C /end REF_CHARACTERISTIC
/end GROUP
/begin GROUP S3394_Charge "VBU0428Test/VBUSystem/VCU /DSPL /DSPL/DriveRange/RemainingRange/SelectDisplayRange/Charge"
 /begin REF_CHARACTERISTIC DSPL_kmChrgDownStepMin_C DSPL_kmChrgUpStepMax_C DSPL_pctSOCFullChrg_C DSPL_pctSocFull_C DSPL_tiBmsSocFullDelay_C /end REF_CHARACTERISTIC
/end GROUP
/begin GROUP S3394_Drive "VBU0428Test/VBUSystem/VCU /DSPL /DSPL/DriveRange/RemainingRange/SelectDisplayRange/Drive"
 /begin REF_CHARACTERISTIC DSPL_numSOCJump_C DSPL_pctSOCJumpHi_C DSPL_pctSOCJumpLo_C DSPL_tiBmsSocZeroDelay_C DSPL_tiSOCJumpDelay_C /end REF_CHARACTERISTIC
/end GROUP
/begin GROUP S3394_storeRange "VBU0428Test/VBUSystem/VCU /DSPL /DSPL/DriveRange/RemainingRange/SelectDisplayRange/storeRange" /begin SUB_GROUP S3433_SwitchParameter /end SUB_GROUP
 /begin REF_CHARACTERISTIC DSPL_kmRemainingRangeDisplayStep_C DSPL_kmRngNEDCMAP_CUR_y_Md_Default DSPL_tiBmsSocVldDelay_C DSPL_tiBmsSocZeroDelay_C /end REF_CHARACTERISTIC
/end GROUP
/begin GROUP S3484_LowpassT "VBU0428Test/VBUSystem/VCU /EDIS/EDIS_Ctrl/BatDis_Power_Lim_Calc/Power_Arbitration/drive_power_limit_calculate/LowpassT" /begin REF_MEASUREMENT EDIS_pwrDrvPwrLimFilter /end REF_MEASUREMENT /end GROUP
/begin GROUP S3503_fid_action "VBU0428Test/VBUSystem/VCU /EDIS/EDIS_Ctrl/battery_power_calculate/charge_power_calculate/ChPowSetPoint/fid_action" /begin SUB_GROUP S3505_GradientLimiter S3505_GradientLimiter1 /end SUB_GROUP
 /begin REF_CHARACTERISTIC EDIS_pwrOfflineChDyn_C EDIS_pwrOfflineChLT_C EDIS_pwrOfflineDisChDyn_C EDIS_pwrOfflineDownStep_C EDIS_pwrOfflineUpStep_C EDIS_pwrOnlineDownStep_C EDIS_pwrOnlineUpStep_C /end REF_CHARACTERISTIC
 /begin REF_MEASUREMENT EDIS_pwrDownStepCh EDIS_pwrUpStepCh /end REF_MEASUREMENT
/end GROUP
/begin GROUP S3503_setpiont "VBU0428Test/VBUSystem/VCU /EDIS/EDIS_Ctrl/battery_power_calculate/charge_power_calculate/ChPowSetPoint/setpiont"
 /begin REF_CHARACTERISTIC EDIS_facBMSSOCCh_CUR_v EDIS_facChPwrDeltaBaseDiff_CUR_v EDIS_facMaxBMSCh_CUR_v EDIS_facMinBMSCh_CUR_v EDIS_facRgnReqCapDelta_CUR_v EDIS_facVehSpd2MotSpd_C EDIS_flgOverPwrLimNum_C EDIS_flgUseEEPROMStroeVal_C EDIS_flgUsePowSpPredict_C EDIS_numChOverLim_C EDIS_numChPwrOverCntEEPROMInit_SY EDIS_pwrChRed40vLim_C EDIS_pwrSpBaseChDyn_CUR_v EDIS_tiBattOverChrg_C EDIS_wChOverEnrgLim_C /end REF_CHARACTERISTIC
 /begin REF_MEASUREMENT EDIS_pwrChDynSp EDIS_pwrChSp /end REF_MEASUREMENT
/end GROUP
/begin GROUP S3518_fid_action "VBU0428Test/VBUSystem/VCU /EDIS/EDIS_Ctrl/battery_power_calculate/discharge_power_calculate/DchPowSetpiont/fid_action"
 /begin SUB_GROUP S3520_GradientLimiter S3520_GradientLimiter1 S3520_GradientLimiter2 /end SUB_GROUP
 /begin REF_CHARACTERISTIC EDIS_pwrOfflineDisChDyn_C EDIS_pwrOfflineDisChLT_C EDIS_pwrOfflineDisChST_C EDIS_pwrOfflineDownStep_C EDIS_pwrOfflineUpStep_C EDIS_pwrOnlineDownStep_C EDIS_pwrOnlineUpStep_C /end REF_CHARACTERISTIC
 /begin REF_MEASUREMENT EDIS_pwrDownStep EDIS_pwrUpStep /end REF_MEASUREMENT
/end GROUP
/begin GROUP S3518_setpoint "VBU0428Test/VBUSystem/VCU /EDIS/EDIS_Ctrl/battery_power_calculate/discharge_power_calculate/DchPowSetpiont/setpoint" /begin SUB_GROUP S3521_batt_stpower_overrite S3521_discharge_setpoint /end SUB_GROUP /end GROUP
/begin GROUP S3518_temperature_correction "VBU0428Test/VBUSystem/VCU /EDIS/EDIS_Ctrl/battery_power_calculate/discharge_power_calculate/DchPowSetpiont/temperature_correction" /begin SUB_GROUP S3522_BattDisChaCold S3522_BattDisChaHot S3522_MinSel /end SUB_GROUP /end GROUP
/begin GROUP S3593_Disenable "VBU0428Test/VBUSystem/VCU /LVC/LVC/LowVoltageBalanceControl/LVC_DcdcStCtl/RoutineControl/Disenable"
 /begin REF_CHARACTERISTIC DIAGS_stPsvResp_SY LVC_stDcDcFailure_SY LVC_stDcDcStandby_SY LVC_stDcDcWorking_SY LVC_tiWaitForOk_C /end REF_CHARACTERISTIC
 /begin REF_MEASUREMENT LVC_stDCDCDisblResp /end REF_MEASUREMENT
/end GROUP
/begin GROUP S3593_Enable "VBU0428Test/VBUSystem/VCU /LVC/LVC/LowVoltageBalanceControl/LVC_DcdcStCtl/RoutineControl/Enable"
 /begin REF_CHARACTERISTIC DIAGS_stPsvResp_SY LVC_stDcDcFailure_SY LVC_stDcDcStandby_SY LVC_stDcDcWorking_SY LVC_tiWaitForOk_C /end REF_CHARACTERISTIC
 /begin REF_MEASUREMENT LVC_stDCDCEnaResp /end REF_MEASUREMENT
/end GROUP
/begin GROUP S3623_StopNM "VBU0428Test/VBUSystem/VCU /PMM/PMM_Ctrl/LvWakeUp_Ctrl/LvWakeUp_State_Calc/LVWSrc/StopNM"
 /begin REF_CHARACTERISTIC PMM_flgVCUStpNMOvrdSwt_C PMM_flgVCUStpNMOvrdVal_C PMM_tiDlyIgnOff_C PMM_tiDlyVCUStpNMAbnrml_C PMM_tiDlyVCUStpNMNrml_C PMM_tiDlyWaitNMStp_C /end REF_CHARACTERISTIC
/end GROUP
/begin GROUP S3623_VCUActSrc "VBU0428Test/VBUSystem/VCU /PMM/PMM_Ctrl/LvWakeUp_Ctrl/LvWakeUp_State_Calc/LVWSrc/VCUActSrc" /begin REF_CHARACTERISTIC PMM_tiDlyPEUDCVltg_C /end REF_CHARACTERISTIC /end GROUP
/begin GROUP S3623_VCUWakeUp "VBU0428Test/VBUSystem/VCU /PMM/PMM_Ctrl/LvWakeUp_Ctrl/LvWakeUp_State_Calc/LVWSrc/VCUWakeUp" /begin REF_CHARACTERISTIC PMM_stAPlushld_SY PMM_tiDlyNMWkup_C /end REF_CHARACTERISTIC /end GROUP
/begin GROUP S3681_Turn_On_Delay_Time "VBU0428Test/VBUSystem/VCU /PMM/PMM_Ctrl/PwrMod_Ctrl/PwrMod_PowerUp/stateflowcondition/Turn_On_Delay_Time" /begin REF_MEASUREMENT PMM_flgInitToHVRlyClReq /end REF_MEASUREMENT /end GROUP
/begin GROUP S3681_Turn_On_Delay_Time1 "VBU0428Test/VBUSystem/VCU /PMM/PMM_Ctrl/PwrMod_Ctrl/PwrMod_PowerUp/stateflowcondition/Turn_On_Delay_Time1" /begin REF_MEASUREMENT PMM_flgOffLoadToACTst /end REF_MEASUREMENT /end GROUP
/begin GROUP S3741_Front "VBU0428Test/VBUSystem/VCU /SPD/SPD/SignalProcessing_10ms/Subsystem1/v_Axle/Front" /begin REF_MEASUREMENT SPD_vFA /end REF_MEASUREMENT /end GROUP
/begin GROUP S3741_Rear "VBU0428Test/VBUSystem/VCU /SPD/SPD/SignalProcessing_10ms/Subsystem1/v_Axle/Rear" /begin REF_MEASUREMENT SPD_vRA /end REF_MEASUREMENT /end GROUP
/begin GROUP S3744_SR_Flip_Flop "VBU0428Test/VBUSystem/VCU /SPD/SPD/SignalProcessing_10ms/VehDir/RearWhl/SR_Flip_Flop" /begin REF_MEASUREMENT SPD_flgRARvs /end REF_MEASUREMENT /end GROUP
/begin GROUP S3746_First_Order_Low_Pass_Filter "VBU0428Test/VBUSystem/VCU /SPD/SPD/SignalProcessing_10ms/VehSpdNorm/Normal_VehSpdCal/First_Order_Low_Pass_Filter" /begin REF_MEASUREMENT SPD_vVehSpd /end REF_MEASUREMENT /end GROUP
/begin GROUP S3864_DeltaSpeedCal "VBU0428Test/VBUSystem/VCU /TQO/TQOAll/STC/STC/PIRgnTorque/DeltaSpeedCal" /begin REF_CHARACTERISTIC STC_nSpeedOffset_CUR_v /end REF_CHARACTERISTIC /end GROUP
/begin GROUP S3864_PI_Controller "VBU0428Test/VBUSystem/VCU /TQO/TQOAll/STC/STC/PIRgnTorque/PI_Controller" /begin REF_CHARACTERISTIC STC_trqRgnRAMax_C /end REF_CHARACTERISTIC /begin REF_MEASUREMENT STC_trqRgnPIRA /end REF_MEASUREMENT /end GROUP
/begin GROUP S3864_ResetCondition "VBU0428Test/VBUSystem/VCU /TQO/TQOAll/STC/STC/PIRgnTorque/ResetCondition"
 /begin REF_CHARACTERISTIC STC_flgRgnPIEna_C STC_nDeltaSpdThd_C STC_pctAccPedPosResetPI_C STC_trqRgnPIResetThd_C STC_trqRgnPISetThd_C /end REF_CHARACTERISTIC
/end GROUP
/begin GROUP S3877_CalcSpdHiFre "VBU0428Test/VBUSystem/VCU /TQO/TQOAll/Subsystem/TQDMP/RAROTC/CalcSpdHiFre"
 /begin REF_CHARACTERISTIC TQDMP_facRAV2N_C TQDMP_flgLowFilterDnRA_C TQDMP_nRPMHysRA_C TQDMP_tiCalcChgLeadFilRA_C TQO_ti10ms_SY /end REF_CHARACTERISTIC
 /begin REF_MEASUREMENT TQDMP_dnMotrR /end REF_MEASUREMENT
/end GROUP
/begin GROUP S3877_Foreback "VBU0428Test/VBUSystem/VCU /TQO/TQOAll/Subsystem/TQDMP/RAROTC/Foreback"
 /begin REF_CHARACTERISTIC TQDMP_facDenRA_CUR_x TQDMP_facNumRA_CUR_x TQDMP_pctDmpDisbThd_C TQDMP_trqDmpEnaThdRA_C TQDMP_trqNumDenThdRA_C /end REF_CHARACTERISTIC
 /begin REF_MEASUREMENT TQDMP_trqDmpRA /end REF_MEASUREMENT
/end GROUP
/begin GROUP S3877_ROTCArbRA "VBU0428Test/VBUSystem/VCU /TQO/TQOAll/Subsystem/TQDMP/RAROTC/ROTCArbRA" /begin REF_CHARACTERISTIC TQDMP_flgRAVCUDmpEna_C /end REF_CHARACTERISTIC /begin REF_MEASUREMENT TQDMP_trqCompRA0 /end REF_MEASUREMENT /end GROUP
/begin GROUP S3877_ROTCConidtion "VBU0428Test/VBUSystem/VCU /TQO/TQOAll/Subsystem/TQDMP/RAROTC/ROTCConidtion"
 /begin SUB_GROUP S3883_ConditionRAArb S3883_SpeedHoldEnableRA S3883_TipInRA S3883_TipOutRA S3883_TipinEnaRA S3883_TipoutEnaRA S3883_VrtlRA /end SUB_GROUP
/end GROUP
/begin GROUP S3877_TorqueCal "VBU0428Test/VBUSystem/VCU /TQO/TQOAll/Subsystem/TQDMP/RAROTC/TorqueCal" /begin SUB_GROUP S3884_CompensationPhase S3884_DeltaTrqArb S3884_TorqueLim /end SUB_GROUP /end GROUP
/begin GROUP S3919_SignalProcess "VBU0428Test/VBUSystem/VCU /TQO/TQOAll/TQARB/TQARB/TrqArb/SignalProcess" /begin REF_CHARACTERISTIC TQARB_flgTrqCompSwitch_C /end REF_CHARACTERISTIC
 /begin REF_MEASUREMENT TQARB_trqPreDisPropRA TQARB_trqPreDisRgnRA TQARB_trqPreFnlRA /end REF_MEASUREMENT
/end GROUP
/begin GROUP S3924_RASinCmp "VBU0428Test/VBUSystem/VCU /TQO/TQOAll/TQCMP/TQCMP/SinCmp/RASinCmp"
 /begin REF_CHARACTERISTIC TQCMP_facDecSinSpdRA_CUR_y TQCMP_facIncSinSpdRA_CUR_y TQCMP_tiSinResetRA_C TQCMP_trqDeadZoneRA_CUR_y TQCMP_trqDecRASinHi_C TQCMP_trqDecRASinLo_C TQCMP_trqDecRATarSinHi_C TQCMP_trqDecRATarSinLo_C TQCMP_trqDecSinOffsetRA_C TQCMP_trqIncRASinHi_C TQCMP_trqIncRASinLo_C TQCMP_trqIncRATarSinHi_C TQCMP_trqIncRATarSinLo_C TQCMP_trqIncSinOffsetRA_C /end REF_CHARACTERISTIC
 /begin REF_MEASUREMENT TQCMP_trqSinFnlRA /end REF_MEASUREMENT
/end GROUP
/begin GROUP S3925_PulseTime "VBU0428Test/VBUSystem/VCU /TQO/TQOAll/TQCMP/TQCMP/TrqPulse/PulseTime" /begin REF_CHARACTERISTIC TQCMP_tiPulseThd_C /end REF_CHARACTERISTIC /end GROUP
/begin GROUP S3925_PulseTrig "VBU0428Test/VBUSystem/VCU /TQO/TQOAll/TQCMP/TQCMP/TrqPulse/PulseTrig" /begin REF_CHARACTERISTIC TQCMP_pBrkCrpOffThd_C /end REF_CHARACTERISTIC /begin REF_MEASUREMENT TQCMP_flgPulseTrig TQCMP_flgShftOn /end REF_MEASUREMENT /end GROUP
/begin GROUP S3925_PulseTrq "VBU0428Test/VBUSystem/VCU /TQO/TQOAll/TQCMP/TQCMP/TrqPulse/PulseTrq" /begin REF_CHARACTERISTIC TQCMP_stPulseRAEna_CUR_v TQCMP_trqPulse_CUR_v /end REF_CHARACTERISTIC /end GROUP
/begin GROUP S3948_SysRst "VBU0428Test/VBUSystem/VCU /TQO/TQOAll/TQDIS/TQDIS/AxleArb/SysRst" /begin REF_CHARACTERISTIC TQDIS_tiSWResetDly_C /end REF_CHARACTERISTIC /end GROUP
/begin GROUP S3949_BrkRgnFilter "VBU0428Test/VBUSystem/VCU /TQO/TQOAll/TQDIS/TQDIS/BrkRgnCp/BrkRgnFilter"
 /begin REF_CHARACTERISTIC TQDIS_facDenRA_CUR_x TQDIS_facNumRA_CUR_x TQDIS_flgABSDislFilter_C TQDIS_trqDecBrk_C TQDIS_trqDmpDeadZone_C TQDIS_trqIncBrk_C TQDIS_trqNumDenThdRABrkRgn_C /end REF_CHARACTERISTIC
 /begin REF_MEASUREMENT TQDIS_trqBrkRgnFilterRA /end REF_MEASUREMENT
/end GROUP
/begin GROUP S3949_CstBrkCal "VBU0428Test/VBUSystem/VCU /TQO/TQOAll/TQDIS/TQDIS/BrkRgnCp/CstBrkCal" /begin REF_MEASUREMENT TQDIS_trqPreDisCstRgnReqRA /end REF_MEASUREMENT /end GROUP
/begin GROUP S3949_facBCUVCUCal "VBU0428Test/VBUSystem/VCU /TQO/TQOAll/TQDIS/TQDIS/BrkRgnCp/facBCUVCUCal" /begin REF_MEASUREMENT TQDIS_trqCstRgnFnlRA /end REF_MEASUREMENT /end GROUP
/begin GROUP S3951_BattLim "VBU0428Test/VBUSystem/VCU /TQO/TQOAll/TQDIS/TQDIS/Dmp/BattLim" /begin REF_MEASUREMENT TQDIS_trqDmpRA2 /end REF_MEASUREMENT /end GROUP
/begin GROUP S3951_DmpFilter "VBU0428Test/VBUSystem/VCU /TQO/TQOAll/TQDIS/TQDIS/Dmp/DmpFilter" /begin SUB_GROUP S3973_BandStopInit /end SUB_GROUP
 /begin REF_CHARACTERISTIC TQDIS_facAccDmpFilterRA_MAP_v TQDIS_facDenRA2_CUR_x TQDIS_facDenRA_CUR_x TQDIS_facNumRA2_CUR_x TQDIS_facNumRA_CUR_x TQDIS_facSpdDmpFilterRA_MAP_v TQDIS_flgDmpFilterRA2_C TQDIS_trqDmpDeadZone_C TQDIS_trqNumDenThdRA_C /end REF_CHARACTERISTIC
 /begin REF_MEASUREMENT TQDIS_trqDmpRA0 /end REF_MEASUREMENT
/end GROUP
/begin GROUP S3951_MotorLim "VBU0428Test/VBUSystem/VCU /TQO/TQOAll/TQDIS/TQDIS/Dmp/MotorLim" /begin REF_MEASUREMENT TQDIS_trqBrkRgnRALim TQDIS_trqDmpRA1 /end REF_MEASUREMENT /end GROUP
/begin GROUP S3952_Arb "VBU0428Test/VBUSystem/VCU /TQO/TQOAll/TQDIS/TQDIS/TrqFilter/Arb"
 /begin REF_CHARACTERISTIC TQDIS_trqRADecMax_C TQDIS_trqRADecMin_C TQDIS_trqRAIncMax_C TQDIS_trqRAIncMin_C /end REF_CHARACTERISTIC
 /begin REF_MEASUREMENT TQDIS_trqRADecLim TQDIS_trqRAIncLim /end REF_MEASUREMENT
/end GROUP
/begin GROUP S3952_DrvLim "VBU0428Test/VBUSystem/VCU /TQO/TQOAll/TQDIS/TQDIS/TrqFilter/DrvLim" /begin SUB_GROUP S3986_AccPdlIdl S3986_Creep S3986_RADrvDec S3986_RADrvInc /end SUB_GROUP /end GROUP
/begin GROUP S3952_Subsystem "VBU0428Test/VBUSystem/VCU /TQO/TQOAll/TQDIS/TQDIS/TrqFilter/Subsystem" /begin REF_MEASUREMENT TQDIS_trqFltRA /end REF_MEASUREMENT /end GROUP
/begin GROUP S4003_ShftChange "VBU0428Test/VBUSystem/VCU /TQO/TQOAll/TQO/TQO/MotorTorque/ShftChange"
 /begin REF_CHARACTERISTIC TQO_facShftChangeHi_CUR_v TQO_facShftChangeLo_CUR_v TQO_facShftChangeSlope_CUR_v /end REF_CHARACTERISTIC
 /begin REF_MEASUREMENT TQO_facShftChangeLo TQO_flgShftRD /end REF_MEASUREMENT
/end GROUP
/begin GROUP S4003_Subsystem "VBU0428Test/VBUSystem/VCU /TQO/TQOAll/TQO/TQO/MotorTorque/Subsystem" /begin SUB_GROUP S4008_GradientLimiter /end SUB_GROUP /begin REF_MEASUREMENT TQDIS_trqRMotrDir TQO_trqRMotr /end REF_MEASUREMENT /end GROUP
/begin GROUP S4004_VirtualAPD "VBU0428Test/VBUSystem/VCU /TQO/TQOAll/TQO/TQO/Subsystem/VirtualAPD" /begin REF_CHARACTERISTIC TQO_trqPTMax_C /end REF_CHARACTERISTIC /end GROUP
/begin GROUP S4005_TrqProtect "VBU0428Test/VBUSystem/VCU /TQO/TQOAll/TQO/TQO/Trq/TrqProtect" /begin SUB_GROUP S4011_DecGradienLimiter /end SUB_GROUP
 /begin REF_CHARACTERISTIC TQO_trqBrk_MAP_v TQO_trqLimpModeMax_CUR_v TQO_trqPTMax_C TQO_trqRARgnMin_C TQO_trqSftyDec_C /end REF_CHARACTERISTIC
 /begin REF_MEASUREMENT TQO_trqSftyRA /end REF_MEASUREMENT
/end GROUP
/begin GROUP S4028_IF_Then_Else1 "VBU0428Test/VBUSystem/VCU /VTQA/Subsystem/MTrqLim/TrqCapacityLim/VehicleSpeedLim/IF_Then_Else1" /begin REF_MEASUREMENT MTQL_trqVehSpdDrvLimR /end REF_MEASUREMENT /end GROUP
/begin GROUP S4068_BrakeStickyCheck "VBU0428Test/VBUSystem/VCU /VehINP/VehINP_Logic/APD/APD/Value_Selection/BrakeStickyCheck"
 /begin REF_CHARACTERISTIC APD_rBrkPedReleased_C APD_rBrkPlausibilityEnHi_C APD_rBrkStickyPressed_C APD_rBrkStickyThreshold_C APD_tiBrkPlausibility_CUR_v APD_tiSampleTime_C APD_tiUnStickyTime_C APD_vBrkDftSpeed_C /end REF_CHARACTERISTIC
/end GROUP
/begin GROUP S4068_FullPedal "VBU0428Test/VBUSystem/VCU /VehINP/VehINP_Logic/APD/APD/Value_Selection/FullPedal"
 /begin REF_CHARACTERISTIC APD_flgFulPedalEnable_C APD_rFullPedalPercent_C APD_stSelectPedal1_C APD_stSelectPedal2_C APD_tiFullPedalTime_C APD_tiSampleTime_C APD_uFullAngle1_C APD_uFullAngle2_C /end REF_CHARACTERISTIC
/end GROUP
/begin GROUP S4068_PedalPercentSelection "VBU0428Test/VBUSystem/VCU /VehINP/VehINP_Logic/APD/APD/Value_Selection/PedalPercentSelection"
 /begin REF_CHARACTERISTIC APD_facRecoveryFillter_C APD_pctIdlePedal_C APD_stSelectPedal1_C APD_stSelectPedal2_C APD_stSelectPedalDefault_C APD_stSelectPedalMin_C /end REF_CHARACTERISTIC
 /begin REF_MEASUREMENT APD_pctAPDbasic /end REF_MEASUREMENT
/end GROUP
/begin GROUP S4068_PedalSelection "VBU0428Test/VBUSystem/VCU /VehINP/VehINP_Logic/APD/APD/Value_Selection/PedalSelection"
 /begin REF_CHARACTERISTIC APD_stSelectPedal1_C APD_stSelectPedal2_C APD_stSelectPedalDefault_C APD_stSelectPedalMin_C APD_stSelectPedalORV /end REF_CHARACTERISTIC
 /begin REF_MEASUREMENT APD_stPedalSelect /end REF_MEASUREMENT
/end GROUP
/begin GROUP S4102_Gear4DriveIntend "VBU0428Test/VBUSystem/VCU /VehINP/VehINP_Logic/GearShift/Gear1/Digital_Gear_D_R/Gear4DriveIntend"
 /begin REF_CHARACTERISTIC Gear_stDriveIntendGearD_C Gear_stDriveIntendGearInvalid_C Gear_stDriveIntendGearNeutral_C Gear_stDriveIntendGearR_C /end REF_CHARACTERISTIC
 /begin REF_MEASUREMENT Gear_stDriveIntendGearRawDigital /end REF_MEASUREMENT
/end GROUP
/begin GROUP S4102_Gear_Bit "VBU0428Test/VBUSystem/VCU /VehINP/VehINP_Logic/GearShift/Gear1/Digital_Gear_D_R/Gear_Bit" /begin SUB_GROUP S4114_SetBit2 /end SUB_GROUP /end GROUP
/begin GROUP S4102_Gear_DR_Req "VBU0428Test/VBUSystem/VCU /VehINP/VehINP_Logic/GearShift/Gear1/Digital_Gear_D_R/Gear_DR_Req"
 /begin SUB_GROUP S4115_Turn_On_Delay_Time S4115_Turn_On_Delay_Time1 S4115_Turn_On_Delay_Time2 /end SUB_GROUP
 /begin REF_CHARACTERISTIC Gear_tiGearES6DebounceCnt_C /end REF_CHARACTERISTIC
 /begin REF_MEASUREMENT Gear_flgDGearReqRawDigital Gear_flgNGearReqRawDigital Gear_flgRGearReqRawDigital /end REF_MEASUREMENT
/end GROUP
/begin GROUP S4102_Gear_DR_Warning "VBU0428Test/VBUSystem/VCU /VehINP/VehINP_Logic/GearShift/Gear1/Digital_Gear_D_R/Gear_DR_Warning" /begin SUB_GROUP S4116_Turn_On_Delay_Time S4116_Turn_On_Delay_Time1 /end SUB_GROUP
 /begin REF_CHARACTERISTIC Gear_tiGearWarningLTES6DebounceCnt_C Gear_tiGearWarningSTES6DebounceCnt_C /end REF_CHARACTERISTIC
 /begin REF_MEASUREMENT Gear_flgDftGearWarningDigital /end REF_MEASUREMENT
/end GROUP
/begin GROUP S4102_Gear_RawReq "VBU0428Test/VBUSystem/VCU /VehINP/VehINP_Logic/GearShift/Gear1/Digital_Gear_D_R/Gear_RawReq"
 /begin REF_CHARACTERISTIC Gear_stGearDValidBit1_C Gear_stGearNValid_C Gear_stGearRValidBit1_C /end REF_CHARACTERISTIC
 /begin REF_MEASUREMENT Gear_flgSensorRawReqGearD Gear_flgSensorRawReqGearN Gear_flgSensorRawReqGearR Gear_flgSensorWarningLT Gear_flgSensorWarningST /end REF_MEASUREMENT
/end GROUP
/begin GROUP S4102_Gear_Warning "VBU0428Test/VBUSystem/VCU /VehINP/VehINP_Logic/GearShift/Gear1/Digital_Gear_D_R/Gear_Warning" /begin SUB_GROUP S4118_SR_Flip_Flop1 /end SUB_GROUP
 /begin REF_CHARACTERISTIC Gear_cntGearPlausibilityDigitalDetect_C Gear_cntGearPlausibilityDigitalShiftFast_C /end REF_CHARACTERISTIC
 /begin REF_MEASUREMENT Gear_flgPlausibilityForce2NDigital /end REF_MEASUREMENT
/end GROUP
/begin GROUP S4110_Gear4Reset "VBU0428Test/VBUSystem/VCU /VehINP/VehINP_Logic/GearShift/Gear1/Gear_Status/Gear4Reset" /begin REF_CHARACTERISTIC Gear_tiGearResetHold_C /end REF_CHARACTERISTIC /end GROUP
/begin GROUP S4110_Gear_CurrentValid "VBU0428Test/VBUSystem/VCU /VehINP/VehINP_Logic/GearShift/Gear1/Gear_Status/Gear_CurrentValid"
 /begin REF_CHARACTERISTIC Gear_flgCurrentGearDisplayInValid_C Gear_flgCurrentGearDisplayValid_C Gear_flgDisplayGearValidEn_C Gear_flgIntendGearDisplayValid_C /end REF_CHARACTERISTIC
/end GROUP
/begin GROUP S4110_Gear_DGear "VBU0428Test/VBUSystem/VCU /VehINP/VehINP_Logic/GearShift/Gear1/Gear_Status/Gear_DGear" /begin REF_CHARACTERISTIC Gear_stIntendGearD_C /end REF_CHARACTERISTIC /end GROUP
/begin GROUP S4110_Gear_DefaultGear "VBU0428Test/VBUSystem/VCU /VehINP/VehINP_Logic/GearShift/Gear1/Gear_Status/Gear_DefaultGear" /begin REF_CHARACTERISTIC Gear_tiDefaultGear2NTime_C Gear_tiDefaultGear2PTime_C /end REF_CHARACTERISTIC /end GROUP
/begin GROUP S4110_Gear_DriverShiftDReq "VBU0428Test/VBUSystem/VCU /VehINP/VehINP_Logic/GearShift/Gear1/Gear_Status/Gear_DriverShiftDReq" /begin REF_CHARACTERISTIC Veh_flgLowSpdGearChange_C /end REF_CHARACTERISTIC
 /begin REF_MEASUREMENT Gear_flgBrkPressed4GearD Gear_flgGearDShiftReq Gear_flgGearWarnDNoReady Gear_flgGearWarnR2DFailure /end REF_MEASUREMENT
/end GROUP
/begin GROUP S4110_Gear_DriverShiftRReq "VBU0428Test/VBUSystem/VCU /VehINP/VehINP_Logic/GearShift/Gear1/Gear_Status/Gear_DriverShiftRReq" /begin REF_CHARACTERISTIC Veh_flgLowSpdGearChange_C /end REF_CHARACTERISTIC
 /begin REF_MEASUREMENT Gear_flgBrkPressed4GearR Gear_flgGearRShiftReq Gear_flgGearWarnD2RFailure Gear_flgGearWarnRNoBrake Gear_flgGearWarnRNoReady /end REF_MEASUREMENT
/end GROUP
/begin GROUP S4110_Gear_GearReq "VBU0428Test/VBUSystem/VCU /VehINP/VehINP_Logic/GearShift/Gear1/Gear_Status/Gear_GearReq" /begin SUB_GROUP S4162_SR_Flip_Flop2 /end SUB_GROUP
 /begin REF_CHARACTERISTIC Gear_tiGearDSustain_C Gear_tiGearInitSustain_C Gear_tiGearPSustain_C Gear_tiGearRSustain_C /end REF_CHARACTERISTIC
/end GROUP
/begin GROUP S4110_Gear_InitGear "VBU0428Test/VBUSystem/VCU /VehINP/VehINP_Logic/GearShift/Gear1/Gear_Status/Gear_InitGear"
 /begin REF_CHARACTERISTIC Gear_tiGearInitTime_C Gear_tiInitGear2NTime_C Gear_tiInitGear2PTime_C /end REF_CHARACTERISTIC
/end GROUP
/begin GROUP S4110_Gear_PGear "VBU0428Test/VBUSystem/VCU /VehINP/VehINP_Logic/GearShift/Gear1/Gear_Status/Gear_PGear" /begin REF_CHARACTERISTIC Gear_cntGearPTimeOut_C /end REF_CHARACTERISTIC /end GROUP
/begin GROUP S4110_Gear_PGear1 "VBU0428Test/VBUSystem/VCU /VehINP/VehINP_Logic/GearShift/Gear1/Gear_Status/Gear_PGear1" /begin REF_CHARACTERISTIC Gear_stIntendGearN_C /end REF_CHARACTERISTIC /end GROUP
/begin GROUP S4110_Gear_Powertrain "VBU0428Test/VBUSystem/VCU /VehINP/VehINP_Logic/GearShift/Gear1/Gear_Status/Gear_Powertrain" /begin REF_MEASUREMENT Gear_stCurrentGear Gear_stTargetGear /end REF_MEASUREMENT /end GROUP
/begin GROUP S4110_Gear_RGear "VBU0428Test/VBUSystem/VCU /VehINP/VehINP_Logic/GearShift/Gear1/Gear_Status/Gear_RGear" /begin REF_CHARACTERISTIC Gear_stIntendGearR_C /end REF_CHARACTERISTIC /end GROUP
/begin GROUP S4110_Warning "VBU0428Test/VBUSystem/VCU /VehINP/VehINP_Logic/GearShift/Gear1/Gear_Status/Warning" /begin REF_CHARACTERISTIC Gear_tiWarnDelayTime_C /end REF_CHARACTERISTIC /end GROUP
/begin GROUP S4220_override_signal1 "VBU0428Test/VBUSystem/VCU /VehINP/VehINP_Logic/Mode/VehMode/Veh_CreepMode/override_signal1" /begin REF_MEASUREMENT CGW_stVehCreepMode /end REF_MEASUREMENT /end GROUP
/begin GROUP S4266_First_Order_Low_Pass_Filter "VBU0428Test/VBUSystem/VCU /VehINP/VehINP_Logic/VehINP_BPD/BPD_BrakePercent/BPD_PressBrake/First_Order_Low_Pass_Filter" /begin REF_MEASUREMENT INP_uBrkPresFlt1 /end REF_MEASUREMENT /end GROUP
/begin GROUP S4282_Veh_HVILCheck "VBU0428Test/VBUSystem/VCU /VehINP/VehINP_Logic/Veh_Status/VehHVIL/HVIL/Veh_HVILCheck"
 /begin REF_CHARACTERISTIC Veh_flgHVILCaliOvrdVal_C Veh_flgHVILCaliOvrd_C Veh_tiVehHVILDebounceCnt_C Veh_vVehHVILDefaultSpd_C Veh_vVehHVILDft_C /end REF_CHARACTERISTIC
/end GROUP
/begin GROUP S4282_Veh_VCUHVIL "VBU0428Test/VBUSystem/VCU /VehINP/VehINP_Logic/Veh_Status/VehHVIL/HVIL/Veh_VCUHVIL"
 /begin REF_CHARACTERISTIC Veh_fHVILLe_C Veh_fHVILRi_C Veh_pctHVILLe_C Veh_pctHVILRi_C Veh_stErr_C Veh_stNoErr_C Veh_tiVCUHVILDebounceCnt_C /end REF_CHARACTERISTIC
/end GROUP
/begin GROUP S56_Calculate_Current_ZeroDruft "VBU0428Test/VBUSystem/BMS/BCV/BCV/Subsystem/Calculate_BatteryCurrent/Correct_BatteryCurrent/Calculate_BatteryCurrent_ZeroDrift/Calculate_Current_ZeroDruft" /begin SUB_GROUP S58_Enabled_Subsystem /end SUB_GROUP /begin REF_CHARACTERISTIC CcBCV_BatteryCurrentZeroDriftTime_ms /end REF_CHARACTERISTIC /end GROUP
/begin GROUP S56_Calculate_ExtremeData "VBU0428Test/VBUSystem/BMS/BCV/BCV/Subsystem/Calculate_BatteryCurrent/Correct_BatteryCurrent/Calculate_BatteryCurrent_ZeroDrift/Calculate_ExtremeData" /begin SUB_GROUP S59_Enabled_Subsystem /end SUB_GROUP /end GROUP
/begin GROUP S192_BigDataMonitor_Handler "VBU0428Test/VBUSystem/BMS/BCV/BCV/Subsystem/Monitor_BCV_Performance/Diagnose_BDM_BCV_Communication_Fault/Diagnose_BdmOutOfRange_Fault/BigDataMonitor_Handler" /begin SUB_GROUP S193_DetermineFault S193_DetermineFaultCounter /end SUB_GROUP /end GROUP
/begin GROUP S192_BigDataMonitor_Handler1 "VBU0428Test/VBUSystem/BMS/BCV/BCV/Subsystem/Monitor_BCV_Performance/Diagnose_BDM_BCV_Communication_Fault/Diagnose_BdmOutOfRange_Fault/BigDataMonitor_Handler1" /begin SUB_GROUP S194_DetermineFault S194_DetermineFaultCounter /end SUB_GROUP /end GROUP
/begin GROUP S203_BigDataMonitor_Handler1 "VBU0428Test/VBUSystem/BMS/BCV/BCV/Subsystem/Monitor_BCV_Performance/Diagnose_BDM_BCV_Data_Fault/Diagnose_BdmBatteryBusVoltageMismatch_Fault/BigDataMonitor_Handler1" /begin SUB_GROUP S205_DetermineFault S205_DetermineFaultCounter /end SUB_GROUP /end GROUP
/begin GROUP S204_BigDataMonitor_Handler "VBU0428Test/VBUSystem/BMS/BCV/BCV/Subsystem/Monitor_BCV_Performance/Diagnose_BDM_BCV_Data_Fault/Diagnose_BdmVoltageCurrent_Fault/BigDataMonitor_Handler" /begin SUB_GROUP S211_DetermineFault S211_DetermineFaultCounter /end SUB_GROUP /end GROUP
/begin GROUP S204_BigDataMonitor_Handler1 "VBU0428Test/VBUSystem/BMS/BCV/BCV/Subsystem/Monitor_BCV_Performance/Diagnose_BDM_BCV_Data_Fault/Diagnose_BdmVoltageCurrent_Fault/BigDataMonitor_Handler1" /begin SUB_GROUP S212_DetermineFault S212_DetermineFaultCounter /end SUB_GROUP /end GROUP
/begin GROUP S204_BigDataMonitor_Handler2 "VBU0428Test/VBUSystem/BMS/BCV/BCV/Subsystem/Monitor_BCV_Performance/Diagnose_BDM_BCV_Data_Fault/Diagnose_BdmVoltageCurrent_Fault/BigDataMonitor_Handler2" /begin SUB_GROUP S213_DetermineFault S213_DetermineFaultCounter /end SUB_GROUP /end GROUP
/begin GROUP S324_Determine_CellBlanceTime "VBU0428Test/VBUSystem/BMS/CBL/Subsystem8/Subsystem/Determine_CSCCellBalanceRequest/Determine_CellBalanceRequest/Cell0/Determine_CellBlanceTime" /begin REF_CHARACTERISTIC CcCBL_CellBalanceCurrentMax_mA /end REF_CHARACTERISTIC /end GROUP
/begin GROUP S324_Determine_SocBalanceReq "VBU0428Test/VBUSystem/BMS/CBL/Subsystem8/Subsystem/Determine_CSCCellBalanceRequest/Determine_CellBalanceRequest/Cell0/Determine_SocBalanceReq" /begin REF_CHARACTERISTIC CcCBL_BalanceStartDeltaSocHysteresis_pct /end REF_CHARACTERISTIC /end GROUP
/begin GROUP S324_Determine_VoltageBalanceReq "VBU0428Test/VBUSystem/BMS/CBL/Subsystem8/Subsystem/Determine_CSCCellBalanceRequest/Determine_CellBalanceRequest/Cell0/Determine_VoltageBalanceReq"
 /begin REF_CHARACTERISTIC CcCBL_BalanceStartDeltaVoltageHysteresis_mV CcCBL_ChargeBalanceStartDeltaVoltageHysteresis_mV CcCBL_ChargeBalanceStartDeltaVoltage_mV /end REF_CHARACTERISTIC
/end GROUP
/begin GROUP S458_Determine_Accumulated_RemainingHeat "VBU0428Test/VBUSystem/BMS/CTD/Subsystem/Subsystem4/PrechrgProcessMonitoring/Precharge_Thermal_Management/Determine_Precharge_JouleHeat/Determine_Accumulated_RemainingHeat"
 /begin SUB_GROUP S460_Determine_Accumulated_Cooling S460_Determine_Accumulated_RemainingHeat /end SUB_GROUP
/end GROUP
/begin GROUP S480_Determine_Diagnostic_Status "VBU0428Test/VBUSystem/BMS/CTD/Subsystem/Subsystem4/Stuck_Open_Diagnostic/MNC_Stuck_Open/MNC_Stuck_Open_With_VehicleSpeed/Determine_Diagnostic_Status" /begin REF_MEASUREMENT CTD_stMnNegContactorStuckOpenDiagnosticStatus /end REF_MEASUREMENT /end GROUP
/begin GROUP S504_Determine_Diagnostic_Status "VBU0428Test/VBUSystem/BMS/CTD/Subsystem/Subsystem4/Stuck_Open_Diagnostic/MPC_Stuck_Open/MPC_Stuck_Open_Without_VehicleSpeed/Determine_Diagnostic_Status" /begin REF_MEASUREMENT CTD_stMnPosContactorStuckOpenDiagnosticStatus /end REF_MEASUREMENT /end GROUP
/begin GROUP S804_Override_Block3 "VBU0428Test/VBUSystem/BMS/FCC /FCC/Subsystem/Determine_Fastcharge_Request/Charge_Request_Protection/Override_Voltage_Request/Override_Block3" /begin REF_CHARACTERISTIC CbFCC_ChargeVoltageOvR_flg CcFCC_ChargeVoltageOvRValue_V /end REF_CHARACTERISTIC /end GROUP
/begin GROUP S812_Delay_FallingEdge "VBU0428Test/VBUSystem/BMS/FCC /FCC/Subsystem/Determine_Fastcharge_Request/DetermineComputeResistancePulseCurrent/Determine_ComputeResistanceCondition/Delay_FallingEdge" /begin REF_MEASUREMENT FCC_flgComputeResistancePulseCurrentEnable /end REF_MEASUREMENT /end GROUP
/begin GROUP S812_RS_Flip_Flop "VBU0428Test/VBUSystem/BMS/FCC /FCC/Subsystem/Determine_Fastcharge_Request/DetermineComputeResistancePulseCurrent/Determine_ComputeResistanceCondition/RS Flip-Flop" /begin REF_MEASUREMENT FCC_flgComputeResistanceEnable /end REF_MEASUREMENT /end GROUP
/begin GROUP S812_S_H "VBU0428Test/VBUSystem/BMS/FCC /FCC/Subsystem/Determine_Fastcharge_Request/DetermineComputeResistancePulseCurrent/Determine_ComputeResistanceCondition/S&H" /begin REF_MEASUREMENT FCC_flgComputeResistanceStart /end REF_MEASUREMENT /end GROUP
/begin GROUP S841_FullCharge_criteria1 "VBU0428Test/VBUSystem/BMS/FCC /FCC/Subsystem/Fastcharge_Conditions_Check/Condition_Categorize/Full_Charge_Determination/FullCharge_criteria1"
 /begin REF_CHARACTERISTIC CaFCC_FullChargeVoltageDCIRMapDimension_n CaFCC_FullChargeVoltageDCIRMapZ_mV CaFCC_FullChargeVoltageHysteresisMapDimension_n CaFCC_FullChargeVoltageHysteresisMapZ_mV CaFCC_FullChargeVoltagePolarizaitonMapDimension_n CaFCC_FullChargeVoltagePolarizaitonMapZ_mV CaFCC_FullChargeVoltageSOHAttenuationMapDimension_n CaFCC_FullChargeVoltageSOHAttenuationMapZ_mV CaSYS_FullChargeOcvMapDimension_n CaSYS_FullChargeOcvMapZ_mV CcFCC_FullChargeOcvDebounceTime_s CcSYS_FullChargeOcv_mV /end REF_CHARACTERISTIC
 /begin REF_MEASUREMENT FCC_flgFullChargeCellVoltageCriteria FCC_mvFullChargeCellVoltage FCC_mvFullChargeDisbaleCellVoltage /end REF_MEASUREMENT
/end GROUP
/begin GROUP S841_FullCharge_criteria2 "VBU0428Test/VBUSystem/BMS/FCC /FCC/Subsystem/Fastcharge_Conditions_Check/Condition_Categorize/Full_Charge_Determination/FullCharge_criteria2"
 /begin REF_CHARACTERISTIC CcFCC_FullChargeOcvDebounceTime_s CcFCC_FullChargePackVoltageDelta_V CcSYS_FullChargeOcv_mV /end REF_CHARACTERISTIC
 /begin REF_MEASUREMENT FCC_flgFullChargePackVoltageCriteria /end REF_MEASUREMENT
/end GROUP
/begin GROUP S3521_discharge_setpoint "VBU0428Test/VBUSystem/VCU /EDIS/EDIS_Ctrl/battery_power_calculate/discharge_power_calculate/DchPowSetpiont/setpoint/discharge_setpoint" /begin REF_CHARACTERISTIC EDIS_flgOverPwrLimNum_C EDIS_flgUseEEPROMStroeVal_C /end REF_CHARACTERISTIC /end GROUP
/begin GROUP S3883_TipInRA "VBU0428Test/VBUSystem/VCU /TQO/TQOAll/Subsystem/TQDMP/RAROTC/ROTCConidtion/TipInRA" /begin REF_CHARACTERISTIC TQO_ti10ms_SY /end REF_CHARACTERISTIC /end GROUP
/begin GROUP S3883_TipOutRA "VBU0428Test/VBUSystem/VCU /TQO/TQOAll/Subsystem/TQDMP/RAROTC/ROTCConidtion/TipOutRA" /begin REF_CHARACTERISTIC TQO_ti10ms_SY /end REF_CHARACTERISTIC /end GROUP
/begin GROUP S3883_TipoutEnaRA "VBU0428Test/VBUSystem/VCU /TQO/TQOAll/Subsystem/TQDMP/RAROTC/ROTCConidtion/TipoutEnaRA" /begin REF_CHARACTERISTIC TQO_ti10ms_SY /end REF_CHARACTERISTIC /end GROUP
/begin GROUP S58_Enabled_Subsystem "VBU0428Test/VBUSystem/BMS/BCV/BCV/Subsystem/Calculate_BatteryCurrent/Correct_BatteryCurrent/Calculate_BatteryCurrent_ZeroDrift/Calculate_Current_ZeroDruft/Enabled_Subsystem" /begin REF_CHARACTERISTIC CcBCV_BatteryCurrentZeroDriftTime_ms /end REF_CHARACTERISTIC /end GROUP
/begin GROUP S64_Calculate_Current_Sum "VBU0428Test/VBUSystem/BMS/BCV/BCV/Subsystem/Calculate_BatteryCurrent/Correct_BatteryCurrent/Calculate_BatteryCurrent_ZeroDrift/Calculate_ExtremeData/Enabled_Subsystem/Calculate_Current_Sum" /begin REF_CHARACTERISTIC CcBCV_BatteryCurrentZeroDriftTime_ms /end REF_CHARACTERISTIC /end GROUP
/end MODULE
/end PROJECT
