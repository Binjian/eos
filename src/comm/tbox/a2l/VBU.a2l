ASAP2_VERSION 1 31
/begin PROJECT ProjectName "Project Comment Goes Here"
/begin HEADER "Header Comments go here" /end HEADER
/begin MODULE ModuleName "Module Comment Goes Here"
/begin MOD_COMMON "Mod Common Comment Here" BYTE_ORDER MSB_LAST /end MOD_COMMON
/begin RECORD_LAYOUT Scalar_BOOLEAN FNC_VALUES 1 UBYTE COLUMN_DIR DIRECT /end RECORD_LAYOUT
/begin RECORD_LAYOUT Scalar_UBYTE FNC_VALUES 1 UBYTE COLUMN_DIR DIRECT /end RECORD_LAYOUT
/begin RECORD_LAYOUT Scalar_BYTE FNC_VALUES 1 SBYTE COLUMN_DIR DIRECT /end RECORD_LAYOUT
/begin RECORD_LAYOUT Scalar_UWORD FNC_VALUES 1 UWORD COLUMN_DIR DIRECT /end RECORD_LAYOUT
/begin RECORD_LAYOUT Scalar_ULONG FNC_VALUES 1 ULONG COLUMN_DIR DIRECT /end RECORD_LAYOUT
/begin RECORD_LAYOUT Scalar_FLOAT32_IEEE FNC_VALUES 1 FLOAT32_IEEE COLUMN_DIR DIRECT /end RECORD_LAYOUT
/begin RECORD_LAYOUT Lookup1D_FLOAT32_IEEE FNC_VALUES 1 FLOAT32_IEEE COLUMN_DIR DIRECT /end RECORD_LAYOUT
/begin RECORD_LAYOUT Lookup1D_X_FLOAT32_IEEE AXIS_PTS_X 1 FLOAT32_IEEE INDEX_INCR DIRECT /end RECORD_LAYOUT
/begin RECORD_LAYOUT Lookup1D_FLOAT64_IEEE FNC_VALUES 1 FLOAT64_IEEE COLUMN_DIR DIRECT /end RECORD_LAYOUT
/begin RECORD_LAYOUT Lookup2D_BOOLEAN FNC_VALUES 1 UBYTE COLUMN_DIR DIRECT /end RECORD_LAYOUT
/begin RECORD_LAYOUT Lookup2D_X_BOOLEAN AXIS_PTS_X 1 UBYTE INDEX_INCR DIRECT /end RECORD_LAYOUT
/begin RECORD_LAYOUT Lookup2D_UBYTE FNC_VALUES 1 UBYTE COLUMN_DIR DIRECT /end RECORD_LAYOUT
/begin RECORD_LAYOUT Lookup2D_X_UWORD AXIS_PTS_X 1 UWORD INDEX_INCR DIRECT /end RECORD_LAYOUT
/begin RECORD_LAYOUT Lookup2D_FLOAT32_IEEE FNC_VALUES 1 FLOAT32_IEEE COLUMN_DIR DIRECT /end RECORD_LAYOUT
/begin RECORD_LAYOUT Lookup2D_X_FLOAT32_IEEE AXIS_PTS_X 1 FLOAT32_IEEE INDEX_INCR DIRECT /end RECORD_LAYOUT
/begin CHARACTERISTIC CaSOC_OcvSocMapZ_pct "" MAP 0x7001a7f2 Lookup2D_FLOAT32_IEEE 0 VBU0513_CM_single_cnt -3.4028234663852886E+38 3.4028234663852886E+38
 /begin AXIS_DESCR COM_AXIS NO_INPUT_QUANTITY VBU0513_CM_uint16_cnt 23 0.0 65535.0 AXIS_PTS_REF CaSOC_OcvSocMapY_mV /end AXIS_DESCR
 /begin AXIS_DESCR COM_AXIS CTM_tCellTempAve VBU0513_CM_single_cnt 9 -3.4028234663852886E+38 3.4028234663852886E+38 AXIS_PTS_REF CaSOC_OcvSocMapX_C /end AXIS_DESCR
/end CHARACTERISTIC
/begin AXIS_PTS CaSOC_OcvSocMapX_C "" 0x700127b6 CTM_tCellTempAve Lookup2D_X_FLOAT32_IEEE 0 VBU0513_CM_single_cnt 9 -3.4028234663852886E+38 3.4028234663852886E+38 /end AXIS_PTS
/begin AXIS_PTS CaSOC_OcvSocMapY_mV "" 0x70013152 NO_INPUT_QUANTITY Lookup2D_X_UWORD 0 VBU0513_CM_uint16_cnt 23 0.0 65535.0 /end AXIS_PTS
/begin CHARACTERISTIC CaSOF_mvDischargeOcvSocTempMap_v "" MAP 0x7001cf12 Lookup2D_FLOAT32_IEEE 0 VBU0513_CM_single_v 0.0 5.0
 /begin AXIS_DESCR COM_AXIS NO_INPUT_QUANTITY VBU0513_CM_single_pct 21 0.0 100.0 AXIS_PTS_REF CaSOF_pctDischargeOcvSocTempMap_y /end AXIS_DESCR
 /begin AXIS_DESCR COM_AXIS CTM_tCellTempAve VBU0513_CM_single_t 19 -40.0 120.0 AXIS_PTS_REF CaSOF_tDischargeOcvSocTempMap_x /end AXIS_DESCR
/end CHARACTERISTIC
/begin AXIS_PTS CaSOF_tDischargeOcvSocTempMap_x "" 0x700141e6 CTM_tCellTempAve Lookup2D_X_FLOAT32_IEEE 0 VBU0513_CM_single_t 19 -40.0 120.0 /end AXIS_PTS
/begin AXIS_PTS CaSOF_pctDischargeOcvSocTempMap_y "" 0x7001459a NO_INPUT_QUANTITY Lookup2D_X_FLOAT32_IEEE 0 VBU0513_CM_single_pct 21 0.0 100.0 /end AXIS_PTS
/begin CHARACTERISTIC CaSOF_mvChargeOcvSocTempMap_v "" MAP 0x7001b8d6 Lookup2D_FLOAT32_IEEE 0 VBU0513_CM_single_v 0.0 5.0
 /begin AXIS_DESCR COM_AXIS NO_INPUT_QUANTITY VBU0513_CM_single_pct 20 0.0 100.0 AXIS_PTS_REF CaSOF_pctChargeOcvSocTempMap_y /end AXIS_DESCR
 /begin AXIS_DESCR COM_AXIS CTM_tCellTempAve VBU0513_CM_single_t 17 -40.0 120.0 AXIS_PTS_REF CaSOF_tChargeOcvSocTempMap_x /end AXIS_DESCR
/end CHARACTERISTIC
/begin AXIS_PTS CaSOF_tChargeOcvSocTempMap_x "" 0x70013e1e CTM_tCellTempAve Lookup2D_X_FLOAT32_IEEE 0 VBU0513_CM_single_t 17 -40.0 120.0 /end AXIS_PTS
/begin AXIS_PTS CaSOF_pctChargeOcvSocTempMap_y "" 0x70014402 NO_INPUT_QUANTITY Lookup2D_X_FLOAT32_IEEE 0 VBU0513_CM_single_pct 20 0.0 100.0 /end AXIS_PTS
/begin CHARACTERISTIC CaSOF_SocpDischargeSocMinMapY_pct "" CURVE 0x70011c9a Lookup1D_FLOAT32_IEEE 0 VBU0513_CM_single_cnt -3.4028234663852886E+38 3.4028234663852886E+38
 /begin AXIS_DESCR COM_AXIS CTM_tCellTempMin VBU0513_CM_single_cnt 4 -3.4028234663852886E+38 3.4028234663852886E+38 AXIS_PTS_REF CaSOF_SocpDischargeSocMinMapX_C /end AXIS_DESCR
/end CHARACTERISTIC
/begin AXIS_PTS CaSOF_SocpDischargeSocMinMapX_C "" 0x70011c8a CTM_tCellTempMin Lookup1D_X_FLOAT32_IEEE 0 VBU0513_CM_single_cnt 4 -3.4028234663852886E+38 3.4028234663852886E+38 /end AXIS_PTS
/begin CHARACTERISTIC CaTHM_FccSohFactorMapY_n "" CURVE 0x70011eb2 Lookup1D_FLOAT32_IEEE 0 VBU0513_CM_single_cnt 0.0 1.0
 /begin AXIS_DESCR COM_AXIS NO_INPUT_QUANTITY VBU0513_CM_single_cnt 5 0.0 100.0 AXIS_PTS_REF CaTHM_PackSohMapX_pct /end AXIS_DESCR
/end CHARACTERISTIC
/begin AXIS_PTS CaTHM_PackSohMapX_pct "" 0x70011eee NO_INPUT_QUANTITY Lookup1D_X_FLOAT32_IEEE 0 VBU0513_CM_single_cnt 5 0.0 100.0 /end AXIS_PTS
/begin CHARACTERISTIC CaTHM_FccHighSocRequestTempMapZ_C "" MAP 0x70014e7e Lookup2D_FLOAT32_IEEE 0 VBU0513_CM_single_cnt -40.0 80.0
 /begin AXIS_DESCR COM_AXIS SOC_pctCellSocMax VBU0513_CM_single_cnt 5 0.0 100.0 AXIS_PTS_REF CaTHM_CellSocMaxMapY_pct /end AXIS_DESCR
 /begin AXIS_DESCR COM_AXIS CTM_tCellTempMax VBU0513_CM_single_cnt 6 -40.0 80.0 AXIS_PTS_REF CaTHM_CellTempMaxMapX_C /end AXIS_DESCR
/end CHARACTERISTIC
/begin AXIS_PTS CaTHM_CellTempMaxMapX_C "" 0x700121ca CTM_tCellTempMax Lookup2D_X_FLOAT32_IEEE 0 VBU0513_CM_single_cnt 6 -40.0 80.0 /end AXIS_PTS
/begin AXIS_PTS CaTHM_CellSocMaxMapY_pct "" 0x70011e9e SOC_pctCellSocMax Lookup2D_X_FLOAT32_IEEE 0 VBU0513_CM_single_cnt 5 0.0 100.0 /end AXIS_PTS
/begin CHARACTERISTIC AVAS_flgNumHwVerOvrd_C "" VALUE 0x70010278 Scalar_FLOAT32_IEEE 0 VBU0513_CM_single 0.0 1.0 /end CHARACTERISTIC
/begin CHARACTERISTIC AVAS_flgNumSoftwareVerOvrd_C "" VALUE 0x7001027c Scalar_FLOAT32_IEEE 0 VBU0513_CM_single 0.0 1.0 /end CHARACTERISTIC
/begin CHARACTERISTIC AVAS_flgStWorkingStatusOvrd_C "" VALUE 0x70010280 Scalar_FLOAT32_IEEE 0 VBU0513_CM_single 0.0 1.0 /end CHARACTERISTIC
/begin CHARACTERISTIC AVAS_numHwVerOvrdVal_C "" VALUE 0x70010284 Scalar_FLOAT32_IEEE 0 VBU0513_CM_single 0.0 4.294967295E+9 /end CHARACTERISTIC
/begin CHARACTERISTIC AVAS_numSoftwareVerOvrdVal_C "" VALUE 0x70010288 Scalar_FLOAT32_IEEE 0 VBU0513_CM_single 0.0 4.294967295E+9 /end CHARACTERISTIC
/begin CHARACTERISTIC AVAS_stWorkingStatusOvrdVal_C "" VALUE 0x7001028c Scalar_FLOAT32_IEEE 0 VBU0513_CM_single 0.0 255.0 /end CHARACTERISTIC
/begin CHARACTERISTIC BCM_flgFlgIG1PwrOvrd_C "" VALUE 0x70010290 Scalar_FLOAT32_IEEE 0 VBU0513_CM_single 0.0 1.0 /end CHARACTERISTIC
/begin CHARACTERISTIC BCM_flgIG1PwrOvrdVal_C "" VALUE 0x70010294 Scalar_FLOAT32_IEEE 0 VBU0513_CM_single 0.0 1.0 /end CHARACTERISTIC
/begin CHARACTERISTIC BCM_flgStAutoHeadlightGearOvrd_C "" VALUE 0x70010298 Scalar_FLOAT32_IEEE 0 VBU0513_CM_single 0.0 1.0 /end CHARACTERISTIC
/begin CHARACTERISTIC BCM_flgStAutoWiperGearOvrd_C "" VALUE 0x7001029c Scalar_FLOAT32_IEEE 0 VBU0513_CM_single 0.0 1.0 /end CHARACTERISTIC
/begin CHARACTERISTIC BCM_flgStBrkLghtStatusOvrd_C "" VALUE 0x700102a0 Scalar_FLOAT32_IEEE 0 VBU0513_CM_single 0.0 1.0 /end CHARACTERISTIC
/begin CHARACTERISTIC BCM_flgStDayLghtStatusOvrd_C "" VALUE 0x700102a4 Scalar_FLOAT32_IEEE 0 VBU0513_CM_single 0.0 1.0 /end CHARACTERISTIC
/begin CHARACTERISTIC BCM_flgStDoorStatusOvrd_C "" VALUE 0x700102a8 Scalar_FLOAT32_IEEE 0 VBU0513_CM_single 0.0 1.0 /end CHARACTERISTIC
/begin CHARACTERISTIC BCM_flgStFrntFogLghtOvrd_C "" VALUE 0x700102ac Scalar_FLOAT32_IEEE 0 VBU0513_CM_single 0.0 1.0 /end CHARACTERISTIC
/begin CHARACTERISTIC BCM_flgStHIWiperStatusOvrd_C "" VALUE 0x700102b0 Scalar_FLOAT32_IEEE 0 VBU0513_CM_single 0.0 1.0 /end CHARACTERISTIC
/begin CHARACTERISTIC BCM_flgStHiBeamOvrd_C "" VALUE 0x700102b4 Scalar_FLOAT32_IEEE 0 VBU0513_CM_single 0.0 1.0 /end CHARACTERISTIC
/begin CHARACTERISTIC BCM_flgStHornStatusOvrd_C "" VALUE 0x700102b8 Scalar_FLOAT32_IEEE 0 VBU0513_CM_single 0.0 1.0 /end CHARACTERISTIC
/begin CHARACTERISTIC BCM_flgStLeTurnStatusOvrd_C "" VALUE 0x700102bc Scalar_FLOAT32_IEEE 0 VBU0513_CM_single 0.0 1.0 /end CHARACTERISTIC
/begin CHARACTERISTIC BCM_flgStLoWiperStatusOvrd_C "" VALUE 0x700102c0 Scalar_FLOAT32_IEEE 0 VBU0513_CM_single 0.0 1.0 /end CHARACTERISTIC
/begin CHARACTERISTIC BCM_flgStLowBeamOvrd_C "" VALUE 0x700102c4 Scalar_FLOAT32_IEEE 0 VBU0513_CM_single 0.0 1.0 /end CHARACTERISTIC
/begin CHARACTERISTIC BCM_flgStParkLghtStatusOvrd_C "" VALUE 0x700102c8 Scalar_FLOAT32_IEEE 0 VBU0513_CM_single 0.0 1.0 /end CHARACTERISTIC
/begin CHARACTERISTIC BCM_flgStParkSwtStatusOvrd_C "" VALUE 0x700102cc Scalar_FLOAT32_IEEE 0 VBU0513_CM_single 0.0 1.0 /end CHARACTERISTIC
/begin CHARACTERISTIC BCM_flgStRealFogLghtOvrd_C "" VALUE 0x700102d0 Scalar_FLOAT32_IEEE 0 VBU0513_CM_single 0.0 1.0 /end CHARACTERISTIC
/begin CHARACTERISTIC BCM_flgStReversingSwtStatusOvrd_C "" VALUE 0x700102d4 Scalar_FLOAT32_IEEE 0 VBU0513_CM_single 0.0 1.0 /end CHARACTERISTIC
/begin CHARACTERISTIC BCM_flgStRiTurnLghtStatusOvrd_C "" VALUE 0x700102d8 Scalar_FLOAT32_IEEE 0 VBU0513_CM_single 0.0 1.0 /end CHARACTERISTIC
/begin CHARACTERISTIC BCM_flgStWashMotrStatusOvrd_C "" VALUE 0x700102dc Scalar_FLOAT32_IEEE 0 VBU0513_CM_single 0.0 1.0 /end CHARACTERISTIC
/begin CHARACTERISTIC BCM_stAutoHeadlightGearOvrdVal_C "" VALUE 0x700102e0 Scalar_FLOAT32_IEEE 0 VBU0513_CM_single 0.0 255.0 /end CHARACTERISTIC
/begin CHARACTERISTIC BCM_stAutoWiperGearOvrdVal_C "" VALUE 0x700102e4 Scalar_FLOAT32_IEEE 0 VBU0513_CM_single 0.0 255.0 /end CHARACTERISTIC
/begin CHARACTERISTIC BCM_stBrkLghtStatusOvrdVal_C "" VALUE 0x700102e8 Scalar_FLOAT32_IEEE 0 VBU0513_CM_single 0.0 255.0 /end CHARACTERISTIC
/begin CHARACTERISTIC BCM_stDayLghtStatusOvrdVal_C "" VALUE 0x700102ec Scalar_FLOAT32_IEEE 0 VBU0513_CM_single 0.0 255.0 /end CHARACTERISTIC
/begin CHARACTERISTIC BCM_stDoorStatusOvrdVal_C "" VALUE 0x700102f0 Scalar_FLOAT32_IEEE 0 VBU0513_CM_single 0.0 255.0 /end CHARACTERISTIC
/begin CHARACTERISTIC BCM_stFrntFogLghtOvrdVal_C "" VALUE 0x700102f4 Scalar_FLOAT32_IEEE 0 VBU0513_CM_single 0.0 255.0 /end CHARACTERISTIC
/begin CHARACTERISTIC BCM_stHIWiperStatusOvrdVal_C "" VALUE 0x700102f8 Scalar_FLOAT32_IEEE 0 VBU0513_CM_single 0.0 255.0 /end CHARACTERISTIC
/begin CHARACTERISTIC BCM_stHiBeamOvrdVal_C "" VALUE 0x700102fc Scalar_FLOAT32_IEEE 0 VBU0513_CM_single 0.0 255.0 /end CHARACTERISTIC
/begin CHARACTERISTIC BCM_stHornStatusOvrdVal_C "" VALUE 0x70010300 Scalar_FLOAT32_IEEE 0 VBU0513_CM_single 0.0 255.0 /end CHARACTERISTIC
/begin CHARACTERISTIC BCM_stLeTurnStatusOvrdVal_C "" VALUE 0x70010304 Scalar_FLOAT32_IEEE 0 VBU0513_CM_single 0.0 255.0 /end CHARACTERISTIC
/begin CHARACTERISTIC BCM_stLoWiperStatusOvrdVal_C "" VALUE 0x70010308 Scalar_FLOAT32_IEEE 0 VBU0513_CM_single 0.0 255.0 /end CHARACTERISTIC
/begin CHARACTERISTIC BCM_stLowBeamOvrdVal_C "" VALUE 0x7001030c Scalar_FLOAT32_IEEE 0 VBU0513_CM_single 0.0 255.0 /end CHARACTERISTIC
/begin CHARACTERISTIC BCM_stParkLghtStatusOvrdVal_C "" VALUE 0x70010310 Scalar_FLOAT32_IEEE 0 VBU0513_CM_single 0.0 255.0 /end CHARACTERISTIC
/begin CHARACTERISTIC BCM_stParkSwtStatusOvrdVal_C "" VALUE 0x70010314 Scalar_FLOAT32_IEEE 0 VBU0513_CM_single 0.0 255.0 /end CHARACTERISTIC
/begin CHARACTERISTIC BCM_stRealFogLghtOvrdVal_C "" VALUE 0x70010318 Scalar_FLOAT32_IEEE 0 VBU0513_CM_single 0.0 255.0 /end CHARACTERISTIC
/begin CHARACTERISTIC BCM_stReversingSwtStatusOvrdVal_C "" VALUE 0x7001031c Scalar_FLOAT32_IEEE 0 VBU0513_CM_single 0.0 255.0 /end CHARACTERISTIC
/begin CHARACTERISTIC BCM_stRiTurnLghtStatusOvrdVal_C "" VALUE 0x70010320 Scalar_FLOAT32_IEEE 0 VBU0513_CM_single 0.0 255.0 /end CHARACTERISTIC
/begin CHARACTERISTIC BCM_stWashMotrStatusOvrdVal_C "" VALUE 0x70010324 Scalar_FLOAT32_IEEE 0 VBU0513_CM_single 0.0 255.0 /end CHARACTERISTIC
/begin CHARACTERISTIC BCU_cntFLWhlSpdPlusCntOvrdVal_C "" VALUE 0x70010328 Scalar_FLOAT32_IEEE 0 VBU0513_CM_single 0.0 4.294967295E+9 /end CHARACTERISTIC
/begin CHARACTERISTIC BCU_cntFRWhlSpdPlusCntOvrdVal_C "" VALUE 0x7001032c Scalar_FLOAT32_IEEE 0 VBU0513_CM_single 0.0 4.294967295E+9 /end CHARACTERISTIC
/begin CHARACTERISTIC BCU_cntRLWhlSpdPlusCntOvrdVal_C "" VALUE 0x70010330 Scalar_FLOAT32_IEEE 0 VBU0513_CM_single 0.0 4.294967295E+9 /end CHARACTERISTIC
/begin CHARACTERISTIC BCU_cntRRWhlSpdPlusCntOvrdVal_C "" VALUE 0x70010334 Scalar_FLOAT32_IEEE 0 VBU0513_CM_single 0.0 4.294967295E+9 /end CHARACTERISTIC
/begin CHARACTERISTIC BCU_flgABSActvOvrdVal_C "" VALUE 0x70010338 Scalar_FLOAT32_IEEE 0 VBU0513_CM_single 0.0 1.0 /end CHARACTERISTIC
/begin CHARACTERISTIC BCU_flgABSFailOvrdVal_C "" VALUE 0x7001033c Scalar_FLOAT32_IEEE 0 VBU0513_CM_single 0.0 1.0 /end CHARACTERISTIC
/begin CHARACTERISTIC BCU_flgCntFLWhlSpdPlusCntOvrd_C "" VALUE 0x70010340 Scalar_FLOAT32_IEEE 0 VBU0513_CM_single 0.0 1.0 /end CHARACTERISTIC
/begin CHARACTERISTIC BCU_flgCntFRWhlSpdPlusCntOvrd_C "" VALUE 0x70010344 Scalar_FLOAT32_IEEE 0 VBU0513_CM_single 0.0 1.0 /end CHARACTERISTIC
/begin CHARACTERISTIC BCU_flgCntRLWhlSpdPlusCntOvrd_C "" VALUE 0x70010348 Scalar_FLOAT32_IEEE 0 VBU0513_CM_single 0.0 1.0 /end CHARACTERISTIC
/begin CHARACTERISTIC BCU_flgCntRRWhlSpdPlusCntOvrd_C "" VALUE 0x7001034c Scalar_FLOAT32_IEEE 0 VBU0513_CM_single 0.0 1.0 /end CHARACTERISTIC
/begin CHARACTERISTIC BCU_flgEBDActiveOvrdVal_C "" VALUE 0x70010350 Scalar_FLOAT32_IEEE 0 VBU0513_CM_single 0.0 1.0 /end CHARACTERISTIC
/begin CHARACTERISTIC BCU_flgEBDFailOvrdVal_C "" VALUE 0x70010354 Scalar_FLOAT32_IEEE 0 VBU0513_CM_single 0.0 1.0 /end CHARACTERISTIC
/begin CHARACTERISTIC BCU_flgFLWhlSpdPlusCntOvrdVal_C "" VALUE 0x70010358 Scalar_FLOAT32_IEEE 0 VBU0513_CM_single 0.0 1.0 /end CHARACTERISTIC
/begin CHARACTERISTIC BCU_flgFRWhlSpdPlusCntOvrdVal_C "" VALUE 0x7001035c Scalar_FLOAT32_IEEE 0 VBU0513_CM_single 0.0 1.0 /end CHARACTERISTIC
/begin CHARACTERISTIC BCU_flgFlgABSActvOvrd_C "" VALUE 0x70010360 Scalar_FLOAT32_IEEE 0 VBU0513_CM_single 0.0 1.0 /end CHARACTERISTIC
/begin CHARACTERISTIC BCU_flgFlgABSFailOvrd_C "" VALUE 0x70010364 Scalar_FLOAT32_IEEE 0 VBU0513_CM_single 0.0 1.0 /end CHARACTERISTIC
/begin CHARACTERISTIC BCU_flgFlgEBDActiveOvrd_C "" VALUE 0x70010368 Scalar_FLOAT32_IEEE 0 VBU0513_CM_single 0.0 1.0 /end CHARACTERISTIC
/begin CHARACTERISTIC BCU_flgFlgEBDFailOvrd_C "" VALUE 0x7001036c Scalar_FLOAT32_IEEE 0 VBU0513_CM_single 0.0 1.0 /end CHARACTERISTIC
/begin CHARACTERISTIC BCU_flgFlgFLWhlSpdPlusCntOvrd_C "" VALUE 0x70010370 Scalar_FLOAT32_IEEE 0 VBU0513_CM_single 0.0 1.0 /end CHARACTERISTIC
/begin CHARACTERISTIC BCU_flgFlgFRWhlSpdPlusCntOvrd_C "" VALUE 0x70010374 Scalar_FLOAT32_IEEE 0 VBU0513_CM_single 0.0 1.0 /end CHARACTERISTIC
/begin CHARACTERISTIC BCU_flgFlgRLWhlSpdPlusCntOvrd_C "" VALUE 0x70010378 Scalar_FLOAT32_IEEE 0 VBU0513_CM_single 0.0 1.0 /end CHARACTERISTIC
/begin CHARACTERISTIC BCU_flgFlgRRWhlSpdPlusCntOvrd_C "" VALUE 0x7001037c Scalar_FLOAT32_IEEE 0 VBU0513_CM_single 0.0 1.0 /end CHARACTERISTIC
/begin CHARACTERISTIC BCU_flgFlgVehicleSpeedValidOvrd_C "" VALUE 0x70010380 Scalar_FLOAT32_IEEE 0 VBU0513_CM_single 0.0 1.0 /end CHARACTERISTIC
/begin CHARACTERISTIC BCU_flgRLWhlSpdPlusCntOvrdVal_C "" VALUE 0x70010384 Scalar_FLOAT32_IEEE 0 VBU0513_CM_single 0.0 1.0 /end CHARACTERISTIC
/begin CHARACTERISTIC BCU_flgRRWhlSpdPlusCntOvrdVal_C "" VALUE 0x70010388 Scalar_FLOAT32_IEEE 0 VBU0513_CM_single 0.0 1.0 /end CHARACTERISTIC
/begin CHARACTERISTIC BCU_flgStWhlFLOvrd_C "" VALUE 0x7001038c Scalar_FLOAT32_IEEE 0 VBU0513_CM_single 0.0 1.0 /end CHARACTERISTIC
/begin CHARACTERISTIC BCU_flgStWhlFROvrd_C "" VALUE 0x70010390 Scalar_FLOAT32_IEEE 0 VBU0513_CM_single 0.0 1.0 /end CHARACTERISTIC
/begin CHARACTERISTIC BCU_flgStWhlRLOvrd_C "" VALUE 0x70010394 Scalar_FLOAT32_IEEE 0 VBU0513_CM_single 0.0 1.0 /end CHARACTERISTIC
/begin CHARACTERISTIC BCU_flgStWhlRROvrd_C "" VALUE 0x70010398 Scalar_FLOAT32_IEEE 0 VBU0513_CM_single 0.0 1.0 /end CHARACTERISTIC
/begin CHARACTERISTIC BCU_flgVVehicleSpeedOvrd_C "" VALUE 0x7001039c Scalar_FLOAT32_IEEE 0 VBU0513_CM_single 0.0 1.0 /end CHARACTERISTIC
/begin CHARACTERISTIC BCU_flgVWhlFLOvrd_C "" VALUE 0x700103a0 Scalar_FLOAT32_IEEE 0 VBU0513_CM_single 0.0 1.0 /end CHARACTERISTIC
/begin CHARACTERISTIC BCU_flgVWhlFROvrd_C "" VALUE 0x700103a4 Scalar_FLOAT32_IEEE 0 VBU0513_CM_single 0.0 1.0 /end CHARACTERISTIC
/begin CHARACTERISTIC BCU_flgVWhlRLOvrd_C "" VALUE 0x700103a8 Scalar_FLOAT32_IEEE 0 VBU0513_CM_single 0.0 1.0 /end CHARACTERISTIC
/begin CHARACTERISTIC BCU_flgVWhlRROvrd_C "" VALUE 0x700103ac Scalar_FLOAT32_IEEE 0 VBU0513_CM_single 0.0 1.0 /end CHARACTERISTIC
/begin CHARACTERISTIC BCU_flgVehicleSpeedValidOvrdVal_C "" VALUE 0x700103b0 Scalar_FLOAT32_IEEE 0 VBU0513_CM_single 0.0 1.0 /end CHARACTERISTIC
/begin CHARACTERISTIC BCU_stWhlFLOvrdVal_C "" VALUE 0x700103b4 Scalar_FLOAT32_IEEE 0 VBU0513_CM_single 0.0 255.0 /end CHARACTERISTIC
/begin CHARACTERISTIC BCU_stWhlFROvrdVal_C "" VALUE 0x700103b8 Scalar_FLOAT32_IEEE 0 VBU0513_CM_single 0.0 255.0 /end CHARACTERISTIC
/begin CHARACTERISTIC BCU_stWhlRLOvrdVal_C "" VALUE 0x700103bc Scalar_FLOAT32_IEEE 0 VBU0513_CM_single 0.0 255.0 /end CHARACTERISTIC
/begin CHARACTERISTIC BCU_stWhlRROvrdVal_C "" VALUE 0x700103c0 Scalar_FLOAT32_IEEE 0 VBU0513_CM_single 0.0 255.0 /end CHARACTERISTIC
/begin CHARACTERISTIC BCU_vVehicleSpeedOvrdVal_C "" VALUE 0x700103c4 Scalar_FLOAT32_IEEE 0 VBU0513_CM_single -3.40282346638528E+38 3.40282346638528E+38 /end CHARACTERISTIC
/begin CHARACTERISTIC BCU_vWhlFLOvrdVal_C "" VALUE 0x700103c8 Scalar_FLOAT32_IEEE 0 VBU0513_CM_single -3.40282346638528E+38 3.40282346638528E+38 /end CHARACTERISTIC
/begin CHARACTERISTIC BCU_vWhlFROvrdVal_C "" VALUE 0x700103cc Scalar_FLOAT32_IEEE 0 VBU0513_CM_single -3.40282346638528E+38 3.40282346638528E+38 /end CHARACTERISTIC
/begin CHARACTERISTIC BCU_vWhlRLOvrdVal_C "" VALUE 0x700103d0 Scalar_FLOAT32_IEEE 0 VBU0513_CM_single -3.40282346638528E+38 3.40282346638528E+38 /end CHARACTERISTIC
/begin CHARACTERISTIC BCU_vWhlRROvrdVal_C "" VALUE 0x700103d4 Scalar_FLOAT32_IEEE 0 VBU0513_CM_single -3.40282346638528E+38 3.40282346638528E+38 /end CHARACTERISTIC
/begin CHARACTERISTIC CCU_flgFlgOverCurrFreqRdcOvrd_C "" VALUE 0x70010408 Scalar_FLOAT32_IEEE 0 VBU0513_CM_single 0.0 1.0 /end CHARACTERISTIC
/begin CHARACTERISTIC CCU_flgFlgOvrCurrOvrd_C "" VALUE 0x7001040c Scalar_FLOAT32_IEEE 0 VBU0513_CM_single 0.0 1.0 /end CHARACTERISTIC
/begin CHARACTERISTIC CCU_flgFlgOvrVltgOvrd_C "" VALUE 0x70010410 Scalar_FLOAT32_IEEE 0 VBU0513_CM_single 0.0 1.0 /end CHARACTERISTIC
/begin CHARACTERISTIC CCU_flgFlgStdbyOvrVltgOvrd_C "" VALUE 0x70010414 Scalar_FLOAT32_IEEE 0 VBU0513_CM_single 0.0 1.0 /end CHARACTERISTIC
/begin CHARACTERISTIC CCU_flgFlgStdbyUndrVltgOvrd_C "" VALUE 0x70010418 Scalar_FLOAT32_IEEE 0 VBU0513_CM_single 0.0 1.0 /end CHARACTERISTIC
/begin CHARACTERISTIC CCU_flgFlgUndrVltgOvrd_C "" VALUE 0x7001041c Scalar_FLOAT32_IEEE 0 VBU0513_CM_single 0.0 1.0 /end CHARACTERISTIC
/begin CHARACTERISTIC CCU_flgICompCurrOvrd_C "" VALUE 0x70010420 Scalar_FLOAT32_IEEE 0 VBU0513_CM_single 0.0 1.0 /end CHARACTERISTIC
/begin CHARACTERISTIC CCU_flgNCompActSpdOvrd_C "" VALUE 0x70010424 Scalar_FLOAT32_IEEE 0 VBU0513_CM_single 0.0 1.0 /end CHARACTERISTIC
/begin CHARACTERISTIC CCU_flgOverCurrFreqRdcOvrdVal_C "" VALUE 0x70010428 Scalar_FLOAT32_IEEE 0 VBU0513_CM_single 0.0 1.0 /end CHARACTERISTIC
/begin CHARACTERISTIC CCU_flgOvrCurrOvrdVal_C "" VALUE 0x7001042c Scalar_FLOAT32_IEEE 0 VBU0513_CM_single 0.0 1.0 /end CHARACTERISTIC
/begin CHARACTERISTIC CCU_flgOvrVltgOvrdVal_C "" VALUE 0x70010430 Scalar_FLOAT32_IEEE 0 VBU0513_CM_single 0.0 1.0 /end CHARACTERISTIC
/begin CHARACTERISTIC CCU_flgStCompFaultOvrd_C "" VALUE 0x70010434 Scalar_FLOAT32_IEEE 0 VBU0513_CM_single 0.0 1.0 /end CHARACTERISTIC
/begin CHARACTERISTIC CCU_flgStCpmpStatusOvrd_C "" VALUE 0x70010438 Scalar_FLOAT32_IEEE 0 VBU0513_CM_single 0.0 1.0 /end CHARACTERISTIC
/begin CHARACTERISTIC CCU_flgStSpdFaultOvrd_C "" VALUE 0x7001043c Scalar_FLOAT32_IEEE 0 VBU0513_CM_single 0.0 1.0 /end CHARACTERISTIC
/begin CHARACTERISTIC CCU_flgStdbyOvrVltgOvrdVal_C "" VALUE 0x70010440 Scalar_FLOAT32_IEEE 0 VBU0513_CM_single 0.0 1.0 /end CHARACTERISTIC
/begin CHARACTERISTIC CCU_flgStdbyUndrVltgOvrdVal_C "" VALUE 0x70010444 Scalar_FLOAT32_IEEE 0 VBU0513_CM_single 0.0 1.0 /end CHARACTERISTIC
/begin CHARACTERISTIC CCU_flgUCompVltgOvrd_C "" VALUE 0x70010448 Scalar_FLOAT32_IEEE 0 VBU0513_CM_single 0.0 1.0 /end CHARACTERISTIC
/begin CHARACTERISTIC CCU_flgUndrVltgOvrdVal_C "" VALUE 0x7001044c Scalar_FLOAT32_IEEE 0 VBU0513_CM_single 0.0 1.0 /end CHARACTERISTIC
/begin CHARACTERISTIC CCU_iCompCurrOvrdVal_C "" VALUE 0x70010450 Scalar_FLOAT32_IEEE 0 VBU0513_CM_single -3.40282346638528E+38 3.40282346638528E+38 /end CHARACTERISTIC
/begin CHARACTERISTIC CCU_nCompActSpdOvrdVal_C "" VALUE 0x70010454 Scalar_FLOAT32_IEEE 0 VBU0513_CM_single -3.40282346638528E+38 3.40282346638528E+38 /end CHARACTERISTIC
/begin CHARACTERISTIC CCU_stCompFaultOvrdVal_C "" VALUE 0x70010458 Scalar_FLOAT32_IEEE 0 VBU0513_CM_single 0.0 255.0 /end CHARACTERISTIC
/begin CHARACTERISTIC CCU_stCpmpStatusOvrdVal_C "" VALUE 0x7001045c Scalar_FLOAT32_IEEE 0 VBU0513_CM_single 0.0 255.0 /end CHARACTERISTIC
/begin CHARACTERISTIC CCU_stSpdFaultOvrdVal_C "" VALUE 0x70010460 Scalar_FLOAT32_IEEE 0 VBU0513_CM_single 0.0 255.0 /end CHARACTERISTIC
/begin CHARACTERISTIC CCU_uCompVltgOvrdVal_C "" VALUE 0x70010464 Scalar_FLOAT32_IEEE 0 VBU0513_CM_single -3.40282346638528E+38 3.40282346638528E+38 /end CHARACTERISTIC
/begin CHARACTERISTIC CDC_flgCreepOnOffOvrdVal_C "" VALUE 0x70010468 Scalar_FLOAT32_IEEE 0 VBU0513_CM_single 0.0 1.0 /end CHARACTERISTIC
/begin CHARACTERISTIC CDC_flgFlgCreepOnOffOvrd_C "" VALUE 0x7001046c Scalar_FLOAT32_IEEE 0 VBU0513_CM_single 0.0 1.0 /end CHARACTERISTIC
/begin CHARACTERISTIC CDC_flgFlgGoNotifierOnOffOvrd_C "" VALUE 0x70010470 Scalar_FLOAT32_IEEE 0 VBU0513_CM_single 0.0 1.0 /end CHARACTERISTIC
/begin CHARACTERISTIC CDC_flgGoNotifierOnOffOvrdVal_C "" VALUE 0x70010474 Scalar_FLOAT32_IEEE 0 VBU0513_CM_single 0.0 1.0 /end CHARACTERISTIC
/begin CHARACTERISTIC CDC_flgStDrvModeOvrd_C "" VALUE 0x70010478 Scalar_FLOAT32_IEEE 0 VBU0513_CM_single 0.0 1.0 /end CHARACTERISTIC
/begin CHARACTERISTIC CDC_flgStRgnModeOvrd_C "" VALUE 0x7001047c Scalar_FLOAT32_IEEE 0 VBU0513_CM_single 0.0 1.0 /end CHARACTERISTIC
/begin CHARACTERISTIC CDC_flgStTowModeOvrd_C "" VALUE 0x70010480 Scalar_FLOAT32_IEEE 0 VBU0513_CM_single 0.0 1.0 /end CHARACTERISTIC
/begin CHARACTERISTIC CDC_stDrvModeOvrdVal_C "" VALUE 0x70010484 Scalar_FLOAT32_IEEE 0 VBU0513_CM_single 0.0 255.0 /end CHARACTERISTIC
/begin CHARACTERISTIC CDC_stRgnModeOvrdVal_C "" VALUE 0x70010488 Scalar_FLOAT32_IEEE 0 VBU0513_CM_single 0.0 255.0 /end CHARACTERISTIC
/begin CHARACTERISTIC CDC_stTowModeOvrdVal_C "" VALUE 0x7001048c Scalar_FLOAT32_IEEE 0 VBU0513_CM_single 0.0 255.0 /end CHARACTERISTIC
/begin CHARACTERISTIC CcSOC_BatteryDisplaySocUpdateDelta_pct "" VALUE 0x700107d0 Scalar_FLOAT32_IEEE 0 VBU0513_CM_single_cnt -3.4028234663852886E+38 3.4028234663852886E+38 /end CHARACTERISTIC
/begin CHARACTERISTIC CcSOC_BatterySOCOvrdVal_pct "" VALUE 0x700107dc Scalar_FLOAT32_IEEE 0 VBU0513_CM_single_cnt -3.4028234663852886E+38 3.4028234663852886E+38 /end CHARACTERISTIC
/begin CHARACTERISTIC CcSOC_BatterySocUpdateDelta_pct "" VALUE 0x700107fc Scalar_FLOAT32_IEEE 0 VBU0513_CM_single_cnt -3.4028234663852886E+38 3.4028234663852886E+38 /end CHARACTERISTIC
/begin CHARACTERISTIC CcSOC_CCCorrectionDisableTem_C "" VALUE 0x70010824 Scalar_FLOAT32_IEEE 0 VBU0513_CM_single_cnt -3.4028234663852886E+38 3.4028234663852886E+38 /end CHARACTERISTIC
/begin CHARACTERISTIC CcSOC_CCCorrectionEnableTem_C "" VALUE 0x70010828 Scalar_FLOAT32_IEEE 0 VBU0513_CM_single_cnt -3.4028234663852886E+38 3.4028234663852886E+38 /end CHARACTERISTIC
/begin CHARACTERISTIC CcSOC_CellSocDefault_pct "" VALUE 0x70010838 Scalar_FLOAT32_IEEE 0 VBU0513_CM_single_cnt -3.4028234663852886E+38 3.4028234663852886E+38 /end CHARACTERISTIC
/begin CHARACTERISTIC CcSOC_CellSocMaxOverrunLimit_pct "" VALUE 0x70010840 Scalar_FLOAT32_IEEE 0 VBU0513_CM_single_cnt -3.4028234663852886E+38 3.4028234663852886E+38 /end CHARACTERISTIC
/begin CHARACTERISTIC CcSOC_CellSocMinOverrunLimit_pct "" VALUE 0x70010844 Scalar_FLOAT32_IEEE 0 VBU0513_CM_single_cnt -3.4028234663852886E+38 3.4028234663852886E+38 /end CHARACTERISTIC
/begin CHARACTERISTIC CcSOC_FastChargeTOCCurrentThld_A "" VALUE 0x7001085c Scalar_FLOAT32_IEEE 0 VBU0513_CM_single -3.4E+38 3.4E+38 /end CHARACTERISTIC
/begin CHARACTERISTIC CcSOC_FastChargeTOCVoltageThld_mV "" VALUE 0x70010868 Scalar_FLOAT32_IEEE 0 VBU0513_CM_single -3.4E+38 3.4E+38 /end CHARACTERISTIC
/begin CHARACTERISTIC CcSOC_MaxAllowSOCDeviation_pct "" VALUE 0x70010874 Scalar_FLOAT32_IEEE 0 VBU0513_CM_single_cnt -3.4028234663852886E+38 3.4028234663852886E+38 /end CHARACTERISTIC
/begin CHARACTERISTIC CcSOC_NoJumpSocChargeRate_pct "" VALUE 0x70010888 Scalar_FLOAT32_IEEE 0 VBU0513_CM_single_cnt -3.4028234663852886E+38 3.4028234663852886E+38 /end CHARACTERISTIC
/begin CHARACTERISTIC CcSOC_OcvCorrectionTempThld_C "" VALUE 0x7001088c Scalar_FLOAT32_IEEE 0 VBU0513_CM_single -3.4E+38 3.4E+38 /end CHARACTERISTIC
/begin CHARACTERISTIC CcSOE_CellEnergyBoL_Kwh "" VALUE 0x700108a0 Scalar_FLOAT32_IEEE 0 VBU0513_CM_single_cnt -3.4028234663852886E+38 3.4028234663852886E+38 /end CHARACTERISTIC
/begin CHARACTERISTIC CcSOE_CellSocDelta_pct "" VALUE 0x700108a4 Scalar_FLOAT32_IEEE 0 VBU0513_CM_single_cnt -3.4028234663852886E+38 3.4028234663852886E+38 /end CHARACTERISTIC
/begin CHARACTERISTIC CcSOE_CellSocEndPredictUpperLimit_pct "" VALUE 0x700108a8 Scalar_FLOAT32_IEEE 0 VBU0513_CM_single_cnt -3.4028234663852886E+38 3.4028234663852886E+38 /end CHARACTERISTIC
/begin CHARACTERISTIC CcSOE_HistoryAveCurrentTimeIntervalNumber_n "" VALUE 0x700108bc Scalar_FLOAT32_IEEE 0 VBU0513_CM_single_cnt -3.4028234663852886E+38 3.4028234663852886E+38 /end CHARACTERISTIC
/begin CHARACTERISTIC CcSOE_HistoryAveCurrentTotalTime_s "" VALUE 0x700108c0 Scalar_FLOAT32_IEEE 0 VBU0513_CM_single_cnt -3.4028234663852886E+38 3.4028234663852886E+38 /end CHARACTERISTIC
/begin CHARACTERISTIC CcSOF_DischargeOCVInLowSOCforPowerLimit_V "" VALUE 0x70010948 Scalar_FLOAT32_IEEE 0 VBU0513_CM_single_cnt -3.4028234663852886E+38 3.4028234663852886E+38 /end CHARACTERISTIC
/begin CHARACTERISTIC CcSOF_SOCLowValueForConstantOCV_pct "" VALUE 0x700109e0 Scalar_FLOAT32_IEEE 0 VBU0513_CM_single_cnt -3.4028234663852886E+38 3.4028234663852886E+38 /end CHARACTERISTIC
/begin CHARACTERISTIC CcSOH_CellCapacityLowFault_pct "" VALUE 0x70010a50 Scalar_FLOAT32_IEEE 0 VBU0513_CM_single_cnt -3.4028234663852886E+38 3.4028234663852886E+38 /end CHARACTERISTIC
/begin CHARACTERISTIC CcSOH_CellCapacityOverDeviationFault_Ah "" VALUE 0x70010a58 Scalar_FLOAT32_IEEE 0 VBU0513_CM_single_cnt -3.4028234663852886E+38 3.4028234663852886E+38 /end CHARACTERISTIC
/begin CHARACTERISTIC CcSOH_CellResistanceHighFault_pct "" VALUE 0x70010a5c Scalar_FLOAT32_IEEE 0 VBU0513_CM_single_cnt -3.4028234663852886E+38 3.4028234663852886E+38 /end CHARACTERISTIC
/begin CHARACTERISTIC CcSOH_FastChargeFactor_n "" VALUE 0x70010a84 Scalar_FLOAT32_IEEE 0 VBU0513_CM_single_cnt -3.4028234663852886E+38 3.4028234663852886E+38 /end CHARACTERISTIC
/begin CHARACTERISTIC CcSOH_NotCalculatedSoh_pct "" VALUE 0x70010aa0 Scalar_FLOAT32_IEEE 0 VBU0513_CM_single_cnt -3.4028234663852886E+38 3.4028234663852886E+38 /end CHARACTERISTIC
/begin CHARACTERISTIC CcSOH_ResistanceBase_mohm "" VALUE 0x70010aa8 Scalar_FLOAT32_IEEE 0 VBU0513_CM_single_cnt -3.4028234663852886E+38 3.4028234663852886E+38 /end CHARACTERISTIC
/begin CHARACTERISTIC CcTHM_ChargeTempRequestHighThreshold_C "" VALUE 0x70010ae8 Scalar_FLOAT32_IEEE 0 VBU0513_CM_single_cnt -3.4028234663852886E+38 3.4028234663852886E+38 /end CHARACTERISTIC
/begin CHARACTERISTIC CcTHM_FccChargeTempRequestLowThreshold_C "" VALUE 0x70010b0c Scalar_FLOAT32_IEEE 0 VBU0513_CM_single_cnt -3.4028234663852886E+38 3.4028234663852886E+38 /end CHARACTERISTIC
/begin CHARACTERISTIC CcTHM_FccSohTempLowThreshold_C "" VALUE 0x70010b14 Scalar_FLOAT32_IEEE 0 VBU0513_CM_single_cnt -3.4028234663852886E+38 3.4028234663852886E+38 /end CHARACTERISTIC
/begin CHARACTERISTIC CcTHM_InvaildTempRequest_C "" VALUE 0x70010b20 Scalar_FLOAT32_IEEE 0 VBU0513_CM_single_cnt -3.4028234663852886E+38 3.4028234663852886E+38 /end CHARACTERISTIC
/begin CHARACTERISTIC CcTHM_PackSohORV_pct "" VALUE 0x70010b3c Scalar_FLOAT32_IEEE 0 VBU0513_CM_single_cnt -3.4028234663852886E+38 3.4028234663852886E+38 /end CHARACTERISTIC
/begin CHARACTERISTIC CcVCT_BMSBatteryRatedCapacityORV_Ah "" VALUE 0x70010b40 Scalar_FLOAT32_IEEE 0 VBU0513_CM_single_Ah -3.4028234663852886E+38 3.4028234663852886E+38 /end CHARACTERISTIC
/begin CHARACTERISTIC CcVCT_BMSBatteryRatedVoltageORV_V "" VALUE 0x70010b44 Scalar_FLOAT32_IEEE 0 VBU0513_CM_single_V -3.4028234663852886E+38 3.4028234663852886E+38 /end CHARACTERISTIC
/begin CHARACTERISTIC CcVCT_BMSCellTempStandardDeviationORV_C "" VALUE 0x70010b48 Scalar_FLOAT32_IEEE 0 VBU0513_CM_single_cnt -3.4028234663852886E+38 3.4028234663852886E+38 /end CHARACTERISTIC
/begin CHARACTERISTIC CcVCT_BMSCellVoltageAveORV_V "" VALUE 0x70010b4c Scalar_FLOAT32_IEEE 0 VBU0513_CM_single_V -3.4028234663852886E+38 3.4028234663852886E+38 /end CHARACTERISTIC
/begin CHARACTERISTIC CcVCT_BMSCellVoltageMaxORV_V "" VALUE 0x70010b50 Scalar_FLOAT32_IEEE 0 VBU0513_CM_single_V -3.4028234663852886E+38 3.4028234663852886E+38 /end CHARACTERISTIC
/begin CHARACTERISTIC CcVCT_BMSCellVoltageMinORV_V "" VALUE 0x70010b54 Scalar_FLOAT32_IEEE 0 VBU0513_CM_single_V -3.4028234663852886E+38 3.4028234663852886E+38 /end CHARACTERISTIC
/begin CHARACTERISTIC CcVCT_BMSChgCurrentLimitORV_A "" VALUE 0x70010b58 Scalar_FLOAT32_IEEE 0 VBU0513_CM_single_A -3.4028234663852886E+38 3.4028234663852886E+38 /end CHARACTERISTIC
/begin CHARACTERISTIC CcVCT_BMSChgPowerLimitDynamicORV_Kw "" VALUE 0x70010b5c Scalar_FLOAT32_IEEE 0 VBU0513_CM_single_Kw -3.4028234663852886E+38 3.4028234663852886E+38 /end CHARACTERISTIC
/begin CHARACTERISTIC CcVCT_BMSChgPowerLimitLTORV_Kw "" VALUE 0x70010b60 Scalar_FLOAT32_IEEE 0 VBU0513_CM_single_Kw -3.4028234663852886E+38 3.4028234663852886E+38 /end CHARACTERISTIC
/begin CHARACTERISTIC CcVCT_BMSChgPowerLimitSTORV_Kw "" VALUE 0x70010b64 Scalar_FLOAT32_IEEE 0 VBU0513_CM_single_Kw -3.4028234663852886E+38 3.4028234663852886E+38 /end CHARACTERISTIC
/begin CHARACTERISTIC CcVCT_BMSCustomerUsageSOCORV_pct "" VALUE 0x70010b68 Scalar_FLOAT32_IEEE 0 VBU0513_CM_single_pct -3.4028234663852886E+38 3.4028234663852886E+38 /end CHARACTERISTIC
/begin CHARACTERISTIC CcVCT_BMSDCChargingCurrentMeasurementORV_A "" VALUE 0x70010b6c Scalar_FLOAT32_IEEE 0 VBU0513_CM_single_A -3.4028234663852886E+38 3.4028234663852886E+38 /end CHARACTERISTIC
/begin CHARACTERISTIC CcVCT_BMSDCChargingVoltageMeasurementORV_V "" VALUE 0x70010b70 Scalar_FLOAT32_IEEE 0 VBU0513_CM_single_V -3.4028234663852886E+38 3.4028234663852886E+38 /end CHARACTERISTIC
/begin CHARACTERISTIC CcVCT_BMSDCChrgCrntReqORV_A "" VALUE 0x70010b74 Scalar_FLOAT32_IEEE 0 VBU0513_CM_single_A -3.4028234663852886E+38 3.4028234663852886E+38 /end CHARACTERISTIC
/begin CHARACTERISTIC CcVCT_BMSDCChrgFinalSOCORV_pct "" VALUE 0x70010b78 Scalar_FLOAT32_IEEE 0 VBU0513_CM_single_pct -3.4028234663852886E+38 3.4028234663852886E+38 /end CHARACTERISTIC
/begin CHARACTERISTIC CcVCT_BMSDCChrgVoltageReqORV_V "" VALUE 0x70010b7c Scalar_FLOAT32_IEEE 0 VBU0513_CM_single_V -3.4028234663852886E+38 3.4028234663852886E+38 /end CHARACTERISTIC
/begin CHARACTERISTIC CcVCT_BMSDischgCurrentLimitORV_A "" VALUE 0x70010b80 Scalar_FLOAT32_IEEE 0 VBU0513_CM_single_A -3.4028234663852886E+38 3.4028234663852886E+38 /end CHARACTERISTIC
/begin CHARACTERISTIC CcVCT_BMSDischgPowerLimitDynamicORV_Kw "" VALUE 0x70010b84 Scalar_FLOAT32_IEEE 0 VBU0513_CM_single_Kw -3.4028234663852886E+38 3.4028234663852886E+38 /end CHARACTERISTIC
/begin CHARACTERISTIC CcVCT_BMSDischgPowerLimitLTIORV_Kw "" VALUE 0x70010b88 Scalar_FLOAT32_IEEE 0 VBU0513_CM_single_Kw -3.4028234663852886E+38 3.4028234663852886E+38 /end CHARACTERISTIC
/begin CHARACTERISTIC CcVCT_BMSDischgPowerLimitSTORV_Kw "" VALUE 0x70010b8c Scalar_FLOAT32_IEEE 0 VBU0513_CM_single_Kw -3.4028234663852886E+38 3.4028234663852886E+38 /end CHARACTERISTIC
/begin CHARACTERISTIC CcVCT_BMSEstimateChargingTimeORV_min "" VALUE 0x70010b90 Scalar_FLOAT32_IEEE 0 VBU0513_CM_single_min -3.4028234663852886E+38 3.4028234663852886E+38 /end CHARACTERISTIC
/begin CHARACTERISTIC CcVCT_BMSInletTempRequestORV_C "" VALUE 0x70010b94 Scalar_FLOAT32_IEEE 0 VBU0513_CM_single_cnt -3.4028234663852886E+38 3.4028234663852886E+38 /end CHARACTERISTIC
/begin CHARACTERISTIC CcVCT_BMSInletWaterTempORV_C "" VALUE 0x70010b98 Scalar_FLOAT32_IEEE 0 VBU0513_CM_single_cnt -3.4028234663852886E+38 3.4028234663852886E+38 /end CHARACTERISTIC
/begin CHARACTERISTIC CcVCT_BMSInsulationResistanceValueORV_Kohm "" VALUE 0x70010b9c Scalar_FLOAT32_IEEE 0 VBU0513_CM_single_Kohm -3.4028234663852886E+38 3.4028234663852886E+38 /end CHARACTERISTIC
/begin CHARACTERISTIC CcVCT_BMSMaxPermitDCChargeVoltageORV_V "" VALUE 0x70010ba0 Scalar_FLOAT32_IEEE 0 VBU0513_CM_single_V -3.4028234663852886E+38 3.4028234663852886E+38 /end CHARACTERISTIC
/begin CHARACTERISTIC CcVCT_BMSMaximumCellTempORV_C "" VALUE 0x70010ba4 Scalar_FLOAT32_IEEE 0 VBU0513_CM_single_cnt -3.4028234663852886E+38 3.4028234663852886E+38 /end CHARACTERISTIC
/begin CHARACTERISTIC CcVCT_BMSMinimumCellTempORV_C "" VALUE 0x70010ba8 Scalar_FLOAT32_IEEE 0 VBU0513_CM_single_cnt -3.4028234663852886E+38 3.4028234663852886E+38 /end CHARACTERISTIC
/begin CHARACTERISTIC CcVCT_BMSOutletWaterTempORV_C "" VALUE 0x70010bac Scalar_FLOAT32_IEEE 0 VBU0513_CM_single_cnt -3.4028234663852886E+38 3.4028234663852886E+38 /end CHARACTERISTIC
/begin CHARACTERISTIC CcVCT_BMSPackCrntORV_A "" VALUE 0x70010bb0 Scalar_FLOAT32_IEEE 0 VBU0513_CM_single_A -3.4028234663852886E+38 3.4028234663852886E+38 /end CHARACTERISTIC
/begin CHARACTERISTIC CcVCT_BMSPackEnergyAvailableORV_Kwh "" VALUE 0x70010bb4 Scalar_FLOAT32_IEEE 0 VBU0513_CM_single_Kwh -3.4028234663852886E+38 3.4028234663852886E+38 /end CHARACTERISTIC
/begin CHARACTERISTIC CcVCT_BMSPackVoltageORV_V "" VALUE 0x70010bb8 Scalar_FLOAT32_IEEE 0 VBU0513_CM_single_V -3.4028234663852886E+38 3.4028234663852886E+38 /end CHARACTERISTIC
/begin CHARACTERISTIC CcVCT_BMSSOCORV_pct "" VALUE 0x70010bc4 Scalar_FLOAT32_IEEE 0 VBU0513_CM_single_pct -3.4028234663852886E+38 3.4028234663852886E+38 /end CHARACTERISTIC
/begin CHARACTERISTIC CcVCT_BMSTemperatureAverageORV_C "" VALUE 0x70010bc8 Scalar_FLOAT32_IEEE 0 VBU0513_CM_single_cnt -3.4028234663852886E+38 3.4028234663852886E+38 /end CHARACTERISTIC
/begin CHARACTERISTIC CcVCT_BMSTemperatureMaxORV_C "" VALUE 0x70010bcc Scalar_FLOAT32_IEEE 0 VBU0513_CM_single_cnt -3.4028234663852886E+38 3.4028234663852886E+38 /end CHARACTERISTIC
/begin CHARACTERISTIC CcVCT_BMSTemperatureMinORF_flg "" VALUE 0x70010bd0 Scalar_FLOAT32_IEEE 0 VBU0513_CM_single_flg -3.4028234663852886E+38 3.4028234663852886E+38 /end CHARACTERISTIC
/begin CHARACTERISTIC CcVCT_BMSTemperatureMinORV_C "" VALUE 0x70010bd4 Scalar_FLOAT32_IEEE 0 VBU0513_CM_single_cnt -3.4028234663852886E+38 3.4028234663852886E+38 /end CHARACTERISTIC
/begin CHARACTERISTIC CcVCT_BMSVoltageLimitMaxORV_V "" VALUE 0x70010bd8 Scalar_FLOAT32_IEEE 0 VBU0513_CM_single_V -3.4028234663852886E+38 3.4028234663852886E+38 /end CHARACTERISTIC
/begin CHARACTERISTIC CcVCT_BMSVoltageLimitMinORV_V "" VALUE 0x70010bdc Scalar_FLOAT32_IEEE 0 VBU0513_CM_single_V -3.4028234663852886E+38 3.4028234663852886E+38 /end CHARACTERISTIC
/begin CHARACTERISTIC CcVCT_BatteryNomalCapacityORV_Kwh "" VALUE 0x70010be0 Scalar_FLOAT32_IEEE 0 VBU0513_CM_single_Kwh -3.4028234663852886E+38 3.4028234663852886E+38 /end CHARACTERISTIC
/begin CHARACTERISTIC CcVCT_EstimatePercTimeORV_min "" VALUE 0x70010bf0 Scalar_FLOAT32_IEEE 0 VBU0513_CM_single_min -3.4028234663852886E+38 3.4028234663852886E+38 /end CHARACTERISTIC
/begin CHARACTERISTIC CcVCT_HVBattStopDchaThdORV_pct "" VALUE 0x70010bf4 Scalar_FLOAT32_IEEE 0 VBU0513_CM_single_pct -3.4028234663852886E+38 3.4028234663852886E+38 /end CHARACTERISTIC
/begin CHARACTERISTIC CcVCT_MaximumChargingCurrentORV_A "" VALUE 0x70010bf8 Scalar_FLOAT32_IEEE 0 VBU0513_CM_single_A -3.4028234663852886E+38 3.4028234663852886E+38 /end CHARACTERISTIC
/begin CHARACTERISTIC CcVCT_MaximumChargingVoltageORV_V "" VALUE 0x70010bfc Scalar_FLOAT32_IEEE 0 VBU0513_CM_single_V -3.4028234663852886E+38 3.4028234663852886E+38 /end CHARACTERISTIC
/begin CHARACTERISTIC CcVCT_MaximumPermitChargeCellVoltageORV_V "" VALUE 0x70010c00 Scalar_FLOAT32_IEEE 0 VBU0513_CM_single_V -3.4028234663852886E+38 3.4028234663852886E+38 /end CHARACTERISTIC
/begin CHARACTERISTIC CcVCT_MaximumPermitTempORV_C "" VALUE 0x70010c04 Scalar_FLOAT32_IEEE 0 VBU0513_CM_single_cnt -3.4028234663852886E+38 3.4028234663852886E+38 /end CHARACTERISTIC
/begin CHARACTERISTIC DCDC_flgDeritingOvrdVal_C "" VALUE 0x70010c20 Scalar_FLOAT32_IEEE 0 VBU0513_CM_single 0.0 1.0 /end CHARACTERISTIC
/begin CHARACTERISTIC DCDC_flgEnaFdbkOvrdVal_C "" VALUE 0x70010c24 Scalar_FLOAT32_IEEE 0 VBU0513_CM_single 0.0 1.0 /end CHARACTERISTIC
/begin CHARACTERISTIC DCDC_flgFlgDeritingOvrd_C "" VALUE 0x70010c28 Scalar_FLOAT32_IEEE 0 VBU0513_CM_single 0.0 1.0 /end CHARACTERISTIC
/begin CHARACTERISTIC DCDC_flgFlgEnaFdbkOvrd_C "" VALUE 0x70010c2c Scalar_FLOAT32_IEEE 0 VBU0513_CM_single 0.0 1.0 /end CHARACTERISTIC
/begin CHARACTERISTIC DCDC_flgFlgOvrHeatOvrd_C "" VALUE 0x70010c30 Scalar_FLOAT32_IEEE 0 VBU0513_CM_single 0.0 1.0 /end CHARACTERISTIC
/begin CHARACTERISTIC DCDC_flgFlgOvrInCurrOvrd_C "" VALUE 0x70010c34 Scalar_FLOAT32_IEEE 0 VBU0513_CM_single 0.0 1.0 /end CHARACTERISTIC
/begin CHARACTERISTIC DCDC_flgFlgOvrInVltgOvrd_C "" VALUE 0x70010c38 Scalar_FLOAT32_IEEE 0 VBU0513_CM_single 0.0 1.0 /end CHARACTERISTIC
/begin CHARACTERISTIC DCDC_flgFlgOvrOutCurrOvrd_C "" VALUE 0x70010c3c Scalar_FLOAT32_IEEE 0 VBU0513_CM_single 0.0 1.0 /end CHARACTERISTIC
/begin CHARACTERISTIC DCDC_flgFlgOvrOutVltgOvrd_C "" VALUE 0x70010c40 Scalar_FLOAT32_IEEE 0 VBU0513_CM_single 0.0 1.0 /end CHARACTERISTIC
/begin CHARACTERISTIC DCDC_flgFlgUndrInVltgOvrd_C "" VALUE 0x70010c44 Scalar_FLOAT32_IEEE 0 VBU0513_CM_single 0.0 1.0 /end CHARACTERISTIC
/begin CHARACTERISTIC DCDC_flgFlgUndrOutVltgOvrd_C "" VALUE 0x70010c48 Scalar_FLOAT32_IEEE 0 VBU0513_CM_single 0.0 1.0 /end CHARACTERISTIC
/begin CHARACTERISTIC DCDC_flgIInputCurrOvrd_C "" VALUE 0x70010c4c Scalar_FLOAT32_IEEE 0 VBU0513_CM_single 0.0 1.0 /end CHARACTERISTIC
/begin CHARACTERISTIC DCDC_flgIOutputCurrOvrd_C "" VALUE 0x70010c50 Scalar_FLOAT32_IEEE 0 VBU0513_CM_single 0.0 1.0 /end CHARACTERISTIC
/begin CHARACTERISTIC DCDC_flgOvrHeatOvrdVal_C "" VALUE 0x70010c54 Scalar_FLOAT32_IEEE 0 VBU0513_CM_single 0.0 1.0 /end CHARACTERISTIC
/begin CHARACTERISTIC DCDC_flgOvrInCurrOvrdVal_C "" VALUE 0x70010c58 Scalar_FLOAT32_IEEE 0 VBU0513_CM_single 0.0 1.0 /end CHARACTERISTIC
/begin CHARACTERISTIC DCDC_flgOvrInVltgOvrdVal_C "" VALUE 0x70010c5c Scalar_FLOAT32_IEEE 0 VBU0513_CM_single 0.0 1.0 /end CHARACTERISTIC
/begin CHARACTERISTIC DCDC_flgOvrOutCurrOvrdVal_C "" VALUE 0x70010c60 Scalar_FLOAT32_IEEE 0 VBU0513_CM_single 0.0 1.0 /end CHARACTERISTIC
/begin CHARACTERISTIC DCDC_flgOvrOutVltgOvrdVal_C "" VALUE 0x70010c64 Scalar_FLOAT32_IEEE 0 VBU0513_CM_single 0.0 1.0 /end CHARACTERISTIC
/begin CHARACTERISTIC DCDC_flgStStatusOvrd_C "" VALUE 0x70010c68 Scalar_FLOAT32_IEEE 0 VBU0513_CM_single 0.0 1.0 /end CHARACTERISTIC
/begin CHARACTERISTIC DCDC_flgTTempOvrd_C "" VALUE 0x70010c6c Scalar_FLOAT32_IEEE 0 VBU0513_CM_single 0.0 1.0 /end CHARACTERISTIC
/begin CHARACTERISTIC DCDC_flgUInputVltgOvrd_C "" VALUE 0x70010c70 Scalar_FLOAT32_IEEE 0 VBU0513_CM_single 0.0 1.0 /end CHARACTERISTIC
/begin CHARACTERISTIC DCDC_flgUOutputVltgOvrd_C "" VALUE 0x70010c74 Scalar_FLOAT32_IEEE 0 VBU0513_CM_single 0.0 1.0 /end CHARACTERISTIC
/begin CHARACTERISTIC DCDC_flgUndrInVltgOvrdVal_C "" VALUE 0x70010c78 Scalar_FLOAT32_IEEE 0 VBU0513_CM_single 0.0 1.0 /end CHARACTERISTIC
/begin CHARACTERISTIC DCDC_flgUndrOutVltgOvrdVal_C "" VALUE 0x70010c7c Scalar_FLOAT32_IEEE 0 VBU0513_CM_single 0.0 1.0 /end CHARACTERISTIC
/begin CHARACTERISTIC DCDC_iInputCurrOvrdVal_C "" VALUE 0x70010c80 Scalar_FLOAT32_IEEE 0 VBU0513_CM_single -3.40282346638528E+38 3.40282346638528E+38 /end CHARACTERISTIC
/begin CHARACTERISTIC DCDC_iOutputCurrOvrdVal_C "" VALUE 0x70010c84 Scalar_FLOAT32_IEEE 0 VBU0513_CM_single -3.40282346638528E+38 3.40282346638528E+38 /end CHARACTERISTIC
/begin CHARACTERISTIC DCDC_stStatusOvrdVal_C "" VALUE 0x70010c88 Scalar_FLOAT32_IEEE 0 VBU0513_CM_single 0.0 255.0 /end CHARACTERISTIC
/begin CHARACTERISTIC DCDC_tTempOvrdVal_C "" VALUE 0x70010c8c Scalar_FLOAT32_IEEE 0 VBU0513_CM_single -3.40282346638528E+38 3.40282346638528E+38 /end CHARACTERISTIC
/begin CHARACTERISTIC DCDC_uInputVltgOvrdVal_C "" VALUE 0x70010c90 Scalar_FLOAT32_IEEE 0 VBU0513_CM_single -3.40282346638528E+38 3.40282346638528E+38 /end CHARACTERISTIC
/begin CHARACTERISTIC DCDC_uOutputVltgOvrdVal_C "" VALUE 0x70010c94 Scalar_FLOAT32_IEEE 0 VBU0513_CM_single -3.40282346638528E+38 3.40282346638528E+38 /end CHARACTERISTIC
/begin CHARACTERISTIC EPB_flgFlgIGNOvrd_C "" VALUE 0x700111e0 Scalar_FLOAT32_IEEE 0 VBU0513_CM_single 0.0 1.0 /end CHARACTERISTIC
/begin CHARACTERISTIC EPB_flgFlgShutDownOvrd_C "" VALUE 0x700111e4 Scalar_FLOAT32_IEEE 0 VBU0513_CM_single 0.0 1.0 /end CHARACTERISTIC
/begin CHARACTERISTIC EPB_flgFrDragForceOvrd_C "" VALUE 0x700111e8 Scalar_FLOAT32_IEEE 0 VBU0513_CM_single 0.0 1.0 /end CHARACTERISTIC
/begin CHARACTERISTIC EPB_flgIGNOvrdVal_C "" VALUE 0x700111ec Scalar_FLOAT32_IEEE 0 VBU0513_CM_single 0.0 1.0 /end CHARACTERISTIC
/begin CHARACTERISTIC EPB_flgShutDownOvrdVal_C "" VALUE 0x700111f0 Scalar_FLOAT32_IEEE 0 VBU0513_CM_single 0.0 1.0 /end CHARACTERISTIC
/begin CHARACTERISTIC EPB_flgStCtlModeOvrd_C "" VALUE 0x700111f4 Scalar_FLOAT32_IEEE 0 VBU0513_CM_single 0.0 1.0 /end CHARACTERISTIC
/begin CHARACTERISTIC EPB_flgStFaultLevelOvrd_C "" VALUE 0x700111f8 Scalar_FLOAT32_IEEE 0 VBU0513_CM_single 0.0 1.0 /end CHARACTERISTIC
/begin CHARACTERISTIC EPB_flgStParkLampOvrd_C "" VALUE 0x700111fc Scalar_FLOAT32_IEEE 0 VBU0513_CM_single 0.0 1.0 /end CHARACTERISTIC
/begin CHARACTERISTIC EPB_flgStStateOvrd_C "" VALUE 0x70011200 Scalar_FLOAT32_IEEE 0 VBU0513_CM_single 0.0 1.0 /end CHARACTERISTIC
/begin CHARACTERISTIC EPB_flgStSwitchFaultOvrd_C "" VALUE 0x70011204 Scalar_FLOAT32_IEEE 0 VBU0513_CM_single 0.0 1.0 /end CHARACTERISTIC
/begin CHARACTERISTIC EPB_flgStSwitchOvrd_C "" VALUE 0x70011208 Scalar_FLOAT32_IEEE 0 VBU0513_CM_single 0.0 1.0 /end CHARACTERISTIC
/begin CHARACTERISTIC EPB_frDragForceOvrdVal_C "" VALUE 0x7001120c Scalar_FLOAT32_IEEE 0 VBU0513_CM_single -3.40282346638528E+38 3.40282346638528E+38 /end CHARACTERISTIC
/begin CHARACTERISTIC EPB_stCtlModeOvrdVal_C "" VALUE 0x70011210 Scalar_FLOAT32_IEEE 0 VBU0513_CM_single 0.0 255.0 /end CHARACTERISTIC
/begin CHARACTERISTIC EPB_stFaultLevelOvrdVal_C "" VALUE 0x70011214 Scalar_FLOAT32_IEEE 0 VBU0513_CM_single 0.0 255.0 /end CHARACTERISTIC
/begin CHARACTERISTIC EPB_stParkLampOvrdVal_C "" VALUE 0x70011218 Scalar_FLOAT32_IEEE 0 VBU0513_CM_single 0.0 255.0 /end CHARACTERISTIC
/begin CHARACTERISTIC EPB_stStateOvrdVal_C "" VALUE 0x7001121c Scalar_FLOAT32_IEEE 0 VBU0513_CM_single 0.0 255.0 /end CHARACTERISTIC
/begin CHARACTERISTIC EPB_stSwitchFaultOvrdVal_C "" VALUE 0x70011220 Scalar_FLOAT32_IEEE 0 VBU0513_CM_single 0.0 255.0 /end CHARACTERISTIC
/begin CHARACTERISTIC EPB_stSwitchOvrdVal_C "" VALUE 0x70011224 Scalar_FLOAT32_IEEE 0 VBU0513_CM_single 0.0 255.0 /end CHARACTERISTIC
/begin CHARACTERISTIC EPS_cntECUMsgCntOvrdVal_C "" VALUE 0x7001122c Scalar_FLOAT32_IEEE 0 VBU0513_CM_single 0.0 4.294967295E+9 /end CHARACTERISTIC
/begin CHARACTERISTIC EPS_degStrngAgSpdOvrdVal_C "" VALUE 0x70011230 Scalar_FLOAT32_IEEE 0 VBU0513_CM_single -3.40282346638528E+38 3.40282346638528E+38 /end CHARACTERISTIC
/begin CHARACTERISTIC EPS_flgCntECUMsgCntOvrd_C "" VALUE 0x70011234 Scalar_FLOAT32_IEEE 0 VBU0513_CM_single 0.0 1.0 /end CHARACTERISTIC
/begin CHARACTERISTIC EPS_flgDegStrngAgSpdOvrd_C "" VALUE 0x70011238 Scalar_FLOAT32_IEEE 0 VBU0513_CM_single 0.0 1.0 /end CHARACTERISTIC
/begin CHARACTERISTIC EPS_flgPhiStrngAgOvrd_C "" VALUE 0x7001123c Scalar_FLOAT32_IEEE 0 VBU0513_CM_single 0.0 1.0 /end CHARACTERISTIC
/begin CHARACTERISTIC EPS_flgStECUModeCntOvrd_C "" VALUE 0x70011240 Scalar_FLOAT32_IEEE 0 VBU0513_CM_single 0.0 1.0 /end CHARACTERISTIC
/begin CHARACTERISTIC EPS_flgTrqTrqMotrOvrd_C "" VALUE 0x70011244 Scalar_FLOAT32_IEEE 0 VBU0513_CM_single 0.0 1.0 /end CHARACTERISTIC
/begin CHARACTERISTIC EPS_flgTrqTrqStrngOvrd_C "" VALUE 0x70011248 Scalar_FLOAT32_IEEE 0 VBU0513_CM_single 0.0 1.0 /end CHARACTERISTIC
/begin CHARACTERISTIC EPS_phiStrngAgOvrdVal_C "" VALUE 0x7001124c Scalar_FLOAT32_IEEE 0 VBU0513_CM_single -3.40282346638528E+38 3.40282346638528E+38 /end CHARACTERISTIC
/begin CHARACTERISTIC EPS_stECUModeCntOvrdVal_C "" VALUE 0x70011250 Scalar_FLOAT32_IEEE 0 VBU0513_CM_single 0.0 255.0 /end CHARACTERISTIC
/begin CHARACTERISTIC EPS_trqTrqMotrOvrdVal_C "" VALUE 0x70011254 Scalar_FLOAT32_IEEE 0 VBU0513_CM_single -3.40282346638528E+38 3.40282346638528E+38 /end CHARACTERISTIC
/begin CHARACTERISTIC EPS_trqTrqStrngOvrdVal_C "" VALUE 0x70011258 Scalar_FLOAT32_IEEE 0 VBU0513_CM_single -3.40282346638528E+38 3.40282346638528E+38 /end CHARACTERISTIC
/begin CHARACTERISTIC IC_flgBrkDisWarnOvrdVal_C "" VALUE 0x700112e4 Scalar_FLOAT32_IEEE 0 VBU0513_CM_single 0.0 1.0 /end CHARACTERISTIC
/begin CHARACTERISTIC IC_flgBrkFluidWarnOvrdVal_C "" VALUE 0x700112e8 Scalar_FLOAT32_IEEE 0 VBU0513_CM_single 0.0 1.0 /end CHARACTERISTIC
/begin CHARACTERISTIC IC_flgFlgBrkDisWarnOvrd_C "" VALUE 0x700112ec Scalar_FLOAT32_IEEE 0 VBU0513_CM_single 0.0 1.0 /end CHARACTERISTIC
/begin CHARACTERISTIC IC_flgFlgBrkFluidWarnOvrd_C "" VALUE 0x700112f0 Scalar_FLOAT32_IEEE 0 VBU0513_CM_single 0.0 1.0 /end CHARACTERISTIC
/begin CHARACTERISTIC IC_flgFlgSeatbeltUnlockOvrd_C "" VALUE 0x700112f4 Scalar_FLOAT32_IEEE 0 VBU0513_CM_single 0.0 1.0 /end CHARACTERISTIC
/begin CHARACTERISTIC IC_flgKmVehOdmeterOvrd_C "" VALUE 0x700112f8 Scalar_FLOAT32_IEEE 0 VBU0513_CM_single 0.0 1.0 /end CHARACTERISTIC
/begin CHARACTERISTIC IC_flgSeatbeltUnlockOvrdVal_C "" VALUE 0x700112fc Scalar_FLOAT32_IEEE 0 VBU0513_CM_single 0.0 1.0 /end CHARACTERISTIC
/begin CHARACTERISTIC IC_kmVehOdmeterOvrdVal_C "" VALUE 0x70011300 Scalar_FLOAT32_IEEE 0 VBU0513_CM_single -3.40282346638528E+38 3.40282346638528E+38 /end CHARACTERISTIC
/begin CHARACTERISTIC PEUR_flgBusOvrVltgOvrdVal_C "" VALUE 0x70011424 Scalar_FLOAT32_IEEE 0 VBU0513_CM_single 0.0 1.0 /end CHARACTERISTIC
/begin CHARACTERISTIC PEUR_flgBusUndrVltgOvrdVal_C "" VALUE 0x70011428 Scalar_FLOAT32_IEEE 0 VBU0513_CM_single 0.0 1.0 /end CHARACTERISTIC
/begin CHARACTERISTIC PEUR_flgCANFaultOvrdVal_C "" VALUE 0x7001142c Scalar_FLOAT32_IEEE 0 VBU0513_CM_single 0.0 1.0 /end CHARACTERISTIC
/begin CHARACTERISTIC PEUR_flgDrvDownarmFailOvrdVal_C "" VALUE 0x70011430 Scalar_FLOAT32_IEEE 0 VBU0513_CM_single 0.0 1.0 /end CHARACTERISTIC
/begin CHARACTERISTIC PEUR_flgDrvUparmFailOvrdVal_C "" VALUE 0x70011434 Scalar_FLOAT32_IEEE 0 VBU0513_CM_single 0.0 1.0 /end CHARACTERISTIC
/begin CHARACTERISTIC PEUR_flgFlgBusOvrVltgOvrd_C "" VALUE 0x70011438 Scalar_FLOAT32_IEEE 0 VBU0513_CM_single 0.0 1.0 /end CHARACTERISTIC
/begin CHARACTERISTIC PEUR_flgFlgBusUndrVltgOvrd_C "" VALUE 0x7001143c Scalar_FLOAT32_IEEE 0 VBU0513_CM_single 0.0 1.0 /end CHARACTERISTIC
/begin CHARACTERISTIC PEUR_flgFlgCANFaultOvrd_C "" VALUE 0x70011440 Scalar_FLOAT32_IEEE 0 VBU0513_CM_single 0.0 1.0 /end CHARACTERISTIC
/begin CHARACTERISTIC PEUR_flgFlgDrvDownarmFailOvrd_C "" VALUE 0x70011444 Scalar_FLOAT32_IEEE 0 VBU0513_CM_single 0.0 1.0 /end CHARACTERISTIC
/begin CHARACTERISTIC PEUR_flgFlgDrvUparmFailOvrd_C "" VALUE 0x70011448 Scalar_FLOAT32_IEEE 0 VBU0513_CM_single 0.0 1.0 /end CHARACTERISTIC
/begin CHARACTERISTIC PEUR_flgFlgHWUnderVoltOvrd_C "" VALUE 0x7001144c Scalar_FLOAT32_IEEE 0 VBU0513_CM_single 0.0 1.0 /end CHARACTERISTIC
/begin CHARACTERISTIC PEUR_flgFlgHallFaultOvrd_C "" VALUE 0x70011450 Scalar_FLOAT32_IEEE 0 VBU0513_CM_single 0.0 1.0 /end CHARACTERISTIC
/begin CHARACTERISTIC PEUR_flgFlgHwOvrVloltOvrd_C "" VALUE 0x70011454 Scalar_FLOAT32_IEEE 0 VBU0513_CM_single 0.0 1.0 /end CHARACTERISTIC
/begin CHARACTERISTIC PEUR_flgFlgIGBTFaultOvrd_C "" VALUE 0x70011458 Scalar_FLOAT32_IEEE 0 VBU0513_CM_single 0.0 1.0 /end CHARACTERISTIC
/begin CHARACTERISTIC PEUR_flgFlgIGBTJunctionOvrTempLimOvrd_C "" VALUE 0x7001145c Scalar_FLOAT32_IEEE 0 VBU0513_CM_single 0.0 1.0 /end CHARACTERISTIC
/begin CHARACTERISTIC PEUR_flgFlgIGBTNTCOvrTempLimOvrd_C "" VALUE 0x70011460 Scalar_FLOAT32_IEEE 0 VBU0513_CM_single 0.0 1.0 /end CHARACTERISTIC
/begin CHARACTERISTIC PEUR_flgFlgIGBTOvrHeatOvrd_C "" VALUE 0x70011464 Scalar_FLOAT32_IEEE 0 VBU0513_CM_single 0.0 1.0 /end CHARACTERISTIC
/begin CHARACTERISTIC PEUR_flgFlgMotrHillHldOvrd_C "" VALUE 0x70011468 Scalar_FLOAT32_IEEE 0 VBU0513_CM_single 0.0 1.0 /end CHARACTERISTIC
/begin CHARACTERISTIC PEUR_flgFlgMotrOvrHeatOvrd_C "" VALUE 0x7001146c Scalar_FLOAT32_IEEE 0 VBU0513_CM_single 0.0 1.0 /end CHARACTERISTIC
/begin CHARACTERISTIC PEUR_flgFlgMotrOvrTempLimOvrd_C "" VALUE 0x70011470 Scalar_FLOAT32_IEEE 0 VBU0513_CM_single 0.0 1.0 /end CHARACTERISTIC
/begin CHARACTERISTIC PEUR_flgFlgMotrSpdVldOvrd_C "" VALUE 0x70011474 Scalar_FLOAT32_IEEE 0 VBU0513_CM_single 0.0 1.0 /end CHARACTERISTIC
/begin CHARACTERISTIC PEUR_flgFlgOutputPhaseFaultOvrd_C "" VALUE 0x70011478 Scalar_FLOAT32_IEEE 0 VBU0513_CM_single 0.0 1.0 /end CHARACTERISTIC
/begin CHARACTERISTIC PEUR_flgFlgOvrCurrOvrd_C "" VALUE 0x7001147c Scalar_FLOAT32_IEEE 0 VBU0513_CM_single 0.0 1.0 /end CHARACTERISTIC
/begin CHARACTERISTIC PEUR_flgFlgOvrSpdOvrd_C "" VALUE 0x70011480 Scalar_FLOAT32_IEEE 0 VBU0513_CM_single 0.0 1.0 /end CHARACTERISTIC
/begin CHARACTERISTIC PEUR_flgFlgRadiatorOvrTempLimOvrd_C "" VALUE 0x70011484 Scalar_FLOAT32_IEEE 0 VBU0513_CM_single 0.0 1.0 /end CHARACTERISTIC
/begin CHARACTERISTIC PEUR_flgFlgResolverFaultOvrd_C "" VALUE 0x70011488 Scalar_FLOAT32_IEEE 0 VBU0513_CM_single 0.0 1.0 /end CHARACTERISTIC
/begin CHARACTERISTIC PEUR_flgHWUnderVoltOvrdVal_C "" VALUE 0x7001148c Scalar_FLOAT32_IEEE 0 VBU0513_CM_single 0.0 1.0 /end CHARACTERISTIC
/begin CHARACTERISTIC PEUR_flgHallFaultOvrdVal_C "" VALUE 0x70011490 Scalar_FLOAT32_IEEE 0 VBU0513_CM_single 0.0 1.0 /end CHARACTERISTIC
/begin CHARACTERISTIC PEUR_flgHwOvrVloltOvrdVal_C "" VALUE 0x70011494 Scalar_FLOAT32_IEEE 0 VBU0513_CM_single 0.0 1.0 /end CHARACTERISTIC
/begin CHARACTERISTIC PEUR_flgICalcDCOvrd_C "" VALUE 0x70011498 Scalar_FLOAT32_IEEE 0 VBU0513_CM_single 0.0 1.0 /end CHARACTERISTIC
/begin CHARACTERISTIC PEUR_flgIGBTFaultOvrdVal_C "" VALUE 0x7001149c Scalar_FLOAT32_IEEE 0 VBU0513_CM_single 0.0 1.0 /end CHARACTERISTIC
/begin CHARACTERISTIC PEUR_flgIGBTJunctionOvrTempLimOvrdVal_C "" VALUE 0x700114a0 Scalar_FLOAT32_IEEE 0 VBU0513_CM_single 0.0 1.0 /end CHARACTERISTIC
/begin CHARACTERISTIC PEUR_flgIGBTNTCOvrTempLimOvrdVal_C "" VALUE 0x700114a4 Scalar_FLOAT32_IEEE 0 VBU0513_CM_single 0.0 1.0 /end CHARACTERISTIC
/begin CHARACTERISTIC PEUR_flgIGBTOvrHeatOvrdVal_C "" VALUE 0x700114a8 Scalar_FLOAT32_IEEE 0 VBU0513_CM_single 0.0 1.0 /end CHARACTERISTIC
/begin CHARACTERISTIC PEUR_flgIUVWMaxCurrOvrd_C "" VALUE 0x700114ac Scalar_FLOAT32_IEEE 0 VBU0513_CM_single 0.0 1.0 /end CHARACTERISTIC
/begin CHARACTERISTIC PEUR_flgMotrHillHldOvrdVal_C "" VALUE 0x700114b0 Scalar_FLOAT32_IEEE 0 VBU0513_CM_single 0.0 1.0 /end CHARACTERISTIC
/begin CHARACTERISTIC PEUR_flgMotrOvrHeatOvrdVal_C "" VALUE 0x700114b4 Scalar_FLOAT32_IEEE 0 VBU0513_CM_single 0.0 1.0 /end CHARACTERISTIC
/begin CHARACTERISTIC PEUR_flgMotrOvrTempLimOvrdVal_C "" VALUE 0x700114b8 Scalar_FLOAT32_IEEE 0 VBU0513_CM_single 0.0 1.0 /end CHARACTERISTIC
/begin CHARACTERISTIC PEUR_flgMotrSpdVldOvrdVal_C "" VALUE 0x700114bc Scalar_FLOAT32_IEEE 0 VBU0513_CM_single 0.0 1.0 /end CHARACTERISTIC
/begin CHARACTERISTIC PEUR_flgNMotrOvrd_C "" VALUE 0x700114c0 Scalar_FLOAT32_IEEE 0 VBU0513_CM_single 0.0 1.0 /end CHARACTERISTIC
/begin CHARACTERISTIC PEUR_flgOutputPhaseFaultOvrdVal_C "" VALUE 0x700114c4 Scalar_FLOAT32_IEEE 0 VBU0513_CM_single 0.0 1.0 /end CHARACTERISTIC
/begin CHARACTERISTIC PEUR_flgOvrCurrOvrdVal_C "" VALUE 0x700114c8 Scalar_FLOAT32_IEEE 0 VBU0513_CM_single 0.0 1.0 /end CHARACTERISTIC
/begin CHARACTERISTIC PEUR_flgOvrSpdOvrdVal_C "" VALUE 0x700114cc Scalar_FLOAT32_IEEE 0 VBU0513_CM_single 0.0 1.0 /end CHARACTERISTIC
/begin CHARACTERISTIC PEUR_flgRadiatorOvrTempLimOvrdVal_C "" VALUE 0x700114d0 Scalar_FLOAT32_IEEE 0 VBU0513_CM_single 0.0 1.0 /end CHARACTERISTIC
/begin CHARACTERISTIC PEUR_flgResolverFaultOvrdVal_C "" VALUE 0x700114d4 Scalar_FLOAT32_IEEE 0 VBU0513_CM_single 0.0 1.0 /end CHARACTERISTIC
/begin CHARACTERISTIC PEUR_flgStActvDisChOvrd_C "" VALUE 0x700114d8 Scalar_FLOAT32_IEEE 0 VBU0513_CM_single 0.0 1.0 /end CHARACTERISTIC
/begin CHARACTERISTIC PEUR_flgStFaultOvrd_C "" VALUE 0x700114dc Scalar_FLOAT32_IEEE 0 VBU0513_CM_single 0.0 1.0 /end CHARACTERISTIC
/begin CHARACTERISTIC PEUR_flgStInvrOvrd_C "" VALUE 0x700114e0 Scalar_FLOAT32_IEEE 0 VBU0513_CM_single 0.0 1.0 /end CHARACTERISTIC
/begin CHARACTERISTIC PEUR_flgTIPMTempOvrd_C "" VALUE 0x700114e4 Scalar_FLOAT32_IEEE 0 VBU0513_CM_single 0.0 1.0 /end CHARACTERISTIC
/begin CHARACTERISTIC PEUR_flgTMeasMaxPhUVWOvrd_C "" VALUE 0x700114e8 Scalar_FLOAT32_IEEE 0 VBU0513_CM_single 0.0 1.0 /end CHARACTERISTIC
/begin CHARACTERISTIC PEUR_flgTMeasMaxStrOvrd_C "" VALUE 0x700114ec Scalar_FLOAT32_IEEE 0 VBU0513_CM_single 0.0 1.0 /end CHARACTERISTIC
/begin CHARACTERISTIC PEUR_flgTrqActOvrd_C "" VALUE 0x700114f0 Scalar_FLOAT32_IEEE 0 VBU0513_CM_single 0.0 1.0 /end CHARACTERISTIC
/begin CHARACTERISTIC PEUR_flgTrqMaxLimitOvrd_C "" VALUE 0x700114f4 Scalar_FLOAT32_IEEE 0 VBU0513_CM_single 0.0 1.0 /end CHARACTERISTIC
/begin CHARACTERISTIC PEUR_flgUDCRlyOutsideVltgOvrd_C "" VALUE 0x700114f8 Scalar_FLOAT32_IEEE 0 VBU0513_CM_single 0.0 1.0 /end CHARACTERISTIC
/begin CHARACTERISTIC PEUR_flgUMeasDCOvrd_C "" VALUE 0x700114fc Scalar_FLOAT32_IEEE 0 VBU0513_CM_single 0.0 1.0 /end CHARACTERISTIC
/begin CHARACTERISTIC PEUR_iCalcDCOvrdVal_C "" VALUE 0x70011500 Scalar_FLOAT32_IEEE 0 VBU0513_CM_single -3.40282346638528E+38 3.40282346638528E+38 /end CHARACTERISTIC
/begin CHARACTERISTIC PEUR_iUVWMaxCurrOvrdVal_C "" VALUE 0x70011504 Scalar_FLOAT32_IEEE 0 VBU0513_CM_single -3.40282346638528E+38 3.40282346638528E+38 /end CHARACTERISTIC
/begin CHARACTERISTIC PEUR_nMotrOvrdVal_C "" VALUE 0x70011508 Scalar_FLOAT32_IEEE 0 VBU0513_CM_single -3.40282346638528E+38 3.40282346638528E+38 /end CHARACTERISTIC
/begin CHARACTERISTIC PEUR_stActvDisChOvrdVal_C "" VALUE 0x7001150c Scalar_FLOAT32_IEEE 0 VBU0513_CM_single 0.0 255.0 /end CHARACTERISTIC
/begin CHARACTERISTIC PEUR_stFaultOvrdVal_C "" VALUE 0x70011510 Scalar_FLOAT32_IEEE 0 VBU0513_CM_single 0.0 255.0 /end CHARACTERISTIC
/begin CHARACTERISTIC PEUR_stInvrOvrdVal_C "" VALUE 0x70011514 Scalar_FLOAT32_IEEE 0 VBU0513_CM_single 0.0 255.0 /end CHARACTERISTIC
/begin CHARACTERISTIC PEUR_tIPMTempOvrdVal_C "" VALUE 0x70011518 Scalar_FLOAT32_IEEE 0 VBU0513_CM_single -3.40282346638528E+38 3.40282346638528E+38 /end CHARACTERISTIC
/begin CHARACTERISTIC PEUR_tMeasMaxPhUVWOvrdVal_C "" VALUE 0x7001151c Scalar_FLOAT32_IEEE 0 VBU0513_CM_single -3.40282346638528E+38 3.40282346638528E+38 /end CHARACTERISTIC
/begin CHARACTERISTIC PEUR_tMeasMaxStrOvrdVal_C "" VALUE 0x70011520 Scalar_FLOAT32_IEEE 0 VBU0513_CM_single -3.40282346638528E+38 3.40282346638528E+38 /end CHARACTERISTIC
/begin CHARACTERISTIC PEUR_trqActOvrdVal_C "" VALUE 0x70011524 Scalar_FLOAT32_IEEE 0 VBU0513_CM_single -3.40282346638528E+38 3.40282346638528E+38 /end CHARACTERISTIC
/begin CHARACTERISTIC PEUR_trqMaxLimitOvrdVal_C "" VALUE 0x70011528 Scalar_FLOAT32_IEEE 0 VBU0513_CM_single -3.40282346638528E+38 3.40282346638528E+38 /end CHARACTERISTIC
/begin CHARACTERISTIC PEUR_uDCRlyOutsideVltgOvrdVal_C "" VALUE 0x7001152c Scalar_FLOAT32_IEEE 0 VBU0513_CM_single -3.40282346638528E+38 3.40282346638528E+38 /end CHARACTERISTIC
/begin CHARACTERISTIC PEUR_uMeasDCOvrdVal_C "" VALUE 0x70011530 Scalar_FLOAT32_IEEE 0 VBU0513_CM_single -3.40282346638528E+38 3.40282346638528E+38 /end CHARACTERISTIC
/begin CHARACTERISTIC PUER_flgCPLDStatusOvrdVal_C "" VALUE 0x700115f0 Scalar_FLOAT32_IEEE 0 VBU0513_CM_single 0.0 1.0 /end CHARACTERISTIC
/begin CHARACTERISTIC PUER_flgFlgCPLDStatusOvrd_C "" VALUE 0x700115f4 Scalar_FLOAT32_IEEE 0 VBU0513_CM_single 0.0 1.0 /end CHARACTERISTIC
/begin CHARACTERISTIC CaSOC_OcvSocMapDimension_n "" VAL_BLK 0x70011a2a Scalar_ULONG 0 VBU0513_CM_uint32_cnt 0.0 4.294967295E+9 NUMBER 2 /end CHARACTERISTIC
/begin CHARACTERISTIC CcSOC_BatteryPolarizationMaxTime_ms "" VALUE 0x700107d8 Scalar_ULONG 0 VBU0513_CM_uint32_cnt 0.0 4.294967295E+9 /end CHARACTERISTIC
/begin CHARACTERISTIC CcSOC_CellSOCStorageTime_ms "" VALUE 0x70010834 Scalar_ULONG 0 VBU0513_CM_uint32 0 4294967295 /end CHARACTERISTIC
/begin CHARACTERISTIC CcSOC_FastChargeTOCCurrentTime_ms "" VALUE 0x70010860 Scalar_ULONG 0 VBU0513_CM_uint32 0 4294967295 /end CHARACTERISTIC
/begin CHARACTERISTIC CcSOC_FastChargeTOCVoltageTime_ms "" VALUE 0x7001086c Scalar_ULONG 0 VBU0513_CM_uint32 0 4294967295 /end CHARACTERISTIC
/begin CHARACTERISTIC CcSOF_BatteryCycleLevel1_n "" VALUE 0x700108d0 Scalar_ULONG 0 VBU0513_CM_uint32_cnt 0.0 4.294967295E+9 /end CHARACTERISTIC
/begin CHARACTERISTIC CcSOF_BatteryCycleLevel2_n "" VALUE 0x700108d4 Scalar_ULONG 0 VBU0513_CM_uint32_cnt 0.0 4.294967295E+9 /end CHARACTERISTIC
/begin CHARACTERISTIC CcSOH_CellResistanceIncRatioUpdateTime_s "" VALUE 0x70010a60 Scalar_ULONG 0 VBU0513_CM_uint32_cnt 0.0 4.294967295E+9 /end CHARACTERISTIC
/begin CHARACTERISTIC CcVCT_BMSProtocalVersionORV_n "" VALUE 0x70010bbc Scalar_ULONG 0 VBU0513_CM_uint32_n 0.0 4.294967295E+9 /end CHARACTERISTIC
/begin CHARACTERISTIC CcSOC_CorrectionEnableCellVoltageDeviation_mV "" VALUE 0x700100c0 Scalar_UWORD 0 VBU0513_CM_uint16_cnt 0.0 65535.0 /end CHARACTERISTIC
/begin CHARACTERISTIC CcSOC_OcvCorrectionCVLowThld_mV "" VALUE 0x700100c8 Scalar_UWORD 0 VBU0513_CM_uint16 0 65535 /end CHARACTERISTIC
/begin CHARACTERISTIC CcSOC_OcvCorrectionCVUpThld_mV "" VALUE 0x700100ca Scalar_UWORD 0 VBU0513_CM_uint16 0 65535 /end CHARACTERISTIC
/begin CHARACTERISTIC CcSOC_OneThirdRateDeviationCellVoltage_mV "" VALUE 0x700100d6 Scalar_UWORD 0 VBU0513_CM_uint16_cnt 0.0 65535.0 /end CHARACTERISTIC
/begin CHARACTERISTIC CcSOC_RelaxationDeviationCellVoltage_mV "" VALUE 0x700100d8 Scalar_UWORD 0 VBU0513_CM_uint16_cnt 0.0 65535.0 /end CHARACTERISTIC
/begin CHARACTERISTIC CcSOF_PowerOnDiscOcvSloDelay_ms "" VALUE 0x70010100 Scalar_UWORD 0 VBU0513_CM_uint16_cnt 0.0 65535.0 /end CHARACTERISTIC
/begin CHARACTERISTIC CcSOH_BDMOutputDelayTime_ms "" VALUE 0x7001010e Scalar_UWORD 0 VBU0513_CM_uint16_cnt 0.0 65535.0 /end CHARACTERISTIC
/begin CHARACTERISTIC CbSOC_BatterySOCOvrdFlg_flg "" VALUE 0x70020b17 Scalar_BOOLEAN 0 VBU0513_CM_boolean_cnt 0.0 1.0 /end CHARACTERISTIC
/begin CHARACTERISTIC CbSOC_ForceOcvSocInitialize_flg "" VALUE 0x70020b1d Scalar_BOOLEAN 0 VBU0513_CM_boolean_cnt 0.0 1.0 /end CHARACTERISTIC
/begin CHARACTERISTIC CbSOC_ReadMemorySOCEnable_flg "" VALUE 0x70020b1f Scalar_BOOLEAN 0 VBU0513_CM_boolean_cnt 0.0 1.0 /end CHARACTERISTIC
/begin CHARACTERISTIC CbSOH_CellCapacityLowFaultEnable_flg "" VALUE 0x70020b25 Scalar_BOOLEAN 0 VBU0513_CM_boolean_cnt 0.0 1.0 /end CHARACTERISTIC
/begin CHARACTERISTIC CbSOH_CellCapacityOverDeviationFaultEnable_flg "" VALUE 0x70020b26 Scalar_BOOLEAN 0 VBU0513_CM_boolean_cnt 0.0 1.0 /end CHARACTERISTIC
/begin CHARACTERISTIC CbSOH_CellResistanceHighFaultEnable_flg "" VALUE 0x70020b27 Scalar_BOOLEAN 0 VBU0513_CM_boolean_cnt 0.0 1.0 /end CHARACTERISTIC
/begin CHARACTERISTIC CbSOH_ComputeResistanceRequestORF_flg "" VALUE 0x70020b28 Scalar_BOOLEAN 0 VBU0513_CM_boolean_cnt 0.0 1.0 /end CHARACTERISTIC
/begin CHARACTERISTIC CbSOH_ComputeResistanceRequestORV_flg "" VALUE 0x70020b29 Scalar_BOOLEAN 0 VBU0513_CM_boolean_cnt 0.0 1.0 /end CHARACTERISTIC
/begin CHARACTERISTIC CbVCT_AbortPrechargeCauseORF_flg "" VALUE 0x70020b33 Scalar_BOOLEAN 0 VBU0513_CM_boolean_flg 0.0 1.0 /end CHARACTERISTIC
/begin CHARACTERISTIC CbVCT_BMSBMSRollingCounterORF_flg "" VALUE 0x70020b34 Scalar_BOOLEAN 0 VBU0513_CM_boolean_flg 0.0 1.0 /end CHARACTERISTIC
/begin CHARACTERISTIC CbVCT_BMSBalanceStatusORF_flg "" VALUE 0x70020b35 Scalar_BOOLEAN 0 VBU0513_CM_boolean_flg 0.0 1.0 /end CHARACTERISTIC
/begin CHARACTERISTIC CbVCT_BMSBatteryRatedCapacityORF_flg "" VALUE 0x70020b36 Scalar_BOOLEAN 0 VBU0513_CM_boolean_flg 0.0 1.0 /end CHARACTERISTIC
/begin CHARACTERISTIC CbVCT_BMSBatteryRatedVoltageORF_flg "" VALUE 0x70020b37 Scalar_BOOLEAN 0 VBU0513_CM_boolean_flg 0.0 1.0 /end CHARACTERISTIC
/begin CHARACTERISTIC CbVCT_BMSBatteryTypeORF_flg "" VALUE 0x70020b38 Scalar_BOOLEAN 0 VBU0513_CM_boolean_flg 0.0 1.0 /end CHARACTERISTIC
/begin CHARACTERISTIC CbVCT_BMSCellTempStandardDeviationORF_flg "" VALUE 0x70020b39 Scalar_BOOLEAN 0 VBU0513_CM_boolean_flg 0.0 1.0 /end CHARACTERISTIC
/begin CHARACTERISTIC CbVCT_BMSCellVoltageAveORF_flg "" VALUE 0x70020b3a Scalar_BOOLEAN 0 VBU0513_CM_boolean_flg 0.0 1.0 /end CHARACTERISTIC
/begin CHARACTERISTIC CbVCT_BMSCellVoltageAveValidityORF_flg "" VALUE 0x70020b3b Scalar_BOOLEAN 0 VBU0513_CM_boolean_flg 0.0 1.0 /end CHARACTERISTIC
/begin CHARACTERISTIC CbVCT_BMSCellVoltageAveValidityORV_flg "" VALUE 0x70020b3c Scalar_BOOLEAN 0 VBU0513_CM_boolean_flg 0.0 1.0 /end CHARACTERISTIC
/begin CHARACTERISTIC CbVCT_BMSCellVoltageMaxORF_flg "" VALUE 0x70020b3d Scalar_BOOLEAN 0 VBU0513_CM_boolean_flg 0.0 1.0 /end CHARACTERISTIC
/begin CHARACTERISTIC CbVCT_BMSCellVoltageMaxValidityORF_flg "" VALUE 0x70020b3e Scalar_BOOLEAN 0 VBU0513_CM_boolean_flg 0.0 1.0 /end CHARACTERISTIC
/begin CHARACTERISTIC CbVCT_BMSCellVoltageMaxValidityORV_flg "" VALUE 0x70020b3f Scalar_BOOLEAN 0 VBU0513_CM_boolean_flg 0.0 1.0 /end CHARACTERISTIC
/begin CHARACTERISTIC CbVCT_BMSCellVoltageMinORF_flg "" VALUE 0x70020b40 Scalar_BOOLEAN 0 VBU0513_CM_boolean_flg 0.0 1.0 /end CHARACTERISTIC
/begin CHARACTERISTIC CbVCT_BMSCellVoltageMinValidityORF_flg "" VALUE 0x70020b41 Scalar_BOOLEAN 0 VBU0513_CM_boolean_flg 0.0 1.0 /end CHARACTERISTIC
/begin CHARACTERISTIC CbVCT_BMSCellVoltageMinValidityORV_flg "" VALUE 0x70020b42 Scalar_BOOLEAN 0 VBU0513_CM_boolean_flg 0.0 1.0 /end CHARACTERISTIC
/begin CHARACTERISTIC CbVCT_BMSCellVoltageOverUnderORF_flg "" VALUE 0x70020b43 Scalar_BOOLEAN 0 VBU0513_CM_boolean_flg 0.0 1.0 /end CHARACTERISTIC
/begin CHARACTERISTIC CbVCT_BMSChargeStateORF_flg "" VALUE 0x70020b44 Scalar_BOOLEAN 0 VBU0513_CM_boolean_flg 0.0 1.0 /end CHARACTERISTIC
/begin CHARACTERISTIC CbVCT_BMSChgCurrentLimitORF_flg "" VALUE 0x70020b45 Scalar_BOOLEAN 0 VBU0513_CM_boolean_flg 0.0 1.0 /end CHARACTERISTIC
/begin CHARACTERISTIC CbVCT_BMSChgPowerLimitDynamicORF_flg "" VALUE 0x70020b46 Scalar_BOOLEAN 0 VBU0513_CM_boolean_flg 0.0 1.0 /end CHARACTERISTIC
/begin CHARACTERISTIC CbVCT_BMSChgPowerLimitLTORF_flg "" VALUE 0x70020b47 Scalar_BOOLEAN 0 VBU0513_CM_boolean_flg 0.0 1.0 /end CHARACTERISTIC
/begin CHARACTERISTIC CbVCT_BMSChgPowerLimitSTORF_flg "" VALUE 0x70020b48 Scalar_BOOLEAN 0 VBU0513_CM_boolean_flg 0.0 1.0 /end CHARACTERISTIC
/begin CHARACTERISTIC CbVCT_BMSChrgConnErrorORF_flg "" VALUE 0x70020b49 Scalar_BOOLEAN 0 VBU0513_CM_boolean_flg 0.0 1.0 /end CHARACTERISTIC
/begin CHARACTERISTIC CbVCT_BMSChrgConnOvertempORF_flg "" VALUE 0x70020b4a Scalar_BOOLEAN 0 VBU0513_CM_boolean_flg 0.0 1.0 /end CHARACTERISTIC
/begin CHARACTERISTIC CbVCT_BMSConnectorOvertempORF_flg "" VALUE 0x70020b4b Scalar_BOOLEAN 0 VBU0513_CM_boolean_flg 0.0 1.0 /end CHARACTERISTIC
/begin CHARACTERISTIC CbVCT_BMSContactorStateORF_flg "" VALUE 0x70020b4c Scalar_BOOLEAN 0 VBU0513_CM_boolean_flg 0.0 1.0 /end CHARACTERISTIC
/begin CHARACTERISTIC CbVCT_BMSCustomerUsageSOCORF_flg "" VALUE 0x70020b4d Scalar_BOOLEAN 0 VBU0513_CM_boolean_flg 0.0 1.0 /end CHARACTERISTIC
/begin CHARACTERISTIC CbVCT_BMSDCChargeCurrentOverUnderORF_flg "" VALUE 0x70020b4e Scalar_BOOLEAN 0 VBU0513_CM_boolean_flg 0.0 1.0 /end CHARACTERISTIC
/begin CHARACTERISTIC CbVCT_BMSDCChargingCurrentMeasurementORF_flg "" VALUE 0x70020b4f Scalar_BOOLEAN 0 VBU0513_CM_boolean_flg 0.0 1.0 /end CHARACTERISTIC
/begin CHARACTERISTIC CbVCT_BMSDCChargingVoltageMeasurementORF_flg "" VALUE 0x70020b50 Scalar_BOOLEAN 0 VBU0513_CM_boolean_flg 0.0 1.0 /end CHARACTERISTIC
/begin CHARACTERISTIC CbVCT_BMSDCChrgCrntReqORF_flg "" VALUE 0x70020b51 Scalar_BOOLEAN 0 VBU0513_CM_boolean_flg 0.0 1.0 /end CHARACTERISTIC
/begin CHARACTERISTIC CbVCT_BMSDCChrgFinalSOCORF_flg "" VALUE 0x70020b52 Scalar_BOOLEAN 0 VBU0513_CM_boolean_flg 0.0 1.0 /end CHARACTERISTIC
/begin CHARACTERISTIC CbVCT_BMSDCChrgVoltageReqORF_flg "" VALUE 0x70020b53 Scalar_BOOLEAN 0 VBU0513_CM_boolean_flg 0.0 1.0 /end CHARACTERISTIC
/begin CHARACTERISTIC CbVCT_BMSDischgCurrentLimitORF_flg "" VALUE 0x70020b54 Scalar_BOOLEAN 0 VBU0513_CM_boolean_flg 0.0 1.0 /end CHARACTERISTIC
/begin CHARACTERISTIC CbVCT_BMSDischgPowerLimitDynamicORF_flg "" VALUE 0x70020b55 Scalar_BOOLEAN 0 VBU0513_CM_boolean_flg 0.0 1.0 /end CHARACTERISTIC
/begin CHARACTERISTIC CbVCT_BMSDischgPowerLimitLTORF_flg "" VALUE 0x70020b56 Scalar_BOOLEAN 0 VBU0513_CM_boolean_flg 0.0 1.0 /end CHARACTERISTIC
/begin CHARACTERISTIC CbVCT_BMSDischgPowerLimitSTORF_flg "" VALUE 0x70020b57 Scalar_BOOLEAN 0 VBU0513_CM_boolean_flg 0.0 1.0 /end CHARACTERISTIC
/begin CHARACTERISTIC CbVCT_BMSESSInletTempMaskORF_flg "" VALUE 0x70020b58 Scalar_BOOLEAN 0 VBU0513_CM_boolean_flg 0.0 1.0 /end CHARACTERISTIC
/begin CHARACTERISTIC CbVCT_BMSESSInletTempMaskORV_flg "" VALUE 0x70020b59 Scalar_BOOLEAN 0 VBU0513_CM_boolean_flg 0.0 1.0 /end CHARACTERISTIC
/begin CHARACTERISTIC CbVCT_BMSESSInletTempValidityORF_flg "" VALUE 0x70020b5a Scalar_BOOLEAN 0 VBU0513_CM_boolean_flg 0.0 1.0 /end CHARACTERISTIC
/begin CHARACTERISTIC CbVCT_BMSESSInletTempValidityORV_flg "" VALUE 0x70020b5b Scalar_BOOLEAN 0 VBU0513_CM_boolean_flg 0.0 1.0 /end CHARACTERISTIC
/begin CHARACTERISTIC CbVCT_BMSESSOutletTempMaskORF_flg "" VALUE 0x70020b5c Scalar_BOOLEAN 0 VBU0513_CM_boolean_flg 0.0 1.0 /end CHARACTERISTIC
/begin CHARACTERISTIC CbVCT_BMSESSOutletTempMaskORV_flg "" VALUE 0x70020b5d Scalar_BOOLEAN 0 VBU0513_CM_boolean_flg 0.0 1.0 /end CHARACTERISTIC
/begin CHARACTERISTIC CbVCT_BMSESSOutletTempValidityORF_flg "" VALUE 0x70020b5e Scalar_BOOLEAN 0 VBU0513_CM_boolean_flg 0.0 1.0 /end CHARACTERISTIC
/begin CHARACTERISTIC CbVCT_BMSESSOutletTempValidityORV_flg "" VALUE 0x70020b5f Scalar_BOOLEAN 0 VBU0513_CM_boolean_flg 0.0 1.0 /end CHARACTERISTIC
/begin CHARACTERISTIC CbVCT_BMSEstimateChargingTimeORF_flg "" VALUE 0x70020b60 Scalar_BOOLEAN 0 VBU0513_CM_boolean_flg 0.0 1.0 /end CHARACTERISTIC
/begin CHARACTERISTIC CbVCT_BMSFaultCatORF_flg "" VALUE 0x70020b61 Scalar_BOOLEAN 0 VBU0513_CM_boolean_flg 0.0 1.0 /end CHARACTERISTIC
/begin CHARACTERISTIC CbVCT_BMSFaultLvlORF_flg "" VALUE 0x70020b62 Scalar_BOOLEAN 0 VBU0513_CM_boolean_flg 0.0 1.0 /end CHARACTERISTIC
/begin CHARACTERISTIC CbVCT_BMSHVShutdownReqORF_flg "" VALUE 0x70020b63 Scalar_BOOLEAN 0 VBU0513_CM_boolean_flg 0.0 1.0 /end CHARACTERISTIC
/begin CHARACTERISTIC CbVCT_BMSHVShutdownReqORV_flg "" VALUE 0x70020b64 Scalar_BOOLEAN 0 VBU0513_CM_boolean_flg 0.0 1.0 /end CHARACTERISTIC
/begin CHARACTERISTIC CbVCT_BMSHvConectorErrorORF_flg "" VALUE 0x70020b65 Scalar_BOOLEAN 0 VBU0513_CM_boolean_flg 0.0 1.0 /end CHARACTERISTIC
/begin CHARACTERISTIC CbVCT_BMSHvIsolationORF_flg "" VALUE 0x70020b66 Scalar_BOOLEAN 0 VBU0513_CM_boolean_flg 0.0 1.0 /end CHARACTERISTIC
/begin CHARACTERISTIC CbVCT_BMSIfBmsSocSetORF_flg "" VALUE 0x70020b67 Scalar_BOOLEAN 0 VBU0513_CM_boolean_flg 0.0 1.0 /end CHARACTERISTIC
/begin CHARACTERISTIC CbVCT_BMSIfCellVoltageSetORF_flg "" VALUE 0x70020b68 Scalar_BOOLEAN 0 VBU0513_CM_boolean_flg 0.0 1.0 /end CHARACTERISTIC
/begin CHARACTERISTIC CbVCT_BMSIfPackVoltageSetORF_flg "" VALUE 0x70020b69 Scalar_BOOLEAN 0 VBU0513_CM_boolean_flg 0.0 1.0 /end CHARACTERISTIC
/begin CHARACTERISTIC CbVCT_BMSInletTempRequestORF_flg "" VALUE 0x70020b6a Scalar_BOOLEAN 0 VBU0513_CM_boolean_flg 0.0 1.0 /end CHARACTERISTIC
/begin CHARACTERISTIC CbVCT_BMSInletWaterTempORF_flg "" VALUE 0x70020b6b Scalar_BOOLEAN 0 VBU0513_CM_boolean_flg 0.0 1.0 /end CHARACTERISTIC
/begin CHARACTERISTIC CbVCT_BMSInsulationResistanceValueORF_flg "" VALUE 0x70020b6c Scalar_BOOLEAN 0 VBU0513_CM_boolean_flg 0.0 1.0 /end CHARACTERISTIC
/begin CHARACTERISTIC CbVCT_BMSInterlockStatusORF_flg "" VALUE 0x70020b6d Scalar_BOOLEAN 0 VBU0513_CM_boolean_flg 0.0 1.0 /end CHARACTERISTIC
/begin CHARACTERISTIC CbVCT_BMSIsolationLevelORF_flg "" VALUE 0x70020b6e Scalar_BOOLEAN 0 VBU0513_CM_boolean_flg 0.0 1.0 /end CHARACTERISTIC
/begin CHARACTERISTIC CbVCT_BMSMaxPermitDCChargeVoltageORF_flg "" VALUE 0x70020b6f Scalar_BOOLEAN 0 VBU0513_CM_boolean_flg 0.0 1.0 /end CHARACTERISTIC
/begin CHARACTERISTIC CbVCT_BMSMaxTempSubSysNumberORF_flg "" VALUE 0x70020b70 Scalar_BOOLEAN 0 VBU0513_CM_boolean_flg 0.0 1.0 /end CHARACTERISTIC
/begin CHARACTERISTIC CbVCT_BMSMaxVoltageSubSysNumberORF_flg "" VALUE 0x70020b71 Scalar_BOOLEAN 0 VBU0513_CM_boolean_flg 0.0 1.0 /end CHARACTERISTIC
/begin CHARACTERISTIC CbVCT_BMSMaximumCellTempORF_flg "" VALUE 0x70020b72 Scalar_BOOLEAN 0 VBU0513_CM_boolean_flg 0.0 1.0 /end CHARACTERISTIC
/begin CHARACTERISTIC CbVCT_BMSMaximumCellVoltageNumberORF_flg "" VALUE 0x70020b73 Scalar_BOOLEAN 0 VBU0513_CM_boolean_flg 0.0 1.0 /end CHARACTERISTIC
/begin CHARACTERISTIC CbVCT_BMSMaximumTempNumberORF_flg "" VALUE 0x70020b74 Scalar_BOOLEAN 0 VBU0513_CM_boolean_flg 0.0 1.0 /end CHARACTERISTIC
/begin CHARACTERISTIC CbVCT_BMSMinTempSubSysNumberORF_flg "" VALUE 0x70020b75 Scalar_BOOLEAN 0 VBU0513_CM_boolean_flg 0.0 1.0 /end CHARACTERISTIC
/begin CHARACTERISTIC CbVCT_BMSMinVoltageSubSysNumberORF_flg "" VALUE 0x70020b76 Scalar_BOOLEAN 0 VBU0513_CM_boolean_flg 0.0 1.0 /end CHARACTERISTIC
/begin CHARACTERISTIC CbVCT_BMSMinimumCellTempORF_flg "" VALUE 0x70020b77 Scalar_BOOLEAN 0 VBU0513_CM_boolean_flg 0.0 1.0 /end CHARACTERISTIC
/begin CHARACTERISTIC CbVCT_BMSMinimumCellVoltageNumberORF_flg "" VALUE 0x70020b78 Scalar_BOOLEAN 0 VBU0513_CM_boolean_flg 0.0 1.0 /end CHARACTERISTIC
/begin CHARACTERISTIC CbVCT_BMSMinimumTempNumberORF_flg "" VALUE 0x70020b79 Scalar_BOOLEAN 0 VBU0513_CM_boolean_flg 0.0 1.0 /end CHARACTERISTIC
/begin CHARACTERISTIC CbVCT_BMSOtherErrorORF_flg "" VALUE 0x70020b7a Scalar_BOOLEAN 0 VBU0513_CM_boolean_flg 0.0 1.0 /end CHARACTERISTIC
/begin CHARACTERISTIC CbVCT_BMSOutletWaterTempORF_flg "" VALUE 0x70020b7b Scalar_BOOLEAN 0 VBU0513_CM_boolean_flg 0.0 1.0 /end CHARACTERISTIC
/begin CHARACTERISTIC CbVCT_BMSOverCurrentORF_flg "" VALUE 0x70020b7c Scalar_BOOLEAN 0 VBU0513_CM_boolean_flg 0.0 1.0 /end CHARACTERISTIC
/begin CHARACTERISTIC CbVCT_BMSPackCrntORF_flg "" VALUE 0x70020b7d Scalar_BOOLEAN 0 VBU0513_CM_boolean_flg 0.0 1.0 /end CHARACTERISTIC
/begin CHARACTERISTIC CbVCT_BMSPackEnergyAvailableORF_flg "" VALUE 0x70020b7e Scalar_BOOLEAN 0 VBU0513_CM_boolean_flg 0.0 1.0 /end CHARACTERISTIC
/begin CHARACTERISTIC CbVCT_BMSPackOverTempORF_flg "" VALUE 0x70020b7f Scalar_BOOLEAN 0 VBU0513_CM_boolean_flg 0.0 1.0 /end CHARACTERISTIC
/begin CHARACTERISTIC CbVCT_BMSPackVoltageORF_flg "" VALUE 0x70020b80 Scalar_BOOLEAN 0 VBU0513_CM_boolean_flg 0.0 1.0 /end CHARACTERISTIC
/begin CHARACTERISTIC CbVCT_BMSProtocalVersionORF_flg "" VALUE 0x70020b81 Scalar_BOOLEAN 0 VBU0513_CM_boolean_flg 0.0 1.0 /end CHARACTERISTIC
/begin CHARACTERISTIC CbVCT_BMSReadyDCChargingORF_flg "" VALUE 0x70020b82 Scalar_BOOLEAN 0 VBU0513_CM_boolean_flg 0.0 1.0 /end CHARACTERISTIC
/begin CHARACTERISTIC CbVCT_BMSRollingCounter225ORF_flg "" VALUE 0x70020b83 Scalar_BOOLEAN 0 VBU0513_CM_boolean_flg 0.0 1.0 /end CHARACTERISTIC
/begin CHARACTERISTIC CbVCT_BMSSOCORF_flg "" VALUE 0x70020b84 Scalar_BOOLEAN 0 VBU0513_CM_boolean_flg 0.0 1.0 /end CHARACTERISTIC
/begin CHARACTERISTIC CbVCT_BMSSOCOverUnderORF_flg "" VALUE 0x70020b85 Scalar_BOOLEAN 0 VBU0513_CM_boolean_flg 0.0 1.0 /end CHARACTERISTIC
/begin CHARACTERISTIC CbVCT_BMSStsORF_flg "" VALUE 0x70020b86 Scalar_BOOLEAN 0 VBU0513_CM_boolean_flg 0.0 1.0 /end CHARACTERISTIC
/begin CHARACTERISTIC CbVCT_BMSTempAverageValidityORF_flg "" VALUE 0x70020b87 Scalar_BOOLEAN 0 VBU0513_CM_boolean_flg 0.0 1.0 /end CHARACTERISTIC
/begin CHARACTERISTIC CbVCT_BMSTempAverageValidityORV_flg "" VALUE 0x70020b88 Scalar_BOOLEAN 0 VBU0513_CM_boolean_flg 0.0 1.0 /end CHARACTERISTIC
/begin CHARACTERISTIC CbVCT_BMSTempMaxValidityORF_flg "" VALUE 0x70020b89 Scalar_BOOLEAN 0 VBU0513_CM_boolean_flg 0.0 1.0 /end CHARACTERISTIC
/begin CHARACTERISTIC CbVCT_BMSTempMaxValidityORV_flg "" VALUE 0x70020b8a Scalar_BOOLEAN 0 VBU0513_CM_boolean_flg 0.0 1.0 /end CHARACTERISTIC
/begin CHARACTERISTIC CbVCT_BMSTempMinValidityORF_flg "" VALUE 0x70020b8b Scalar_BOOLEAN 0 VBU0513_CM_boolean_flg 0.0 1.0 /end CHARACTERISTIC
/begin CHARACTERISTIC CbVCT_BMSTempMinValidityORV_flg "" VALUE 0x70020b8c Scalar_BOOLEAN 0 VBU0513_CM_boolean_flg 0.0 1.0 /end CHARACTERISTIC
/begin CHARACTERISTIC CbVCT_BMSTempRequestValidORF_flg "" VALUE 0x70020b8d Scalar_BOOLEAN 0 VBU0513_CM_boolean_flg 0.0 1.0 /end CHARACTERISTIC
/begin CHARACTERISTIC CbVCT_BMSTempRequestValidORV_flg "" VALUE 0x70020b8e Scalar_BOOLEAN 0 VBU0513_CM_boolean_flg 0.0 1.0 /end CHARACTERISTIC
/begin CHARACTERISTIC CbVCT_BMSTemperatureAverageORF_flg "" VALUE 0x70020b8f Scalar_BOOLEAN 0 VBU0513_CM_boolean_flg 0.0 1.0 /end CHARACTERISTIC
/begin CHARACTERISTIC CbVCT_BMSTemperatureMaxORF_flg "" VALUE 0x70020b90 Scalar_BOOLEAN 0 VBU0513_CM_boolean_flg 0.0 1.0 /end CHARACTERISTIC
/begin CHARACTERISTIC CbVCT_BMSVolMismatchORF_flg "" VALUE 0x70020b91 Scalar_BOOLEAN 0 VBU0513_CM_boolean_flg 0.0 1.0 /end CHARACTERISTIC
/begin CHARACTERISTIC CbVCT_BMSVoltageLimitMaxORF_flg "" VALUE 0x70020b92 Scalar_BOOLEAN 0 VBU0513_CM_boolean_flg 0.0 1.0 /end CHARACTERISTIC
/begin CHARACTERISTIC CbVCT_BMSVoltageLimitMinORF_flg "" VALUE 0x70020b93 Scalar_BOOLEAN 0 VBU0513_CM_boolean_flg 0.0 1.0 /end CHARACTERISTIC
/begin CHARACTERISTIC CbVCT_BatteryAbnormalAlarm1ORF_flg "" VALUE 0x70020b94 Scalar_BOOLEAN 0 VBU0513_CM_boolean_flg 0.0 1.0 /end CHARACTERISTIC
/begin CHARACTERISTIC CbVCT_BatteryAbnormalAlarm1ORV_flg "" VALUE 0x70020b95 Scalar_BOOLEAN 0 VBU0513_CM_boolean_flg 0.0 1.0 /end CHARACTERISTIC
/begin CHARACTERISTIC CbVCT_BatteryAbnormalAlarm2ORF_flg "" VALUE 0x70020b96 Scalar_BOOLEAN 0 VBU0513_CM_boolean_flg 0.0 1.0 /end CHARACTERISTIC
/begin CHARACTERISTIC CbVCT_BatteryAbnormalAlarm2ORV_flg "" VALUE 0x70020b97 Scalar_BOOLEAN 0 VBU0513_CM_boolean_flg 0.0 1.0 /end CHARACTERISTIC
/begin CHARACTERISTIC CbVCT_BatteryAbnormalAlarm3ORF_flg "" VALUE 0x70020b98 Scalar_BOOLEAN 0 VBU0513_CM_boolean_flg 0.0 1.0 /end CHARACTERISTIC
/begin CHARACTERISTIC CbVCT_BatteryAbnormalAlarm3ORV_flg "" VALUE 0x70020b99 Scalar_BOOLEAN 0 VBU0513_CM_boolean_flg 0.0 1.0 /end CHARACTERISTIC
/begin CHARACTERISTIC CbVCT_BatteryConsistencyAlarmORF_flg "" VALUE 0x70020b9a Scalar_BOOLEAN 0 VBU0513_CM_boolean_flg 0.0 1.0 /end CHARACTERISTIC
/begin CHARACTERISTIC CbVCT_BatteryNomalCapacityORF_flg "" VALUE 0x70020b9b Scalar_BOOLEAN 0 VBU0513_CM_boolean_flg 0.0 1.0 /end CHARACTERISTIC
/begin CHARACTERISTIC CbVCT_BatteryOutputConnectorStateORF_flg "" VALUE 0x70020b9c Scalar_BOOLEAN 0 VBU0513_CM_boolean_flg 0.0 1.0 /end CHARACTERISTIC
/begin CHARACTERISTIC CbVCT_BatteryTempDifferAlarmORF_flg "" VALUE 0x70020b9d Scalar_BOOLEAN 0 VBU0513_CM_boolean_flg 0.0 1.0 /end CHARACTERISTIC
/begin CHARACTERISTIC CbVCT_BatteryTempOverORF_flg "" VALUE 0x70020b9e Scalar_BOOLEAN 0 VBU0513_CM_boolean_flg 0.0 1.0 /end CHARACTERISTIC
/begin CHARACTERISTIC CbVCT_BatteryTypeDismatchAlarmORF_flg "" VALUE 0x70020b9f Scalar_BOOLEAN 0 VBU0513_CM_boolean_flg 0.0 1.0 /end CHARACTERISTIC
/begin CHARACTERISTIC CbVCT_BetteryCellTempHighAlarmORF_flg "" VALUE 0x70020ba0 Scalar_BOOLEAN 0 VBU0513_CM_boolean_flg 0.0 1.0 /end CHARACTERISTIC
/begin CHARACTERISTIC CbVCT_BetteryCellTempLowAlarmORF_flg "" VALUE 0x70020ba1 Scalar_BOOLEAN 0 VBU0513_CM_boolean_flg 0.0 1.0 /end CHARACTERISTIC
/begin CHARACTERISTIC CbVCT_BetteryCellVolHighAlarmORF_flg "" VALUE 0x70020ba2 Scalar_BOOLEAN 0 VBU0513_CM_boolean_flg 0.0 1.0 /end CHARACTERISTIC
/begin CHARACTERISTIC CbVCT_BetteryCellVolLowAlarmORF_flg "" VALUE 0x70020ba3 Scalar_BOOLEAN 0 VBU0513_CM_boolean_flg 0.0 1.0 /end CHARACTERISTIC
/begin CHARACTERISTIC CbVCT_BetteryPckVoltOverAlarmORF_flg "" VALUE 0x70020ba4 Scalar_BOOLEAN 0 VBU0513_CM_boolean_flg 0.0 1.0 /end CHARACTERISTIC
/begin CHARACTERISTIC CbVCT_BetteryPckVoltUnderAlarmORF_flg "" VALUE 0x70020ba5 Scalar_BOOLEAN 0 VBU0513_CM_boolean_flg 0.0 1.0 /end CHARACTERISTIC
/begin CHARACTERISTIC CbVCT_CTDMnNegContactorWeldORF_flg "" VALUE 0x70020ba6 Scalar_BOOLEAN 0 VBU0513_CM_boolean_flg 0.0 1.0 /end CHARACTERISTIC
/begin CHARACTERISTIC CbVCT_CTDMnPosContactorWeldORF_flg "" VALUE 0x70020ba7 Scalar_BOOLEAN 0 VBU0513_CM_boolean_flg 0.0 1.0 /end CHARACTERISTIC
/begin CHARACTERISTIC CbVCT_CTDPrechargeEnergyHighORF_flg "" VALUE 0x70020ba8 Scalar_BOOLEAN 0 VBU0513_CM_boolean_flg 0.0 1.0 /end CHARACTERISTIC
/begin CHARACTERISTIC CbVCT_CTDPrechargeRelayBlownORF_flg "" VALUE 0x70020ba9 Scalar_BOOLEAN 0 VBU0513_CM_boolean_flg 0.0 1.0 /end CHARACTERISTIC
/begin CHARACTERISTIC CbVCT_CTDPrechargeRelayStuckOpenORF_flg "" VALUE 0x70020baa Scalar_BOOLEAN 0 VBU0513_CM_boolean_flg 0.0 1.0 /end CHARACTERISTIC
/begin CHARACTERISTIC CbVCT_CTDPrechargeTimeoutORF_flg "" VALUE 0x70020bab Scalar_BOOLEAN 0 VBU0513_CM_boolean_flg 0.0 1.0 /end CHARACTERISTIC
/begin CHARACTERISTIC CbVCT_CTMCellThermalRunawayORF_flg "" VALUE 0x70020bac Scalar_BOOLEAN 0 VBU0513_CM_boolean_flg 0.0 1.0 /end CHARACTERISTIC
/begin CHARACTERISTIC CbVCT_CTMCellThermalRunawayValidORF_flg "" VALUE 0x70020bad Scalar_BOOLEAN 0 VBU0513_CM_boolean_flg 0.0 1.0 /end CHARACTERISTIC
/begin CHARACTERISTIC CbVCT_CTMCellThermalRunawayValidORV_flg "" VALUE 0x70020bae Scalar_BOOLEAN 0 VBU0513_CM_boolean_flg 0.0 1.0 /end CHARACTERISTIC
/begin CHARACTERISTIC CbVCT_ChargeAvailableORF_flg "" VALUE 0x70020baf Scalar_BOOLEAN 0 VBU0513_CM_boolean_flg 0.0 1.0 /end CHARACTERISTIC
/begin CHARACTERISTIC CbVCT_ChargeAvailableORV_flg "" VALUE 0x70020bb0 Scalar_BOOLEAN 0 VBU0513_CM_boolean_flg 0.0 1.0 /end CHARACTERISTIC
/begin CHARACTERISTIC CbVCT_ChargeCurrentDerateORF_flg "" VALUE 0x70020bb1 Scalar_BOOLEAN 0 VBU0513_CM_boolean_flg 0.0 1.0 /end CHARACTERISTIC
/begin CHARACTERISTIC CbVCT_ChargeCurrentDerateORV_flg "" VALUE 0x70020bb2 Scalar_BOOLEAN 0 VBU0513_CM_boolean_flg 0.0 1.0 /end CHARACTERISTIC
/begin CHARACTERISTIC CbVCT_DCChargeModeORF_flg "" VALUE 0x70020bb3 Scalar_BOOLEAN 0 VBU0513_CM_boolean_flg 0.0 1.0 /end CHARACTERISTIC
/begin CHARACTERISTIC CbVCT_DCChargingPermitStatusORF_flg "" VALUE 0x70020bb4 Scalar_BOOLEAN 0 VBU0513_CM_boolean_flg 0.0 1.0 /end CHARACTERISTIC
/begin CHARACTERISTIC CbVCT_EstimatePercTimeORF_flg "" VALUE 0x70020bb5 Scalar_BOOLEAN 0 VBU0513_CM_boolean_flg 0.0 1.0 /end CHARACTERISTIC
/begin CHARACTERISTIC CbVCT_HVBattSOCLowCritORF_flg "" VALUE 0x70020bb6 Scalar_BOOLEAN 0 VBU0513_CM_boolean_flg 0.0 1.0 /end CHARACTERISTIC
/begin CHARACTERISTIC CbVCT_HVBattSOCLowCritORV_flg "" VALUE 0x70020bb7 Scalar_BOOLEAN 0 VBU0513_CM_boolean_flg 0.0 1.0 /end CHARACTERISTIC
/begin CHARACTERISTIC CbVCT_HVBattSOCLowWarnORF_flg "" VALUE 0x70020bb8 Scalar_BOOLEAN 0 VBU0513_CM_boolean_flg 0.0 1.0 /end CHARACTERISTIC
/begin CHARACTERISTIC CbVCT_HVBattSOCLowWarnORV_flg "" VALUE 0x70020bb9 Scalar_BOOLEAN 0 VBU0513_CM_boolean_flg 0.0 1.0 /end CHARACTERISTIC
/begin CHARACTERISTIC CbVCT_HVBattStopDchaThdORF_flg "" VALUE 0x70020bba Scalar_BOOLEAN 0 VBU0513_CM_boolean_flg 0.0 1.0 /end CHARACTERISTIC
/begin CHARACTERISTIC CbVCT_InhibitPrechargeCauseORF_flg "" VALUE 0x70020bbb Scalar_BOOLEAN 0 VBU0513_CM_boolean_flg 0.0 1.0 /end CHARACTERISTIC
/begin CHARACTERISTIC CbVCT_MaximumChargingCurrentORF_flg "" VALUE 0x70020bbc Scalar_BOOLEAN 0 VBU0513_CM_boolean_flg 0.0 1.0 /end CHARACTERISTIC
/begin CHARACTERISTIC CbVCT_MaximumChargingVoltageORF_flg "" VALUE 0x70020bbd Scalar_BOOLEAN 0 VBU0513_CM_boolean_flg 0.0 1.0 /end CHARACTERISTIC
/begin CHARACTERISTIC CbVCT_MaximumPermitChargeCellVoltageORF_flg "" VALUE 0x70020bbe Scalar_BOOLEAN 0 VBU0513_CM_boolean_flg 0.0 1.0 /end CHARACTERISTIC
/begin CHARACTERISTIC CbVCT_MaximumPermitTempORF_flg "" VALUE 0x70020bbf Scalar_BOOLEAN 0 VBU0513_CM_boolean_flg 0.0 1.0 /end CHARACTERISTIC
/begin CHARACTERISTIC CbVCT_SOCJumpAlarmORF_flg "" VALUE 0x70020bc0 Scalar_BOOLEAN 0 VBU0513_CM_boolean_flg 0.0 1.0 /end CHARACTERISTIC
/begin CHARACTERISTIC CbVCT_SOCJumpReasonORF_flg "" VALUE 0x70020bc1 Scalar_BOOLEAN 0 VBU0513_CM_boolean_flg 0.0 1.0 /end CHARACTERISTIC
/begin CHARACTERISTIC CcTHM_PackSohORF_flg "" VALUE 0x70020c63 Scalar_BOOLEAN 0 VBU0513_CM_boolean_cnt 0.0 1.0 /end CHARACTERISTIC
/begin CHARACTERISTIC CcSOH_CellCapacityLowFaultFIC_n "" VALUE 0x70020c4e Scalar_BYTE 0 VBU0513_CM_int8_cnt -128.0 127.0 /end CHARACTERISTIC
/begin CHARACTERISTIC CcSOH_CellCapacityLowFaultPIC_n "" VALUE 0x70020c4f Scalar_BYTE 0 VBU0513_CM_int8_cnt -128.0 127.0 /end CHARACTERISTIC
/begin CHARACTERISTIC CcSOH_CellCapacityOverDeviationFaultFIC_n "" VALUE 0x70020c50 Scalar_BYTE 0 VBU0513_CM_int8_cnt -128.0 127.0 /end CHARACTERISTIC
/begin CHARACTERISTIC CcSOH_CellCapacityOverDeviationFaultPIC_n "" VALUE 0x70020c51 Scalar_BYTE 0 VBU0513_CM_int8_cnt -128.0 127.0 /end CHARACTERISTIC
/begin CHARACTERISTIC CcSOH_CellResistanceHighFaultFIC_n "" VALUE 0x70020c52 Scalar_BYTE 0 VBU0513_CM_int8_cnt -128.0 127.0 /end CHARACTERISTIC
/begin CHARACTERISTIC CcSOH_CellResistanceHighFaultPIC_n "" VALUE 0x70020c53 Scalar_BYTE 0 VBU0513_CM_int8_cnt -128.0 127.0 /end CHARACTERISTIC
/begin CHARACTERISTIC CaSOE_InvalidHistoryCurrentData_A "" VALUE 0x70020aa8 Scalar_UBYTE 0 VBU0513_CM_uint8_cnt 0.0 255.0 /end CHARACTERISTIC
/begin CHARACTERISTIC CcSOE_HistoryCurrentDataDimension_n "" VALUE 0x70020c44 Scalar_UBYTE 0 VBU0513_CM_uint8_cnt 0.0 255.0 /end CHARACTERISTIC
/begin CHARACTERISTIC CcSOH_ComputeResistanceUpdateCycle_n "" VALUE 0x70020c54 Scalar_UBYTE 0 VBU0513_CM_uint8_cnt 0.0 255.0 /end CHARACTERISTIC
/begin CHARACTERISTIC CcVCT_BMSMaxTempSubSysNumberORV_n "" VALUE 0x70020c65 Scalar_UBYTE 0 VBU0513_CM_uint8_n 0.0 255.0 /end CHARACTERISTIC
/begin CHARACTERISTIC CcVCT_BMSMaxVoltageSubSysNumberORV_n "" VALUE 0x70020c66 Scalar_UBYTE 0 VBU0513_CM_uint8_n 0.0 255.0 /end CHARACTERISTIC
/begin CHARACTERISTIC CcVCT_BMSMaximumCellVoltageNumberORV_n "" VALUE 0x70020c67 Scalar_UBYTE 0 VBU0513_CM_uint8_n 0.0 255.0 /end CHARACTERISTIC
/begin CHARACTERISTIC CcVCT_BMSMaximumTempNumberORV_n "" VALUE 0x70020c68 Scalar_UBYTE 0 VBU0513_CM_uint8_n 0.0 255.0 /end CHARACTERISTIC
/begin CHARACTERISTIC CcVCT_BMSMinTempSubSysNumberORV_n "" VALUE 0x70020c69 Scalar_UBYTE 0 VBU0513_CM_uint8_n 0.0 255.0 /end CHARACTERISTIC
/begin CHARACTERISTIC CcVCT_BMSMinVoltageSubSysNumberORV_n "" VALUE 0x70020c6a Scalar_UBYTE 0 VBU0513_CM_uint8_n 0.0 255.0 /end CHARACTERISTIC
/begin CHARACTERISTIC CcVCT_BMSMinimumCellVoltageNumberORV_n "" VALUE 0x70020c6b Scalar_UBYTE 0 VBU0513_CM_uint8_n 0.0 255.0 /end CHARACTERISTIC
/begin CHARACTERISTIC CcVCT_BMSMinimumTempNumberORV_n "" VALUE 0x70020c6c Scalar_UBYTE 0 VBU0513_CM_uint8_n 0.0 255.0 /end CHARACTERISTIC
/begin CHARACTERISTIC CcVCT_BMSReadyDCChargingORV_enum "" VALUE 0x70020c6d Scalar_UBYTE 0 VBU0513_CM_uint8_enum 0.0 255.0 /end CHARACTERISTIC
/begin CHARACTERISTIC CcVCT_BMSRollingCounter225ORV_n "" VALUE 0x70020c6e Scalar_UBYTE 0 VBU0513_CM_uint8_n 0.0 255.0 /end CHARACTERISTIC
/begin CHARACTERISTIC CeVCT_AbortPrechargeCauseORV_enum "" VALUE 0x70020c6f Scalar_UBYTE 0 VBU0513_CM_uint8_enum 0.0 255.0 /end CHARACTERISTIC
/begin CHARACTERISTIC CeVCT_BMSBMSRollingCounterORV_enum "" VALUE 0x70020c70 Scalar_UBYTE 0 VBU0513_CM_uint8_enum 0.0 255.0 /end CHARACTERISTIC
/begin CHARACTERISTIC CeVCT_BMSBalanceStatusORV_enum "" VALUE 0x70020c71 Scalar_UBYTE 0 VBU0513_CM_uint8_enum 0.0 255.0 /end CHARACTERISTIC
/begin CHARACTERISTIC CeVCT_BMSBatteryTypeORV_enum "" VALUE 0x70020c72 Scalar_UBYTE 0 VBU0513_CM_uint8_enum 0.0 255.0 /end CHARACTERISTIC
/begin CHARACTERISTIC CeVCT_BMSCellVoltageOverUnderORV_enum "" VALUE 0x70020c74 Scalar_UBYTE 0 VBU0513_CM_uint8_enum 0.0 255.0 /end CHARACTERISTIC
/begin CHARACTERISTIC CeVCT_BMSChargeStateORV_enum "" VALUE 0x70020c75 Scalar_UBYTE 0 VBU0513_CM_uint8_enum 0.0 255.0 /end CHARACTERISTIC
/begin CHARACTERISTIC CeVCT_BMSChrgConnErrorORV_enum "" VALUE 0x70020c76 Scalar_UBYTE 0 VBU0513_CM_uint8_enum 0.0 255.0 /end CHARACTERISTIC
/begin CHARACTERISTIC CeVCT_BMSChrgConnOvertempORV_enum "" VALUE 0x70020c77 Scalar_UBYTE 0 VBU0513_CM_uint8_enum 0.0 255.0 /end CHARACTERISTIC
/begin CHARACTERISTIC CeVCT_BMSConnectorOvertempORV_enum "" VALUE 0x70020c78 Scalar_UBYTE 0 VBU0513_CM_uint8_enum 0.0 255.0 /end CHARACTERISTIC
/begin CHARACTERISTIC CeVCT_BMSContactorStateORV_enum "" VALUE 0x70020c79 Scalar_UBYTE 0 VBU0513_CM_uint8_enum 0.0 255.0 /end CHARACTERISTIC
/begin CHARACTERISTIC CeVCT_BMSDCChargeCurrentOverUnderORV_enum "" VALUE 0x70020c7a Scalar_UBYTE 0 VBU0513_CM_uint8_enum 0.0 255.0 /end CHARACTERISTIC
/begin CHARACTERISTIC CeVCT_BMSFaultCatORV_enum "" VALUE 0x70020c7b Scalar_UBYTE 0 VBU0513_CM_uint8_enum 0.0 255.0 /end CHARACTERISTIC
/begin CHARACTERISTIC CeVCT_BMSFaultLvlORV_enum "" VALUE 0x70020c7c Scalar_UBYTE 0 VBU0513_CM_uint8_enum 0.0 255.0 /end CHARACTERISTIC
/begin CHARACTERISTIC CeVCT_BMSHvConectorErrorORV_enum "" VALUE 0x70020c7d Scalar_UBYTE 0 VBU0513_CM_uint8_enum 0.0 255.0 /end CHARACTERISTIC
/begin CHARACTERISTIC CeVCT_BMSHvIsolationORV_enum "" VALUE 0x70020c7e Scalar_UBYTE 0 VBU0513_CM_uint8_enum 0.0 255.0 /end CHARACTERISTIC
/begin CHARACTERISTIC CeVCT_BMSIfBmsSocSetORV_enum "" VALUE 0x70020c7f Scalar_UBYTE 0 VBU0513_CM_uint8_enum 0.0 255.0 /end CHARACTERISTIC
/begin CHARACTERISTIC CeVCT_BMSIfCellVoltageSetORV_enum "" VALUE 0x70020c80 Scalar_UBYTE 0 VBU0513_CM_uint8_enum 0.0 255.0 /end CHARACTERISTIC
/begin CHARACTERISTIC CeVCT_BMSIfPackVoltageSetORV_enum "" VALUE 0x70020c81 Scalar_UBYTE 0 VBU0513_CM_uint8_enum 0.0 255.0 /end CHARACTERISTIC
/begin CHARACTERISTIC CeVCT_BMSInterlockStatusORV_enum "" VALUE 0x70020c82 Scalar_UBYTE 0 VBU0513_CM_uint8_enum 0.0 255.0 /end CHARACTERISTIC
/begin CHARACTERISTIC CeVCT_BMSIsolationLevelORV_enum "" VALUE 0x70020c83 Scalar_UBYTE 0 VBU0513_CM_uint8_enum 0.0 255.0 /end CHARACTERISTIC
/begin CHARACTERISTIC CeVCT_BMSOtherErrorORV_enum "" VALUE 0x70020c84 Scalar_UBYTE 0 VBU0513_CM_uint8_enum 0.0 255.0 /end CHARACTERISTIC
/begin CHARACTERISTIC CeVCT_BMSOverCurrentORV_enum "" VALUE 0x70020c85 Scalar_UBYTE 0 VBU0513_CM_uint8_enum 0.0 255.0 /end CHARACTERISTIC
/begin CHARACTERISTIC CeVCT_BMSPackOverTempORV_enum "" VALUE 0x70020c86 Scalar_UBYTE 0 VBU0513_CM_uint8_enum 0.0 255.0 /end CHARACTERISTIC
/begin CHARACTERISTIC CeVCT_BMSSOCOverUnderORV_enum "" VALUE 0x70020c87 Scalar_UBYTE 0 VBU0513_CM_uint8_enum 0.0 255.0 /end CHARACTERISTIC
/begin CHARACTERISTIC CeVCT_BMSStsORV_enum "" VALUE 0x70020c88 Scalar_UBYTE 0 VBU0513_CM_uint8_enum 0.0 255.0 /end CHARACTERISTIC
/begin CHARACTERISTIC CeVCT_BMSVolMismatchORV_enum "" VALUE 0x70020c89 Scalar_UBYTE 0 VBU0513_CM_uint8_enum 0.0 255.0 /end CHARACTERISTIC
/begin CHARACTERISTIC CeVCT_BatteryConsistencyAlarmORV_enum "" VALUE 0x70020c8a Scalar_UBYTE 0 VBU0513_CM_uint8_enum 0.0 255.0 /end CHARACTERISTIC
/begin CHARACTERISTIC CeVCT_BatteryOutputConnectorStateORV_enum "" VALUE 0x70020c8b Scalar_UBYTE 0 VBU0513_CM_uint8_enum 0.0 255.0 /end CHARACTERISTIC
/begin CHARACTERISTIC CeVCT_BatteryTempDifferAlarmORV_enum "" VALUE 0x70020c8c Scalar_UBYTE 0 VBU0513_CM_uint8_enum 0.0 255.0 /end CHARACTERISTIC
/begin CHARACTERISTIC CeVCT_BatteryTempOverORV_enum "" VALUE 0x70020c8d Scalar_UBYTE 0 VBU0513_CM_uint8_enum 0.0 255.0 /end CHARACTERISTIC
/begin CHARACTERISTIC CeVCT_BatteryTypeDismatchAlarmORV_enum "" VALUE 0x70020c8e Scalar_UBYTE 0 VBU0513_CM_uint8_enum 0.0 255.0 /end CHARACTERISTIC
/begin CHARACTERISTIC CeVCT_BetteryCellTempHighAlarmORV_enum "" VALUE 0x70020c8f Scalar_UBYTE 0 VBU0513_CM_uint8_enum 0.0 255.0 /end CHARACTERISTIC
/begin CHARACTERISTIC CeVCT_BetteryCellTempLowAlarmORV_enum "" VALUE 0x70020c90 Scalar_UBYTE 0 VBU0513_CM_uint8_enum 0.0 255.0 /end CHARACTERISTIC
/begin CHARACTERISTIC CeVCT_BetteryCellVolHighAlarmORV_enum "" VALUE 0x70020c91 Scalar_UBYTE 0 VBU0513_CM_uint8_enum 0.0 255.0 /end CHARACTERISTIC
/begin CHARACTERISTIC CeVCT_BetteryCellVolLowAlarmORV_enum "" VALUE 0x70020c92 Scalar_UBYTE 0 VBU0513_CM_uint8_enum 0.0 255.0 /end CHARACTERISTIC
/begin CHARACTERISTIC CeVCT_BetteryPckVoltOverAlarmORV_enum "" VALUE 0x70020c93 Scalar_UBYTE 0 VBU0513_CM_uint8_enum 0.0 255.0 /end CHARACTERISTIC
/begin CHARACTERISTIC CeVCT_BetteryPckVoltUnderAlarmORV_enum "" VALUE 0x70020c94 Scalar_UBYTE 0 VBU0513_CM_uint8_enum 0.0 255.0 /end CHARACTERISTIC
/begin CHARACTERISTIC CeVCT_CTDMnNegContactorWeldORV_enum "" VALUE 0x70020c95 Scalar_UBYTE 0 VBU0513_CM_uint8_enum 0.0 255.0 /end CHARACTERISTIC
/begin CHARACTERISTIC CeVCT_CTDMnPosContactorWeldORV_enum "" VALUE 0x70020c96 Scalar_UBYTE 0 VBU0513_CM_uint8_enum 0.0 255.0 /end CHARACTERISTIC
/begin CHARACTERISTIC CeVCT_CTDPrechargeEnergyHighORV_enum "" VALUE 0x70020c97 Scalar_UBYTE 0 VBU0513_CM_uint8_enum 0.0 255.0 /end CHARACTERISTIC
/begin CHARACTERISTIC CeVCT_CTDPrechargeRelayBlownORV_enum "" VALUE 0x70020c98 Scalar_UBYTE 0 VBU0513_CM_uint8_enum 0.0 255.0 /end CHARACTERISTIC
/begin CHARACTERISTIC CeVCT_CTDPrechargeRelayStuckOpenORV_enum "" VALUE 0x70020c99 Scalar_UBYTE 0 VBU0513_CM_uint8_enum 0.0 255.0 /end CHARACTERISTIC
/begin CHARACTERISTIC CeVCT_CTDPrechargeTimeoutORV_enum "" VALUE 0x70020c9a Scalar_UBYTE 0 VBU0513_CM_uint8_enum 0.0 255.0 /end CHARACTERISTIC
/begin CHARACTERISTIC CeVCT_CTMCellThermalRunawayORV_enum "" VALUE 0x70020c9b Scalar_UBYTE 0 VBU0513_CM_uint8_enum 0.0 255.0 /end CHARACTERISTIC
/begin CHARACTERISTIC CeVCT_DCChargeModeORV_enum "" VALUE 0x70020c9c Scalar_UBYTE 0 VBU0513_CM_uint8_enum 0.0 255.0 /end CHARACTERISTIC
/begin CHARACTERISTIC CeVCT_DCChargingPermitStatusORV_enum "" VALUE 0x70020c9d Scalar_UBYTE 0 VBU0513_CM_uint8_enum 0.0 255.0 /end CHARACTERISTIC
/begin CHARACTERISTIC CeVCT_InhibitPrechargeCauseORV_enum "" VALUE 0x70020c9e Scalar_UBYTE 0 VBU0513_CM_uint8_enum 0.0 255.0 /end CHARACTERISTIC
/begin CHARACTERISTIC CeVCT_SOCJumpAlarmORV_enum "" VALUE 0x70020c9f Scalar_UBYTE 0 VBU0513_CM_uint8_enum 0.0 255.0 /end CHARACTERISTIC
/begin CHARACTERISTIC CeVCT_SOCJumpReasonORV_enum "" VALUE 0x70020ca0 Scalar_UBYTE 0 VBU0513_CM_uint8_enum 0.0 255.0 /end CHARACTERISTIC
/begin CHARACTERISTIC SOH_CELL_CAPACITY_LOW_FAULT "" VALUE 0x70020ed1 Scalar_UBYTE 0 VBU0513_CM_uint8_cnt 0.0 255.0 /end CHARACTERISTIC
/begin CHARACTERISTIC SOH_CELL_CAPACITY_OVER_DEVIATION_FAULT "" VALUE 0x70020ed2 Scalar_UBYTE 0 VBU0513_CM_uint8_cnt 0.0 255.0 /end CHARACTERISTIC
/begin CHARACTERISTIC SOH_CELL_RESISTANCE_HIGH_FAULT "" VALUE 0x70020ed3 Scalar_UBYTE 0 VBU0513_CM_uint8_cnt 0.0 255.0 /end CHARACTERISTIC
/begin MEASUREMENT LEM_BatteryCurrent "" ULONG VBU0513_CM_ufix32_Bn2147483648 0 0 -2.147483648E+9 2.147483647E+9 ECU_ADDRESS 0x900022d2 /end MEASUREMENT
/begin MEASUREMENT LEM_SensorName "" ULONG VBU0513_CM_ufix24 0 0 0 1.6777215E+7 ECU_ADDRESS 0x900022d6 /end MEASUREMENT
/begin MEASUREMENT THM_tInletCoolantTemp "" FLOAT32_IEEE VBU0513_CM_single 0 0 -3.4E+38 3.4E+38 ECU_ADDRESS 0x9000230a /end MEASUREMENT
/begin MEASUREMENT THM_tOutletCoolantTemp "" FLOAT32_IEEE VBU0513_CM_single 0 0 -3.4E+38 3.4E+38 ECU_ADDRESS 0x90002312 /end MEASUREMENT
/begin MEASUREMENT SOE_kwhPackRemainingEnergySoc "" FLOAT32_IEEE VBU0513_CM_single 0 0 -3.4E+38 3.4E+38 ECU_ADDRESS 0x900021a6 /end MEASUREMENT
/begin MEASUREMENT SOF_uPackChargeOcv "" FLOAT32_IEEE VBU0513_CM_single 0 0 -3.4E+38 3.4E+38 ECU_ADDRESS 0x900024da /end MEASUREMENT
/begin MEASUREMENT SOF_uPackDischargeOcv "" FLOAT32_IEEE VBU0513_CM_single 0 0 -3.4E+38 3.4E+38 ECU_ADDRESS 0x900024de /end MEASUREMENT
/begin MEASUREMENT LcSOF_kwChargePowerLimitCycle "" FLOAT32_IEEE VBU0513_CM_single 0 0 -3.4E+38 3.4E+38 ECU_ADDRESS 0x90002452 /end MEASUREMENT
/begin MEASUREMENT LaSOC_OcvSoc_pct "" FLOAT32_IEEE VBU0513_CM_single 0 0 0.0 100.0 ARRAY_SIZE 198 ECU_ADDRESS 0x6003b396 /end MEASUREMENT
/begin MEASUREMENT SOC_pctCellBatterySOCDeviation "" FLOAT32_IEEE VBU0513_CM_single 0 0 -3.4E+38 3.4E+38 ECU_ADDRESS 0x90002482 /end MEASUREMENT
/begin MEASUREMENT CellVolt1 "" UWORD VBU0513_CM_uint16 0 0 0 65535 ECU_ADDRESS 0x900037a4 /end MEASUREMENT
/begin MEASUREMENT CellVolt2 "" UWORD VBU0513_CM_uint16 0 0 0 65535 ECU_ADDRESS 0x90003882 /end MEASUREMENT
/begin MEASUREMENT CellVolt3 "" UWORD VBU0513_CM_uint16 0 0 0 65535 ECU_ADDRESS 0x9000389a /end MEASUREMENT
/begin MEASUREMENT CellVolt4 "" UWORD VBU0513_CM_uint16 0 0 0 65535 ECU_ADDRESS 0x900038b0 /end MEASUREMENT
/begin MEASUREMENT Low_Cell_Volt_4 "" UWORD VBU0513_CM_uint16 0 0 0 65535 ECU_ADDRESS 0x9000397a /end MEASUREMENT
/begin MEASUREMENT Low_Cell_Volt_5 "" UWORD VBU0513_CM_uint16 0 0 0 65535 ECU_ADDRESS 0x9000397c /end MEASUREMENT
/begin MEASUREMENT Low_Cell_Volt_2 "" UWORD VBU0513_CM_uint16 0 0 0 65535 ECU_ADDRESS 0x90003976 /end MEASUREMENT
/begin MEASUREMENT Low_Cell_Volt_3 "" UWORD VBU0513_CM_uint16 0 0 0 65535 ECU_ADDRESS 0x90003978 /end MEASUREMENT
/begin MEASUREMENT High_Cell_Volt_5 "" UWORD VBU0513_CM_uint16 0 0 0 65535 ECU_ADDRESS 0x90003960 /end MEASUREMENT
/begin MEASUREMENT Low_Cell_Volt_1 "" UWORD VBU0513_CM_uint16 0 0 0 65535 ECU_ADDRESS 0x90003974 /end MEASUREMENT
/begin MEASUREMENT High_Cell_Volt_3 "" UWORD VBU0513_CM_uint16 0 0 0 65535 ECU_ADDRESS 0x9000395c /end MEASUREMENT
/begin MEASUREMENT High_Cell_Volt_4 "" UWORD VBU0513_CM_uint16 0 0 0 65535 ECU_ADDRESS 0x9000395e /end MEASUREMENT
/begin MEASUREMENT High_Cell_Volt_1 "" UWORD VBU0513_CM_uint16 0 0 0 65535 ECU_ADDRESS 0x90003958 /end MEASUREMENT
/begin MEASUREMENT High_Cell_Volt_2 "" UWORD VBU0513_CM_uint16 0 0 0 65535 ECU_ADDRESS 0x9000395a /end MEASUREMENT
/begin MEASUREMENT Min_Volt "" UWORD VBU0513_CM_uint16 0 0 0 65535 ECU_ADDRESS 0x90003990 /end MEASUREMENT
/begin MEASUREMENT Max_Volt "" UWORD VBU0513_CM_uint16 0 0 0 65535 ECU_ADDRESS 0x9000398c /end MEASUREMENT
/begin MEASUREMENT Insulation_R_Minus "" UWORD VBU0513_CM_uint16 0 0 0 65535 ECU_ADDRESS 0x90003962 /end MEASUREMENT
/begin MEASUREMENT Insulation_R_Plus "" UWORD VBU0513_CM_uint16 0 0 0 65535 ECU_ADDRESS 0x90003964 /end MEASUREMENT
/begin MEASUREMENT Ave_Volt "" UWORD VBU0513_CM_uint16 0 0 0 65535 ECU_ADDRESS 0x90003798 /end MEASUREMENT
/begin MEASUREMENT Insulation_Resistance "" UWORD VBU0513_CM_uint16 0 0 0 65535 ECU_ADDRESS 0x90003966 /end MEASUREMENT
/begin MEASUREMENT High_Cell_Temp_1 "" UWORD VBU0513_CM_ufix16_Sp1_Bn40 0 0 -40.0 6513.5 ECU_ADDRESS 0x9000394e /end MEASUREMENT
/begin MEASUREMENT High_Cell_Temp_2 "" UWORD VBU0513_CM_ufix16_Sp1_Bn40 0 0 -40.0 6513.5 ECU_ADDRESS 0x90003950 /end MEASUREMENT
/begin MEASUREMENT Low_Cell_Temp_4 "" UWORD VBU0513_CM_ufix16_Sp1_Bn40 0 0 -40.0 6513.5 ECU_ADDRESS 0x90003970 /end MEASUREMENT
/begin MEASUREMENT Low_Cell_Temp_5 "" UWORD VBU0513_CM_ufix16_Sp1_Bn40 0 0 -40.0 6513.5 ECU_ADDRESS 0x90003972 /end MEASUREMENT
/begin MEASUREMENT Low_Cell_Temp_2 "" UWORD VBU0513_CM_ufix16_Sp1_Bn40 0 0 -40.0 6513.5 ECU_ADDRESS 0x9000396c /end MEASUREMENT
/begin MEASUREMENT Low_Cell_Temp_3 "" UWORD VBU0513_CM_ufix16_Sp1_Bn40 0 0 -40.0 6513.5 ECU_ADDRESS 0x9000396e /end MEASUREMENT
/begin MEASUREMENT High_Cell_Temp_5 "" UWORD VBU0513_CM_ufix16_Sp1_Bn40 0 0 -40.0 6513.5 ECU_ADDRESS 0x90003956 /end MEASUREMENT
/begin MEASUREMENT Low_Cell_Temp_1 "" UWORD VBU0513_CM_ufix16_Sp1_Bn40 0 0 -40.0 6513.5 ECU_ADDRESS 0x9000396a /end MEASUREMENT
/begin MEASUREMENT High_Cell_Temp_3 "" UWORD VBU0513_CM_ufix16_Sp1_Bn40 0 0 -40.0 6513.5 ECU_ADDRESS 0x90003952 /end MEASUREMENT
/begin MEASUREMENT High_Cell_Temp_4 "" UWORD VBU0513_CM_ufix16_Sp1_Bn40 0 0 -40.0 6513.5 ECU_ADDRESS 0x90003954 /end MEASUREMENT
/begin MEASUREMENT Max_Temp "" UWORD VBU0513_CM_ufix16_Sp1_Bn40 0 0 -40.0 6513.5 ECU_ADDRESS 0x9000398a /end MEASUREMENT
/begin MEASUREMENT Min_Temp "" UWORD VBU0513_CM_ufix16_Sp1_Bn40 0 0 -40.0 6513.5 ECU_ADDRESS 0x9000398e /end MEASUREMENT
/begin MEASUREMENT Total_Volt "" UWORD VBU0513_CM_ufix16_Sp1 0 0 0 6553.5 ECU_ADDRESS 0x9000399c /end MEASUREMENT
/begin MEASUREMENT Total_Temp_Num "" UBYTE VBU0513_CM_uint8 0 0 0 255 ECU_ADDRESS 0x9000420a /end MEASUREMENT
/begin MEASUREMENT Total_Volt_Cell_Num "" UBYTE VBU0513_CM_uint8 0 0 0 255 ECU_ADDRESS 0x9000420b /end MEASUREMENT
/begin MEASUREMENT High_Cell_Temp_1_BMU_ID "" UBYTE VBU0513_CM_uint8 0 0 0 255 ECU_ADDRESS 0x90004156 /end MEASUREMENT
/begin MEASUREMENT High_Cell_Temp_1_BMU_Index "" UBYTE VBU0513_CM_uint8 0 0 0 255 ECU_ADDRESS 0x90004157 /end MEASUREMENT
/begin MEASUREMENT High_Cell_Temp_2_BMU_ID "" UBYTE VBU0513_CM_uint8 0 0 0 255 ECU_ADDRESS 0x90004158 /end MEASUREMENT
/begin MEASUREMENT High_Cell_Temp_2_BMU_Index "" UBYTE VBU0513_CM_uint8 0 0 0 255 ECU_ADDRESS 0x90004159 /end MEASUREMENT
/begin MEASUREMENT Low_Cell_Volt_4_BMU_ID "" UBYTE VBU0513_CM_uint8 0 0 0 255 ECU_ADDRESS 0x90004187 /end MEASUREMENT
/begin MEASUREMENT Low_Cell_Volt_4_BMU_Index "" UBYTE VBU0513_CM_uint8 0 0 0 255 ECU_ADDRESS 0x90004188 /end MEASUREMENT
/begin MEASUREMENT Low_Cell_Volt_5_BMU_ID "" UBYTE VBU0513_CM_uint8 0 0 0 255 ECU_ADDRESS 0x90004189 /end MEASUREMENT
/begin MEASUREMENT Low_Cell_Volt_5_BMU_Index "" UBYTE VBU0513_CM_uint8 0 0 0 255 ECU_ADDRESS 0x9000418a /end MEASUREMENT
/begin MEASUREMENT Low_Cell_Volt_2_BMU_ID "" UBYTE VBU0513_CM_uint8 0 0 0 255 ECU_ADDRESS 0x90004183 /end MEASUREMENT
/begin MEASUREMENT Low_Cell_Volt_2_BMU_Index "" UBYTE VBU0513_CM_uint8 0 0 0 255 ECU_ADDRESS 0x90004184 /end MEASUREMENT
/begin MEASUREMENT Low_Cell_Volt_3_BMU_ID "" UBYTE VBU0513_CM_uint8 0 0 0 255 ECU_ADDRESS 0x90004185 /end MEASUREMENT
/begin MEASUREMENT Low_Cell_Volt_3_BMU_Index "" UBYTE VBU0513_CM_uint8 0 0 0 255 ECU_ADDRESS 0x90004186 /end MEASUREMENT
/begin MEASUREMENT High_Cell_Volt_5_BMU_ID "" UBYTE VBU0513_CM_uint8 0 0 0 255 ECU_ADDRESS 0x90004168 /end MEASUREMENT
/begin MEASUREMENT High_Cell_Volt_5_BMU_Index "" UBYTE VBU0513_CM_uint8 0 0 0 255 ECU_ADDRESS 0x90004169 /end MEASUREMENT
/begin MEASUREMENT Low_Cell_Volt_1_BMU_ID "" UBYTE VBU0513_CM_uint8 0 0 0 255 ECU_ADDRESS 0x90004181 /end MEASUREMENT
/begin MEASUREMENT Low_Cell_Volt_1_BMU_Index "" UBYTE VBU0513_CM_uint8 0 0 0 255 ECU_ADDRESS 0x90004182 /end MEASUREMENT
/begin MEASUREMENT High_Cell_Volt_3_BMU_ID "" UBYTE VBU0513_CM_uint8 0 0 0 255 ECU_ADDRESS 0x90004164 /end MEASUREMENT
/begin MEASUREMENT High_Cell_Volt_3_BMU_Index "" UBYTE VBU0513_CM_uint8 0 0 0 255 ECU_ADDRESS 0x90004165 /end MEASUREMENT
/begin MEASUREMENT High_Cell_Volt_4_BMU_ID "" UBYTE VBU0513_CM_uint8 0 0 0 255 ECU_ADDRESS 0x90004166 /end MEASUREMENT
/begin MEASUREMENT High_Cell_Volt_4_BMU_Index "" UBYTE VBU0513_CM_uint8 0 0 0 255 ECU_ADDRESS 0x90004167 /end MEASUREMENT
/begin MEASUREMENT High_Cell_Volt_1_BMU_ID "" UBYTE VBU0513_CM_uint8 0 0 0 255 ECU_ADDRESS 0x90004160 /end MEASUREMENT
/begin MEASUREMENT High_Cell_Volt_1_BMU_Index "" UBYTE VBU0513_CM_uint8 0 0 0 255 ECU_ADDRESS 0x90004161 /end MEASUREMENT
/begin MEASUREMENT High_Cell_Volt_2_BMU_ID "" UBYTE VBU0513_CM_uint8 0 0 0 255 ECU_ADDRESS 0x90004162 /end MEASUREMENT
/begin MEASUREMENT High_Cell_Volt_2_BMU_Index "" UBYTE VBU0513_CM_uint8 0 0 0 255 ECU_ADDRESS 0x90004163 /end MEASUREMENT
/begin MEASUREMENT HCU_Statistics_State3_Heart "" UBYTE VBU0513_CM_uint8 0 0 0 255 ECU_ADDRESS 0x90004155 /end MEASUREMENT
/begin MEASUREMENT Max_Volt_BMU_index "" UBYTE VBU0513_CM_uint8 0 0 0 255 ECU_ADDRESS 0x900041ae /end MEASUREMENT
/begin MEASUREMENT Min_Volt_BMU_ID "" UBYTE VBU0513_CM_uint8 0 0 0 255 ECU_ADDRESS 0x900041b3 /end MEASUREMENT
/begin MEASUREMENT Min_Volt_BMU_index "" UBYTE VBU0513_CM_uint8 0 0 0 255 ECU_ADDRESS 0x900041b4 /end MEASUREMENT
/begin MEASUREMENT Min_Volt_Index "" UBYTE VBU0513_CM_uint8 0 0 0 255 ECU_ADDRESS 0x900041b5 /end MEASUREMENT
/begin MEASUREMENT HCU_Statistics_State2_Heart "" UBYTE VBU0513_CM_uint8 0 0 0 255 ECU_ADDRESS 0x90004154 /end MEASUREMENT
/begin MEASUREMENT Max_Volt_BMU_ID "" UBYTE VBU0513_CM_uint8 0 0 0 255 ECU_ADDRESS 0x900041ad /end MEASUREMENT
/begin MEASUREMENT Max_Volt_Index "" UBYTE VBU0513_CM_uint8 0 0 0 255 ECU_ADDRESS 0x900041af /end MEASUREMENT
/begin MEASUREMENT Min_Temp_BMU_ID "" UBYTE VBU0513_CM_uint8 0 0 0 255 ECU_ADDRESS 0x900041b0 /end MEASUREMENT
/begin MEASUREMENT Min_Temp_BMU_index "" UBYTE VBU0513_CM_uint8 0 0 0 255 ECU_ADDRESS 0x900041b1 /end MEASUREMENT
/begin MEASUREMENT Min_Temp_index "" UBYTE VBU0513_CM_uint8 0 0 0 255 ECU_ADDRESS 0x900041b2 /end MEASUREMENT
/begin MEASUREMENT Low_Cell_Temp_4_BMU_ID "" UBYTE VBU0513_CM_uint8 0 0 0 255 ECU_ADDRESS 0x9000417d /end MEASUREMENT
/begin MEASUREMENT Low_Cell_Temp_4_BMU_Index "" UBYTE VBU0513_CM_uint8 0 0 0 255 ECU_ADDRESS 0x9000417e /end MEASUREMENT
/begin MEASUREMENT Low_Cell_Temp_5_BMU_ID "" UBYTE VBU0513_CM_uint8 0 0 0 255 ECU_ADDRESS 0x9000417f /end MEASUREMENT
/begin MEASUREMENT Low_Cell_Temp_5_BMU_Index "" UBYTE VBU0513_CM_uint8 0 0 0 255 ECU_ADDRESS 0x90004180 /end MEASUREMENT
/begin MEASUREMENT Low_Cell_Temp_2_BMU_ID "" UBYTE VBU0513_CM_uint8 0 0 0 255 ECU_ADDRESS 0x90004179 /end MEASUREMENT
/begin MEASUREMENT Low_Cell_Temp_2_BMU_Index "" UBYTE VBU0513_CM_uint8 0 0 0 255 ECU_ADDRESS 0x9000417a /end MEASUREMENT
/begin MEASUREMENT Low_Cell_Temp_3_BMU_ID "" UBYTE VBU0513_CM_uint8 0 0 0 255 ECU_ADDRESS 0x9000417b /end MEASUREMENT
/begin MEASUREMENT Low_Cell_Temp_3_BMU_Index "" UBYTE VBU0513_CM_uint8 0 0 0 255 ECU_ADDRESS 0x9000417c /end MEASUREMENT
/begin MEASUREMENT High_Cell_Temp_5_BMU_ID "" UBYTE VBU0513_CM_uint8 0 0 0 255 ECU_ADDRESS 0x9000415e /end MEASUREMENT
/begin MEASUREMENT High_Cell_Temp_5_BMU_Index "" UBYTE VBU0513_CM_uint8 0 0 0 255 ECU_ADDRESS 0x9000415f /end MEASUREMENT
/begin MEASUREMENT Low_Cell_Temp_1_BMU_ID "" UBYTE VBU0513_CM_uint8 0 0 0 255 ECU_ADDRESS 0x90004177 /end MEASUREMENT
/begin MEASUREMENT Low_Cell_Temp_1_BMU_Index "" UBYTE VBU0513_CM_uint8 0 0 0 255 ECU_ADDRESS 0x90004178 /end MEASUREMENT
/begin MEASUREMENT High_Cell_Temp_3_BMU_ID "" UBYTE VBU0513_CM_uint8 0 0 0 255 ECU_ADDRESS 0x9000415a /end MEASUREMENT
/begin MEASUREMENT High_Cell_Temp_3_BMU_Index "" UBYTE VBU0513_CM_uint8 0 0 0 255 ECU_ADDRESS 0x9000415b /end MEASUREMENT
/begin MEASUREMENT High_Cell_Temp_4_BMU_ID "" UBYTE VBU0513_CM_uint8 0 0 0 255 ECU_ADDRESS 0x9000415c /end MEASUREMENT
/begin MEASUREMENT High_Cell_Temp_4_BMU_Index "" UBYTE VBU0513_CM_uint8 0 0 0 255 ECU_ADDRESS 0x9000415d /end MEASUREMENT
/begin MEASUREMENT HCU_Statistics_State1_Heart "" UBYTE VBU0513_CM_uint8 0 0 0 255 ECU_ADDRESS 0x90004153 /end MEASUREMENT
/begin MEASUREMENT MaxTempBMU_ID "" UBYTE VBU0513_CM_uint8 0 0 0 255 ECU_ADDRESS 0x900041aa /end MEASUREMENT
/begin MEASUREMENT Max_Temp_BMU_index "" UBYTE VBU0513_CM_uint8 0 0 0 255 ECU_ADDRESS 0x900041ab /end MEASUREMENT
/begin MEASUREMENT Max_Temp_index "" UBYTE VBU0513_CM_uint8 0 0 0 255 ECU_ADDRESS 0x900041ac /end MEASUREMENT
/begin MEASUREMENT PWM_IN1_Duty "" UBYTE VBU0513_CM_uint8 0 0 0 255 ECU_ADDRESS 0x900041b8 /end MEASUREMENT
/begin MEASUREMENT PWM_IN2_Duty "" UBYTE VBU0513_CM_uint8 0 0 0 255 ECU_ADDRESS 0x900041ba /end MEASUREMENT
/begin MEASUREMENT HCU_Message_6_Heart "" UBYTE VBU0513_CM_uint8 0 0 0 255 ECU_ADDRESS 0x90004151 /end MEASUREMENT
/begin MEASUREMENT HCU_Message_5_Heart "" UBYTE VBU0513_CM_uint8 0 0 0 255 ECU_ADDRESS 0x90004150 /end MEASUREMENT
/begin MEASUREMENT Insulation_State "" UBYTE VBU0513_CM_uint8 0 0 0 255 ECU_ADDRESS 0x9000416e /end MEASUREMENT
/begin MEASUREMENT Self_Lock_State "" UBYTE VBU0513_CM_uint8 0 0 0 255 ECU_ADDRESS 0x900041cd /end MEASUREMENT
/begin MEASUREMENT VCT_stBatteryAbnormalAlarm1 "" UBYTE VBU0513_CM_uint8 0 0 0 255 ECU_ADDRESS 0x9000423d /end MEASUREMENT
/begin MEASUREMENT VCT_stBatteryAbnormalAlarm2 "" UBYTE VBU0513_CM_uint8 0 0 0 255 ECU_ADDRESS 0x9000423e /end MEASUREMENT
/begin MEASUREMENT VCT_stBatteryAbnormalAlarm3 "" UBYTE VBU0513_CM_uint8 0 0 0 255 ECU_ADDRESS 0x9000423f /end MEASUREMENT
/begin MEASUREMENT VCT_stCTDPrechargeTimeout "" UBYTE VBU0513_CM_uint8 0 0 0 255 ECU_ADDRESS 0x90004250 /end MEASUREMENT
/begin MEASUREMENT VCT_stCTDPrechargeEnergyHigh "" UBYTE VBU0513_CM_uint8 0 0 0 255 ECU_ADDRESS 0x9000424d /end MEASUREMENT
/begin MEASUREMENT VCT_stCTDPrechargeRelayBlown "" UBYTE VBU0513_CM_uint8 0 0 0 255 ECU_ADDRESS 0x9000424e /end MEASUREMENT
/begin MEASUREMENT VCT_stCTDPrechargeRelayStuckOpen "" UBYTE VBU0513_CM_uint8 0 0 0 255 ECU_ADDRESS 0x9000424f /end MEASUREMENT
/begin MEASUREMENT VCT_stCTDMnPosContactorWeld "" UBYTE VBU0513_CM_uint8 0 0 0 255 ECU_ADDRESS 0x9000424c /end MEASUREMENT
/begin MEASUREMENT VCT_stCTDMnNegContactorWeld "" UBYTE VBU0513_CM_uint8 0 0 0 255 ECU_ADDRESS 0x9000424b /end MEASUREMENT
/begin MEASUREMENT SOC_stBatterySocJump "" UBYTE VBU0513_CM_uint8 0 0 0 255 ECU_ADDRESS 0x900042b7 /end MEASUREMENT
/begin MEASUREMENT PWM_IN1_Freq "" UBYTE VBU0513_CM_ufix8_S10 0 0 0 2550.0 ECU_ADDRESS 0x900041b9 /end MEASUREMENT
/begin MEASUREMENT PWM_IN2_Freq "" UBYTE VBU0513_CM_ufix8_S10 0 0 0 2550.0 ECU_ADDRESS 0x900041bb /end MEASUREMENT
/begin MEASUREMENT Temperature_17 "" UBYTE VBU0513_CM_ufix8_Bn40 0 0 -40.0 215.0 ECU_ADDRESS 0x900041ea /end MEASUREMENT
/begin MEASUREMENT Temperature_18 "" UBYTE VBU0513_CM_ufix8_Bn40 0 0 -40.0 215.0 ECU_ADDRESS 0x900041eb /end MEASUREMENT
/begin MEASUREMENT Temperature_19 "" UBYTE VBU0513_CM_ufix8_Bn40 0 0 -40.0 215.0 ECU_ADDRESS 0x900041ec /end MEASUREMENT
/begin MEASUREMENT Temperature_20 "" UBYTE VBU0513_CM_ufix8_Bn40 0 0 -40.0 215.0 ECU_ADDRESS 0x900041ee /end MEASUREMENT
/begin MEASUREMENT Temperature_21 "" UBYTE VBU0513_CM_ufix8_Bn40 0 0 -40.0 215.0 ECU_ADDRESS 0x900041ef /end MEASUREMENT
/begin MEASUREMENT Temperature_22 "" UBYTE VBU0513_CM_ufix8_Bn40 0 0 -40.0 215.0 ECU_ADDRESS 0x900041f0 /end MEASUREMENT
/begin MEASUREMENT Temperature_23 "" UBYTE VBU0513_CM_ufix8_Bn40 0 0 -40.0 215.0 ECU_ADDRESS 0x900041f1 /end MEASUREMENT
/begin MEASUREMENT Temperature_24 "" UBYTE VBU0513_CM_ufix8_Bn40 0 0 -40.0 215.0 ECU_ADDRESS 0x900041f2 /end MEASUREMENT
/begin MEASUREMENT Temp_HCU_3 "" UBYTE VBU0513_CM_ufix8_Bn40 0 0 -40.0 215.0 ECU_ADDRESS 0x900041d9 /end MEASUREMENT
/begin MEASUREMENT Temp_HCU_4 "" UBYTE VBU0513_CM_ufix8_Bn40 0 0 -40.0 215.0 ECU_ADDRESS 0x900041da /end MEASUREMENT
/begin MEASUREMENT Temp_HCU_5 "" UBYTE VBU0513_CM_ufix8_Bn40 0 0 -40.0 215.0 ECU_ADDRESS 0x900041db /end MEASUREMENT
/begin MEASUREMENT Temp_HCU_6 "" UBYTE VBU0513_CM_ufix8_Bn40 0 0 -40.0 215.0 ECU_ADDRESS 0x900041dc /end MEASUREMENT
/begin MEASUREMENT Temp_HCU_7 "" UBYTE VBU0513_CM_ufix8_Bn40 0 0 -40.0 215.0 ECU_ADDRESS 0x900041dd /end MEASUREMENT
/begin MEASUREMENT Temp_HCU_8 "" UBYTE VBU0513_CM_ufix8_Bn40 0 0 -40.0 215.0 ECU_ADDRESS 0x900041de /end MEASUREMENT
/begin MEASUREMENT Temp_HCU_Water_Inlet "" UBYTE VBU0513_CM_ufix8_Bn40 0 0 -40.0 215.0 ECU_ADDRESS 0x900041df /end MEASUREMENT
/begin MEASUREMENT Temp_HCU_Water_Outlet "" UBYTE VBU0513_CM_ufix8_Bn40 0 0 -40.0 215.0 ECU_ADDRESS 0x900041e0 /end MEASUREMENT
/begin MEASUREMENT Temperature_10 "" UBYTE VBU0513_CM_ufix8_Bn40 0 0 -40.0 215.0 ECU_ADDRESS 0x900041e3 /end MEASUREMENT
/begin MEASUREMENT Temperature_11 "" UBYTE VBU0513_CM_ufix8_Bn40 0 0 -40.0 215.0 ECU_ADDRESS 0x900041e4 /end MEASUREMENT
/begin MEASUREMENT Temperature_12 "" UBYTE VBU0513_CM_ufix8_Bn40 0 0 -40.0 215.0 ECU_ADDRESS 0x900041e5 /end MEASUREMENT
/begin MEASUREMENT Temperature_13 "" UBYTE VBU0513_CM_ufix8_Bn40 0 0 -40.0 215.0 ECU_ADDRESS 0x900041e6 /end MEASUREMENT
/begin MEASUREMENT Temperature_14 "" UBYTE VBU0513_CM_ufix8_Bn40 0 0 -40.0 215.0 ECU_ADDRESS 0x900041e7 /end MEASUREMENT
/begin MEASUREMENT Temperature_15 "" UBYTE VBU0513_CM_ufix8_Bn40 0 0 -40.0 215.0 ECU_ADDRESS 0x900041e8 /end MEASUREMENT
/begin MEASUREMENT Temperature_16 "" UBYTE VBU0513_CM_ufix8_Bn40 0 0 -40.0 215.0 ECU_ADDRESS 0x900041e9 /end MEASUREMENT
/begin MEASUREMENT Temperature_9 "" UBYTE VBU0513_CM_ufix8_Bn40 0 0 -40.0 215.0 ECU_ADDRESS 0x90004209 /end MEASUREMENT
/begin MEASUREMENT Ave_Temp "" UBYTE VBU0513_CM_ufix8_Bn40 0 0 -40.0 215.0 ECU_ADDRESS 0x900040d4 /end MEASUREMENT
/begin MEASUREMENT Board_Temp "" UBYTE VBU0513_CM_ufix8_Bn40 0 0 -40.0 215.0 ECU_ADDRESS 0x900040f7 /end MEASUREMENT
/begin MEASUREMENT Temperature_1 "" UBYTE VBU0513_CM_ufix8_Bn40 0 0 -40.0 215.0 ECU_ADDRESS 0x900041e2 /end MEASUREMENT
/begin MEASUREMENT Temperature_2 "" UBYTE VBU0513_CM_ufix8_Bn40 0 0 -40.0 215.0 ECU_ADDRESS 0x900041ed /end MEASUREMENT
/begin MEASUREMENT Temperature_3 "" UBYTE VBU0513_CM_ufix8_Bn40 0 0 -40.0 215.0 ECU_ADDRESS 0x900041f8 /end MEASUREMENT
/begin MEASUREMENT Temperature_4 "" UBYTE VBU0513_CM_ufix8_Bn40 0 0 -40.0 215.0 ECU_ADDRESS 0x90004203 /end MEASUREMENT
/begin MEASUREMENT Temperature_5 "" UBYTE VBU0513_CM_ufix8_Bn40 0 0 -40.0 215.0 ECU_ADDRESS 0x90004205 /end MEASUREMENT
/begin MEASUREMENT Temperature_6 "" UBYTE VBU0513_CM_ufix8_Bn40 0 0 -40.0 215.0 ECU_ADDRESS 0x90004206 /end MEASUREMENT
/begin MEASUREMENT Temperature_7 "" UBYTE VBU0513_CM_ufix8_Bn40 0 0 -40.0 215.0 ECU_ADDRESS 0x90004207 /end MEASUREMENT
/begin MEASUREMENT Temperature_8 "" UBYTE VBU0513_CM_ufix8_Bn40 0 0 -40.0 215.0 ECU_ADDRESS 0x90004208 /end MEASUREMENT
/begin MEASUREMENT LEM_stFaultInfor "" UBYTE VBU0513_CM_ufix7 0 0 0 127.0 ECU_ADDRESS 0x90004170 /end MEASUREMENT
/begin MEASUREMENT Power_Supply_Error_lev "" UBYTE VBU0513_CM_ufix2 0 0 0 3.0 ECU_ADDRESS 0x900041bf /end MEASUREMENT
/begin MEASUREMENT LEM_CurrentSensorInvalid "" UBYTE VBU0513_CM_ufix1 0 0 0 1.0 ECU_ADDRESS 0x9000416f /end MEASUREMENT
/begin MEASUREMENT ADS_Error_1 "" UBYTE VBU0513_CM_ufix1 0 0 0 1.0 ECU_ADDRESS 0x900040d1 /end MEASUREMENT
/begin MEASUREMENT ADS_Error_2 "" UBYTE VBU0513_CM_ufix1 0 0 0 1.0 ECU_ADDRESS 0x900040d2 /end MEASUREMENT
/begin MEASUREMENT Comm_Error "" UBYTE VBU0513_CM_ufix1 0 0 0 1.0 ECU_ADDRESS 0x90004119 /end MEASUREMENT
/begin MEASUREMENT Power_5V_High_Error "" UBYTE VBU0513_CM_ufix1 0 0 0 1.0 ECU_ADDRESS 0x900041bd /end MEASUREMENT
/begin MEASUREMENT Power_5V_Low_Error "" UBYTE VBU0513_CM_ufix1 0 0 0 1.0 ECU_ADDRESS 0x900041be /end MEASUREMENT
/begin MEASUREMENT Self_Test "" UBYTE VBU0513_CM_ufix1 0 0 0 1.0 ECU_ADDRESS 0x900041ce /end MEASUREMENT
/begin MEASUREMENT Temp_Line_Error "" UBYTE VBU0513_CM_ufix1 0 0 0 1.0 ECU_ADDRESS 0x900041e1 /end MEASUREMENT
/begin MEASUREMENT Volt_Line_Error "" UBYTE VBU0513_CM_ufix1 0 0 0 1.0 ECU_ADDRESS 0x90004257 /end MEASUREMENT
/begin MEASUREMENT THM_flgSystemCoolingAbilityDecrease "" UBYTE VBU0513_CM_boolean 0 0 0 1 ECU_ADDRESS 0x900041d1 /end MEASUREMENT
/begin MEASUREMENT SOF_flgCurrentLimitTargetCalculateEnable "" UBYTE VBU0513_CM_boolean 0 0 0 1 ECU_ADDRESS 0x90004072 /end MEASUREMENT
/begin MEASUREMENT SOC_flgInternalResistanceCausedDevCellVoltage "" UBYTE VBU0513_CM_boolean 0 0 0 1 ECU_ADDRESS 0x900042b5 /end MEASUREMENT
/begin MEASUREMENT SOC_flgFastChargeCorrectionEnable "" UBYTE VBU0513_CM_boolean 0 0 0 1 ECU_ADDRESS 0x900042b4 /end MEASUREMENT
/begin MEASUREMENT LbSOC_EolFlashingInitialize_flg "" UBYTE VBU0513_CM_boolean 0 0 0 1 ECU_ADDRESS 0x900042ad /end MEASUREMENT
/begin MEASUREMENT SOC_flgCellSOCArrayInvalid "" UBYTE VBU0513_CM_boolean 0 0 0 1 ECU_ADDRESS 0x900042b3 /end MEASUREMENT
/begin COMPU_METHOD VBU0513_CM_single_cnt "Q = V" RAT_FUNC "%8.6" "cnt" COEFFS 0 1 0 0 0 1 /end COMPU_METHOD
/begin COMPU_METHOD VBU0513_CM_uint16_cnt "Q = V" RAT_FUNC "%5.0" "cnt" COEFFS 0 1 0 0 0 1 /end COMPU_METHOD
/begin COMPU_METHOD VBU0513_CM_single_pct "Q = V" RAT_FUNC "%8.6" "pct" COEFFS 0 1 0 0 0 1 /end COMPU_METHOD
/begin COMPU_METHOD VBU0513_CM_single_v "Q = V" RAT_FUNC "%8.6" "v" COEFFS 0 1 0 0 0 1 /end COMPU_METHOD
/begin COMPU_METHOD VBU0513_CM_single_t "Q = V" RAT_FUNC "%8.6" "t" COEFFS 0 1 0 0 0 1 /end COMPU_METHOD
/begin COMPU_METHOD VBU0513_CM_single_A "Q = V" RAT_FUNC "%8.6" "A" COEFFS 0 1 0 0 0 1 /end COMPU_METHOD
/begin COMPU_METHOD VBU0513_CM_uint8 "Q = V" RAT_FUNC "%3.0" "" COEFFS 0 1 0 0 0 1 /end COMPU_METHOD
/begin COMPU_METHOD VBU0513_CM_single_V "Q = V" RAT_FUNC "%8.6" "V" COEFFS 0 1 0 0 0 1 /end COMPU_METHOD
/begin COMPU_METHOD VBU0513_CM_uint16 "Q = V" RAT_FUNC "%5.0" "" COEFFS 0 1 0 0 0 1 /end COMPU_METHOD
/begin COMPU_METHOD VBU0513_CM_single "Q = V" RAT_FUNC "%8.6" "" COEFFS 0 1 0 0 0 1 /end COMPU_METHOD
/begin COMPU_METHOD VBU0513_CM_single_Ah "Q = V" RAT_FUNC "%8.6" "Ah" COEFFS 0 1 0 0 0 1 /end COMPU_METHOD
/begin COMPU_METHOD VBU0513_CM_single_Kw "Q = V" RAT_FUNC "%8.6" "Kw" COEFFS 0 1 0 0 0 1 /end COMPU_METHOD
/begin COMPU_METHOD VBU0513_CM_single_min "Q = V" RAT_FUNC "%8.6" "min" COEFFS 0 1 0 0 0 1 /end COMPU_METHOD
/begin COMPU_METHOD VBU0513_CM_single_Kohm "Q = V" RAT_FUNC "%8.6" "Kohm" COEFFS 0 1 0 0 0 1 /end COMPU_METHOD
/begin COMPU_METHOD VBU0513_CM_single_Kwh "Q = V" RAT_FUNC "%8.6" "Kwh" COEFFS 0 1 0 0 0 1 /end COMPU_METHOD
/begin COMPU_METHOD VBU0513_CM_single_flg "Q = V" RAT_FUNC "%8.6" "flg" COEFFS 0 1 0 0 0 1 /end COMPU_METHOD
/begin COMPU_METHOD VBU0513_CM_uint32_cnt "Q = V" RAT_FUNC "%10.0" "cnt" COEFFS 0 1 0 0 0 1 /end COMPU_METHOD
/begin COMPU_METHOD VBU0513_CM_uint32 "Q = V" RAT_FUNC "%10.0" "" COEFFS 0 1 0 0 0 1 /end COMPU_METHOD
/begin COMPU_METHOD VBU0513_CM_uint32_n "Q = V" RAT_FUNC "%10.0" "n" COEFFS 0 1 0 0 0 1 /end COMPU_METHOD
/begin COMPU_METHOD VBU0513_CM_boolean_flg "Q = V" RAT_FUNC "%1.0" "flg" COEFFS 0 1 0 0 0 1 /end COMPU_METHOD
/begin COMPU_METHOD VBU0513_CM_boolean_cnt "Q = V" RAT_FUNC "%1.0" "cnt" COEFFS 0 1 0 0 0 1 /end COMPU_METHOD
/begin COMPU_METHOD VBU0513_CM_boolean "Q = V" RAT_FUNC "%1.0" "" COEFFS 0 1 0 0 0 1 /end COMPU_METHOD
/begin COMPU_METHOD VBU0513_CM_int8_cnt "Q = V" RAT_FUNC "%3.0" "cnt" COEFFS 0 1 0 0 0 1 /end COMPU_METHOD
/begin COMPU_METHOD VBU0513_CM_uint8_cnt "Q = V" RAT_FUNC "%3.0" "cnt" COEFFS 0 1 0 0 0 1 /end COMPU_METHOD
/begin COMPU_METHOD VBU0513_CM_uint8_n "Q = V" RAT_FUNC "%3.0" "n" COEFFS 0 1 0 0 0 1 /end COMPU_METHOD
/begin COMPU_METHOD VBU0513_CM_uint8_enum "Q = V" RAT_FUNC "%3.0" "enum" COEFFS 0 1 0 0 0 1 /end COMPU_METHOD
/begin COMPU_METHOD VBU0513_CM_ufix32_Bn2147483648 "Q = (V+2147483648.000000)/1.000000" RAT_FUNC "%0.6" "" COEFFS 0 1.000000 2147483648.000000 0 0 1.000000 /end COMPU_METHOD
/begin COMPU_METHOD VBU0513_CM_ufix24 "Q = V/1.000000" RAT_FUNC "%10.0" "" COEFFS 0 1.000000 0.000000 0 0 1.000000 /end COMPU_METHOD
/begin COMPU_METHOD VBU0513_CM_ufix16_Sp1_Bn40 "Q = (V+40.000000)*10.000000" RAT_FUNC "%0.6" "" COEFFS 0 10.000000 400.000000 0 0 1.000000 /end COMPU_METHOD
/begin COMPU_METHOD VBU0513_CM_ufix16_Sp1 "Q = V*10.000000" RAT_FUNC "%0.6" "" COEFFS 0 10.000000 0.000000 0 0 1.000000 /end COMPU_METHOD
/begin COMPU_METHOD VBU0513_CM_ufix8_S10 "Q = V/10.000000" RAT_FUNC "%0.6" "" COEFFS 0 1.000000 0.000000 0 0 10.000000 /end COMPU_METHOD
/begin COMPU_METHOD VBU0513_CM_ufix8_Bn40 "Q = (V+40.000000)/1.000000" RAT_FUNC "%0.6" "" COEFFS 0 1.000000 40.000000 0 0 1.000000 /end COMPU_METHOD
/begin COMPU_METHOD VBU0513_CM_ufix7 "Q = V/1.000000" RAT_FUNC "%3.0" "" COEFFS 0 1.000000 0.000000 0 0 1.000000 /end COMPU_METHOD
/begin COMPU_METHOD VBU0513_CM_ufix2 "Q = V/1.000000" RAT_FUNC "%3.0" "" COEFFS 0 1.000000 0.000000 0 0 1.000000 /end COMPU_METHOD
/begin COMPU_METHOD VBU0513_CM_ufix1 "Q = V/1.000000" RAT_FUNC "%3.0" "" COEFFS 0 1.000000 0.000000 0 0 1.000000 /end COMPU_METHOD
/begin GROUP S966_NoJumpSOC_Driving_Calculation "VBU0513/VBUSystem/BMS/SOC/Subsystem5/Subsystem/Determine_Display_SOC/NoJumpSOC_Driving_Calculation" /begin REF_CHARACTERISTIC CcSOC_NoJumpSocChargeRate_pct /end REF_CHARACTERISTIC /end GROUP
/begin GROUP S966_NoJumpSOC_Startup_Calculation "VBU0513/VBUSystem/BMS/SOC/Subsystem5/Subsystem/Determine_Display_SOC/NoJumpSOC_Startup_Calculation" /begin REF_CHARACTERISTIC CbSOC_ReadMemorySOCEnable_flg /end REF_CHARACTERISTIC /end GROUP
/begin GROUP S967_Determine_FastChargeCorrectionEnable "VBU0513/VBUSystem/BMS/SOC/Subsystem5/Subsystem/Determine_FastChargeCorrection_Soc/Determine_FastChargeCorrectionEnable"
 /begin REF_CHARACTERISTIC CcSOC_BatteryPolarizationMaxTime_ms CcSOC_CCCorrectionDisableTem_C CcSOC_CCCorrectionEnableTem_C CcSOC_CorrectionEnableCellVoltageDeviation_mV /end REF_CHARACTERISTIC
 /begin REF_MEASUREMENT SOC_flgFastChargeCorrectionEnable /end REF_MEASUREMENT
/end GROUP
/begin GROUP S967_Determine_InternalResistanceCausedDevCellVoltage "VBU0513/VBUSystem/BMS/SOC/Subsystem5/Subsystem/Determine_FastChargeCorrection_Soc/Determine_InternalResistanceCausedDevCellVoltage"
 /begin REF_CHARACTERISTIC CcSOC_OneThirdRateDeviationCellVoltage_mV CcSOC_RelaxationDeviationCellVoltage_mV /end REF_CHARACTERISTIC
 /begin REF_MEASUREMENT SOC_flgInternalResistanceCausedDevCellVoltage /end REF_MEASUREMENT
/end GROUP
/begin GROUP S967_FastCharge_DynamicCorrection "VBU0513/VBUSystem/BMS/SOC/Subsystem5/Subsystem/Determine_FastChargeCorrection_Soc/FastCharge_DynamicCorrection" /begin SUB_GROUP S1045_FastCharge_DynamicCorrection_Enable /end SUB_GROUP /end GROUP
/begin GROUP S967_FastCharge_PreCorrection "VBU0513/VBUSystem/BMS/SOC/Subsystem5/Subsystem/Determine_FastChargeCorrection_Soc/FastCharge_PreCorrection"
 /begin SUB_GROUP S1046_Calculate_WindowAverage_BatteryCurrent S1046_FastCharge_PreCorrectionMain /end SUB_GROUP
 /begin REF_CHARACTERISTIC CcSOC_CCCorrectionDisableTem_C CcSOC_CCCorrectionEnableTem_C CcSOC_FastChargeTOCCurrentThld_A CcSOC_FastChargeTOCCurrentTime_ms /end REF_CHARACTERISTIC
/end GROUP
/begin GROUP S967_FastCharge_TopofChargeCorrection "VBU0513/VBUSystem/BMS/SOC/Subsystem5/Subsystem/Determine_FastChargeCorrection_Soc/FastCharge_TopofChargeCorrection"
 /begin SUB_GROUP S1047_Calculate_WindowAverage_BatteryCurrent S1047_FastCharge_TOCAdjustAllSOC S1047_RiseEdge /end SUB_GROUP
 /begin REF_CHARACTERISTIC CcSOC_CCCorrectionDisableTem_C CcSOC_CCCorrectionEnableTem_C CcSOC_FastChargeTOCCurrentThld_A CcSOC_FastChargeTOCCurrentTime_ms CcSOC_FastChargeTOCVoltageThld_mV CcSOC_FastChargeTOCVoltageTime_ms /end REF_CHARACTERISTIC
/end GROUP
/begin GROUP S968_CellSOC_Startup_AbnormalPoweroff "VBU0513/VBUSystem/BMS/SOC/Subsystem5/Subsystem/Determine_Initial_SoC/CellSOC_Startup_AbnormalPoweroff" /begin REF_CHARACTERISTIC CbSOC_ForceOcvSocInitialize_flg CcSOC_CellSocDefault_pct /end REF_CHARACTERISTIC /end GROUP
/begin GROUP S968_CellSOC_Startup_AbnormalReset "VBU0513/VBUSystem/BMS/SOC/Subsystem5/Subsystem/Determine_Initial_SoC/CellSOC_Startup_AbnormalReset" /begin SUB_GROUP S1082_Battery_SOC_Calculation /end SUB_GROUP
 /begin REF_CHARACTERISTIC CbSOC_ForceOcvSocInitialize_flg CcSOC_MaxAllowSOCDeviation_pct /end REF_CHARACTERISTIC
 /begin REF_MEASUREMENT SOC_flgCellSOCArrayInvalid SOC_pctCellBatterySOCDeviation /end REF_MEASUREMENT
/end GROUP
/begin GROUP S968_CellSOC_Startup_EolFlashing "VBU0513/VBUSystem/BMS/SOC/Subsystem5/Subsystem/Determine_Initial_SoC/CellSOC_Startup_EolFlashing" /begin REF_CHARACTERISTIC CcSOC_CellSocDefault_pct /end REF_CHARACTERISTIC /end GROUP
/begin GROUP S968_CellSOC_Startup_Normal "VBU0513/VBUSystem/BMS/SOC/Subsystem5/Subsystem/Determine_Initial_SoC/CellSOC_Startup_Normal" /begin SUB_GROUP S1084_Battery_SOC_Calculation /end SUB_GROUP
 /begin REF_CHARACTERISTIC CbSOC_ForceOcvSocInitialize_flg CcSOC_CellSocDefault_pct CcSOC_MaxAllowSOCDeviation_pct /end REF_CHARACTERISTIC
/end GROUP
/begin GROUP S968_Determine_EOL_Flashing "VBU0513/VBUSystem/BMS/SOC/Subsystem5/Subsystem/Determine_Initial_SoC/Determine_EOL_Flashing" /begin REF_MEASUREMENT LbSOC_EolFlashingInitialize_flg /end REF_MEASUREMENT /end GROUP
/begin GROUP S968_Determine_Soc_Jump "VBU0513/VBUSystem/BMS/SOC/Subsystem5/Subsystem/Determine_Initial_SoC/Determine_Soc_Jump" /begin SUB_GROUP S1086_After_Startup S1086_Startup /end SUB_GROUP /begin REF_MEASUREMENT SOC_stBatterySocJump /end REF_MEASUREMENT /end GROUP
/begin GROUP S970_Replace_Invalid_CellTemperature "VBU0513/VBUSystem/BMS/SOC/Subsystem5/Subsystem/Determine_OcvSoc/Replace_Invalid_CellTemperature" /begin SUB_GROUP S1110_Calculate_Cell_Temperature /end SUB_GROUP /end GROUP
/begin GROUP S970_Replace_Invalid_CellVoltage "VBU0513/VBUSystem/BMS/SOC/Subsystem5/Subsystem/Determine_OcvSoc/Replace_Invalid_CellVoltage"
 /begin REF_CHARACTERISTIC CaSOC_OcvSocMapDimension_n CaSOC_OcvSocMapZ_pct CcSOC_OcvCorrectionCVLowThld_mV CcSOC_OcvCorrectionCVUpThld_mV CcSOC_OcvCorrectionTempThld_C /end REF_CHARACTERISTIC
 /begin REF_MEASUREMENT LaSOC_OcvSoc_pct /end REF_MEASUREMENT
/end GROUP
/begin GROUP S971_Current_Limit_Condition "VBU0513/VBUSystem/BMS/SOC/Subsystem5/Subsystem/Determine_ShortTimeCorrection_Condition/Current_Limit_Condition" /begin SUB_GROUP S1115_Current_Limit /end SUB_GROUP /end GROUP
/begin GROUP S974_Data_Storage "VBU0513/VBUSystem/BMS/SOC/Subsystem5/Subsystem/Soc_Data_Storage/Data_Storage"
 /begin REF_CHARACTERISTIC CbSOC_BatterySOCOvrdFlg_flg CcSOC_BatteryDisplaySocUpdateDelta_pct CcSOC_BatterySOCOvrdVal_pct CcSOC_BatterySocUpdateDelta_pct CcSOC_CellSOCStorageTime_ms CcSOC_CellSocMaxOverrunLimit_pct CcSOC_CellSocMinOverrunLimit_pct /end REF_CHARACTERISTIC
/end GROUP
/begin GROUP S1137_Determine_History_Current_Data "VBU0513/VBUSystem/BMS/SOE/Subsystem2/Subsystem/Calculate_History_Average_Current/Determine_History_Current_Data"
 /begin REF_CHARACTERISTIC CaSOE_InvalidHistoryCurrentData_A CcSOE_HistoryAveCurrentTimeIntervalNumber_n CcSOE_HistoryAveCurrentTotalTime_s CcSOE_HistoryCurrentDataDimension_n /end REF_CHARACTERISTIC
/end GROUP
/begin GROUP S1137_Time_Counter "VBU0513/VBUSystem/BMS/SOE/Subsystem2/Subsystem/Calculate_History_Average_Current/Time_Counter"
 /begin REF_CHARACTERISTIC CcSOE_HistoryAveCurrentTimeIntervalNumber_n CcSOE_HistoryAveCurrentTotalTime_s /end REF_CHARACTERISTIC
/end GROUP
/begin GROUP S1138_Charge_and_Idle_Mode "VBU0513/VBUSystem/BMS/SOE/Subsystem2/Subsystem/Calculate_Pack_Remaining_Energy/Charge_and_Idle_Mode" /begin REF_CHARACTERISTIC CcSOE_CellEnergyBoL_Kwh /end REF_CHARACTERISTIC /end GROUP
/begin GROUP S1138_Discharge_Mode "VBU0513/VBUSystem/BMS/SOE/Subsystem2/Subsystem/Calculate_Pack_Remaining_Energy/Discharge_Mode"
 /begin SUB_GROUP S1149_Calculate_Energy_Retention_Factor S1149_Calculate_Remaining_Energy S1149_Predict_SOC_End /end SUB_GROUP
 /begin REF_CHARACTERISTIC CcSOE_CellSocDelta_pct CcSOE_CellSocEndPredictUpperLimit_pct /end REF_CHARACTERISTIC
/end GROUP
/begin GROUP S1141_Rate_Limiter_Reset1 "VBU0513/VBUSystem/BMS/SOE/Subsystem2/Subsystem/Rate_Limit_and_Output_SOC/Rate_Limiter_Reset1" /begin REF_MEASUREMENT SOE_kwhPackRemainingEnergySoc /end REF_MEASUREMENT /end GROUP
/begin GROUP S1190_Calculate_Pack_OCV "VBU0513/VBUSystem/BMS/SOF/Subsystem6/Subsystem/Calculate_PowerLimit/Calculate_Pack_OCV" /begin SUB_GROUP S1196_Calculate_Locked_SOC S1196_Rate_Limiter /end SUB_GROUP
 /begin REF_CHARACTERISTIC CaSOF_mvChargeOcvSocTempMap_v CaSOF_mvDischargeOcvSocTempMap_v CcSOF_DischargeOCVInLowSOCforPowerLimit_V CcSOF_PowerOnDiscOcvSloDelay_ms CcSOF_SOCLowValueForConstantOCV_pct /end REF_CHARACTERISTIC
 /begin REF_MEASUREMENT SOF_uPackChargeOcv SOF_uPackDischargeOcv /end REF_MEASUREMENT
/end GROUP
/begin GROUP S1190_Determine_Capacity_Cycle_PowerLimit "VBU0513/VBUSystem/BMS/SOF/Subsystem6/Subsystem/Calculate_PowerLimit/Determine_Capacity_Cycle_PowerLimit"
 /begin SUB_GROUP S1197_Power_Limit_Cycle_Level1 S1197_Power_Limit_Cycle_Level2 S1197_Power_Limit_Cycle_Level3 /end SUB_GROUP
 /begin REF_CHARACTERISTIC CcSOF_BatteryCycleLevel1_n CcSOF_BatteryCycleLevel2_n /end REF_CHARACTERISTIC
 /begin REF_MEASUREMENT LcSOF_kwChargePowerLimitCycle /end REF_MEASUREMENT
/end GROUP
/begin GROUP S1190_Determine_SOCP_PowerLimit "VBU0513/VBUSystem/BMS/SOF/Subsystem6/Subsystem/Calculate_PowerLimit/Determine_SOCP_PowerLimit"
 /begin SUB_GROUP S1198_Calculate_Locked_SOC S1198_Determine_ContinuousDischargePowerLimitTarget S1198_Determine_DischargePowerLimitTarget /end SUB_GROUP
 /begin REF_CHARACTERISTIC CaSOF_SocpDischargeSocMinMapY_pct /end REF_CHARACTERISTIC
/end GROUP
/begin GROUP S1192_Calculate_CurrentLimit_Target "VBU0513/VBUSystem/BMS/SOF/Subsystem6/Subsystem/Determine_Currentlimit_Target/Calculate_CurrentLimit_Target"
 /begin SUB_GROUP S1228_Calculate_CurrentLimit_Base S1228_Calculate_Dynamic_CurrentLimit S1228_CurrentLimit_FastCharge_Check S1228_CurrentLimit_Fault_Correct S1228_CurrentLimit_Voltage_Correct /end SUB_GROUP
/end GROUP
/begin GROUP S1192_Determine_CurrentLimitTarget_Enable "VBU0513/VBUSystem/BMS/SOF/Subsystem6/Subsystem/Determine_Currentlimit_Target/Determine_CurrentLimitTarget_Enable" /begin REF_MEASUREMENT SOF_flgCurrentLimitTargetCalculateEnable /end REF_MEASUREMENT /end GROUP
/begin GROUP S1416_Calculate_CellCapacity "VBU0513/VBUSystem/BMS/SOH/Subsystem4/Subsystem1/Calculate_Capacity/Calculate_CellCapacity"
 /begin SUB_GROUP S1422_Caculate_CellCapacity_LifeTimeQ S1422_CellCapacity_Limit S1422_Determine_CellCapacity S1422_Determine_PackSoh S1422_PackSoh_Storage /end SUB_GROUP
/end GROUP
/begin GROUP S1416_Calculate_CellCapacity_SlowCharge "VBU0513/VBUSystem/BMS/SOH/Subsystem4/Subsystem1/Calculate_Capacity/Calculate_CellCapacity_SlowCharge"
 /begin SUB_GROUP S1423_Caculate_CellCapacity S1423_Determine_AhIntegral_DeltaQ S1423_Determine_Soc S1423_Determine_SocEndandCondition S1423_Determine_SocStart /end SUB_GROUP
/end GROUP
/begin GROUP S1416_Calculate_MinCellCapacity274_SlowCharge "VBU0513/VBUSystem/BMS/SOH/Subsystem4/Subsystem1/Calculate_Capacity/Calculate_MinCellCapacity274_SlowCharge" /begin REF_CHARACTERISTIC CcSOH_NotCalculatedSoh_pct /end REF_CHARACTERISTIC /end GROUP
/begin GROUP S1416_Determine_CalculateCellCapacity_Condition "VBU0513/VBUSystem/BMS/SOH/Subsystem4/Subsystem1/Calculate_Capacity/Determine_CalculateCellCapacity_Condition"
 /begin SUB_GROUP S1425_Determine_SlowCharge S1425_Determine_SlowChargeEnd S1425_Determine_SlowChargeStart /end SUB_GROUP
/end GROUP
/begin GROUP S1417_BasicCellResistance_Calculation_Check "VBU0513/VBUSystem/BMS/SOH/Subsystem4/Subsystem1/Calculate_Resistance/BasicCellResistance_Calculation_Check"
 /begin SUB_GROUP S1491_BeforStep_DuringStep_AfterStep_Check S1491_ResistanceCalc_Check /end SUB_GROUP
/end GROUP
/begin GROUP S1417_Caculate_CellResistance "VBU0513/VBUSystem/BMS/SOH/Subsystem4/Subsystem1/Calculate_Resistance/Caculate_CellResistance" /begin REF_CHARACTERISTIC CcSOH_ResistanceBase_mohm /end REF_CHARACTERISTIC /end GROUP
/begin GROUP S1417_Calculate_ModuleCurrent "VBU0513/VBUSystem/BMS/SOH/Subsystem4/Subsystem1/Calculate_Resistance/Calculate_ModuleCurrent" /begin SUB_GROUP S1493_CONTACTOR_STATUS_CLOSED /end SUB_GROUP /end GROUP
/begin GROUP S1417_Calculate_Relaxation_Average_CurrentVoltage "VBU0513/VBUSystem/BMS/SOH/Subsystem4/Subsystem1/Calculate_Resistance/Calculate_Relaxation_Average_CurrentVoltage" /begin SUB_GROUP S1494_CalCurrent_Data_BeforeStep /end SUB_GROUP /end GROUP
/begin GROUP S1417_Compute_Resistance_Request "VBU0513/VBUSystem/BMS/SOH/Subsystem4/Subsystem1/Calculate_Resistance/Compute_Resistance_Request"
 /begin REF_CHARACTERISTIC CbSOH_ComputeResistanceRequestORF_flg CbSOH_ComputeResistanceRequestORV_flg CcSOH_CellResistanceIncRatioUpdateTime_s CcSOH_ComputeResistanceUpdateCycle_n CcSOH_FastChargeFactor_n /end REF_CHARACTERISTIC
/end GROUP
/begin GROUP S1417_Determine_Condition_Calculate_Pulse_Average_CurrentVoltage "VBU0513/VBUSystem/BMS/SOH/Subsystem4/Subsystem1/Calculate_Resistance/Determine_Condition_Calculate_Pulse_Average_CurrentVoltage"
 /begin SUB_GROUP S1498_Calculate_Pulse_Average_CurrentVoltage S1498_Determine_Condition /end SUB_GROUP
/end GROUP
/begin GROUP S1420_CellCapacity_Diagnostic "VBU0513/VBUSystem/BMS/SOH/Subsystem4/Subsystem1/SOH_Diagnositic/CellCapacity_Diagnostic"
 /begin REF_CHARACTERISTIC CbSOH_CellCapacityLowFaultEnable_flg CbSOH_CellCapacityOverDeviationFaultEnable_flg CcSOH_CellCapacityLowFaultFIC_n CcSOH_CellCapacityLowFaultPIC_n CcSOH_CellCapacityLowFault_pct CcSOH_CellCapacityOverDeviationFaultFIC_n CcSOH_CellCapacityOverDeviationFaultPIC_n CcSOH_CellCapacityOverDeviationFault_Ah SOH_CELL_CAPACITY_LOW_FAULT SOH_CELL_CAPACITY_OVER_DEVIATION_FAULT /end REF_CHARACTERISTIC
/end GROUP
/begin GROUP S1420_CellResistanceIncRto_Diagnostic "VBU0513/VBUSystem/BMS/SOH/Subsystem4/Subsystem1/SOH_Diagnositic/CellResistanceIncRto_Diagnostic"
 /begin REF_CHARACTERISTIC CbSOH_CellResistanceHighFaultEnable_flg CcSOH_CellResistanceHighFaultFIC_n CcSOH_CellResistanceHighFaultPIC_n CcSOH_CellResistanceHighFault_pct SOH_CELL_RESISTANCE_HIGH_FAULT /end REF_CHARACTERISTIC
/end GROUP
/begin GROUP S1420_Monitor_SOH_Performance "VBU0513/VBUSystem/BMS/SOH/Subsystem4/Subsystem1/SOH_Diagnositic/Monitor_SOH_Performance" /begin REF_CHARACTERISTIC CcSOH_BDMOutputDelayTime_ms /end REF_CHARACTERISTIC /end GROUP
/begin GROUP S1547_Determine_CoolantSensorTemp_Validation "VBU0513/VBUSystem/BMS/THM/Subsystem/Subsystem/Calculate_PipeTemperature/Determine_CoolantSensorTemp_Validation"
 /begin SUB_GROUP S1557_Determine_InletTemp_Validation S1557_Determine_OutletTemp_Validation /end SUB_GROUP
 /begin REF_MEASUREMENT THM_tInletCoolantTemp THM_tOutletCoolantTemp /end REF_MEASUREMENT
/end GROUP
/begin GROUP S1548_FCC_Temp_Request "VBU0513/VBUSystem/BMS/THM/Subsystem/Subsystem/Charge_Mode_Temp_Request/FCC_Temp_Request"
 /begin REF_CHARACTERISTIC CaTHM_FccHighSocRequestTempMapZ_C CaTHM_FccSohFactorMapY_n CcTHM_ChargeTempRequestHighThreshold_C CcTHM_FccChargeTempRequestLowThreshold_C CcTHM_FccSohTempLowThreshold_C CcTHM_PackSohORF_flg CcTHM_PackSohORV_pct /end REF_CHARACTERISTIC
/end GROUP
/begin GROUP S1548_Invaild_Temp_Request "VBU0513/VBUSystem/BMS/THM/Subsystem/Subsystem/Charge_Mode_Temp_Request/Invaild_Temp_Request" /begin REF_CHARACTERISTIC CcTHM_InvaildTempRequest_C /end REF_CHARACTERISTIC /end GROUP
/begin GROUP S1548_OBC_Temp_Request "VBU0513/VBUSystem/BMS/THM/Subsystem/Subsystem/Charge_Mode_Temp_Request/OBC_Temp_Request" /begin SUB_GROUP S1569_Normal_Condition /end SUB_GROUP /end GROUP
/begin GROUP S1555_Delay_FallingEdge "VBU0513/VBUSystem/BMS/THM/Subsystem/Subsystem/Thermal_System_Damage_Judgement/Delay_FallingEdge" /begin REF_MEASUREMENT THM_flgSystemCoolingAbilityDecrease /end REF_MEASUREMENT /end GROUP
/begin GROUP S1556_FCC_Temp_Valid "VBU0513/VBUSystem/BMS/THM/Subsystem/Subsystem/Valid_Condition_Determination/FCC_Temp_Valid"
 /begin SUB_GROUP S1610_SOC_Hysteretic_Determination S1610_Temp_Hysteretic_Determination /end SUB_GROUP
/end GROUP
/begin GROUP S1556_OBC_Temp_Valid "VBU0513/VBUSystem/BMS/THM/Subsystem/Subsystem/Valid_Condition_Determination/OBC_Temp_Valid"
 /begin SUB_GROUP S1612_Hysteretic_Determination S1612_SOC_Hysteretic_Determination /end SUB_GROUP
/end GROUP
/begin GROUP S1621_Override "VBU0513/VBUSystem/BMS/VCT/Subsystem/Subsystem/Determine_BMS_VCU_267/Override"
 /begin SUB_GROUP S1637_LOW_HIGH1 S1637_LOW_HIGH17 S1637_LOW_HIGH2 S1637_LOW_HIGH3 S1637_LOW_HIGH4 S1637_LOW_HIGH5 S1637_LOW_HIGH7 /end SUB_GROUP
 /begin REF_CHARACTERISTIC CbVCT_BMSChgCurrentLimitORF_flg CbVCT_BMSDCChrgCrntReqORF_flg CbVCT_BMSDCChrgVoltageReqORF_flg CbVCT_BMSPackEnergyAvailableORF_flg CbVCT_CTMCellThermalRunawayORF_flg CbVCT_CTMCellThermalRunawayValidORF_flg CbVCT_CTMCellThermalRunawayValidORV_flg CbVCT_DCChargeModeORF_flg CcVCT_BMSChgCurrentLimitORV_A CcVCT_BMSDCChrgCrntReqORV_A CcVCT_BMSDCChrgVoltageReqORV_V CcVCT_BMSPackEnergyAvailableORV_Kwh CeVCT_CTMCellThermalRunawayORV_enum CeVCT_DCChargeModeORV_enum /end REF_CHARACTERISTIC
/end GROUP
/begin GROUP S1622_Override "VBU0513/VBUSystem/BMS/VCT/Subsystem/Subsystem/Determine_BMS_VCU_268/Override"
 /begin SUB_GROUP S1646_LOW_HIGH1 S1646_LOW_HIGH14 S1646_LOW_HIGH2 S1646_LOW_HIGH3 /end SUB_GROUP
 /begin REF_CHARACTERISTIC CbVCT_BMSDischgPowerLimitDynamicORF_flg CbVCT_BMSDischgPowerLimitLTORF_flg CbVCT_BMSDischgPowerLimitSTORF_flg CbVCT_BMSInsulationResistanceValueORF_flg CcVCT_BMSDischgPowerLimitDynamicORV_Kw CcVCT_BMSDischgPowerLimitLTIORV_Kw CcVCT_BMSDischgPowerLimitSTORV_Kw CcVCT_BMSInsulationResistanceValueORV_Kohm /end REF_CHARACTERISTIC
/end GROUP
/begin GROUP S1623_Override "VBU0513/VBUSystem/BMS/VCT/Subsystem/Subsystem/Determine_BMS_VCU_269/Override"
 /begin SUB_GROUP S1654_LOW_HIGH1 S1654_LOW_HIGH17 S1654_LOW_HIGH2 S1654_LOW_HIGH3 S1654_LOW_HIGH4 S1654_LOW_HIGH5 S1654_LOW_HIGH6 /end SUB_GROUP
 /begin REF_CHARACTERISTIC CbVCT_BMSCellVoltageAveORF_flg CbVCT_BMSCellVoltageAveValidityORF_flg CbVCT_BMSCellVoltageAveValidityORV_flg CbVCT_BMSCellVoltageMaxORF_flg CbVCT_BMSCellVoltageMaxValidityORF_flg CbVCT_BMSCellVoltageMaxValidityORV_flg CbVCT_BMSCellVoltageMinORF_flg CbVCT_BMSCellVoltageMinValidityORF_flg CbVCT_BMSCellVoltageMinValidityORV_flg CbVCT_BMSEstimateChargingTimeORF_flg CcVCT_BMSCellVoltageAveORV_V CcVCT_BMSCellVoltageMaxORV_V CcVCT_BMSCellVoltageMinORV_V CcVCT_BMSEstimateChargingTimeORV_min /end REF_CHARACTERISTIC
/end GROUP
/begin GROUP S1624_Override "VBU0513/VBUSystem/BMS/VCT/Subsystem/Subsystem/Determine_BMS_VCU_26A/Override"
 /begin SUB_GROUP S1662_LOW_HIGH1 S1662_LOW_HIGH14 S1662_LOW_HIGH2 S1662_LOW_HIGH3 /end SUB_GROUP
 /begin REF_CHARACTERISTIC CbVCT_BMSChgPowerLimitDynamicORF_flg CbVCT_BMSChgPowerLimitLTORF_flg CbVCT_BMSChgPowerLimitSTORF_flg CbVCT_EstimatePercTimeORF_flg CcVCT_BMSChgPowerLimitDynamicORV_Kw CcVCT_BMSChgPowerLimitLTORV_Kw CcVCT_BMSChgPowerLimitSTORV_Kw CcVCT_EstimatePercTimeORV_min /end REF_CHARACTERISTIC
/end GROUP
/begin GROUP S1625_Override "VBU0513/VBUSystem/BMS/VCT/Subsystem/Subsystem/Determine_BMS_VCU_26F/Override"
 /begin SUB_GROUP S1667_LOW_HIGH1 S1667_LOW_HIGH14 S1667_LOW_HIGH2 S1667_LOW_HIGH3 /end SUB_GROUP
 /begin REF_CHARACTERISTIC CbVCT_BMSBatteryRatedCapacityORF_flg CbVCT_BMSBatteryTypeORF_flg CbVCT_BMSMaxPermitDCChargeVoltageORF_flg CbVCT_BMSProtocalVersionORF_flg CcVCT_BMSBatteryRatedCapacityORV_Ah CcVCT_BMSMaxPermitDCChargeVoltageORV_V CcVCT_BMSProtocalVersionORV_n CeVCT_BMSBatteryTypeORV_enum /end REF_CHARACTERISTIC
/end GROUP
/begin GROUP S1626_Override "VBU0513/VBUSystem/BMS/VCT/Subsystem/Subsystem/Determine_BMS_VCU_270/Override"
 /begin SUB_GROUP S1673_LOW_HIGH1 S1673_LOW_HIGH14 S1673_LOW_HIGH2 S1673_LOW_HIGH3 /end SUB_GROUP
 /begin REF_CHARACTERISTIC CbVCT_BMSBatteryRatedVoltageORF_flg CbVCT_BMSDCChargingCurrentMeasurementORF_flg CbVCT_BMSDCChargingVoltageMeasurementORF_flg CbVCT_BMSReadyDCChargingORF_flg CcVCT_BMSBatteryRatedVoltageORV_V CcVCT_BMSDCChargingCurrentMeasurementORV_A CcVCT_BMSDCChargingVoltageMeasurementORV_V CcVCT_BMSReadyDCChargingORV_enum /end REF_CHARACTERISTIC
/end GROUP
/begin GROUP S1627_Override "VBU0513/VBUSystem/BMS/VCT/Subsystem/Subsystem/Determine_BMS_VCU_271/Override"
 /begin SUB_GROUP S1678_LOW_HIGH1 S1678_LOW_HIGH14 S1678_LOW_HIGH2 S1678_LOW_HIGH3 S1678_LOW_HIGH4 S1678_LOW_HIGH5 /end SUB_GROUP
 /begin REF_CHARACTERISTIC CbVCT_BMSDCChrgFinalSOCORF_flg CbVCT_BMSMaximumCellTempORF_flg CbVCT_BMSMaximumCellVoltageNumberORF_flg CbVCT_BMSMaximumTempNumberORF_flg CbVCT_BMSMinimumCellTempORF_flg CbVCT_BMSMinimumTempNumberORF_flg CcVCT_BMSDCChrgFinalSOCORV_pct CcVCT_BMSMaximumCellTempORV_C CcVCT_BMSMaximumCellVoltageNumberORV_n CcVCT_BMSMaximumTempNumberORV_n CcVCT_BMSMinimumCellTempORV_C CcVCT_BMSMinimumTempNumberORV_n /end REF_CHARACTERISTIC
/end GROUP
/begin GROUP S1628_Override "VBU0513/VBUSystem/BMS/VCT/Subsystem/Subsystem/Determine_BMS_VCU_272/Override"
 /begin SUB_GROUP S1686_LOW_HIGH1 S1686_LOW_HIGH10 S1686_LOW_HIGH11 S1686_LOW_HIGH12 S1686_LOW_HIGH13 S1686_LOW_HIGH14 S1686_LOW_HIGH16 S1686_LOW_HIGH17 S1686_LOW_HIGH18 S1686_LOW_HIGH2 S1686_LOW_HIGH3 S1686_LOW_HIGH4 S1686_LOW_HIGH5 S1686_LOW_HIGH6 S1686_LOW_HIGH7 S1686_LOW_HIGH8 S1686_LOW_HIGH9 /end SUB_GROUP
 /begin REF_CHARACTERISTIC CbVCT_BMSCellVoltageOverUnderORF_flg CbVCT_BMSDCChargeCurrentOverUnderORF_flg CbVCT_BMSSOCOverUnderORF_flg CbVCT_BatteryAbnormalAlarm1ORF_flg CbVCT_BatteryAbnormalAlarm1ORV_flg CbVCT_BatteryAbnormalAlarm2ORF_flg CbVCT_BatteryAbnormalAlarm2ORV_flg CbVCT_BatteryAbnormalAlarm3ORF_flg CbVCT_BatteryAbnormalAlarm3ORV_flg CbVCT_BatteryConsistencyAlarmORF_flg CbVCT_BatteryOutputConnectorStateORF_flg CbVCT_BatteryTempDifferAlarmORF_flg CbVCT_BatteryTempOverORF_flg CbVCT_BatteryTypeDismatchAlarmORF_flg CbVCT_BetteryCellTempHighAlarmORF_flg CbVCT_BetteryCellTempLowAlarmORF_flg CbVCT_BetteryCellVolHighAlarmORF_flg CbVCT_BetteryCellVolLowAlarmORF_flg CbVCT_BetteryPckVoltOverAlarmORF_flg CbVCT_BetteryPckVoltUnderAlarmORF_flg CbVCT_CTDMnNegContactorWeldORF_flg CbVCT_CTDMnPosContactorWeldORF_flg CbVCT_CTDPrechargeEnergyHighORF_flg CbVCT_CTDPrechargeRelayBlownORF_flg CbVCT_CTDPrechargeRelayStuckOpenORF_flg CbVCT_CTDPrechargeTimeoutORF_flg CbVCT_DCChargingPermitStatusORF_flg CbVCT_SOCJumpAlarmORF_flg CbVCT_SOCJumpReasonORF_flg CeVCT_BMSCellVoltageOverUnderORV_enum CeVCT_BMSDCChargeCurrentOverUnderORV_enum CeVCT_BMSSOCOverUnderORV_enum CeVCT_BatteryConsistencyAlarmORV_enum CeVCT_BatteryOutputConnectorStateORV_enum CeVCT_BatteryTempDifferAlarmORV_enum CeVCT_BatteryTempOverORV_enum CeVCT_BatteryTypeDismatchAlarmORV_enum CeVCT_BetteryCellTempHighAlarmORV_enum CeVCT_BetteryCellTempLowAlarmORV_enum CeVCT_BetteryCellVolHighAlarmORV_enum CeVCT_BetteryCellVolLowAlarmORV_enum CeVCT_BetteryPckVoltOverAlarmORV_enum CeVCT_BetteryPckVoltUnderAlarmORV_enum CeVCT_CTDMnNegContactorWeldORV_enum CeVCT_CTDMnPosContactorWeldORV_enum CeVCT_CTDPrechargeEnergyHighORV_enum CeVCT_CTDPrechargeRelayBlownORV_enum CeVCT_CTDPrechargeRelayStuckOpenORV_enum CeVCT_CTDPrechargeTimeoutORV_enum CeVCT_DCChargingPermitStatusORV_enum CeVCT_SOCJumpAlarmORV_enum CeVCT_SOCJumpReasonORV_enum /end REF_CHARACTERISTIC
 /begin REF_MEASUREMENT VCT_stBatteryAbnormalAlarm1 VCT_stBatteryAbnormalAlarm2 VCT_stBatteryAbnormalAlarm3 VCT_stCTDMnNegContactorWeld VCT_stCTDMnPosContactorWeld VCT_stCTDPrechargeEnergyHigh VCT_stCTDPrechargeRelayBlown VCT_stCTDPrechargeRelayStuckOpen VCT_stCTDPrechargeTimeout /end REF_MEASUREMENT
/end GROUP
/begin GROUP S1629_Override "VBU0513/VBUSystem/BMS/VCT/Subsystem/Subsystem/Determine_BMS_VCU_273/Override"
 /begin SUB_GROUP S1731_LOW_HIGH1 S1731_LOW_HIGH2 S1731_LOW_HIGH3 S1731_LOW_HIGH4 S1731_LOW_HIGH5 /end SUB_GROUP
 /begin REF_CHARACTERISTIC CbVCT_BMSMaxTempSubSysNumberORF_flg CbVCT_BMSMaxVoltageSubSysNumberORF_flg CbVCT_BMSMinTempSubSysNumberORF_flg CbVCT_BMSMinVoltageSubSysNumberORF_flg CbVCT_BMSMinimumCellVoltageNumberORF_flg CcVCT_BMSMaxTempSubSysNumberORV_n CcVCT_BMSMaxVoltageSubSysNumberORV_n CcVCT_BMSMinTempSubSysNumberORV_n CcVCT_BMSMinVoltageSubSysNumberORV_n CcVCT_BMSMinimumCellVoltageNumberORV_n /end REF_CHARACTERISTIC
/end GROUP
/begin GROUP S1630_Override "VBU0513/VBUSystem/BMS/VCT/Subsystem/Subsystem/Determine_BMS_VCU_34/Override"
 /begin SUB_GROUP S1742_LOW_HIGH1 S1742_LOW_HIGH2 S1742_LOW_HIGH3 S1742_LOW_HIGH5 /end SUB_GROUP
 /begin REF_CHARACTERISTIC CbVCT_AbortPrechargeCauseORF_flg CbVCT_BMSBMSRollingCounterORF_flg CbVCT_BMSContactorStateORF_flg CbVCT_BMSStsORF_flg CbVCT_InhibitPrechargeCauseORF_flg CeVCT_AbortPrechargeCauseORV_enum CeVCT_BMSBMSRollingCounterORV_enum CeVCT_BMSContactorStateORV_enum CeVCT_BMSStsORV_enum CeVCT_InhibitPrechargeCauseORV_enum /end REF_CHARACTERISTIC
/end GROUP
/begin GROUP S1631_Override "VBU0513/VBUSystem/BMS/VCT/Subsystem/Subsystem/Determine_BMS_VCU_372/Override"
 /begin SUB_GROUP S1748_LOW_HIGH1 S1748_LOW_HIGH16 S1748_LOW_HIGH2 S1748_LOW_HIGH3 S1748_LOW_HIGH4 /end SUB_GROUP
 /begin REF_CHARACTERISTIC CbVCT_BatteryNomalCapacityORF_flg CbVCT_HVBattStopDchaThdORF_flg CbVCT_MaximumChargingCurrentORF_flg CbVCT_MaximumChargingVoltageORF_flg CbVCT_MaximumPermitTempORF_flg CcVCT_BatteryNomalCapacityORV_Kwh CcVCT_HVBattStopDchaThdORV_pct CcVCT_MaximumChargingCurrentORV_A CcVCT_MaximumChargingVoltageORV_V CcVCT_MaximumPermitTempORV_C /end REF_CHARACTERISTIC
/end GROUP
/begin GROUP S1632_Override "VBU0513/VBUSystem/BMS/VCT/Subsystem/Subsystem/Determine_BMS_VCU_373/Override"
 /begin SUB_GROUP S1757_LOW_HIGH1 S1757_LOW_HIGH10 S1757_LOW_HIGH11 S1757_LOW_HIGH12 S1757_LOW_HIGH13 S1757_LOW_HIGH14 S1757_LOW_HIGH15 S1757_LOW_HIGH17 S1757_LOW_HIGH2 S1757_LOW_HIGH3 S1757_LOW_HIGH4 S1757_LOW_HIGH5 S1757_LOW_HIGH6 S1757_LOW_HIGH7 S1757_LOW_HIGH8 S1757_LOW_HIGH9 /end SUB_GROUP
 /begin REF_CHARACTERISTIC CbVCT_BMSCellTempStandardDeviationORF_flg CbVCT_BMSESSInletTempMaskORF_flg CbVCT_BMSESSInletTempMaskORV_flg CbVCT_BMSESSInletTempValidityORF_flg CbVCT_BMSESSInletTempValidityORV_flg CbVCT_BMSESSOutletTempMaskORF_flg CbVCT_BMSESSOutletTempMaskORV_flg CbVCT_BMSESSOutletTempValidityORF_flg CbVCT_BMSESSOutletTempValidityORV_flg CbVCT_BMSHVShutdownReqORF_flg CbVCT_BMSHVShutdownReqORV_flg CbVCT_BMSInletTempRequestORF_flg CbVCT_BMSInletWaterTempORF_flg CbVCT_BMSOutletWaterTempORF_flg CbVCT_BMSTempAverageValidityORF_flg CbVCT_BMSTempAverageValidityORV_flg CbVCT_BMSTempMaxValidityORF_flg CbVCT_BMSTempMaxValidityORV_flg CbVCT_BMSTempMinValidityORF_flg CbVCT_BMSTempMinValidityORV_flg CbVCT_BMSTempRequestValidORF_flg CbVCT_BMSTempRequestValidORV_flg CbVCT_BMSTemperatureAverageORF_flg CbVCT_BMSTemperatureMaxORF_flg CcVCT_BMSCellTempStandardDeviationORV_C CcVCT_BMSInletTempRequestORV_C CcVCT_BMSInletWaterTempORV_C CcVCT_BMSOutletWaterTempORV_C CcVCT_BMSTemperatureAverageORV_C CcVCT_BMSTemperatureMaxORV_C CcVCT_BMSTemperatureMinORF_flg CcVCT_BMSTemperatureMinORV_C /end REF_CHARACTERISTIC
/end GROUP
/begin GROUP S1633_Override "VBU0513/VBUSystem/BMS/VCT/Subsystem/Subsystem/Determine_BMS_VCU_AC/Override"
 /begin SUB_GROUP S1776_LOW_HIGH1 S1776_LOW_HIGH10 S1776_LOW_HIGH17 S1776_LOW_HIGH2 S1776_LOW_HIGH3 S1776_LOW_HIGH4 S1776_LOW_HIGH5 S1776_LOW_HIGH7 S1776_LOW_HIGH8 S1776_LOW_HIGH9 /end SUB_GROUP
 /begin REF_CHARACTERISTIC CbVCT_BMSCustomerUsageSOCORF_flg CbVCT_BMSFaultCatORF_flg CbVCT_BMSFaultLvlORF_flg CbVCT_BMSPackCrntORF_flg CbVCT_BMSPackVoltageORF_flg CbVCT_BMSRollingCounter225ORF_flg CbVCT_BMSSOCORF_flg CbVCT_ChargeAvailableORF_flg CbVCT_ChargeAvailableORV_flg CbVCT_HVBattSOCLowCritORF_flg CbVCT_HVBattSOCLowCritORV_flg CbVCT_HVBattSOCLowWarnORF_flg CbVCT_HVBattSOCLowWarnORV_flg CcVCT_BMSCustomerUsageSOCORV_pct CcVCT_BMSPackCrntORV_A CcVCT_BMSPackVoltageORV_V CcVCT_BMSRollingCounter225ORV_n CcVCT_BMSSOCORV_pct CeVCT_BMSFaultCatORV_enum CeVCT_BMSFaultLvlORV_enum /end REF_CHARACTERISTIC
/end GROUP
/begin GROUP S1634_Override "VBU0513/VBUSystem/BMS/VCT/Subsystem/Subsystem/Determine_BMS_VCU_AD/Override"
 /begin SUB_GROUP S1789_LOW_HIGH17 S1789_LOW_HIGH2 S1789_LOW_HIGH3 S1789_LOW_HIGH4 S1789_LOW_HIGH5 S1789_LOW_HIGH6 S1789_LOW_HIGH7 /end SUB_GROUP
 /begin REF_CHARACTERISTIC CbVCT_BMSBalanceStatusORF_flg CbVCT_BMSChargeStateORF_flg CbVCT_BMSDischgCurrentLimitORF_flg CbVCT_BMSInterlockStatusORF_flg CbVCT_BMSIsolationLevelORF_flg CbVCT_BMSVoltageLimitMaxORF_flg CbVCT_BMSVoltageLimitMinORF_flg CbVCT_ChargeCurrentDerateORF_flg CbVCT_ChargeCurrentDerateORV_flg CcVCT_BMSDischgCurrentLimitORV_A CcVCT_BMSVoltageLimitMaxORV_V CcVCT_BMSVoltageLimitMinORV_V CeVCT_BMSBalanceStatusORV_enum CeVCT_BMSChargeStateORV_enum CeVCT_BMSInterlockStatusORV_enum CeVCT_BMSIsolationLevelORV_enum /end REF_CHARACTERISTIC
/end GROUP
/begin GROUP S1635_Override "VBU0513/VBUSystem/BMS/VCT/Subsystem/Subsystem/Determine_BMS_VCU_AE/Override"
 /begin SUB_GROUP S1801_LOW_HIGH1 S1801_LOW_HIGH10 S1801_LOW_HIGH11 S1801_LOW_HIGH12 S1801_LOW_HIGH17 S1801_LOW_HIGH2 S1801_LOW_HIGH3 S1801_LOW_HIGH4 S1801_LOW_HIGH5 S1801_LOW_HIGH6 S1801_LOW_HIGH7 S1801_LOW_HIGH8 S1801_LOW_HIGH9 /end SUB_GROUP
 /begin REF_CHARACTERISTIC CbVCT_BMSChrgConnErrorORF_flg CbVCT_BMSChrgConnOvertempORF_flg CbVCT_BMSConnectorOvertempORF_flg CbVCT_BMSHvConectorErrorORF_flg CbVCT_BMSHvIsolationORF_flg CbVCT_BMSIfBmsSocSetORF_flg CbVCT_BMSIfCellVoltageSetORF_flg CbVCT_BMSIfPackVoltageSetORF_flg CbVCT_BMSOtherErrorORF_flg CbVCT_BMSOverCurrentORF_flg CbVCT_BMSPackOverTempORF_flg CbVCT_BMSVolMismatchORF_flg CbVCT_MaximumPermitChargeCellVoltageORF_flg CcVCT_MaximumPermitChargeCellVoltageORV_V CeVCT_BMSChrgConnErrorORV_enum CeVCT_BMSChrgConnOvertempORV_enum CeVCT_BMSConnectorOvertempORV_enum CeVCT_BMSHvConectorErrorORV_enum CeVCT_BMSHvIsolationORV_enum CeVCT_BMSIfBmsSocSetORV_enum CeVCT_BMSIfCellVoltageSetORV_enum CeVCT_BMSIfPackVoltageSetORV_enum CeVCT_BMSOtherErrorORV_enum CeVCT_BMSOverCurrentORV_enum CeVCT_BMSPackOverTempORV_enum CeVCT_BMSVolMismatchORV_enum /end REF_CHARACTERISTIC
/end GROUP
/begin GROUP S2020_Input_CAN_Signal_No_Range_Check "VBU0513/VBUSystem/HALIn/PTCAN/Subsystem/20ms/ABS_0x068/Input_CAN_Signal_No_Range_Check" /begin REF_CHARACTERISTIC BCU_flgABSFailOvrdVal_C BCU_flgFlgABSFailOvrd_C /end REF_CHARACTERISTIC /end GROUP
/begin GROUP S2020_Input_CAN_Signal_No_Range_Check1 "VBU0513/VBUSystem/HALIn/PTCAN/Subsystem/20ms/ABS_0x068/Input_CAN_Signal_No_Range_Check1" /begin REF_CHARACTERISTIC BCU_flgEBDFailOvrdVal_C BCU_flgFlgEBDFailOvrd_C /end REF_CHARACTERISTIC /end GROUP
/begin GROUP S2020_Input_CAN_Signal_No_Range_Check2 "VBU0513/VBUSystem/HALIn/PTCAN/Subsystem/20ms/ABS_0x068/Input_CAN_Signal_No_Range_Check2" /begin REF_CHARACTERISTIC BCU_flgEBDActiveOvrdVal_C BCU_flgFlgEBDActiveOvrd_C /end REF_CHARACTERISTIC /end GROUP
/begin GROUP S2020_Input_CAN_Signal_No_Range_Check3 "VBU0513/VBUSystem/HALIn/PTCAN/Subsystem/20ms/ABS_0x068/Input_CAN_Signal_No_Range_Check3" /begin REF_CHARACTERISTIC BCU_flgABSActvOvrdVal_C BCU_flgFlgABSActvOvrd_C /end REF_CHARACTERISTIC /end GROUP
/begin GROUP S2020_Input_CAN_Signal_No_Range_Check4 "VBU0513/VBUSystem/HALIn/PTCAN/Subsystem/20ms/ABS_0x068/Input_CAN_Signal_No_Range_Check4" /begin REF_CHARACTERISTIC BCU_flgVVehicleSpeedOvrd_C BCU_vVehicleSpeedOvrdVal_C /end REF_CHARACTERISTIC /end GROUP
/begin GROUP S2020_Input_CAN_Signal_No_Range_Check5 "VBU0513/VBUSystem/HALIn/PTCAN/Subsystem/20ms/ABS_0x068/Input_CAN_Signal_No_Range_Check5"
 /begin REF_CHARACTERISTIC BCU_flgFlgVehicleSpeedValidOvrd_C BCU_flgVehicleSpeedValidOvrdVal_C /end REF_CHARACTERISTIC
/end GROUP
/begin GROUP S2021_Input_CAN_Signal_No_Range_Check "VBU0513/VBUSystem/HALIn/PTCAN/Subsystem/20ms/ABS_0x115/Input_CAN_Signal_No_Range_Check"
 /begin REF_CHARACTERISTIC BCU_cntFLWhlSpdPlusCntOvrdVal_C BCU_flgCntFLWhlSpdPlusCntOvrd_C /end REF_CHARACTERISTIC
/end GROUP
/begin GROUP S2021_Input_CAN_Signal_No_Range_Check1 "VBU0513/VBUSystem/HALIn/PTCAN/Subsystem/20ms/ABS_0x115/Input_CAN_Signal_No_Range_Check1"
 /begin REF_CHARACTERISTIC BCU_cntFRWhlSpdPlusCntOvrdVal_C BCU_flgCntFRWhlSpdPlusCntOvrd_C /end REF_CHARACTERISTIC
/end GROUP
/begin GROUP S2021_Input_CAN_Signal_No_Range_Check2 "VBU0513/VBUSystem/HALIn/PTCAN/Subsystem/20ms/ABS_0x115/Input_CAN_Signal_No_Range_Check2"
 /begin REF_CHARACTERISTIC BCU_flgFLWhlSpdPlusCntOvrdVal_C BCU_flgFlgFLWhlSpdPlusCntOvrd_C /end REF_CHARACTERISTIC
/end GROUP
/begin GROUP S2021_Input_CAN_Signal_No_Range_Check3 "VBU0513/VBUSystem/HALIn/PTCAN/Subsystem/20ms/ABS_0x115/Input_CAN_Signal_No_Range_Check3"
 /begin REF_CHARACTERISTIC BCU_flgFRWhlSpdPlusCntOvrdVal_C BCU_flgFlgFRWhlSpdPlusCntOvrd_C /end REF_CHARACTERISTIC
/end GROUP
/begin GROUP S2021_Input_CAN_Signal_No_Range_Check4 "VBU0513/VBUSystem/HALIn/PTCAN/Subsystem/20ms/ABS_0x115/Input_CAN_Signal_No_Range_Check4"
 /begin REF_CHARACTERISTIC BCU_cntRLWhlSpdPlusCntOvrdVal_C BCU_flgCntRLWhlSpdPlusCntOvrd_C /end REF_CHARACTERISTIC
/end GROUP
/begin GROUP S2021_Input_CAN_Signal_No_Range_Check5 "VBU0513/VBUSystem/HALIn/PTCAN/Subsystem/20ms/ABS_0x115/Input_CAN_Signal_No_Range_Check5"
 /begin REF_CHARACTERISTIC BCU_cntRRWhlSpdPlusCntOvrdVal_C BCU_flgCntRRWhlSpdPlusCntOvrd_C /end REF_CHARACTERISTIC
/end GROUP
/begin GROUP S2021_Input_CAN_Signal_No_Range_Check6 "VBU0513/VBUSystem/HALIn/PTCAN/Subsystem/20ms/ABS_0x115/Input_CAN_Signal_No_Range_Check6"
 /begin REF_CHARACTERISTIC BCU_flgFlgRLWhlSpdPlusCntOvrd_C BCU_flgRLWhlSpdPlusCntOvrdVal_C /end REF_CHARACTERISTIC
/end GROUP
/begin GROUP S2021_Input_CAN_Signal_No_Range_Check7 "VBU0513/VBUSystem/HALIn/PTCAN/Subsystem/20ms/ABS_0x115/Input_CAN_Signal_No_Range_Check7"
 /begin REF_CHARACTERISTIC BCU_flgFlgRRWhlSpdPlusCntOvrd_C BCU_flgRRWhlSpdPlusCntOvrdVal_C /end REF_CHARACTERISTIC
/end GROUP
/begin GROUP S2022_Input_CAN_Signal_No_Range_Check "VBU0513/VBUSystem/HALIn/PTCAN/Subsystem/20ms/ABS_0x75/Input_CAN_Signal_No_Range_Check" /begin REF_CHARACTERISTIC BCU_flgVWhlFLOvrd_C BCU_vWhlFLOvrdVal_C /end REF_CHARACTERISTIC /end GROUP
/begin GROUP S2022_Input_CAN_Signal_No_Range_Check1 "VBU0513/VBUSystem/HALIn/PTCAN/Subsystem/20ms/ABS_0x75/Input_CAN_Signal_No_Range_Check1" /begin REF_CHARACTERISTIC BCU_flgStWhlFLOvrd_C BCU_stWhlFLOvrdVal_C /end REF_CHARACTERISTIC /end GROUP
/begin GROUP S2022_Input_CAN_Signal_No_Range_Check2 "VBU0513/VBUSystem/HALIn/PTCAN/Subsystem/20ms/ABS_0x75/Input_CAN_Signal_No_Range_Check2" /begin REF_CHARACTERISTIC BCU_flgVWhlFROvrd_C BCU_vWhlFROvrdVal_C /end REF_CHARACTERISTIC /end GROUP
/begin GROUP S2022_Input_CAN_Signal_No_Range_Check3 "VBU0513/VBUSystem/HALIn/PTCAN/Subsystem/20ms/ABS_0x75/Input_CAN_Signal_No_Range_Check3" /begin REF_CHARACTERISTIC BCU_flgStWhlFROvrd_C BCU_stWhlFROvrdVal_C /end REF_CHARACTERISTIC /end GROUP
/begin GROUP S2023_Input_CAN_Signal_No_Range_Check "VBU0513/VBUSystem/HALIn/PTCAN/Subsystem/20ms/ABS_0x79/Input_CAN_Signal_No_Range_Check" /begin SUB_GROUP S2103_override_signal /end SUB_GROUP /begin REF_CHARACTERISTIC BCU_flgVWhlRLOvrd_C BCU_vWhlRLOvrdVal_C /end REF_CHARACTERISTIC /end GROUP
/begin GROUP S2023_Input_CAN_Signal_No_Range_Check1 "VBU0513/VBUSystem/HALIn/PTCAN/Subsystem/20ms/ABS_0x79/Input_CAN_Signal_No_Range_Check1" /begin REF_CHARACTERISTIC BCU_flgStWhlRLOvrd_C BCU_stWhlRLOvrdVal_C /end REF_CHARACTERISTIC /end GROUP
/begin GROUP S2023_Input_CAN_Signal_No_Range_Check2 "VBU0513/VBUSystem/HALIn/PTCAN/Subsystem/20ms/ABS_0x79/Input_CAN_Signal_No_Range_Check2" /begin SUB_GROUP S2105_override_signal /end SUB_GROUP /begin REF_CHARACTERISTIC BCU_flgVWhlRROvrd_C BCU_vWhlRROvrdVal_C /end REF_CHARACTERISTIC /end GROUP
/begin GROUP S2023_Input_CAN_Signal_No_Range_Check3 "VBU0513/VBUSystem/HALIn/PTCAN/Subsystem/20ms/ABS_0x79/Input_CAN_Signal_No_Range_Check3" /begin REF_CHARACTERISTIC BCU_flgStWhlRROvrd_C BCU_stWhlRROvrdVal_C /end REF_CHARACTERISTIC /end GROUP
/begin GROUP S2024_Input_CAN_Signal_No_Range_Check1 "VBU0513/VBUSystem/HALIn/PTCAN/Subsystem/20ms/EPB_0x80/Input_CAN_Signal_No_Range_Check1" /begin REF_CHARACTERISTIC EPB_flgStStateOvrd_C EPB_stStateOvrdVal_C /end REF_CHARACTERISTIC /end GROUP
/begin GROUP S2024_Input_CAN_Signal_No_Range_Check10 "VBU0513/VBUSystem/HALIn/PTCAN/Subsystem/20ms/EPB_0x80/Input_CAN_Signal_No_Range_Check10" /begin REF_CHARACTERISTIC EPB_flgStSwitchOvrd_C EPB_stSwitchOvrdVal_C /end REF_CHARACTERISTIC /end GROUP
/begin GROUP S2024_Input_CAN_Signal_No_Range_Check2 "VBU0513/VBUSystem/HALIn/PTCAN/Subsystem/20ms/EPB_0x80/Input_CAN_Signal_No_Range_Check2" /begin REF_CHARACTERISTIC EPB_flgFlgShutDownOvrd_C EPB_flgShutDownOvrdVal_C /end REF_CHARACTERISTIC /end GROUP
/begin GROUP S2024_Input_CAN_Signal_No_Range_Check3 "VBU0513/VBUSystem/HALIn/PTCAN/Subsystem/20ms/EPB_0x80/Input_CAN_Signal_No_Range_Check3" /begin REF_CHARACTERISTIC EPB_flgStParkLampOvrd_C EPB_stParkLampOvrdVal_C /end REF_CHARACTERISTIC /end GROUP
/begin GROUP S2024_Input_CAN_Signal_No_Range_Check4 "VBU0513/VBUSystem/HALIn/PTCAN/Subsystem/20ms/EPB_0x80/Input_CAN_Signal_No_Range_Check4" /begin REF_CHARACTERISTIC EPB_flgStFaultLevelOvrd_C EPB_stFaultLevelOvrdVal_C /end REF_CHARACTERISTIC /end GROUP
/begin GROUP S2024_Input_CAN_Signal_No_Range_Check5 "VBU0513/VBUSystem/HALIn/PTCAN/Subsystem/20ms/EPB_0x80/Input_CAN_Signal_No_Range_Check5" /begin REF_CHARACTERISTIC EPB_flgStCtlModeOvrd_C EPB_stCtlModeOvrdVal_C /end REF_CHARACTERISTIC /end GROUP
/begin GROUP S2024_Input_CAN_Signal_No_Range_Check6 "VBU0513/VBUSystem/HALIn/PTCAN/Subsystem/20ms/EPB_0x80/Input_CAN_Signal_No_Range_Check6" /begin REF_CHARACTERISTIC EPB_flgFrDragForceOvrd_C EPB_frDragForceOvrdVal_C /end REF_CHARACTERISTIC /end GROUP
/begin GROUP S2024_Input_CAN_Signal_No_Range_Check7 "VBU0513/VBUSystem/HALIn/PTCAN/Subsystem/20ms/EPB_0x80/Input_CAN_Signal_No_Range_Check7" /begin REF_CHARACTERISTIC EPB_flgFlgIGNOvrd_C EPB_flgIGNOvrdVal_C /end REF_CHARACTERISTIC /end GROUP
/begin GROUP S2024_Input_CAN_Signal_No_Range_Check9 "VBU0513/VBUSystem/HALIn/PTCAN/Subsystem/20ms/EPB_0x80/Input_CAN_Signal_No_Range_Check9" /begin REF_CHARACTERISTIC EPB_flgStSwitchFaultOvrd_C EPB_stSwitchFaultOvrdVal_C /end REF_CHARACTERISTIC /end GROUP
/begin GROUP S2025_Input_CAN_Signal_No_Range_Check1 "VBU0513/VBUSystem/HALIn/PTCAN/Subsystem/20ms/EPS_0x70/Input_CAN_Signal_No_Range_Check1" /begin REF_CHARACTERISTIC EPS_degStrngAgSpdOvrdVal_C EPS_flgDegStrngAgSpdOvrd_C /end REF_CHARACTERISTIC /end GROUP
/begin GROUP S2025_Input_CAN_Signal_No_Range_Check2 "VBU0513/VBUSystem/HALIn/PTCAN/Subsystem/20ms/EPS_0x70/Input_CAN_Signal_No_Range_Check2" /begin REF_CHARACTERISTIC EPS_flgTrqTrqStrngOvrd_C EPS_trqTrqStrngOvrdVal_C /end REF_CHARACTERISTIC /end GROUP
/begin GROUP S2025_Input_CAN_Signal_No_Range_Check3 "VBU0513/VBUSystem/HALIn/PTCAN/Subsystem/20ms/EPS_0x70/Input_CAN_Signal_No_Range_Check3" /begin REF_CHARACTERISTIC EPS_flgTrqTrqMotrOvrd_C EPS_trqTrqMotrOvrdVal_C /end REF_CHARACTERISTIC /end GROUP
/begin GROUP S2025_Input_CAN_Signal_No_Range_Check4 "VBU0513/VBUSystem/HALIn/PTCAN/Subsystem/20ms/EPS_0x70/Input_CAN_Signal_No_Range_Check4" /begin REF_CHARACTERISTIC EPS_flgStECUModeCntOvrd_C EPS_stECUModeCntOvrdVal_C /end REF_CHARACTERISTIC /end GROUP
/begin GROUP S2025_Input_CAN_Signal_No_Range_Check5 "VBU0513/VBUSystem/HALIn/PTCAN/Subsystem/20ms/EPS_0x70/Input_CAN_Signal_No_Range_Check5" /begin REF_CHARACTERISTIC EPS_flgPhiStrngAgOvrd_C EPS_phiStrngAgOvrdVal_C /end REF_CHARACTERISTIC /end GROUP
/begin GROUP S2025_Input_CAN_Signal_No_Range_Check6 "VBU0513/VBUSystem/HALIn/PTCAN/Subsystem/20ms/EPS_0x70/Input_CAN_Signal_No_Range_Check6" /begin REF_CHARACTERISTIC EPS_cntECUMsgCntOvrdVal_C EPS_flgCntECUMsgCntOvrd_C /end REF_CHARACTERISTIC /end GROUP
/begin GROUP S2026_Input_CAN_Signal_No_Range_Check1 "VBU0513/VBUSystem/HALIn/PTCAN/Subsystem/20ms/MCU_205/Input_CAN_Signal_No_Range_Check1" /begin SUB_GROUP S2187_override_signal /end SUB_GROUP /begin REF_CHARACTERISTIC PEUR_flgTrqActOvrd_C PEUR_trqActOvrdVal_C /end REF_CHARACTERISTIC /end GROUP
/begin GROUP S2026_Input_CAN_Signal_No_Range_Check2 "VBU0513/VBUSystem/HALIn/PTCAN/Subsystem/20ms/MCU_205/Input_CAN_Signal_No_Range_Check2" /begin REF_CHARACTERISTIC PEUR_flgStInvrOvrd_C PEUR_stInvrOvrdVal_C /end REF_CHARACTERISTIC /end GROUP
/begin GROUP S2026_Input_CAN_Signal_No_Range_Check3 "VBU0513/VBUSystem/HALIn/PTCAN/Subsystem/20ms/MCU_205/Input_CAN_Signal_No_Range_Check3" /begin SUB_GROUP S2189_override_signal /end SUB_GROUP /begin REF_CHARACTERISTIC PEUR_flgFlgMotrHillHldOvrd_C PEUR_flgMotrHillHldOvrdVal_C /end REF_CHARACTERISTIC /end GROUP
/begin GROUP S2026_Input_CAN_Signal_No_Range_Check4 "VBU0513/VBUSystem/HALIn/PTCAN/Subsystem/20ms/MCU_205/Input_CAN_Signal_No_Range_Check4" /begin SUB_GROUP S2190_override_signal /end SUB_GROUP /begin REF_CHARACTERISTIC PEUR_flgStActvDisChOvrd_C PEUR_stActvDisChOvrdVal_C /end REF_CHARACTERISTIC /end GROUP
/begin GROUP S2026_Input_CAN_Signal_No_Range_Check5 "VBU0513/VBUSystem/HALIn/PTCAN/Subsystem/20ms/MCU_205/Input_CAN_Signal_No_Range_Check5" /begin SUB_GROUP S2191_override_signal /end SUB_GROUP /begin REF_CHARACTERISTIC PEUR_flgNMotrOvrd_C PEUR_nMotrOvrdVal_C /end REF_CHARACTERISTIC /end GROUP
/begin GROUP S2026_Input_CAN_Signal_No_Range_Check6 "VBU0513/VBUSystem/HALIn/PTCAN/Subsystem/20ms/MCU_205/Input_CAN_Signal_No_Range_Check6" /begin REF_CHARACTERISTIC PEUR_flgFlgMotrSpdVldOvrd_C PEUR_flgMotrSpdVldOvrdVal_C /end REF_CHARACTERISTIC /end GROUP
/begin GROUP S2026_Input_CAN_Signal_No_Range_Check7 "VBU0513/VBUSystem/HALIn/PTCAN/Subsystem/20ms/MCU_205/Input_CAN_Signal_No_Range_Check7" /begin SUB_GROUP S2193_override_signal /end SUB_GROUP /begin REF_CHARACTERISTIC PEUR_flgICalcDCOvrd_C PEUR_iCalcDCOvrdVal_C /end REF_CHARACTERISTIC /end GROUP
/begin GROUP S2214_Input_CAN_Signal_No_Range_Check "VBU0513/VBUSystem/HALIn/PTCAN/Subsystem/50ms/BCM_0x18FE0121/Input_CAN_Signal_No_Range_Check" /begin REF_CHARACTERISTIC BCM_flgStRealFogLghtOvrd_C BCM_stRealFogLghtOvrdVal_C /end REF_CHARACTERISTIC /end GROUP
/begin GROUP S2214_Input_CAN_Signal_No_Range_Check1 "VBU0513/VBUSystem/HALIn/PTCAN/Subsystem/50ms/BCM_0x18FE0121/Input_CAN_Signal_No_Range_Check1" /begin REF_CHARACTERISTIC BCM_flgStDayLghtStatusOvrd_C BCM_stDayLghtStatusOvrdVal_C /end REF_CHARACTERISTIC /end GROUP
/begin GROUP S2214_Input_CAN_Signal_No_Range_Check10 "VBU0513/VBUSystem/HALIn/PTCAN/Subsystem/50ms/BCM_0x18FE0121/Input_CAN_Signal_No_Range_Check10" /begin REF_CHARACTERISTIC BCM_flgStParkSwtStatusOvrd_C BCM_stParkSwtStatusOvrdVal_C /end REF_CHARACTERISTIC /end GROUP
/begin GROUP S2214_Input_CAN_Signal_No_Range_Check11 "VBU0513/VBUSystem/HALIn/PTCAN/Subsystem/50ms/BCM_0x18FE0121/Input_CAN_Signal_No_Range_Check11" /begin REF_CHARACTERISTIC BCM_flgStBrkLghtStatusOvrd_C BCM_stBrkLghtStatusOvrdVal_C /end REF_CHARACTERISTIC /end GROUP
/begin GROUP S2214_Input_CAN_Signal_No_Range_Check12 "VBU0513/VBUSystem/HALIn/PTCAN/Subsystem/50ms/BCM_0x18FE0121/Input_CAN_Signal_No_Range_Check12" /begin REF_CHARACTERISTIC BCM_flgStDoorStatusOvrd_C BCM_stDoorStatusOvrdVal_C /end REF_CHARACTERISTIC /end GROUP
/begin GROUP S2214_Input_CAN_Signal_No_Range_Check13 "VBU0513/VBUSystem/HALIn/PTCAN/Subsystem/50ms/BCM_0x18FE0121/Input_CAN_Signal_No_Range_Check13" /begin REF_CHARACTERISTIC BCM_flgFlgIG1PwrOvrd_C BCM_flgIG1PwrOvrdVal_C /end REF_CHARACTERISTIC /end GROUP
/begin GROUP S2214_Input_CAN_Signal_No_Range_Check14 "VBU0513/VBUSystem/HALIn/PTCAN/Subsystem/50ms/BCM_0x18FE0121/Input_CAN_Signal_No_Range_Check14"
 /begin REF_CHARACTERISTIC BCM_flgStWashMotrStatusOvrd_C BCM_stWashMotrStatusOvrdVal_C /end REF_CHARACTERISTIC
/end GROUP
/begin GROUP S2214_Input_CAN_Signal_No_Range_Check15 "VBU0513/VBUSystem/HALIn/PTCAN/Subsystem/50ms/BCM_0x18FE0121/Input_CAN_Signal_No_Range_Check15" /begin REF_CHARACTERISTIC BCM_flgStLoWiperStatusOvrd_C BCM_stLoWiperStatusOvrdVal_C /end REF_CHARACTERISTIC /end GROUP
/begin GROUP S2214_Input_CAN_Signal_No_Range_Check16 "VBU0513/VBUSystem/HALIn/PTCAN/Subsystem/50ms/BCM_0x18FE0121/Input_CAN_Signal_No_Range_Check16" /begin REF_CHARACTERISTIC BCM_flgStHIWiperStatusOvrd_C BCM_stHIWiperStatusOvrdVal_C /end REF_CHARACTERISTIC /end GROUP
/begin GROUP S2214_Input_CAN_Signal_No_Range_Check17 "VBU0513/VBUSystem/HALIn/PTCAN/Subsystem/50ms/BCM_0x18FE0121/Input_CAN_Signal_No_Range_Check17" /begin REF_CHARACTERISTIC BCM_flgStAutoWiperGearOvrd_C BCM_stAutoWiperGearOvrdVal_C /end REF_CHARACTERISTIC /end GROUP
/begin GROUP S2214_Input_CAN_Signal_No_Range_Check18 "VBU0513/VBUSystem/HALIn/PTCAN/Subsystem/50ms/BCM_0x18FE0121/Input_CAN_Signal_No_Range_Check18"
 /begin REF_CHARACTERISTIC BCM_flgStAutoHeadlightGearOvrd_C BCM_stAutoHeadlightGearOvrdVal_C /end REF_CHARACTERISTIC
/end GROUP
/begin GROUP S2214_Input_CAN_Signal_No_Range_Check2 "VBU0513/VBUSystem/HALIn/PTCAN/Subsystem/50ms/BCM_0x18FE0121/Input_CAN_Signal_No_Range_Check2"
 /begin REF_CHARACTERISTIC BCM_flgStParkLghtStatusOvrd_C BCM_stParkLghtStatusOvrdVal_C /end REF_CHARACTERISTIC
/end GROUP
/begin GROUP S2214_Input_CAN_Signal_No_Range_Check3 "VBU0513/VBUSystem/HALIn/PTCAN/Subsystem/50ms/BCM_0x18FE0121/Input_CAN_Signal_No_Range_Check3" /begin REF_CHARACTERISTIC BCM_flgStFrntFogLghtOvrd_C BCM_stFrntFogLghtOvrdVal_C /end REF_CHARACTERISTIC /end GROUP
/begin GROUP S2214_Input_CAN_Signal_No_Range_Check4 "VBU0513/VBUSystem/HALIn/PTCAN/Subsystem/50ms/BCM_0x18FE0121/Input_CAN_Signal_No_Range_Check4"
 /begin REF_CHARACTERISTIC BCM_flgStRiTurnLghtStatusOvrd_C BCM_stRiTurnLghtStatusOvrdVal_C /end REF_CHARACTERISTIC
/end GROUP
/begin GROUP S2214_Input_CAN_Signal_No_Range_Check5 "VBU0513/VBUSystem/HALIn/PTCAN/Subsystem/50ms/BCM_0x18FE0121/Input_CAN_Signal_No_Range_Check5" /begin REF_CHARACTERISTIC BCM_flgStLeTurnStatusOvrd_C BCM_stLeTurnStatusOvrdVal_C /end REF_CHARACTERISTIC /end GROUP
/begin GROUP S2214_Input_CAN_Signal_No_Range_Check6 "VBU0513/VBUSystem/HALIn/PTCAN/Subsystem/50ms/BCM_0x18FE0121/Input_CAN_Signal_No_Range_Check6" /begin REF_CHARACTERISTIC BCM_flgStLowBeamOvrd_C BCM_stLowBeamOvrdVal_C /end REF_CHARACTERISTIC /end GROUP
/begin GROUP S2214_Input_CAN_Signal_No_Range_Check7 "VBU0513/VBUSystem/HALIn/PTCAN/Subsystem/50ms/BCM_0x18FE0121/Input_CAN_Signal_No_Range_Check7" /begin REF_CHARACTERISTIC BCM_flgStHiBeamOvrd_C BCM_stHiBeamOvrdVal_C /end REF_CHARACTERISTIC /end GROUP
/begin GROUP S2214_Input_CAN_Signal_No_Range_Check8 "VBU0513/VBUSystem/HALIn/PTCAN/Subsystem/50ms/BCM_0x18FE0121/Input_CAN_Signal_No_Range_Check8"
 /begin REF_CHARACTERISTIC BCM_flgStReversingSwtStatusOvrd_C BCM_stReversingSwtStatusOvrdVal_C /end REF_CHARACTERISTIC
/end GROUP
/begin GROUP S2214_Input_CAN_Signal_No_Range_Check9 "VBU0513/VBUSystem/HALIn/PTCAN/Subsystem/50ms/BCM_0x18FE0121/Input_CAN_Signal_No_Range_Check9" /begin REF_CHARACTERISTIC BCM_flgStHornStatusOvrd_C BCM_stHornStatusOvrdVal_C /end REF_CHARACTERISTIC /end GROUP
/begin GROUP S2215_Input_CAN_Signal_No_Range_Check "VBU0513/VBUSystem/HALIn/PTCAN/Subsystem/50ms/MCU_305/Input_CAN_Signal_No_Range_Check" /begin SUB_GROUP S2281_override_signal /end SUB_GROUP
 /begin REF_CHARACTERISTIC PEUR_flgUDCRlyOutsideVltgOvrd_C PEUR_uDCRlyOutsideVltgOvrdVal_C /end REF_CHARACTERISTIC
/end GROUP
/begin GROUP S2215_Input_CAN_Signal_No_Range_Check1 "VBU0513/VBUSystem/HALIn/PTCAN/Subsystem/50ms/MCU_305/Input_CAN_Signal_No_Range_Check1" /begin REF_CHARACTERISTIC PEUR_flgTrqMaxLimitOvrd_C PEUR_trqMaxLimitOvrdVal_C /end REF_CHARACTERISTIC /end GROUP
/begin GROUP S2215_Input_CAN_Signal_No_Range_Check2 "VBU0513/VBUSystem/HALIn/PTCAN/Subsystem/50ms/MCU_305/Input_CAN_Signal_No_Range_Check2" /begin REF_CHARACTERISTIC PEUR_flgUMeasDCOvrd_C PEUR_uMeasDCOvrdVal_C /end REF_CHARACTERISTIC /end GROUP
/begin GROUP S2398_CanRxData_Unpack "VBU0513/VBUSystem/HALIn/PTCAN/Subsystem/CanMsgUnpack/MsgRxData_Unpack1/CanRxData_Unpack" /begin SUB_GROUP S2418_ABS_VehicleSpeedAndStatus /end SUB_GROUP /end GROUP
/begin GROUP S2399_CanRxData_Unpack "VBU0513/VBUSystem/HALIn/PTCAN/Subsystem/CanMsgUnpack/MsgRxData_Unpack10/CanRxData_Unpack" /begin SUB_GROUP S2420_DCDC_VCU_509 /end SUB_GROUP /end GROUP
/begin GROUP S2400_CanRxData_Unpack "VBU0513/VBUSystem/HALIn/PTCAN/Subsystem/CanMsgUnpack/MsgRxData_Unpack11/CanRxData_Unpack" /begin SUB_GROUP S2422_EPB_State /end SUB_GROUP /end GROUP
/begin GROUP S2401_CanRxData_Unpack "VBU0513/VBUSystem/HALIn/PTCAN/Subsystem/CanMsgUnpack/MsgRxData_Unpack12/CanRxData_Unpack" /begin SUB_GROUP S2424_EPS_DM1 /end SUB_GROUP /end GROUP
/begin GROUP S2402_CanRxData_Unpack "VBU0513/VBUSystem/HALIn/PTCAN/Subsystem/CanMsgUnpack/MsgRxData_Unpack13/CanRxData_Unpack" /begin SUB_GROUP S2426_EPS_FEEDBACK_STA /end SUB_GROUP /end GROUP
/begin GROUP S2403_CanRxData_Unpack "VBU0513/VBUSystem/HALIn/PTCAN/Subsystem/CanMsgUnpack/MsgRxData_Unpack14/CanRxData_Unpack" /begin SUB_GROUP S2428_IC_401 /end SUB_GROUP /end GROUP
/begin GROUP S2404_CanRxData_Unpack "VBU0513/VBUSystem/HALIn/PTCAN/Subsystem/CanMsgUnpack/MsgRxData_Unpack15/CanRxData_Unpack" /begin SUB_GROUP S2430_MCU_205 /end SUB_GROUP /end GROUP
/begin GROUP S2405_CanRxData_Unpack "VBU0513/VBUSystem/HALIn/PTCAN/Subsystem/CanMsgUnpack/MsgRxData_Unpack16/CanRxData_Unpack" /begin SUB_GROUP S2432_MCU_305 /end SUB_GROUP /end GROUP
/begin GROUP S2406_CanRxData_Unpack "VBU0513/VBUSystem/HALIn/PTCAN/Subsystem/CanMsgUnpack/MsgRxData_Unpack17/CanRxData_Unpack" /begin SUB_GROUP S2434_MCU_405 /end SUB_GROUP /end GROUP
/begin GROUP S2407_CanRxData_Unpack "VBU0513/VBUSystem/HALIn/PTCAN/Subsystem/CanMsgUnpack/MsgRxData_Unpack18/CanRxData_Unpack" /begin SUB_GROUP S2436_MCU_505 /end SUB_GROUP /end GROUP
/begin GROUP S2408_CanRxData_Unpack "VBU0513/VBUSystem/HALIn/PTCAN/Subsystem/CanMsgUnpack/MsgRxData_Unpack19/CanRxData_Unpack" /begin SUB_GROUP S2438_T_BOX_510 /end SUB_GROUP /end GROUP
/begin GROUP S2409_CanRxData_Unpack "VBU0513/VBUSystem/HALIn/PTCAN/Subsystem/CanMsgUnpack/MsgRxData_Unpack2/CanRxData_Unpack" /begin SUB_GROUP S2440_ABS_WheelSpeed_Front_Whl /end SUB_GROUP /end GROUP
/begin GROUP S2410_CanRxData_Unpack "VBU0513/VBUSystem/HALIn/PTCAN/Subsystem/CanMsgUnpack/MsgRxData_Unpack20/CanRxData_Unpack" /begin SUB_GROUP S2442_T_BOX_511 /end SUB_GROUP /end GROUP
/begin GROUP S2411_CanRxData_Unpack "VBU0513/VBUSystem/HALIn/PTCAN/Subsystem/CanMsgUnpack/MsgRxData_Unpack3/CanRxData_Unpack" /begin SUB_GROUP S2444_ABS_WheelSpeed_PulseCounter /end SUB_GROUP /end GROUP
/begin GROUP S2412_CanRxData_Unpack "VBU0513/VBUSystem/HALIn/PTCAN/Subsystem/CanMsgUnpack/MsgRxData_Unpack4/CanRxData_Unpack" /begin SUB_GROUP S2446_ABS_WheelSpeed_Rear_Whl /end SUB_GROUP /end GROUP
/begin GROUP S2413_CanRxData_Unpack "VBU0513/VBUSystem/HALIn/PTCAN/Subsystem/CanMsgUnpack/MsgRxData_Unpack5/CanRxData_Unpack" /begin SUB_GROUP S2448_AC_VCU /end SUB_GROUP /end GROUP
/begin GROUP S2414_CanRxData_Unpack "VBU0513/VBUSystem/HALIn/PTCAN/Subsystem/CanMsgUnpack/MsgRxData_Unpack6/CanRxData_Unpack" /begin SUB_GROUP S2450_AVAS /end SUB_GROUP /end GROUP
/begin GROUP S2415_CanRxData_Unpack "VBU0513/VBUSystem/HALIn/PTCAN/Subsystem/CanMsgUnpack/MsgRxData_Unpack7/CanRxData_Unpack" /begin SUB_GROUP S2452_BCM_VCU /end SUB_GROUP /end GROUP
/begin GROUP S2416_CanRxData_Unpack "VBU0513/VBUSystem/HALIn/PTCAN/Subsystem/CanMsgUnpack/MsgRxData_Unpack8/CanRxData_Unpack" /begin SUB_GROUP S2454_CDC_VCU /end SUB_GROUP /end GROUP
/begin GROUP S2417_CanRxData_Unpack "VBU0513/VBUSystem/HALIn/PTCAN/Subsystem/CanMsgUnpack/MsgRxData_Unpack9/CanRxData_Unpack" /begin SUB_GROUP S2456_DCDC_VCU_303 /end SUB_GROUP /end GROUP
/begin GROUP S2458_Input_CAN_Signal_No_Range_Check "VBU0513/VBUSystem/HALIn/PTCAN/Subsystem/Subsystem2/AVAS_1801D0D3/Input_CAN_Signal_No_Range_Check"
 /begin REF_CHARACTERISTIC AVAS_flgStWorkingStatusOvrd_C AVAS_stWorkingStatusOvrdVal_C /end REF_CHARACTERISTIC
/end GROUP
/begin GROUP S2458_Input_CAN_Signal_No_Range_Check1 "VBU0513/VBUSystem/HALIn/PTCAN/Subsystem/Subsystem2/AVAS_1801D0D3/Input_CAN_Signal_No_Range_Check1" /begin REF_CHARACTERISTIC AVAS_flgNumHwVerOvrd_C AVAS_numHwVerOvrdVal_C /end REF_CHARACTERISTIC /end GROUP
/begin GROUP S2458_Input_CAN_Signal_No_Range_Check2 "VBU0513/VBUSystem/HALIn/PTCAN/Subsystem/Subsystem2/AVAS_1801D0D3/Input_CAN_Signal_No_Range_Check2" /begin REF_CHARACTERISTIC AVAS_flgNumSoftwareVerOvrd_C AVAS_numSoftwareVerOvrdVal_C /end REF_CHARACTERISTIC /end GROUP
/begin GROUP S2459_Input_CAN_Signal_No_Range_Check "VBU0513/VBUSystem/HALIn/PTCAN/Subsystem/Subsystem2/IC_401/Input_CAN_Signal_No_Range_Check" /begin REF_CHARACTERISTIC IC_flgBrkDisWarnOvrdVal_C IC_flgFlgBrkDisWarnOvrd_C /end REF_CHARACTERISTIC /end GROUP
/begin GROUP S2459_Input_CAN_Signal_No_Range_Check1 "VBU0513/VBUSystem/HALIn/PTCAN/Subsystem/Subsystem2/IC_401/Input_CAN_Signal_No_Range_Check1"
 /begin REF_CHARACTERISTIC IC_flgFlgSeatbeltUnlockOvrd_C IC_flgSeatbeltUnlockOvrdVal_C /end REF_CHARACTERISTIC
/end GROUP
/begin GROUP S2459_Input_CAN_Signal_No_Range_Check2 "VBU0513/VBUSystem/HALIn/PTCAN/Subsystem/Subsystem2/IC_401/Input_CAN_Signal_No_Range_Check2" /begin REF_CHARACTERISTIC IC_flgKmVehOdmeterOvrd_C IC_kmVehOdmeterOvrdVal_C /end REF_CHARACTERISTIC /end GROUP
/begin GROUP S2459_Input_CAN_Signal_No_Range_Check3 "VBU0513/VBUSystem/HALIn/PTCAN/Subsystem/Subsystem2/IC_401/Input_CAN_Signal_No_Range_Check3" /begin REF_CHARACTERISTIC IC_flgBrkFluidWarnOvrdVal_C IC_flgFlgBrkFluidWarnOvrd_C /end REF_CHARACTERISTIC /end GROUP
/begin GROUP S2460_Input_CAN_Signal_No_Range_Check "VBU0513/VBUSystem/HALIn/PTCAN/Subsystem/Subsystem2/MCU_505/Input_CAN_Signal_No_Range_Check" /begin REF_CHARACTERISTIC PEUR_flgFlgMotrOvrHeatOvrd_C PEUR_flgMotrOvrHeatOvrdVal_C /end REF_CHARACTERISTIC /end GROUP
/begin GROUP S2460_Input_CAN_Signal_No_Range_Check1 "VBU0513/VBUSystem/HALIn/PTCAN/Subsystem/Subsystem2/MCU_505/Input_CAN_Signal_No_Range_Check1" /begin REF_CHARACTERISTIC PEUR_flgFlgIGBTOvrHeatOvrd_C PEUR_flgIGBTOvrHeatOvrdVal_C /end REF_CHARACTERISTIC /end GROUP
/begin GROUP S2460_Input_CAN_Signal_No_Range_Check10 "VBU0513/VBUSystem/HALIn/PTCAN/Subsystem/Subsystem2/MCU_505/Input_CAN_Signal_No_Range_Check10"
 /begin REF_CHARACTERISTIC PEUR_flgDrvUparmFailOvrdVal_C PEUR_flgFlgDrvUparmFailOvrd_C /end REF_CHARACTERISTIC
/end GROUP
/begin GROUP S2460_Input_CAN_Signal_No_Range_Check11 "VBU0513/VBUSystem/HALIn/PTCAN/Subsystem/Subsystem2/MCU_505/Input_CAN_Signal_No_Range_Check11" /begin REF_CHARACTERISTIC PEUR_flgFlgHWUnderVoltOvrd_C PEUR_flgHWUnderVoltOvrdVal_C /end REF_CHARACTERISTIC /end GROUP
/begin GROUP S2460_Input_CAN_Signal_No_Range_Check12 "VBU0513/VBUSystem/HALIn/PTCAN/Subsystem/Subsystem2/MCU_505/Input_CAN_Signal_No_Range_Check12" /begin REF_CHARACTERISTIC PEUR_flgFlgHwOvrVloltOvrd_C PEUR_flgHwOvrVloltOvrdVal_C /end REF_CHARACTERISTIC /end GROUP
/begin GROUP S2460_Input_CAN_Signal_No_Range_Check13 "VBU0513/VBUSystem/HALIn/PTCAN/Subsystem/Subsystem2/MCU_505/Input_CAN_Signal_No_Range_Check13" /begin REF_CHARACTERISTIC PEUR_flgBusUndrVltgOvrdVal_C PEUR_flgFlgBusUndrVltgOvrd_C /end REF_CHARACTERISTIC /end GROUP
/begin GROUP S2460_Input_CAN_Signal_No_Range_Check14 "VBU0513/VBUSystem/HALIn/PTCAN/Subsystem/Subsystem2/MCU_505/Input_CAN_Signal_No_Range_Check14" /begin REF_CHARACTERISTIC PEUR_flgBusOvrVltgOvrdVal_C PEUR_flgFlgBusOvrVltgOvrd_C /end REF_CHARACTERISTIC /end GROUP
/begin GROUP S2460_Input_CAN_Signal_No_Range_Check15 "VBU0513/VBUSystem/HALIn/PTCAN/Subsystem/Subsystem2/MCU_505/Input_CAN_Signal_No_Range_Check15" /begin REF_CHARACTERISTIC PEUR_flgCANFaultOvrdVal_C PEUR_flgFlgCANFaultOvrd_C /end REF_CHARACTERISTIC /end GROUP
/begin GROUP S2460_Input_CAN_Signal_No_Range_Check16 "VBU0513/VBUSystem/HALIn/PTCAN/Subsystem/Subsystem2/MCU_505/Input_CAN_Signal_No_Range_Check16"
 /begin REF_CHARACTERISTIC PEUR_flgFlgRadiatorOvrTempLimOvrd_C PEUR_flgRadiatorOvrTempLimOvrdVal_C /end REF_CHARACTERISTIC
/end GROUP
/begin GROUP S2460_Input_CAN_Signal_No_Range_Check17 "VBU0513/VBUSystem/HALIn/PTCAN/Subsystem/Subsystem2/MCU_505/Input_CAN_Signal_No_Range_Check17"
 /begin REF_CHARACTERISTIC PEUR_flgFlgIGBTJunctionOvrTempLimOvrd_C PEUR_flgIGBTJunctionOvrTempLimOvrdVal_C /end REF_CHARACTERISTIC
/end GROUP
/begin GROUP S2460_Input_CAN_Signal_No_Range_Check18 "VBU0513/VBUSystem/HALIn/PTCAN/Subsystem/Subsystem2/MCU_505/Input_CAN_Signal_No_Range_Check18"
 /begin REF_CHARACTERISTIC PEUR_flgFlgIGBTNTCOvrTempLimOvrd_C PEUR_flgIGBTNTCOvrTempLimOvrdVal_C /end REF_CHARACTERISTIC
/end GROUP
/begin GROUP S2460_Input_CAN_Signal_No_Range_Check19 "VBU0513/VBUSystem/HALIn/PTCAN/Subsystem/Subsystem2/MCU_505/Input_CAN_Signal_No_Range_Check19"
 /begin REF_CHARACTERISTIC PEUR_flgFlgMotrOvrTempLimOvrd_C PEUR_flgMotrOvrTempLimOvrdVal_C /end REF_CHARACTERISTIC
/end GROUP
/begin GROUP S2460_Input_CAN_Signal_No_Range_Check2 "VBU0513/VBUSystem/HALIn/PTCAN/Subsystem/Subsystem2/MCU_505/Input_CAN_Signal_No_Range_Check2"
 /begin REF_CHARACTERISTIC PEUR_flgFlgResolverFaultOvrd_C PEUR_flgResolverFaultOvrdVal_C /end REF_CHARACTERISTIC
/end GROUP
/begin GROUP S2460_Input_CAN_Signal_No_Range_Check20 "VBU0513/VBUSystem/HALIn/PTCAN/Subsystem/Subsystem2/MCU_505/Input_CAN_Signal_No_Range_Check20" /begin REF_CHARACTERISTIC PEUR_flgStFaultOvrd_C PEUR_stFaultOvrdVal_C /end REF_CHARACTERISTIC /end GROUP
/begin GROUP S2460_Input_CAN_Signal_No_Range_Check3 "VBU0513/VBUSystem/HALIn/PTCAN/Subsystem/Subsystem2/MCU_505/Input_CAN_Signal_No_Range_Check3" /begin REF_CHARACTERISTIC PEUR_flgFlgHallFaultOvrd_C PEUR_flgHallFaultOvrdVal_C /end REF_CHARACTERISTIC /end GROUP
/begin GROUP S2460_Input_CAN_Signal_No_Range_Check4 "VBU0513/VBUSystem/HALIn/PTCAN/Subsystem/Subsystem2/MCU_505/Input_CAN_Signal_No_Range_Check4" /begin REF_CHARACTERISTIC PEUR_flgFlgOvrSpdOvrd_C PEUR_flgOvrSpdOvrdVal_C /end REF_CHARACTERISTIC /end GROUP
/begin GROUP S2460_Input_CAN_Signal_No_Range_Check5 "VBU0513/VBUSystem/HALIn/PTCAN/Subsystem/Subsystem2/MCU_505/Input_CAN_Signal_No_Range_Check5"
 /begin REF_CHARACTERISTIC PEUR_flgFlgOutputPhaseFaultOvrd_C PEUR_flgOutputPhaseFaultOvrdVal_C /end REF_CHARACTERISTIC
/end GROUP
/begin GROUP S2460_Input_CAN_Signal_No_Range_Check6 "VBU0513/VBUSystem/HALIn/PTCAN/Subsystem/Subsystem2/MCU_505/Input_CAN_Signal_No_Range_Check6" /begin REF_CHARACTERISTIC PEUR_flgFlgIGBTFaultOvrd_C PEUR_flgIGBTFaultOvrdVal_C /end REF_CHARACTERISTIC /end GROUP
/begin GROUP S2460_Input_CAN_Signal_No_Range_Check7 "VBU0513/VBUSystem/HALIn/PTCAN/Subsystem/Subsystem2/MCU_505/Input_CAN_Signal_No_Range_Check7" /begin REF_CHARACTERISTIC PEUR_flgFlgOvrCurrOvrd_C PEUR_flgOvrCurrOvrdVal_C /end REF_CHARACTERISTIC /end GROUP
/begin GROUP S2460_Input_CAN_Signal_No_Range_Check8 "VBU0513/VBUSystem/HALIn/PTCAN/Subsystem/Subsystem2/MCU_505/Input_CAN_Signal_No_Range_Check8" /begin REF_CHARACTERISTIC PUER_flgCPLDStatusOvrdVal_C PUER_flgFlgCPLDStatusOvrd_C /end REF_CHARACTERISTIC /end GROUP
/begin GROUP S2460_Input_CAN_Signal_No_Range_Check9 "VBU0513/VBUSystem/HALIn/PTCAN/Subsystem/Subsystem2/MCU_505/Input_CAN_Signal_No_Range_Check9"
 /begin REF_CHARACTERISTIC PEUR_flgDrvDownarmFailOvrdVal_C PEUR_flgFlgDrvDownarmFailOvrd_C /end REF_CHARACTERISTIC
/end GROUP
/begin GROUP S2566_Input_CAN_Signal_No_Range_Check "VBU0513/VBUSystem/HALIn/PTCAN/Subsystem/Subsystem3/DCDC_509/Input_CAN_Signal_No_Range_Check" /begin REF_CHARACTERISTIC DCDC_flgTTempOvrd_C DCDC_tTempOvrdVal_C /end REF_CHARACTERISTIC /end GROUP
/begin GROUP S2566_Input_CAN_Signal_No_Range_Check1 "VBU0513/VBUSystem/HALIn/PTCAN/Subsystem/Subsystem3/DCDC_509/Input_CAN_Signal_No_Range_Check1" /begin REF_CHARACTERISTIC DCDC_flgFlgUndrOutVltgOvrd_C DCDC_flgUndrOutVltgOvrdVal_C /end REF_CHARACTERISTIC /end GROUP
/begin GROUP S2566_Input_CAN_Signal_No_Range_Check2 "VBU0513/VBUSystem/HALIn/PTCAN/Subsystem/Subsystem3/DCDC_509/Input_CAN_Signal_No_Range_Check2" /begin REF_CHARACTERISTIC DCDC_flgFlgOvrOutVltgOvrd_C DCDC_flgOvrOutVltgOvrdVal_C /end REF_CHARACTERISTIC /end GROUP
/begin GROUP S2566_Input_CAN_Signal_No_Range_Check3 "VBU0513/VBUSystem/HALIn/PTCAN/Subsystem/Subsystem3/DCDC_509/Input_CAN_Signal_No_Range_Check3" /begin REF_CHARACTERISTIC DCDC_flgFlgUndrInVltgOvrd_C DCDC_flgUndrInVltgOvrdVal_C /end REF_CHARACTERISTIC /end GROUP
/begin GROUP S2566_Input_CAN_Signal_No_Range_Check4 "VBU0513/VBUSystem/HALIn/PTCAN/Subsystem/Subsystem3/DCDC_509/Input_CAN_Signal_No_Range_Check4" /begin REF_CHARACTERISTIC DCDC_flgFlgOvrInVltgOvrd_C DCDC_flgOvrInVltgOvrdVal_C /end REF_CHARACTERISTIC /end GROUP
/begin GROUP S2566_Input_CAN_Signal_No_Range_Check5 "VBU0513/VBUSystem/HALIn/PTCAN/Subsystem/Subsystem3/DCDC_509/Input_CAN_Signal_No_Range_Check5" /begin REF_CHARACTERISTIC DCDC_flgFlgOvrOutCurrOvrd_C DCDC_flgOvrOutCurrOvrdVal_C /end REF_CHARACTERISTIC /end GROUP
/begin GROUP S2566_Input_CAN_Signal_No_Range_Check6 "VBU0513/VBUSystem/HALIn/PTCAN/Subsystem/Subsystem3/DCDC_509/Input_CAN_Signal_No_Range_Check6" /begin REF_CHARACTERISTIC DCDC_flgFlgOvrInCurrOvrd_C DCDC_flgOvrInCurrOvrdVal_C /end REF_CHARACTERISTIC /end GROUP
/begin GROUP S2566_Input_CAN_Signal_No_Range_Check7 "VBU0513/VBUSystem/HALIn/PTCAN/Subsystem/Subsystem3/DCDC_509/Input_CAN_Signal_No_Range_Check7" /begin REF_CHARACTERISTIC DCDC_flgFlgOvrHeatOvrd_C DCDC_flgOvrHeatOvrdVal_C /end REF_CHARACTERISTIC /end GROUP
/begin GROUP S2566_Input_CAN_Signal_No_Range_Check8 "VBU0513/VBUSystem/HALIn/PTCAN/Subsystem/Subsystem3/DCDC_509/Input_CAN_Signal_No_Range_Check8" /begin REF_CHARACTERISTIC DCDC_flgDeritingOvrdVal_C DCDC_flgFlgDeritingOvrd_C /end REF_CHARACTERISTIC /end GROUP
/begin GROUP S2601_Input_CAN_Signal_No_Range_Check "VBU0513/VBUSystem/HALIn/PTCAN/Subsystem/Subsystem4/AC_248/Input_CAN_Signal_No_Range_Check" /begin REF_CHARACTERISTIC CCU_flgNCompActSpdOvrd_C CCU_nCompActSpdOvrdVal_C /end REF_CHARACTERISTIC /end GROUP
/begin GROUP S2601_Input_CAN_Signal_No_Range_Check1 "VBU0513/VBUSystem/HALIn/PTCAN/Subsystem/Subsystem4/AC_248/Input_CAN_Signal_No_Range_Check1" /begin REF_CHARACTERISTIC CCU_flgStCpmpStatusOvrd_C CCU_stCpmpStatusOvrdVal_C /end REF_CHARACTERISTIC /end GROUP
/begin GROUP S2601_Input_CAN_Signal_No_Range_Check10 "VBU0513/VBUSystem/HALIn/PTCAN/Subsystem/Subsystem4/AC_248/Input_CAN_Signal_No_Range_Check10" /begin REF_CHARACTERISTIC CCU_flgICompCurrOvrd_C CCU_iCompCurrOvrdVal_C /end REF_CHARACTERISTIC /end GROUP
/begin GROUP S2601_Input_CAN_Signal_No_Range_Check11 "VBU0513/VBUSystem/HALIn/PTCAN/Subsystem/Subsystem4/AC_248/Input_CAN_Signal_No_Range_Check11" /begin REF_CHARACTERISTIC CCU_flgUCompVltgOvrd_C CCU_uCompVltgOvrdVal_C /end REF_CHARACTERISTIC /end GROUP
/begin GROUP S2601_Input_CAN_Signal_No_Range_Check2 "VBU0513/VBUSystem/HALIn/PTCAN/Subsystem/Subsystem4/AC_248/Input_CAN_Signal_No_Range_Check2" /begin REF_CHARACTERISTIC CCU_flgStSpdFaultOvrd_C CCU_stSpdFaultOvrdVal_C /end REF_CHARACTERISTIC /end GROUP
/begin GROUP S2601_Input_CAN_Signal_No_Range_Check3 "VBU0513/VBUSystem/HALIn/PTCAN/Subsystem/Subsystem4/AC_248/Input_CAN_Signal_No_Range_Check3"
 /begin REF_CHARACTERISTIC CCU_flgFlgOverCurrFreqRdcOvrd_C CCU_flgOverCurrFreqRdcOvrdVal_C /end REF_CHARACTERISTIC
/end GROUP
/begin GROUP S2601_Input_CAN_Signal_No_Range_Check4 "VBU0513/VBUSystem/HALIn/PTCAN/Subsystem/Subsystem4/AC_248/Input_CAN_Signal_No_Range_Check4" /begin REF_CHARACTERISTIC CCU_flgStCompFaultOvrd_C CCU_stCompFaultOvrdVal_C /end REF_CHARACTERISTIC /end GROUP
/begin GROUP S2601_Input_CAN_Signal_No_Range_Check5 "VBU0513/VBUSystem/HALIn/PTCAN/Subsystem/Subsystem4/AC_248/Input_CAN_Signal_No_Range_Check5"
 /begin REF_CHARACTERISTIC CCU_flgFlgStdbyUndrVltgOvrd_C CCU_flgStdbyUndrVltgOvrdVal_C /end REF_CHARACTERISTIC
/end GROUP
/begin GROUP S2601_Input_CAN_Signal_No_Range_Check6 "VBU0513/VBUSystem/HALIn/PTCAN/Subsystem/Subsystem4/AC_248/Input_CAN_Signal_No_Range_Check6" /begin REF_CHARACTERISTIC CCU_flgFlgStdbyOvrVltgOvrd_C CCU_flgStdbyOvrVltgOvrdVal_C /end REF_CHARACTERISTIC /end GROUP
/begin GROUP S2601_Input_CAN_Signal_No_Range_Check7 "VBU0513/VBUSystem/HALIn/PTCAN/Subsystem/Subsystem4/AC_248/Input_CAN_Signal_No_Range_Check7" /begin REF_CHARACTERISTIC CCU_flgFlgUndrVltgOvrd_C CCU_flgUndrVltgOvrdVal_C /end REF_CHARACTERISTIC /end GROUP
/begin GROUP S2601_Input_CAN_Signal_No_Range_Check8 "VBU0513/VBUSystem/HALIn/PTCAN/Subsystem/Subsystem4/AC_248/Input_CAN_Signal_No_Range_Check8" /begin REF_CHARACTERISTIC CCU_flgFlgOvrVltgOvrd_C CCU_flgOvrVltgOvrdVal_C /end REF_CHARACTERISTIC /end GROUP
/begin GROUP S2601_Input_CAN_Signal_No_Range_Check9 "VBU0513/VBUSystem/HALIn/PTCAN/Subsystem/Subsystem4/AC_248/Input_CAN_Signal_No_Range_Check9" /begin REF_CHARACTERISTIC CCU_flgFlgOvrCurrOvrd_C CCU_flgOvrCurrOvrdVal_C /end REF_CHARACTERISTIC /end GROUP
/begin GROUP S2602_Input_CAN_Signal_No_Range_Check "VBU0513/VBUSystem/HALIn/PTCAN/Subsystem/Subsystem4/CDC_220/Input_CAN_Signal_No_Range_Check" /begin REF_CHARACTERISTIC CDC_flgCreepOnOffOvrdVal_C CDC_flgFlgCreepOnOffOvrd_C /end REF_CHARACTERISTIC /end GROUP
/begin GROUP S2602_Input_CAN_Signal_No_Range_Check1 "VBU0513/VBUSystem/HALIn/PTCAN/Subsystem/Subsystem4/CDC_220/Input_CAN_Signal_No_Range_Check1" /begin REF_CHARACTERISTIC CDC_flgStTowModeOvrd_C CDC_stTowModeOvrdVal_C /end REF_CHARACTERISTIC /end GROUP
/begin GROUP S2602_Input_CAN_Signal_No_Range_Check2 "VBU0513/VBUSystem/HALIn/PTCAN/Subsystem/Subsystem4/CDC_220/Input_CAN_Signal_No_Range_Check2"
 /begin REF_CHARACTERISTIC CDC_flgFlgGoNotifierOnOffOvrd_C CDC_flgGoNotifierOnOffOvrdVal_C /end REF_CHARACTERISTIC
/end GROUP
/begin GROUP S2602_Input_CAN_Signal_No_Range_Check3 "VBU0513/VBUSystem/HALIn/PTCAN/Subsystem/Subsystem4/CDC_220/Input_CAN_Signal_No_Range_Check3" /begin SUB_GROUP S2652_override_signal /end SUB_GROUP /begin REF_CHARACTERISTIC CDC_flgStRgnModeOvrd_C CDC_stRgnModeOvrdVal_C /end REF_CHARACTERISTIC /end GROUP
/begin GROUP S2602_Input_CAN_Signal_No_Range_Check4 "VBU0513/VBUSystem/HALIn/PTCAN/Subsystem/Subsystem4/CDC_220/Input_CAN_Signal_No_Range_Check4" /begin SUB_GROUP S2653_override_signal /end SUB_GROUP /begin REF_CHARACTERISTIC CDC_flgStDrvModeOvrd_C CDC_stDrvModeOvrdVal_C /end REF_CHARACTERISTIC /end GROUP
/begin GROUP S2603_Input_CAN_Signal_No_Range_Check "VBU0513/VBUSystem/HALIn/PTCAN/Subsystem/Subsystem4/DCDC_303/Input_CAN_Signal_No_Range_Check" /begin REF_CHARACTERISTIC DCDC_flgUInputVltgOvrd_C DCDC_uInputVltgOvrdVal_C /end REF_CHARACTERISTIC /end GROUP
/begin GROUP S2603_Input_CAN_Signal_No_Range_Check1 "VBU0513/VBUSystem/HALIn/PTCAN/Subsystem/Subsystem4/DCDC_303/Input_CAN_Signal_No_Range_Check1" /begin REF_CHARACTERISTIC DCDC_flgUOutputVltgOvrd_C DCDC_uOutputVltgOvrdVal_C /end REF_CHARACTERISTIC /end GROUP
/begin GROUP S2603_Input_CAN_Signal_No_Range_Check2 "VBU0513/VBUSystem/HALIn/PTCAN/Subsystem/Subsystem4/DCDC_303/Input_CAN_Signal_No_Range_Check2" /begin REF_CHARACTERISTIC DCDC_flgIInputCurrOvrd_C DCDC_iInputCurrOvrdVal_C /end REF_CHARACTERISTIC /end GROUP
/begin GROUP S2603_Input_CAN_Signal_No_Range_Check3 "VBU0513/VBUSystem/HALIn/PTCAN/Subsystem/Subsystem4/DCDC_303/Input_CAN_Signal_No_Range_Check3" /begin REF_CHARACTERISTIC DCDC_flgIOutputCurrOvrd_C DCDC_iOutputCurrOvrdVal_C /end REF_CHARACTERISTIC /end GROUP
/begin GROUP S2603_Input_CAN_Signal_No_Range_Check4 "VBU0513/VBUSystem/HALIn/PTCAN/Subsystem/Subsystem4/DCDC_303/Input_CAN_Signal_No_Range_Check4" /begin REF_CHARACTERISTIC DCDC_flgStStatusOvrd_C DCDC_stStatusOvrdVal_C /end REF_CHARACTERISTIC /end GROUP
/begin GROUP S2603_Input_CAN_Signal_No_Range_Check5 "VBU0513/VBUSystem/HALIn/PTCAN/Subsystem/Subsystem4/DCDC_303/Input_CAN_Signal_No_Range_Check5" /begin REF_CHARACTERISTIC DCDC_flgEnaFdbkOvrdVal_C DCDC_flgFlgEnaFdbkOvrd_C /end REF_CHARACTERISTIC /end GROUP
/begin GROUP S2604_Input_CAN_Signal_No_Range_Check "VBU0513/VBUSystem/HALIn/PTCAN/Subsystem/Subsystem4/MCU_405/Input_CAN_Signal_No_Range_Check" /begin REF_CHARACTERISTIC PEUR_flgTMeasMaxPhUVWOvrd_C PEUR_tMeasMaxPhUVWOvrdVal_C /end REF_CHARACTERISTIC /end GROUP
/begin GROUP S2604_Input_CAN_Signal_No_Range_Check1 "VBU0513/VBUSystem/HALIn/PTCAN/Subsystem/Subsystem4/MCU_405/Input_CAN_Signal_No_Range_Check1" /begin REF_CHARACTERISTIC PEUR_flgTMeasMaxStrOvrd_C PEUR_tMeasMaxStrOvrdVal_C /end REF_CHARACTERISTIC /end GROUP
/begin GROUP S2604_Input_CAN_Signal_No_Range_Check2 "VBU0513/VBUSystem/HALIn/PTCAN/Subsystem/Subsystem4/MCU_405/Input_CAN_Signal_No_Range_Check2" /begin REF_CHARACTERISTIC PEUR_flgTIPMTempOvrd_C PEUR_tIPMTempOvrdVal_C /end REF_CHARACTERISTIC /end GROUP
/begin GROUP S2604_Input_CAN_Signal_No_Range_Check3 "VBU0513/VBUSystem/HALIn/PTCAN/Subsystem/Subsystem4/MCU_405/Input_CAN_Signal_No_Range_Check3" /begin REF_CHARACTERISTIC PEUR_flgIUVWMaxCurrOvrd_C PEUR_iUVWMaxCurrOvrdVal_C /end REF_CHARACTERISTIC /end GROUP
/begin GROUP S2794_HCUCellTemp_1 "VBU0513/VBUSystem/HALIn/PrivateCAN/CanMsgUnpack1/MsgRxData_Unpack1/CanRxData_Unpack/HCUCellTemp_1"
 /begin REF_MEASUREMENT Temperature_1 Temperature_2 Temperature_3 Temperature_4 Temperature_5 Temperature_6 Temperature_7 Temperature_8 /end REF_MEASUREMENT
/end GROUP
/begin GROUP S2796_HCU_Message_5 "VBU0513/VBUSystem/HALIn/PrivateCAN/CanMsgUnpack1/MsgRxData_Unpack10/CanRxData_Unpack/HCU_Message_5"
 /begin REF_MEASUREMENT ADS_Error_1 ADS_Error_2 Comm_Error HCU_Message_5_Heart Insulation_Resistance Insulation_State Power_5V_High_Error Power_5V_Low_Error Power_Supply_Error_lev Self_Lock_State Self_Test Temp_Line_Error Volt_Line_Error /end REF_MEASUREMENT
/end GROUP
/begin GROUP S2798_HCU_Message_6 "VBU0513/VBUSystem/HALIn/PrivateCAN/CanMsgUnpack1/MsgRxData_Unpack11/CanRxData_Unpack/HCU_Message_6"
 /begin REF_MEASUREMENT Ave_Temp Ave_Volt Board_Temp HCU_Message_6_Heart Total_Volt /end REF_MEASUREMENT
/end GROUP
/begin GROUP S2800_HCU_Message_7_PWM "VBU0513/VBUSystem/HALIn/PrivateCAN/CanMsgUnpack1/MsgRxData_Unpack12/CanRxData_Unpack/HCU_Message_7_PWM"
 /begin REF_MEASUREMENT Insulation_R_Minus Insulation_R_Plus PWM_IN1_Duty PWM_IN1_Freq PWM_IN2_Duty PWM_IN2_Freq /end REF_MEASUREMENT
/end GROUP
/begin GROUP S2802_HCU_Statistics_State1 "VBU0513/VBUSystem/HALIn/PrivateCAN/CanMsgUnpack1/MsgRxData_Unpack13/CanRxData_Unpack/HCU_Statistics_State1"
 /begin REF_MEASUREMENT HCU_Statistics_State1_Heart MaxTempBMU_ID Max_Temp Max_Temp_BMU_index Max_Temp_index Min_Temp /end REF_MEASUREMENT
/end GROUP
/begin GROUP S2804_HCU_Statistics_State10 "VBU0513/VBUSystem/HALIn/PrivateCAN/CanMsgUnpack1/MsgRxData_Unpack14/CanRxData_Unpack/HCU_Statistics_State10"
 /begin REF_MEASUREMENT High_Cell_Temp_3 High_Cell_Temp_3_BMU_ID High_Cell_Temp_3_BMU_Index High_Cell_Temp_4 High_Cell_Temp_4_BMU_ID High_Cell_Temp_4_BMU_Index /end REF_MEASUREMENT
/end GROUP
/begin GROUP S2806_HCU_Statistics_State11 "VBU0513/VBUSystem/HALIn/PrivateCAN/CanMsgUnpack1/MsgRxData_Unpack15/CanRxData_Unpack/HCU_Statistics_State11"
 /begin REF_MEASUREMENT High_Cell_Temp_5 High_Cell_Temp_5_BMU_ID High_Cell_Temp_5_BMU_Index Low_Cell_Temp_1 Low_Cell_Temp_1_BMU_ID Low_Cell_Temp_1_BMU_Index /end REF_MEASUREMENT
/end GROUP
/begin GROUP S2808_HCU_Statistics_State12 "VBU0513/VBUSystem/HALIn/PrivateCAN/CanMsgUnpack1/MsgRxData_Unpack16/CanRxData_Unpack/HCU_Statistics_State12"
 /begin REF_MEASUREMENT Low_Cell_Temp_2 Low_Cell_Temp_2_BMU_ID Low_Cell_Temp_2_BMU_Index Low_Cell_Temp_3 Low_Cell_Temp_3_BMU_ID Low_Cell_Temp_3_BMU_Index /end REF_MEASUREMENT
/end GROUP
/begin GROUP S2810_HCU_Statistics_State13 "VBU0513/VBUSystem/HALIn/PrivateCAN/CanMsgUnpack1/MsgRxData_Unpack17/CanRxData_Unpack/HCU_Statistics_State13"
 /begin REF_MEASUREMENT Low_Cell_Temp_4 Low_Cell_Temp_4_BMU_ID Low_Cell_Temp_4_BMU_Index Low_Cell_Temp_5 Low_Cell_Temp_5_BMU_ID Low_Cell_Temp_5_BMU_Index /end REF_MEASUREMENT
/end GROUP
/begin GROUP S2812_HCU_Statistics_State2 "VBU0513/VBUSystem/HALIn/PrivateCAN/CanMsgUnpack1/MsgRxData_Unpack18/CanRxData_Unpack/HCU_Statistics_State2"
 /begin REF_MEASUREMENT HCU_Statistics_State2_Heart Max_Volt Max_Volt_BMU_ID Max_Volt_Index Min_Temp_BMU_ID Min_Temp_BMU_index Min_Temp_index /end REF_MEASUREMENT
/end GROUP
/begin GROUP S2814_HCU_Statistics_State3 "VBU0513/VBUSystem/HALIn/PrivateCAN/CanMsgUnpack1/MsgRxData_Unpack19/CanRxData_Unpack/HCU_Statistics_State3"
 /begin REF_MEASUREMENT HCU_Statistics_State3_Heart Max_Volt_BMU_index Min_Volt Min_Volt_BMU_ID Min_Volt_BMU_index Min_Volt_Index /end REF_MEASUREMENT
/end GROUP
/begin GROUP S2816_HCUCellTemp_2 "VBU0513/VBUSystem/HALIn/PrivateCAN/CanMsgUnpack1/MsgRxData_Unpack2/CanRxData_Unpack/HCUCellTemp_2"
 /begin REF_MEASUREMENT Temperature_10 Temperature_11 Temperature_12 Temperature_13 Temperature_14 Temperature_15 Temperature_16 Temperature_9 /end REF_MEASUREMENT
/end GROUP
/begin GROUP S2818_HCU_Statistics_State4 "VBU0513/VBUSystem/HALIn/PrivateCAN/CanMsgUnpack1/MsgRxData_Unpack20/CanRxData_Unpack/HCU_Statistics_State4"
 /begin REF_MEASUREMENT High_Cell_Volt_1 High_Cell_Volt_1_BMU_ID High_Cell_Volt_1_BMU_Index High_Cell_Volt_2 High_Cell_Volt_2_BMU_ID High_Cell_Volt_2_BMU_Index /end REF_MEASUREMENT
/end GROUP
/begin GROUP S2820_HCU_Statistics_State5 "VBU0513/VBUSystem/HALIn/PrivateCAN/CanMsgUnpack1/MsgRxData_Unpack21/CanRxData_Unpack/HCU_Statistics_State5"
 /begin REF_MEASUREMENT High_Cell_Volt_3 High_Cell_Volt_3_BMU_ID High_Cell_Volt_3_BMU_Index High_Cell_Volt_4 High_Cell_Volt_4_BMU_ID High_Cell_Volt_4_BMU_Index /end REF_MEASUREMENT
/end GROUP
/begin GROUP S2822_HCU_Statistics_State6 "VBU0513/VBUSystem/HALIn/PrivateCAN/CanMsgUnpack1/MsgRxData_Unpack22/CanRxData_Unpack/HCU_Statistics_State6"
 /begin REF_MEASUREMENT High_Cell_Volt_5 High_Cell_Volt_5_BMU_ID High_Cell_Volt_5_BMU_Index Low_Cell_Volt_1 Low_Cell_Volt_1_BMU_ID Low_Cell_Volt_1_BMU_Index /end REF_MEASUREMENT
/end GROUP
/begin GROUP S2824_HCU_Statistics_State7 "VBU0513/VBUSystem/HALIn/PrivateCAN/CanMsgUnpack1/MsgRxData_Unpack23/CanRxData_Unpack/HCU_Statistics_State7"
 /begin REF_MEASUREMENT Low_Cell_Volt_2 Low_Cell_Volt_2_BMU_ID Low_Cell_Volt_2_BMU_Index Low_Cell_Volt_3 Low_Cell_Volt_3_BMU_ID Low_Cell_Volt_3_BMU_Index /end REF_MEASUREMENT
/end GROUP
/begin GROUP S2826_HCU_Statistics_State8 "VBU0513/VBUSystem/HALIn/PrivateCAN/CanMsgUnpack1/MsgRxData_Unpack24/CanRxData_Unpack/HCU_Statistics_State8"
 /begin REF_MEASUREMENT Low_Cell_Volt_4 Low_Cell_Volt_4_BMU_ID Low_Cell_Volt_4_BMU_Index Low_Cell_Volt_5 Low_Cell_Volt_5_BMU_ID Low_Cell_Volt_5_BMU_Index /end REF_MEASUREMENT
/end GROUP
/begin GROUP S2828_HCU_Statistics_State9 "VBU0513/VBUSystem/HALIn/PrivateCAN/CanMsgUnpack1/MsgRxData_Unpack25/CanRxData_Unpack/HCU_Statistics_State9"
 /begin REF_MEASUREMENT High_Cell_Temp_1 High_Cell_Temp_1_BMU_ID High_Cell_Temp_1_BMU_Index High_Cell_Temp_2 High_Cell_Temp_2_BMU_ID High_Cell_Temp_2_BMU_Index /end REF_MEASUREMENT
/end GROUP
/begin GROUP S2830_HCU_Temp "VBU0513/VBUSystem/HALIn/PrivateCAN/CanMsgUnpack1/MsgRxData_Unpack26/CanRxData_Unpack/HCU_Temp"
 /begin REF_MEASUREMENT Temp_HCU_3 Temp_HCU_4 Temp_HCU_5 Temp_HCU_6 Temp_HCU_7 Temp_HCU_8 Temp_HCU_Water_Inlet Temp_HCU_Water_Outlet /end REF_MEASUREMENT
/end GROUP
/begin GROUP S2832_HCU_Total_Cell_Num "VBU0513/VBUSystem/HALIn/PrivateCAN/CanMsgUnpack1/MsgRxData_Unpack27/CanRxData_Unpack/HCU_Total_Cell_Num" /begin REF_MEASUREMENT Total_Temp_Num Total_Volt_Cell_Num /end REF_MEASUREMENT /end GROUP
/begin GROUP S2834_LEM_CurrentSensor_3C2 "VBU0513/VBUSystem/HALIn/PrivateCAN/CanMsgUnpack1/MsgRxData_Unpack28/CanRxData_Unpack/LEM_CurrentSensor_3C2"
 /begin REF_MEASUREMENT LEM_BatteryCurrent LEM_CurrentSensorInvalid LEM_SensorName LEM_stFaultInfor /end REF_MEASUREMENT
/end GROUP
/begin GROUP S2836_HCUCellVolt1 "VBU0513/VBUSystem/HALIn/PrivateCAN/CanMsgUnpack1/MsgRxData_Unpack29/CanRxData_Unpack/HCUCellVolt1" /begin REF_MEASUREMENT CellVolt1 CellVolt2 CellVolt3 CellVolt4 /end REF_MEASUREMENT /end GROUP
/begin GROUP S2838_HCUCellTemp_3 "VBU0513/VBUSystem/HALIn/PrivateCAN/CanMsgUnpack1/MsgRxData_Unpack3/CanRxData_Unpack/HCUCellTemp_3"
 /begin REF_MEASUREMENT Temperature_17 Temperature_18 Temperature_19 Temperature_20 Temperature_21 Temperature_22 Temperature_23 Temperature_24 /end REF_MEASUREMENT
/end GROUP
/begin GROUP S1149_Calculate_Remaining_Energy "VBU0513/VBUSystem/BMS/SOE/Subsystem2/Subsystem/Calculate_Pack_Remaining_Energy/Discharge_Mode/Calculate_Remaining_Energy" /begin REF_CHARACTERISTIC CcSOE_CellEnergyBoL_Kwh /end REF_CHARACTERISTIC /end GROUP
/begin GROUP S1149_Predict_SOC_End "VBU0513/VBUSystem/BMS/SOE/Subsystem2/Subsystem/Calculate_Pack_Remaining_Energy/Discharge_Mode/Predict_SOC_End" /begin REF_CHARACTERISTIC CcSOE_CellSocDelta_pct /end REF_CHARACTERISTIC /end GROUP
/begin GROUP S1569_Normal_Condition "VBU0513/VBUSystem/BMS/THM/Subsystem/Subsystem/Charge_Mode_Temp_Request/OBC_Temp_Request/Normal_Condition"
 /begin REF_CHARACTERISTIC CcTHM_ChargeTempRequestHighThreshold_C CcTHM_PackSohORF_flg CcTHM_PackSohORV_pct /end REF_CHARACTERISTIC
/end GROUP
/end MODULE
/end PROJECT
