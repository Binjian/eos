ASAP2_VERSION 1 31
/begin PROJECT ProjectName "Project Comment Goes Here"
/begin HEADER "Header Comments go here" /end HEADER
/begin MODULE ModuleName "Module Comment Goes Here"
/begin MOD_COMMON "Mod Common Comment Here" BYTE_ORDER MSB_LAST /end MOD_COMMON
/begin RECORD_LAYOUT Scalar_BOOLEAN FNC_VALUES 1 UBYTE COLUMN_DIR DIRECT /end RECORD_LAYOUT
/begin RECORD_LAYOUT Scalar_UBYTE FNC_VALUES 1 UBYTE COLUMN_DIR DIRECT /end RECORD_LAYOUT
/begin RECORD_LAYOUT Scalar_BYTE FNC_VALUES 1 SBYTE COLUMN_DIR DIRECT /end RECORD_LAYOUT
/begin RECORD_LAYOUT Scalar_UWORD FNC_VALUES 1 UWORD COLUMN_DIR DIRECT /end RECORD_LAYOUT
/begin RECORD_LAYOUT Scalar_ULONG FNC_VALUES 1 ULONG COLUMN_DIR DIRECT /end RECORD_LAYOUT
/begin RECORD_LAYOUT Scalar_FLOAT32_IEEE FNC_VALUES 1 FLOAT32_IEEE COLUMN_DIR DIRECT /end RECORD_LAYOUT
/begin RECORD_LAYOUT Scalar_FLOAT64_IEEE FNC_VALUES 1 FLOAT64_IEEE COLUMN_DIR DIRECT /end RECORD_LAYOUT
/begin RECORD_LAYOUT Lookup1D_BYTE FNC_VALUES 1 SBYTE COLUMN_DIR DIRECT /end RECORD_LAYOUT
/begin RECORD_LAYOUT Lookup1D_X_BYTE AXIS_PTS_X 1 SBYTE INDEX_INCR DIRECT /end RECORD_LAYOUT
/begin RECORD_LAYOUT Lookup2D_FLOAT32_IEEE FNC_VALUES 1 FLOAT32_IEEE COLUMN_DIR DIRECT /end RECORD_LAYOUT
/begin RECORD_LAYOUT Lookup2D_X_FLOAT32_IEEE AXIS_PTS_X 1 FLOAT32_IEEE INDEX_INCR DIRECT /end RECORD_LAYOUT
/begin CHARACTERISTIC TQD_trqDrvBrkRgn_MAP_V "" MAP 0x70016290 Lookup2D_FLOAT32_IEEE 0 VBU0428Test_CM_single_cnt -10000.0 10000.0
 /begin AXIS_DESCR COM_AXIS TQD_vVehSpd VBU0428Test_CM_single_cnt 8 0.0 100.0 AXIS_PTS_REF TQD_pBrkDrvPressFlt /end AXIS_DESCR
 /begin AXIS_DESCR COM_AXIS TQD_pBrkPressFlt VBU0428Test_CM_single_cnt 13 -250.0 250.0 AXIS_PTS_REF TQD_vBrkPressVehSpd /end AXIS_DESCR
/end CHARACTERISTIC
/begin AXIS_PTS TQD_vBrkPressVehSpd "" 0x7001377e TQD_pBrkPressFlt Lookup2D_X_FLOAT32_IEEE 0 VBU0428Test_CM_single_cnt 13 -250.0 250.0 /end AXIS_PTS
/begin AXIS_PTS TQD_pBrkDrvPressFlt "" 0x7001259e TQD_vVehSpd Lookup2D_X_FLOAT32_IEEE 0 VBU0428Test_CM_single_cnt 8 0.0 100.0 /end AXIS_PTS
/begin CHARACTERISTIC TQD_trqRvsBrkRgn_MAP_V "" MAP 0x70016430 Lookup2D_FLOAT32_IEEE 0 VBU0428Test_CM_single_cnt -10000.0 10000.0
 /begin AXIS_DESCR COM_AXIS TQD_vVehSpd VBU0428Test_CM_single_cnt 8 0.0 100.0 AXIS_PTS_REF TQD_pBrkRvsPressFlt /end AXIS_DESCR
 /begin AXIS_DESCR COM_AXIS TQD_pBrkPressFlt VBU0428Test_CM_single_cnt 13 -250.0 250.0 AXIS_PTS_REF TQD_vBrkPressVehSpd /end AXIS_DESCR
/end CHARACTERISTIC
/begin AXIS_PTS TQD_pBrkRvsPressFlt "" 0x700125be TQD_vVehSpd Lookup2D_X_FLOAT32_IEEE 0 VBU0428Test_CM_single_cnt 8 0.0 100.0 /end AXIS_PTS
/begin CHARACTERISTIC TQD_flgBrkRgnConfig_C "" VALUE 0x70011890 Scalar_FLOAT64_IEEE 0 VBU0428Test_CM_double -1.7E+308 1.7E+308 /end CHARACTERISTIC
/begin CHARACTERISTIC APO_ACOvrdVal_C "" VALUE 0x700101a8 Scalar_FLOAT32_IEEE 0 VBU0428Test_CM_single_cnt -3.4028234663852886E+38 3.4028234663852886E+38 /end CHARACTERISTIC
/begin CHARACTERISTIC APO_ACPowerOvrdVal_C "" VALUE 0x700101ac Scalar_FLOAT32_IEEE 0 VBU0428Test_CM_single_cnt -3.4028234663852886E+38 3.4028234663852886E+38 /end CHARACTERISTIC
/begin CHARACTERISTIC APO_ACSpeedOvrdVal_C "" VALUE 0x700101b0 Scalar_FLOAT32_IEEE 0 VBU0428Test_CM_single_cnt -3.4028234663852886E+38 3.4028234663852886E+38 /end CHARACTERISTIC
/begin CHARACTERISTIC APO_BrakWarningOvrdVal_C "" VALUE 0x700101c0 Scalar_FLOAT32_IEEE 0 VBU0428Test_CM_single_cnt -3.4028234663852886E+38 3.4028234663852886E+38 /end CHARACTERISTIC
/begin CHARACTERISTIC APO_BrkingWhileDrivingOvrdVal_C "" VALUE 0x700101c4 Scalar_FLOAT32_IEEE 0 VBU0428Test_CM_single_cnt -3.4028234663852886E+38 3.4028234663852886E+38 /end CHARACTERISTIC
/begin CHARACTERISTIC APO_CruiseStatusOvrdVal_C "" VALUE 0x700101c8 Scalar_FLOAT32_IEEE 0 VBU0428Test_CM_single_cnt -3.4028234663852886E+38 3.4028234663852886E+38 /end CHARACTERISTIC
/begin CHARACTERISTIC APO_EPBCtrlModeOvrdVal_C "" VALUE 0x700101cc Scalar_FLOAT32_IEEE 0 VBU0428Test_CM_single_cnt -3.4028234663852886E+38 3.4028234663852886E+38 /end CHARACTERISTIC
/begin CHARACTERISTIC APO_EPBFaultOvrdVal_C "" VALUE 0x700101d0 Scalar_FLOAT32_IEEE 0 VBU0428Test_CM_single_cnt -3.4028234663852886E+38 3.4028234663852886E+38 /end CHARACTERISTIC
/begin CHARACTERISTIC APO_EPFaultLevelWarningOvrdVal_C "" VALUE 0x700101d4 Scalar_FLOAT32_IEEE 0 VBU0428Test_CM_single_cnt -3.4028234663852886E+38 3.4028234663852886E+38 /end CHARACTERISTIC
/begin CHARACTERISTIC APO_EPSFaultOvrdVal_C "" VALUE 0x700101d8 Scalar_FLOAT32_IEEE 0 VBU0428Test_CM_single_cnt -3.4028234663852886E+38 3.4028234663852886E+38 /end CHARACTERISTIC
/begin CHARACTERISTIC APO_LimpHomeOvrdVal_C "" VALUE 0x700101e0 Scalar_FLOAT32_IEEE 0 VBU0428Test_CM_single_cnt -3.4028234663852886E+38 3.4028234663852886E+38 /end CHARACTERISTIC
/begin CHARACTERISTIC APO_OverSpeedOvrdVal_C "" VALUE 0x700101e4 Scalar_FLOAT32_IEEE 0 VBU0428Test_CM_single_cnt -3.4028234663852886E+38 3.4028234663852886E+38 /end CHARACTERISTIC
/begin CHARACTERISTIC APO_PlsUSE750VDCOvrdVal_C "" VALUE 0x700101e8 Scalar_FLOAT32_IEEE 0 VBU0428Test_CM_single_cnt -3.4028234663852886E+38 3.4028234663852886E+38 /end CHARACTERISTIC
/begin CHARACTERISTIC APO_PowerModeOvrdVal_C "" VALUE 0x700101ec Scalar_FLOAT32_IEEE 0 VBU0428Test_CM_single_cnt -3.4028234663852886E+38 3.4028234663852886E+38 /end CHARACTERISTIC
/begin CHARACTERISTIC APO_TotalChargeEnergyOvrdVal_C "" VALUE 0x70010200 Scalar_FLOAT32_IEEE 0 VBU0428Test_CM_single_cnt -3.4028234663852886E+38 3.4028234663852886E+38 /end CHARACTERISTIC
/begin CHARACTERISTIC APO_TotalDischargeEnergyOvrdVal_C "" VALUE 0x70010204 Scalar_FLOAT32_IEEE 0 VBU0428Test_CM_single_cnt -3.4028234663852886E+38 3.4028234663852886E+38 /end CHARACTERISTIC
/begin CHARACTERISTIC APO_VCURemainingRngOvrdVal_C "" VALUE 0x70010208 Scalar_FLOAT32_IEEE 0 VBU0428Test_CM_single_cnt -3.4028234663852886E+38 3.4028234663852886E+38 /end CHARACTERISTIC
/begin CHARACTERISTIC APO_VehicleModeOvrdVal_C "" VALUE 0x7001020c Scalar_FLOAT32_IEEE 0 VBU0428Test_CM_single_cnt -3.4028234663852886E+38 3.4028234663852886E+38 /end CHARACTERISTIC
/begin CHARACTERISTIC APO_fACPumpOvrdVal_C "" VALUE 0x70010214 Scalar_FLOAT32_IEEE 0 VBU0428Test_CM_single_cnt -3.4028234663852886E+38 3.4028234663852886E+38 /end CHARACTERISTIC
/begin CHARACTERISTIC APO_fFanOvrdVal_C "" VALUE 0x70010218 Scalar_FLOAT32_IEEE 0 VBU0428Test_CM_single_cnt -3.4028234663852886E+38 3.4028234663852886E+38 /end CHARACTERISTIC
/begin CHARACTERISTIC APO_fHVIL1OvrdVal_C "" VALUE 0x7001021c Scalar_FLOAT32_IEEE 0 VBU0428Test_CM_single_cnt -3.4028234663852886E+38 3.4028234663852886E+38 /end CHARACTERISTIC
/begin CHARACTERISTIC APO_fVacuumPumpOvrdVal_C "" VALUE 0x70010220 Scalar_FLOAT32_IEEE 0 VBU0428Test_CM_single_cnt -3.4028234663852886E+38 3.4028234663852886E+38 /end CHARACTERISTIC
/begin CHARACTERISTIC APO_fWaterPump1OvrdVal_C "" VALUE 0x70010224 Scalar_FLOAT32_IEEE 0 VBU0428Test_CM_single_cnt -3.4028234663852886E+38 3.4028234663852886E+38 /end CHARACTERISTIC
/begin CHARACTERISTIC APO_fWaterPump2OvrdVal_C "" VALUE 0x70010228 Scalar_FLOAT32_IEEE 0 VBU0428Test_CM_single_cnt -3.4028234663852886E+38 3.4028234663852886E+38 /end CHARACTERISTIC
/begin CHARACTERISTIC APO_pctACPumpOvrdVal_C "" VALUE 0x7001023c Scalar_FLOAT32_IEEE 0 VBU0428Test_CM_single_cnt -3.4028234663852886E+38 3.4028234663852886E+38 /end CHARACTERISTIC
/begin CHARACTERISTIC APO_pctFanOvrdVal_C "" VALUE 0x70010250 Scalar_FLOAT32_IEEE 0 VBU0428Test_CM_single_cnt -3.4028234663852886E+38 3.4028234663852886E+38 /end CHARACTERISTIC
/begin CHARACTERISTIC APO_pctHVIL1OvrdVal_C "" VALUE 0x70010254 Scalar_FLOAT32_IEEE 0 VBU0428Test_CM_single_cnt -3.4028234663852886E+38 3.4028234663852886E+38 /end CHARACTERISTIC
/begin CHARACTERISTIC APO_pctWaterPump1OvrdVal_C "" VALUE 0x70010258 Scalar_FLOAT32_IEEE 0 VBU0428Test_CM_single_cnt -3.4028234663852886E+38 3.4028234663852886E+38 /end CHARACTERISTIC
/begin CHARACTERISTIC APO_pctWaterPump2OvrdVal_C "" VALUE 0x7001025c Scalar_FLOAT32_IEEE 0 VBU0428Test_CM_single_cnt -3.4028234663852886E+38 3.4028234663852886E+38 /end CHARACTERISTIC
/begin CHARACTERISTIC CaBMM_HALKL30BMUVoltageORV_V "" VAL_BLK 0x70012992 Scalar_FLOAT32_IEEE 0 VBU0428Test_CM_single_cnt -3.4028234663852886E+38 3.4028234663852886E+38 NUMBER 10 /end CHARACTERISTIC
/begin CHARACTERISTIC CcBCV_HALBatteryVoltageORV_V "" VALUE 0x70010530 Scalar_FLOAT32_IEEE 0 VBU0428Test_CM_single_cnt -3.4028234663852886E+38 3.4028234663852886E+38 /end CHARACTERISTIC
/begin CHARACTERISTIC CcBCV_HALBusNegativeVoltageORV_V "" VALUE 0x70010534 Scalar_FLOAT32_IEEE 0 VBU0428Test_CM_single_cnt -3.4028234663852886E+38 3.4028234663852886E+38 /end CHARACTERISTIC
/begin CHARACTERISTIC CcBCV_HALFuseVoltageORV_V "" VALUE 0x70010538 Scalar_FLOAT32_IEEE 0 VBU0428Test_CM_single_cnt -3.4028234663852886E+38 3.4028234663852886E+38 /end CHARACTERISTIC
/begin CHARACTERISTIC CcBCV_HALPrechargeVoltageORV_V "" VALUE 0x7001053c Scalar_FLOAT32_IEEE 0 VBU0428Test_CM_single_cnt -3.4028234663852886E+38 3.4028234663852886E+38 /end CHARACTERISTIC
/begin CHARACTERISTIC CcBCV_HALVx2VoltageORV_V "" VALUE 0x70010540 Scalar_FLOAT32_IEEE 0 VBU0428Test_CM_single_cnt -3.4028234663852886E+38 3.4028234663852886E+38 /end CHARACTERISTIC
/begin CHARACTERISTIC CcBMM_HALKL30BMUVoltageLow_V "" VALUE 0x7001054c Scalar_FLOAT32_IEEE 0 VBU0428Test_CM_single_cnt -3.4028234663852886E+38 3.4028234663852886E+38 /end CHARACTERISTIC
/begin CHARACTERISTIC CcBMM_SOCJumpThreshold_pct "" VALUE 0x70010554 Scalar_FLOAT32_IEEE 0 VBU0428Test_CM_single_cnt -3.4028234663852886E+38 3.4028234663852886E+38 /end CHARACTERISTIC
/begin CHARACTERISTIC CcCBL_BoardTempBalanceStartMaxHysteresis_C "" VALUE 0x70010570 Scalar_FLOAT32_IEEE 0 VBU0428Test_CM_single_cnt -3.4028234663852886E+38 3.4028234663852886E+38 /end CHARACTERISTIC
/begin CHARACTERISTIC CcCBL_BoardTempBalanceStartMax_C "" VALUE 0x70010574 Scalar_FLOAT32_IEEE 0 VBU0428Test_CM_single_cnt -3.4028234663852886E+38 3.4028234663852886E+38 /end CHARACTERISTIC
/begin CHARACTERISTIC CcCBL_CTMBoardTempMaxORV_C "" VALUE 0x70010578 Scalar_FLOAT32_IEEE 0 VBU0428Test_CM_single_cnt -3.4028234663852886E+38 3.4028234663852886E+38 /end CHARACTERISTIC
/begin CHARACTERISTIC CcCTD_HALSystemVoltageHighDelta_V "" VALUE 0x700105b0 Scalar_FLOAT32_IEEE 0 VBU0428Test_CM_single_cnt -3.4028234663852886E+38 3.4028234663852886E+38 /end CHARACTERISTIC
/begin CHARACTERISTIC CcCTD_HALSystemVoltageHigh_V "" VALUE 0x700105b4 Scalar_FLOAT32_IEEE 0 VBU0428Test_CM_single_cnt -3.4028234663852886E+38 3.4028234663852886E+38 /end CHARACTERISTIC
/begin CHARACTERISTIC CcCTD_HALSystemVoltageLowDelta_V "" VALUE 0x700105b8 Scalar_FLOAT32_IEEE 0 VBU0428Test_CM_single_cnt -3.4028234663852886E+38 3.4028234663852886E+38 /end CHARACTERISTIC
/begin CHARACTERISTIC CcCTD_HALSystemVoltageLow_V "" VALUE 0x700105bc Scalar_FLOAT32_IEEE 0 VBU0428Test_CM_single_cnt -3.4028234663852886E+38 3.4028234663852886E+38 /end CHARACTERISTIC
/begin CHARACTERISTIC CcCTD_MainFuseBlownDeltaVoltage_V "" VALUE 0x700105c4 Scalar_FLOAT32_IEEE 0 VBU0428Test_CM_single_cnt -3.4028234663852886E+38 3.4028234663852886E+38 /end CHARACTERISTIC
/begin CHARACTERISTIC CcCTD_PrechargeResistanceBlownDeltaVoltage_V "" VALUE 0x70010608 Scalar_FLOAT32_IEEE 0 VBU0428Test_CM_single_cnt -3.4028234663852886E+38 3.4028234663852886E+38 /end CHARACTERISTIC
/begin CHARACTERISTIC CcCTM_BoardOverTempFault_C "" VALUE 0x70010628 Scalar_FLOAT32_IEEE 0 VBU0428Test_CM_single_cnt -3.4028234663852886E+38 3.4028234663852886E+38 /end CHARACTERISTIC
/begin CHARACTERISTIC CcCTM_BoardTempInvalidFaultDelayTime_ms "" VALUE 0x7001062c Scalar_FLOAT32_IEEE 0 VBU0428Test_CM_single_cnt -3.4028234663852886E+38 3.4028234663852886E+38 /end CHARACTERISTIC
/begin CHARACTERISTIC CcCTM_CSCSupplyPowerLowHysteresis_V "" VALUE 0x70010630 Scalar_FLOAT32_IEEE 0 VBU0428Test_CM_single_cnt -3.4028234663852886E+38 3.4028234663852886E+38 /end CHARACTERISTIC
/begin CHARACTERISTIC CcCTM_CSCSupplyPowerLow_V "" VALUE 0x70010634 Scalar_FLOAT32_IEEE 0 VBU0428Test_CM_single_cnt -3.4028234663852886E+38 3.4028234663852886E+38 /end CHARACTERISTIC
/begin CHARACTERISTIC CcCTM_CellOverTempEVMFault_C "" VALUE 0x70010638 Scalar_FLOAT32_IEEE 0 VBU0428Test_CM_single_cnt -3.4028234663852886E+38 3.4028234663852886E+38 /end CHARACTERISTIC
/begin CHARACTERISTIC CcCTM_CellOverTempFault_C "" VALUE 0x7001063c Scalar_FLOAT32_IEEE 0 VBU0428Test_CM_single_cnt -3.4028234663852886E+38 3.4028234663852886E+38 /end CHARACTERISTIC
/begin CHARACTERISTIC CcCTM_CellOverTempLvl2Fault_C "" VALUE 0x70010640 Scalar_FLOAT32_IEEE 0 VBU0428Test_CM_single_cnt -3.4028234663852886E+38 3.4028234663852886E+38 /end CHARACTERISTIC
/begin CHARACTERISTIC CcCTM_CellOverTempWarningFault_C "" VALUE 0x70010648 Scalar_FLOAT32_IEEE 0 VBU0428Test_CM_single_cnt -3.4028234663852886E+38 3.4028234663852886E+38 /end CHARACTERISTIC
/begin CHARACTERISTIC CcCTM_CellTempInvalidFaultDelayTime_ms "" VALUE 0x7001064c Scalar_FLOAT32_IEEE 0 VBU0428Test_CM_single_cnt -3.4028234663852886E+38 3.4028234663852886E+38 /end CHARACTERISTIC
/begin CHARACTERISTIC CcCTM_CellTempOverDeviationEVMFault_C "" VALUE 0x70010650 Scalar_FLOAT32_IEEE 0 VBU0428Test_CM_single_cnt -3.4028234663852886E+38 3.4028234663852886E+38 /end CHARACTERISTIC
/begin CHARACTERISTIC CcCTM_CellUnderTempFault_C "" VALUE 0x70010658 Scalar_FLOAT32_IEEE 0 VBU0428Test_CM_single_cnt -3.4028234663852886E+38 3.4028234663852886E+38 /end CHARACTERISTIC
/begin CHARACTERISTIC CcCTM_EnableEVMTempDevDelayTime_ms "" VALUE 0x7001065c Scalar_FLOAT32_IEEE 0 VBU0428Test_CM_single_cnt -3.4028234663852886E+38 3.4028234663852886E+38 /end CHARACTERISTIC
/begin CHARACTERISTIC CcCTM_EnableEVMTempDevThreshold_A "" VALUE 0x70010660 Scalar_FLOAT32_IEEE 0 VBU0428Test_CM_single_cnt -3.4028234663852886E+38 3.4028234663852886E+38 /end CHARACTERISTIC
/begin CHARACTERISTIC CcCTM_PowerOnTempVoltageDelay_ms "" VALUE 0x70010664 Scalar_FLOAT32_IEEE 0 VBU0428Test_CM_single_cnt -3.4028234663852886E+38 3.4028234663852886E+38 /end CHARACTERISTIC
/begin CHARACTERISTIC CcCTS_DeltaVoltagePrecharge_V "" VALUE 0x70010688 Scalar_FLOAT32_IEEE 0 VBU0428Test_CM_single_cnt 0.0 800.0 /end CHARACTERISTIC
/begin CHARACTERISTIC CcCTS_OpenContactorsDelayTime_ms "" VALUE 0x7001068c Scalar_FLOAT32_IEEE 0 VBU0428Test_CM_single_cnt -3.4028234663852886E+38 3.4028234663852886E+38 /end CHARACTERISTIC
/begin CHARACTERISTIC CcCTS_PrechargeTimerLimit_ms "" VALUE 0x70010690 Scalar_FLOAT32_IEEE 0 VBU0428Test_CM_single_cnt -3.4028234663852886E+38 3.4028234663852886E+38 /end CHARACTERISTIC
/begin CHARACTERISTIC CcCTS_PrechargeTimer_ms "" VALUE 0x70010694 Scalar_FLOAT32_IEEE 0 VBU0428Test_CM_single_cnt -3.4028234663852886E+38 3.4028234663852886E+38 /end CHARACTERISTIC
/begin CHARACTERISTIC DCH_cBCPNrmCapOvrdVal_C "" VALUE 0x70010c6c Scalar_FLOAT32_IEEE 0 VBU0428Test_CM_single_cnt -3.4028234663852886E+38 3.4028234663852886E+38 /end CHARACTERISTIC
/begin CHARACTERISTIC DCH_cBRMBattRatedCapOvrdVal_C "" VALUE 0x70010c70 Scalar_FLOAT32_IEEE 0 VBU0428Test_CM_single_cnt -3.4028234663852886E+38 3.4028234663852886E+38 /end CHARACTERISTIC
/begin CHARACTERISTIC DCH_iBCPMaxChCurrOvrdVal_C "" VALUE 0x70010c8c Scalar_FLOAT32_IEEE 0 VBU0428Test_CM_single_cnt -3.4028234663852886E+38 3.4028234663852886E+38 /end CHARACTERISTIC
/begin CHARACTERISTIC DCH_iBCSChCurrMeasureOvrdVal_C "" VALUE 0x70010c90 Scalar_FLOAT32_IEEE 0 VBU0428Test_CM_single_cnt -3.4028234663852886E+38 3.4028234663852886E+38 /end CHARACTERISTIC
/begin CHARACTERISTIC DCH_numBCSMaxCellVltgNumOvrdVal_C "" VALUE 0x70010cc4 Scalar_FLOAT32_IEEE 0 VBU0428Test_CM_single_cnt -3.4028234663852886E+38 3.4028234663852886E+38 /end CHARACTERISTIC
/begin CHARACTERISTIC DCH_pctBCPSocOvrdVal_C "" VALUE 0x70010d30 Scalar_FLOAT32_IEEE 0 VBU0428Test_CM_single_cnt -3.4028234663852886E+38 3.4028234663852886E+38 /end CHARACTERISTIC
/begin CHARACTERISTIC DCH_pctBCSCurrSocOvrdVal_C "" VALUE 0x70010d34 Scalar_FLOAT32_IEEE 0 VBU0428Test_CM_single_cnt -3.4028234663852886E+38 3.4028234663852886E+38 /end CHARACTERISTIC
/begin CHARACTERISTIC DCH_tBCPMaxPermitTempOvrdVal_C "" VALUE 0x70010d40 Scalar_FLOAT32_IEEE 0 VBU0428Test_CM_single_cnt -3.4028234663852886E+38 3.4028234663852886E+38 /end CHARACTERISTIC
/begin CHARACTERISTIC DCH_tiBCSChNeedTOvrdVal_C "" VALUE 0x70010d84 Scalar_FLOAT32_IEEE 0 VBU0428Test_CM_single_cnt -3.4028234663852886E+38 3.4028234663852886E+38 /end CHARACTERISTIC
/begin CHARACTERISTIC DCH_uBCPBattVltgOvrdVal_C "" VALUE 0x70010e04 Scalar_FLOAT32_IEEE 0 VBU0428Test_CM_single_cnt -3.4028234663852886E+38 3.4028234663852886E+38 /end CHARACTERISTIC
/begin CHARACTERISTIC DCH_uBCPMaxCellVltgForChOvrdVal_C "" VALUE 0x70010e08 Scalar_FLOAT32_IEEE 0 VBU0428Test_CM_single_cnt -3.4028234663852886E+38 3.4028234663852886E+38 /end CHARACTERISTIC
/begin CHARACTERISTIC DCH_uBCPMaxVltgForChOvrdVal_C "" VALUE 0x70010e0c Scalar_FLOAT32_IEEE 0 VBU0428Test_CM_single_cnt -3.4028234663852886E+38 3.4028234663852886E+38 /end CHARACTERISTIC
/begin CHARACTERISTIC DCH_uBCSChVltgMeasureOvrdVal_C "" VALUE 0x70010e10 Scalar_FLOAT32_IEEE 0 VBU0428Test_CM_single_cnt -3.4028234663852886E+38 3.4028234663852886E+38 /end CHARACTERISTIC
/begin CHARACTERISTIC DCH_uBCSMaxCellVltgOvrdVal_C "" VALUE 0x70010e14 Scalar_FLOAT32_IEEE 0 VBU0428Test_CM_single_cnt -3.4028234663852886E+38 3.4028234663852886E+38 /end CHARACTERISTIC
/begin CHARACTERISTIC DCH_uBRMBattRatedVltgOvrdVal_C "" VALUE 0x70010e18 Scalar_FLOAT32_IEEE 0 VBU0428Test_CM_single_cnt -3.4028234663852886E+38 3.4028234663852886E+38 /end CHARACTERISTIC
/begin CHARACTERISTIC DSPL_facMtrDrvLT_C "" VALUE 0x70010f78 Scalar_FLOAT32_IEEE 0 VBU0428Test_CM_single_fac 0.0 1.0 /end CHARACTERISTIC
/begin CHARACTERISTIC DSPL_facRegenReq_C "" VALUE 0x70010f7c Scalar_FLOAT32_IEEE 0 VBU0428Test_CM_single_fac 0.0 1.0 /end CHARACTERISTIC
/begin CHARACTERISTIC DSPL_nMotSpdOvrSpdLower_C "" VALUE 0x70010fd8 Scalar_FLOAT32_IEEE 0 VBU0428Test_CM_single_cnt 0.0 1.0E+23 /end CHARACTERISTIC
/begin CHARACTERISTIC DSPL_pctAccPedLe_C "" VALUE 0x70010fe0 Scalar_FLOAT32_IEEE 0 VBU0428Test_CM_single_pct 0.0 100.0 /end CHARACTERISTIC
/begin CHARACTERISTIC DSPL_pctAccPedRe_C "" VALUE 0x70010fe4 Scalar_FLOAT32_IEEE 0 VBU0428Test_CM_single_pct 0.0 100.0 /end CHARACTERISTIC
/begin CHARACTERISTIC DSPL_pctSocLowWarnLower_C "" VALUE 0x7001101c Scalar_FLOAT32_IEEE 0 VBU0428Test_CM_single_pct 0.0 100.0 /end CHARACTERISTIC
/begin CHARACTERISTIC DSPL_pctSocLowWarnUpper_C "" VALUE 0x70011020 Scalar_FLOAT32_IEEE 0 VBU0428Test_CM_single_pct 0.0 100.0 /end CHARACTERISTIC
/begin CHARACTERISTIC DSPL_tiDCDCStsFail_C "" VALUE 0x70011040 Scalar_FLOAT32_IEEE 0 VBU0428Test_CM_single_s 0.0 1.0E+23 /end CHARACTERISTIC
/begin CHARACTERISTIC DSPL_tiDisableDCDC_C "" VALUE 0x7001104c Scalar_FLOAT32_IEEE 0 VBU0428Test_CM_single_s 0.0 1.0E+23 /end CHARACTERISTIC
/begin CHARACTERISTIC DSPL_tiMotOvrSpd_C "" VALUE 0x70011060 Scalar_FLOAT32_IEEE 0 VBU0428Test_CM_single_s 0.0 1.0E+23 /end CHARACTERISTIC
/begin CHARACTERISTIC DSPL_tiMtrDrvLT_C "" VALUE 0x70011064 Scalar_FLOAT32_IEEE 0 VBU0428Test_CM_single_s 0.0 1.0E+23 /end CHARACTERISTIC
/begin CHARACTERISTIC DSPL_tiRegenLimDecline_C "" VALUE 0x70011068 Scalar_FLOAT32_IEEE 0 VBU0428Test_CM_single_s 0.0 1.0E+23 /end CHARACTERISTIC
/begin CHARACTERISTIC DSPL_tiRegenLimRise_C "" VALUE 0x7001106c Scalar_FLOAT32_IEEE 0 VBU0428Test_CM_single_s 0.0 1.0E+23 /end CHARACTERISTIC
/begin CHARACTERISTIC DSPL_tiSample_SY "" VALUE 0x70011078 Scalar_FLOAT32_IEEE 0 VBU0428Test_CM_single_s 0.0 1.0E+23 /end CHARACTERISTIC
/begin CHARACTERISTIC DSPL_trqMotReqLe_C "" VALUE 0x7001107c Scalar_FLOAT32_IEEE 0 VBU0428Test_CM_single_cnt 0.0 1.0E+23 /end CHARACTERISTIC
/begin CHARACTERISTIC DSPL_trqMotReqRe_C "" VALUE 0x70011080 Scalar_FLOAT32_IEEE 0 VBU0428Test_CM_single_cnt 0.0 1.0E+23 /end CHARACTERISTIC
/begin CHARACTERISTIC DSPL_trqMtrDrvLTHi_C "" VALUE 0x70011084 Scalar_FLOAT32_IEEE 0 VBU0428Test_CM_single_cnt 0.0 1.0E+23 /end CHARACTERISTIC
/begin CHARACTERISTIC DSPL_trqMtrDrvLTLo_C "" VALUE 0x70011088 Scalar_FLOAT32_IEEE 0 VBU0428Test_CM_single_cnt 0.0 1.0E+23 /end CHARACTERISTIC
/begin CHARACTERISTIC DSPL_trqRegenReqLe_C "" VALUE 0x7001108c Scalar_FLOAT32_IEEE 0 VBU0428Test_CM_single_cnt 0.0 1.0E+23 /end CHARACTERISTIC
/begin CHARACTERISTIC DSPL_trqRegenReqRe_C "" VALUE 0x70011090 Scalar_FLOAT32_IEEE 0 VBU0428Test_CM_single_cnt 0.0 1.0E+23 /end CHARACTERISTIC
/begin CHARACTERISTIC DSPL_vVehSpdRegenLe_C "" VALUE 0x700110a0 Scalar_FLOAT32_IEEE 0 VBU0428Test_CM_single_cnt 0.0 1.0E+23 /end CHARACTERISTIC
/begin CHARACTERISTIC DSPL_vVehSpdRegenRe_C "" VALUE 0x700110a4 Scalar_FLOAT32_IEEE 0 VBU0428Test_CM_single_cnt 0.0 1.0E+23 /end CHARACTERISTIC
/begin CHARACTERISTIC EDIS_pwrCurrPwrOvrdVal_C "" VALUE 0x7001110c Scalar_FLOAT32_IEEE 0 VBU0428Test_CM_single_cnt -3.4028234663852886E+38 3.4028234663852886E+38 /end CHARACTERISTIC
/begin CHARACTERISTIC EPFaultLevelWarning "" VALUE 0x700111fc Scalar_FLOAT32_IEEE 0 VBU0428Test_CM_single_cnt 0.0 1.0E+23 /end CHARACTERISTIC
/begin CHARACTERISTIC HVBattCutOffOvrdVal_C "" VALUE 0x700112b4 Scalar_FLOAT32_IEEE 0 VBU0428Test_CM_single_cnt -3.4028234663852886E+38 3.4028234663852886E+38 /end CHARACTERISTIC
/begin CHARACTERISTIC LVC_uDCDCReqOvrdVal_C "" VALUE 0x700113ac Scalar_FLOAT32_IEEE 0 VBU0428Test_CM_single_cnt -3.4028234663852886E+38 3.4028234663852886E+38 /end CHARACTERISTIC
/begin CHARACTERISTIC LowBatteryWarningOvrdVal_C "" VALUE 0x700113c8 Scalar_FLOAT32_IEEE 0 VBU0428Test_CM_single_cnt -3.4028234663852886E+38 3.4028234663852886E+38 /end CHARACTERISTIC
/begin CHARACTERISTIC PMM_tiACTst_C "" VALUE 0x70011518 Scalar_FLOAT32_IEEE 0 VBU0428Test_CM_single_cnt -3.4028234663852886E+38 3.4028234663852886E+38 /end CHARACTERISTIC
/begin CHARACTERISTIC PMM_tiActvDisCh_C "" VALUE 0x7001151c Scalar_FLOAT32_IEEE 0 VBU0428Test_CM_single_cnt -3.4028234663852886E+38 3.4028234663852886E+38 /end CHARACTERISTIC
/begin CHARACTERISTIC PMM_tiDCDCDisbl_C "" VALUE 0x70011524 Scalar_FLOAT32_IEEE 0 VBU0428Test_CM_single_cnt -3.4028234663852886E+38 3.4028234663852886E+38 /end CHARACTERISTIC
/begin CHARACTERISTIC PMM_tiDlyInitRst_C "" VALUE 0x70011558 Scalar_FLOAT32_IEEE 0 VBU0428Test_CM_single_cnt -3.4028234663852886E+38 3.4028234663852886E+38 /end CHARACTERISTIC
/begin CHARACTERISTIC PMM_tiHVRlyOpenReq_C "" VALUE 0x70011594 Scalar_FLOAT32_IEEE 0 VBU0428Test_CM_single_cnt -3.4028234663852886E+38 3.4028234663852886E+38 /end CHARACTERISTIC
/begin CHARACTERISTIC PMM_tiHVRlyT_C "" VALUE 0x70011598 Scalar_FLOAT32_IEEE 0 VBU0428Test_CM_single_cnt -3.4028234663852886E+38 3.4028234663852886E+38 /end CHARACTERISTIC
/begin CHARACTERISTIC PMM_tiRstKeep_C "" VALUE 0x700115a8 Scalar_FLOAT32_IEEE 0 VBU0428Test_CM_single_cnt -3.4028234663852886E+38 3.4028234663852886E+38 /end CHARACTERISTIC
/begin CHARACTERISTIC PMM_tiSmplT_SY "" VALUE 0x700115ac Scalar_FLOAT32_IEEE 0 VBU0428Test_CM_single_cnt -3.4028234663852886E+38 3.4028234663852886E+38 /end CHARACTERISTIC
/begin CHARACTERISTIC PermitVoltageOvrdVal_C "" VALUE 0x700115cc Scalar_FLOAT32_IEEE 0 VBU0428Test_CM_single_cnt -3.4028234663852886E+38 3.4028234663852886E+38 /end CHARACTERISTIC
/begin CHARACTERISTIC SPD_vVehSpdOvrdVal_C "" VALUE 0x7001161c Scalar_FLOAT32_IEEE 0 VBU0428Test_CM_single_cnt -3.4028234663852886E+38 3.4028234663852886E+38 /end CHARACTERISTIC
/begin CHARACTERISTIC SYS_facGearRatioF_SY "" VALUE 0x70011634 Scalar_FLOAT32_IEEE 0 VBU0428Test_CM_single_cnt -3.4028234663852886E+38 3.4028234663852886E+38 /end CHARACTERISTIC
/begin CHARACTERISTIC TEMP_OVEROvrdVal_C "" VALUE 0x70011650 Scalar_FLOAT32_IEEE 0 VBU0428Test_CM_single_cnt -3.4028234663852886E+38 3.4028234663852886E+38 /end CHARACTERISTIC
/begin CHARACTERISTIC THM_pctFANMax_C "" VALUE 0x70011668 Scalar_FLOAT32_IEEE 0 VBU0428Test_CM_single -3.4E+38 3.4E+38 /end CHARACTERISTIC
/begin CHARACTERISTIC THM_pctFANOff_C "" VALUE 0x7001166c Scalar_FLOAT32_IEEE 0 VBU0428Test_CM_single -3.4E+38 3.4E+38 /end CHARACTERISTIC
/begin CHARACTERISTIC THM_pctMaxEDSFlow "" VALUE 0x70011670 Scalar_FLOAT32_IEEE 0 VBU0428Test_CM_single -3.4E+38 3.4E+38 /end CHARACTERISTIC
/begin CHARACTERISTIC THM_pctMaxESSFlow "" VALUE 0x70011674 Scalar_FLOAT32_IEEE 0 VBU0428Test_CM_single -3.4E+38 3.4E+38 /end CHARACTERISTIC
/begin CHARACTERISTIC TQO_trqRMotrOvrdVal_C "" VALUE 0x70011928 Scalar_FLOAT32_IEEE 0 VBU0428Test_CM_single_cnt -3.4028234663852886E+38 3.4028234663852886E+38 /end CHARACTERISTIC
/begin CHARACTERISTIC VCUImdStopDrivingOvrdVal_C "" VALUE 0x70011930 Scalar_FLOAT32_IEEE 0 VBU0428Test_CM_single_cnt -3.4028234663852886E+38 3.4028234663852886E+38 /end CHARACTERISTIC
/begin CHARACTERISTIC VCURmvAcChgerOvrdVal_C "" VALUE 0x70011934 Scalar_FLOAT32_IEEE 0 VBU0428Test_CM_single_cnt -3.4028234663852886E+38 3.4028234663852886E+38 /end CHARACTERISTIC
/begin CHARACTERISTIC VIN1VIN2VIN3OvrdVal_C "" VALUE 0x70011938 Scalar_FLOAT32_IEEE 0 VBU0428Test_CM_single_cnt -3.4028234663852886E+38 3.4028234663852886E+38 /end CHARACTERISTIC
/begin CHARACTERISTIC VehPwrLimdLampReqOvrdVal_C "" VALUE 0x700119dc Scalar_FLOAT32_IEEE 0 VBU0428Test_CM_single_cnt -3.4028234663852886E+38 3.4028234663852886E+38 /end CHARACTERISTIC
/begin CHARACTERISTIC Veh_flgHVILOvrdVal_C "" VALUE 0x700119e8 Scalar_FLOAT32_IEEE 0 VBU0428Test_CM_single_cnt -3.4028234663852886E+38 3.4028234663852886E+38 /end CHARACTERISTIC
/begin CHARACTERISTIC Veh_pVacPumpRun_C "" VALUE 0x700119ec Scalar_FLOAT32_IEEE 0 VBU0428Test_CM_single_cnt 0.0 1.0E+23 /end CHARACTERISTIC
/begin CHARACTERISTIC Veh_pVacPumpStop_C "" VALUE 0x700119f0 Scalar_FLOAT32_IEEE 0 VBU0428Test_CM_single_cnt 0.0 1.0E+23 /end CHARACTERISTIC
/begin CHARACTERISTIC Veh_pVacPumpWarning_C "" VALUE 0x700119f4 Scalar_FLOAT32_IEEE 0 VBU0428Test_CM_single_cnt 0.0 1.0E+23 /end CHARACTERISTIC
/begin CHARACTERISTIC Veh_tiHWResetConfirmTime_C "" VALUE 0x70011a08 Scalar_FLOAT32_IEEE 0 VBU0428Test_CM_single_cnt -3.4028234663852886E+38 3.4028234663852886E+38 /end CHARACTERISTIC
/begin CHARACTERISTIC Veh_tiHWResetDelayTime_C "" VALUE 0x70011a0c Scalar_FLOAT32_IEEE 0 VBU0428Test_CM_single_cnt -3.4028234663852886E+38 3.4028234663852886E+38 /end CHARACTERISTIC
/begin CHARACTERISTIC Veh_tiSampleTime_C "" VALUE 0x70011a18 Scalar_FLOAT32_IEEE 0 VBU0428Test_CM_single_cnt -3.4028234663852886E+38 3.4028234663852886E+38 /end CHARACTERISTIC
/begin CHARACTERISTIC Veh_vVehSpdHWReset_C "" VALUE 0x70011a2c Scalar_FLOAT32_IEEE 0 VBU0428Test_CM_single_cnt -3.4028234663852886E+38 3.4028234663852886E+38 /end CHARACTERISTIC
/begin CHARACTERISTIC CcCTM_CellOverTempWarningDebounce_ms "" VALUE 0x70010644 Scalar_ULONG 0 VBU0428Test_CM_uint32_cnt 0.0 4.294967295E+9 /end CHARACTERISTIC
/begin CHARACTERISTIC CTM_BOARD_OVER_TEMP_FAULT "" VALUE 0x70010018 Scalar_UWORD 0 VBU0428Test_CM_uint16_cnt 0.0 65535.0 /end CHARACTERISTIC
/begin CHARACTERISTIC CTM_CELL_OVER_TEMP_WARNING_FAULT "" VALUE 0x7001001c Scalar_UWORD 0 VBU0428Test_CM_uint16_cnt 0.0 65535.0 /end CHARACTERISTIC
/begin CHARACTERISTIC CTM_CELL_TEMP_OVER_DEVIATION_FAULT "" VALUE 0x7001001e Scalar_UWORD 0 VBU0428Test_CM_uint16_cnt 0.0 65535.0 /end CHARACTERISTIC
/begin CHARACTERISTIC CTM_CELL_UNDER_TEMP_FAULT "" VALUE 0x70010022 Scalar_UWORD 0 VBU0428Test_CM_uint16_cnt 0.0 65535.0 /end CHARACTERISTIC
/begin CHARACTERISTIC CcBCV_BDMOutputDelayTime_ms "" VALUE 0x70010028 Scalar_UWORD 0 VBU0428Test_CM_uint16_cnt 0.0 65535.0 /end CHARACTERISTIC
/begin CHARACTERISTIC CcBMM_BDMOutputDelayTime_ms "" VALUE 0x70010038 Scalar_UWORD 0 VBU0428Test_CM_uint16_cnt 0.0 65535.0 /end CHARACTERISTIC
/begin CHARACTERISTIC CcBMM_MaxAfterrunTime_s "" VALUE 0x7001003e Scalar_UWORD 0 VBU0428Test_CM_uint16_cnt 0.0 65535.0 /end CHARACTERISTIC
/begin CHARACTERISTIC CcBMM_SOCJumpDelayTime_ms "" VALUE 0x70010042 Scalar_UWORD 0 VBU0428Test_CM_uint16_cnt 0.0 65535.0 /end CHARACTERISTIC
/begin CHARACTERISTIC CcBMM_SOCJumpPowerOnDelayTime_ms "" VALUE 0x70010044 Scalar_UWORD 0 VBU0428Test_CM_uint16_cnt 0.0 65535.0 /end CHARACTERISTIC
/begin CHARACTERISTIC CcBMM_WakeupLineFEDebounceTime_ms "" VALUE 0x70010046 Scalar_UWORD 0 VBU0428Test_CM_uint16_cnt 0.0 65535.0 /end CHARACTERISTIC
/begin CHARACTERISTIC CcCTM_CellTempOverDeviationFault_C "" VALUE 0x7001005e Scalar_UWORD 0 VBU0428Test_CM_uint16_cnt 0.0 65535.0 /end CHARACTERISTIC
/begin CHARACTERISTIC CcCTS_CmdMnPosContactorDelayTime_ms "" VALUE 0x70010060 Scalar_UWORD 0 VBU0428Test_CM_uint16_cnt 0.0 65535.0 /end CHARACTERISTIC
/begin CHARACTERISTIC CcCTS_DiagnoseMPCWeldCheckDischargeTime_ms "" VALUE 0x70010064 Scalar_UWORD 0 VBU0428Test_CM_uint16_cnt 0.0 65535.0 /end CHARACTERISTIC
/begin CHARACTERISTIC CcCTS_DiagnoseMPCWeldCheckTime_ms "" VALUE 0x70010066 Scalar_UWORD 0 VBU0428Test_CM_uint16_cnt 0.0 65535.0 /end CHARACTERISTIC
/begin CHARACTERISTIC CcCTS_MaxCloseAndDiagnoseContactorsTime_ms "" VALUE 0x70010068 Scalar_UWORD 0 VBU0428Test_CM_uint16_cnt 0.0 65535.0 /end CHARACTERISTIC
/begin CHARACTERISTIC CcCTS_MinOpenAndDiagnoseWeldTime_ms "" VALUE 0x7001006a Scalar_UWORD 0 VBU0428Test_CM_uint16_cnt 0.0 65535.0 /end CHARACTERISTIC
/begin CHARACTERISTIC CcCTS_PrechargeTimerThreshold1_ms "" VALUE 0x7001006c Scalar_UWORD 0 VBU0428Test_CM_uint16_cnt 0.0 65535.0 /end CHARACTERISTIC
/begin CHARACTERISTIC CcCTS_PrechargeTimerThreshold2_ms "" VALUE 0x7001006e Scalar_UWORD 0 VBU0428Test_CM_uint16_cnt 0.0 65535.0 /end CHARACTERISTIC
/begin CHARACTERISTIC CcCTS_PrechargeTimerThreshold3_ms "" VALUE 0x70010070 Scalar_UWORD 0 VBU0428Test_CM_uint16_cnt 0.0 65535.0 /end CHARACTERISTIC
/begin CHARACTERISTIC CcSYS_SystemMaxInitialTime_ms "" VALUE 0x70010112 Scalar_UWORD 0 VBU0428Test_CM_uint16_cnt 0.0 65535.0 /end CHARACTERISTIC
/begin CHARACTERISTIC DSPL_nMotSpdOvrSpdUpper_C "" VALUE 0x70010120 Scalar_UWORD 0 VBU0428Test_CM_uint16_cnt 0.0 65535.0 /end CHARACTERISTIC
/begin CHARACTERISTIC INP_numEXVPosition1Lower_C "" VALUE 0x70010126 Scalar_UWORD 0 VBU0428Test_CM_uint16_cnt 0.0 480.0 /end CHARACTERISTIC
/begin CHARACTERISTIC INP_numEXVPosition1Upper_C "" VALUE 0x70010128 Scalar_UWORD 0 VBU0428Test_CM_uint16_cnt 0.0 480.0 /end CHARACTERISTIC
/begin CHARACTERISTIC INP_numEXVPosition2Upper_C "" VALUE 0x7001012a Scalar_UWORD 0 VBU0428Test_CM_uint16_cnt 0.0 480.0 /end CHARACTERISTIC
/begin CHARACTERISTIC MILIAMPERES_PER_AMPERE_SY "" VALUE 0x7001012c Scalar_UWORD 0 VBU0428Test_CM_uint16_cnt 0.0 65535.0 /end CHARACTERISTIC
/begin CHARACTERISTIC SAMPLE_TIME_TASK_D "" VALUE 0x70010138 Scalar_UWORD 0 VBU0428Test_CM_uint16_cnt 0.0 65535.0 /end CHARACTERISTIC
/begin CHARACTERISTIC APO_ACOvrd_C "" VALUE 0x70021f0a Scalar_BOOLEAN 0 VBU0428Test_CM_boolean_cnt 0.0 1.0 /end CHARACTERISTIC
/begin CHARACTERISTIC APO_ACPowerOvrd_C "" VALUE 0x70021f0b Scalar_BOOLEAN 0 VBU0428Test_CM_boolean_cnt 0.0 1.0 /end CHARACTERISTIC
/begin CHARACTERISTIC APO_ACSpeedOvrd_C "" VALUE 0x70021f0c Scalar_BOOLEAN 0 VBU0428Test_CM_boolean_cnt 0.0 1.0 /end CHARACTERISTIC
/begin CHARACTERISTIC APO_BrakWarningOvrd_C "" VALUE 0x70021f11 Scalar_BOOLEAN 0 VBU0428Test_CM_boolean_cnt 0.0 1.0 /end CHARACTERISTIC
/begin CHARACTERISTIC APO_BrkingWhileDrivingOvrd_C "" VALUE 0x70021f12 Scalar_BOOLEAN 0 VBU0428Test_CM_boolean_cnt 0.0 1.0 /end CHARACTERISTIC
/begin CHARACTERISTIC APO_CruiseStatusOvrd_C "" VALUE 0x70021f13 Scalar_BOOLEAN 0 VBU0428Test_CM_boolean_cnt 0.0 1.0 /end CHARACTERISTIC
/begin CHARACTERISTIC APO_EPBCtrlModeOvrd_C "" VALUE 0x70021f14 Scalar_BOOLEAN 0 VBU0428Test_CM_boolean_cnt 0.0 1.0 /end CHARACTERISTIC
/begin CHARACTERISTIC APO_EPFaultLevelWarningOvrd_C "" VALUE 0x70021f15 Scalar_BOOLEAN 0 VBU0428Test_CM_boolean_cnt 0.0 1.0 /end CHARACTERISTIC
/begin CHARACTERISTIC APO_LimpHomeOvrd_C "" VALUE 0x70021f17 Scalar_BOOLEAN 0 VBU0428Test_CM_boolean_cnt 0.0 1.0 /end CHARACTERISTIC
/begin CHARACTERISTIC APO_OverSpeedOvrd_C "" VALUE 0x70021f18 Scalar_BOOLEAN 0 VBU0428Test_CM_boolean_cnt 0.0 1.0 /end CHARACTERISTIC
/begin CHARACTERISTIC APO_PlsUSE750VDCOvrd_C "" VALUE 0x70021f19 Scalar_BOOLEAN 0 VBU0428Test_CM_boolean_cnt 0.0 1.0 /end CHARACTERISTIC
/begin CHARACTERISTIC APO_PowerModeOvrd_C "" VALUE 0x70021f1a Scalar_BOOLEAN 0 VBU0428Test_CM_boolean_cnt 0.0 1.0 /end CHARACTERISTIC
/begin CHARACTERISTIC APO_TotalChargeEnergyOvrd_C "" VALUE 0x70021f1f Scalar_BOOLEAN 0 VBU0428Test_CM_boolean_cnt 0.0 1.0 /end CHARACTERISTIC
/begin CHARACTERISTIC APO_TotalDischargeEnergyOvrd_C "" VALUE 0x70021f20 Scalar_BOOLEAN 0 VBU0428Test_CM_boolean_cnt 0.0 1.0 /end CHARACTERISTIC
/begin CHARACTERISTIC APO_VCURemainingRngOvrd_C "" VALUE 0x70021f21 Scalar_BOOLEAN 0 VBU0428Test_CM_boolean_cnt 0.0 1.0 /end CHARACTERISTIC
/begin CHARACTERISTIC APO_VehicleModeOvrd_C "" VALUE 0x70021f22 Scalar_BOOLEAN 0 VBU0428Test_CM_boolean_cnt 0.0 1.0 /end CHARACTERISTIC
/begin CHARACTERISTIC APO_fACPumpOvrd_C "" VALUE 0x70021f24 Scalar_BOOLEAN 0 VBU0428Test_CM_boolean_cnt 0.0 1.0 /end CHARACTERISTIC
/begin CHARACTERISTIC APO_fFanOvrd_C "" VALUE 0x70021f25 Scalar_BOOLEAN 0 VBU0428Test_CM_boolean_cnt 0.0 1.0 /end CHARACTERISTIC
/begin CHARACTERISTIC APO_fHVIL1Ovrd_C "" VALUE 0x70021f26 Scalar_BOOLEAN 0 VBU0428Test_CM_boolean_cnt 0.0 1.0 /end CHARACTERISTIC
/begin CHARACTERISTIC APO_fVacuumPumpOvrd_C "" VALUE 0x70021f27 Scalar_BOOLEAN 0 VBU0428Test_CM_boolean_cnt 0.0 1.0 /end CHARACTERISTIC
/begin CHARACTERISTIC APO_fWaterPump1Ovrd_C "" VALUE 0x70021f28 Scalar_BOOLEAN 0 VBU0428Test_CM_boolean_cnt 0.0 1.0 /end CHARACTERISTIC
/begin CHARACTERISTIC APO_fWaterPump2Ovrd_C "" VALUE 0x70021f29 Scalar_BOOLEAN 0 VBU0428Test_CM_boolean_cnt 0.0 1.0 /end CHARACTERISTIC
/begin CHARACTERISTIC APO_flgBMSChargeStateOvrd_C "" VALUE 0x70021f2e Scalar_BOOLEAN 0 VBU0428Test_CM_boolean_flg 0.0 1.0 /end CHARACTERISTIC
/begin CHARACTERISTIC APO_flgBattPackTempWarningOvrd_C "" VALUE 0x70021f38 Scalar_BOOLEAN 0 VBU0428Test_CM_boolean_cnt 0.0 1.0 /end CHARACTERISTIC
/begin CHARACTERISTIC APO_flgDCChgRlyOvrdVal_C "" VALUE 0x70021f3d Scalar_BOOLEAN 0 VBU0428Test_CM_boolean_cnt 0.0 1.0 /end CHARACTERISTIC
/begin CHARACTERISTIC APO_flgDCChgRlyOvrd_C "" VALUE 0x70021f3e Scalar_BOOLEAN 0 VBU0428Test_CM_boolean_cnt 0.0 1.0 /end CHARACTERISTIC
/begin CHARACTERISTIC APO_flgEPBFaultOvrd_C "" VALUE 0x70021f3f Scalar_BOOLEAN 0 VBU0428Test_CM_boolean_cnt 0.0 1.0 /end CHARACTERISTIC
/begin CHARACTERISTIC APO_flgEPSFaultOvrd_C "" VALUE 0x70021f40 Scalar_BOOLEAN 0 VBU0428Test_CM_boolean_cnt 0.0 1.0 /end CHARACTERISTIC
/begin CHARACTERISTIC APO_flgFanORF "" VALUE 0x70021f42 Scalar_BOOLEAN 0 VBU0428Test_CM_boolean 0 1 /end CHARACTERISTIC
/begin CHARACTERISTIC APO_flgHVBattWarningOvrd_C "" VALUE 0x70021f43 Scalar_BOOLEAN 0 VBU0428Test_CM_boolean_cnt 0.0 1.0 /end CHARACTERISTIC
/begin CHARACTERISTIC APO_flgHVOnOvrd_C "" VALUE 0x70021f44 Scalar_BOOLEAN 0 VBU0428Test_CM_boolean_flg 0.0 1.0 /end CHARACTERISTIC
/begin CHARACTERISTIC APO_flgHWSleepEnableORF "" VALUE 0x70021f45 Scalar_BOOLEAN 0 VBU0428Test_CM_boolean 0 1 /end CHARACTERISTIC
/begin CHARACTERISTIC APO_flgIsolutionWarningOvrd_C "" VALUE 0x70021f46 Scalar_BOOLEAN 0 VBU0428Test_CM_boolean_cnt 0.0 1.0 /end CHARACTERISTIC
/begin CHARACTERISTIC APO_flgMainRlyOvrdVal_C "" VALUE 0x70021f48 Scalar_BOOLEAN 0 VBU0428Test_CM_boolean_cnt 0.0 1.0 /end CHARACTERISTIC
/begin CHARACTERISTIC APO_flgMainRlyOvrd_C "" VALUE 0x70021f49 Scalar_BOOLEAN 0 VBU0428Test_CM_boolean_cnt 0.0 1.0 /end CHARACTERISTIC
/begin CHARACTERISTIC APO_flgSleepEnableORV "" VALUE 0x70021f4a Scalar_BOOLEAN 0 VBU0428Test_CM_boolean 0 1 /end CHARACTERISTIC
/begin CHARACTERISTIC APO_flgWakeUp1OvrdVal_C "" VALUE 0x70021f4b Scalar_BOOLEAN 0 VBU0428Test_CM_boolean_cnt 0.0 1.0 /end CHARACTERISTIC
/begin CHARACTERISTIC APO_flgWakeUp1Ovrd_C "" VALUE 0x70021f4c Scalar_BOOLEAN 0 VBU0428Test_CM_boolean_cnt 0.0 1.0 /end CHARACTERISTIC
/begin CHARACTERISTIC APO_flgWakeUp2OvrdVal_C "" VALUE 0x70021f4d Scalar_BOOLEAN 0 VBU0428Test_CM_boolean_cnt 0.0 1.0 /end CHARACTERISTIC
/begin CHARACTERISTIC APO_flgWakeUp2Ovrd_C "" VALUE 0x70021f4e Scalar_BOOLEAN 0 VBU0428Test_CM_boolean_cnt 0.0 1.0 /end CHARACTERISTIC
/begin CHARACTERISTIC APO_pctACPumpOvrd_C "" VALUE 0x70021f4f Scalar_BOOLEAN 0 VBU0428Test_CM_boolean_cnt 0.0 1.0 /end CHARACTERISTIC
/begin CHARACTERISTIC APO_pctHVIL1Ovrd_C "" VALUE 0x70021f50 Scalar_BOOLEAN 0 VBU0428Test_CM_boolean_cnt 0.0 1.0 /end CHARACTERISTIC
/begin CHARACTERISTIC APO_pctWaterPump1Ovrd_C "" VALUE 0x70021f51 Scalar_BOOLEAN 0 VBU0428Test_CM_boolean_cnt 0.0 1.0 /end CHARACTERISTIC
/begin CHARACTERISTIC APO_pctWaterPump2Ovrd_C "" VALUE 0x70021f52 Scalar_BOOLEAN 0 VBU0428Test_CM_boolean_cnt 0.0 1.0 /end CHARACTERISTIC
/begin CHARACTERISTIC BATTERY_DATE_DAYOvrd_C "" VALUE 0x70021f5e Scalar_BOOLEAN 0 VBU0428Test_CM_boolean_cnt 0.0 1.0 /end CHARACTERISTIC
/begin CHARACTERISTIC BATTERY_DATE_MONTHOvrd_C "" VALUE 0x70021f60 Scalar_BOOLEAN 0 VBU0428Test_CM_boolean_cnt 0.0 1.0 /end CHARACTERISTIC
/begin CHARACTERISTIC BATTERY_DATE_YEAROvrd_C "" VALUE 0x70021f62 Scalar_BOOLEAN 0 VBU0428Test_CM_boolean_cnt 0.0 1.0 /end CHARACTERISTIC
/begin CHARACTERISTIC BATTERY_GROUP_NUMBEROvrd_C "" VALUE 0x70021f65 Scalar_BOOLEAN 0 VBU0428Test_CM_boolean_cnt 0.0 1.0 /end CHARACTERISTIC
/begin CHARACTERISTIC BATTERY_ISOLATION_STATEOvrd_C "" VALUE 0x70021f67 Scalar_BOOLEAN 0 VBU0428Test_CM_boolean_cnt 0.0 1.0 /end CHARACTERISTIC
/begin CHARACTERISTIC BATTERY_OUTPUT_CONNECTOR_STATEOvrd_C "" VALUE 0x70021f69 Scalar_BOOLEAN 0 VBU0428Test_CM_boolean_cnt 0.0 1.0 /end CHARACTERISTIC
/begin CHARACTERISTIC BATTERY_PROPERTY_IDENTIFYOvrd_C "" VALUE 0x70021f6b Scalar_BOOLEAN 0 VBU0428Test_CM_boolean_cnt 0.0 1.0 /end CHARACTERISTIC
/begin CHARACTERISTIC BATTERY_SUPPLIEROvrd_C "" VALUE 0x70021f6d Scalar_BOOLEAN 0 VBU0428Test_CM_boolean_cnt 0.0 1.0 /end CHARACTERISTIC
/begin CHARACTERISTIC BMS_SOFTWARE_VERSION1Ovrd_C "" VALUE 0x70021f85 Scalar_BOOLEAN 0 VBU0428Test_CM_boolean_cnt 0.0 1.0 /end CHARACTERISTIC
/begin CHARACTERISTIC BMS_SOFTWARE_VERSION2Ovrd_C "" VALUE 0x70021f87 Scalar_BOOLEAN 0 VBU0428Test_CM_boolean_cnt 0.0 1.0 /end CHARACTERISTIC
/begin CHARACTERISTIC BRM_RESERVEDOvrd_C "" VALUE 0x70021f92 Scalar_BOOLEAN 0 VBU0428Test_CM_boolean_cnt 0.0 1.0 /end CHARACTERISTIC
/begin CHARACTERISTIC CELL_VOLTAGE_OVER_UNDEROvrd_C "" VALUE 0x70021fa3 Scalar_BOOLEAN 0 VBU0428Test_CM_boolean_cnt 0.0 1.0 /end CHARACTERISTIC
/begin CHARACTERISTIC CGW_flgVehDrvModeOvrd_C "" VALUE 0x70021fa7 Scalar_BOOLEAN 0 VBU0428Test_CM_boolean_cnt 0.0 1.0 /end CHARACTERISTIC
/begin CHARACTERISTIC CGW_stVehRgnModeOvrd_C "" VALUE 0x70021fb7 Scalar_BOOLEAN 0 VBU0428Test_CM_boolean_cnt 0.0 1.0 /end CHARACTERISTIC
/begin CHARACTERISTIC CHARGER_MESSAGE_OT_00Ovrd_C "" VALUE 0x70021fbd Scalar_BOOLEAN 0 VBU0428Test_CM_boolean_cnt 0.0 1.0 /end CHARACTERISTIC
/begin CHARACTERISTIC CHARGER_MESSAGE_OT_AAOvrd_C "" VALUE 0x70021fbf Scalar_BOOLEAN 0 VBU0428Test_CM_boolean_cnt 0.0 1.0 /end CHARACTERISTIC
/begin CHARACTERISTIC CHARGER_MESSAGE_OT_READYOvrd_C "" VALUE 0x70021fc1 Scalar_BOOLEAN 0 VBU0428Test_CM_boolean_cnt 0.0 1.0 /end CHARACTERISTIC
/begin CHARACTERISTIC CHARGER_MESSAGE_OT_STATEOvrd_C "" VALUE 0x70021fc3 Scalar_BOOLEAN 0 VBU0428Test_CM_boolean_cnt 0.0 1.0 /end CHARACTERISTIC
/begin CHARACTERISTIC CHARGER_MESSAGE_OT_STATISTICSOvrd_C "" VALUE 0x70021fc5 Scalar_BOOLEAN 0 VBU0428Test_CM_boolean_cnt 0.0 1.0 /end CHARACTERISTIC
/begin CHARACTERISTIC CHARGER_MESSAGE_OT_STOPOvrd_C "" VALUE 0x70021fc7 Scalar_BOOLEAN 0 VBU0428Test_CM_boolean_cnt 0.0 1.0 /end CHARACTERISTIC
/begin CHARACTERISTIC CHARGER_MESSAGE_OT_SYNCHRONOUSOvrd_C "" VALUE 0x70021fc9 Scalar_BOOLEAN 0 VBU0428Test_CM_boolean_cnt 0.0 1.0 /end CHARACTERISTIC
/begin CHARACTERISTIC CHARGING_MODEOvrd_C "" VALUE 0x70021fcb Scalar_BOOLEAN 0 VBU0428Test_CM_boolean_cnt 0.0 1.0 /end CHARACTERISTIC
/begin CHARACTERISTIC CHARGING_PERMITOvrd_C "" VALUE 0x70021fcd Scalar_BOOLEAN 0 VBU0428Test_CM_boolean_cnt 0.0 1.0 /end CHARACTERISTIC
/begin CHARACTERISTIC CHARGING_TIMEOvrd_C "" VALUE 0x70021fcf Scalar_BOOLEAN 0 VBU0428Test_CM_boolean_cnt 0.0 1.0 /end CHARACTERISTIC
/begin CHARACTERISTIC CURRENT_OVER_UNDEROvrd_C "" VALUE 0x70021fed Scalar_BOOLEAN 0 VBU0428Test_CM_boolean_cnt 0.0 1.0 /end CHARACTERISTIC
/begin CHARACTERISTIC CURRENT_REQUIREMENTOvrd_C "" VALUE 0x70021fef Scalar_BOOLEAN 0 VBU0428Test_CM_boolean_cnt 0.0 1.0 /end CHARACTERISTIC
/begin CHARACTERISTIC CaBMM_HALKL30BMUVoltageORF_flg "" VAL_BLK 0x70022498 Scalar_BOOLEAN 0 VBU0428Test_CM_boolean_cnt 0.0 1.0 NUMBER 10 /end CHARACTERISTIC
/begin CHARACTERISTIC CbBCV_HALBatteryVoltageORF_flg "" VALUE 0x70022006 Scalar_BOOLEAN 0 VBU0428Test_CM_boolean_cnt 0.0 1.0 /end CHARACTERISTIC
/begin CHARACTERISTIC CbBCV_HALBatteryVoltageStatusORF_flg "" VALUE 0x70022007 Scalar_BOOLEAN 0 VBU0428Test_CM_boolean_cnt 0.0 1.0 /end CHARACTERISTIC
/begin CHARACTERISTIC CbBCV_HALBatteryVoltageStatusORV_flg "" VALUE 0x70022008 Scalar_BOOLEAN 0 VBU0428Test_CM_boolean_cnt 0.0 1.0 /end CHARACTERISTIC
/begin CHARACTERISTIC CbBCV_HALBusNegativeVoltageORF_flg "" VALUE 0x70022009 Scalar_BOOLEAN 0 VBU0428Test_CM_boolean_cnt 0.0 1.0 /end CHARACTERISTIC
/begin CHARACTERISTIC CbBCV_HALBusNegativeVoltageStatusORF_flg "" VALUE 0x7002200a Scalar_BOOLEAN 0 VBU0428Test_CM_boolean_cnt 0.0 1.0 /end CHARACTERISTIC
/begin CHARACTERISTIC CbBCV_HALBusNegativeVoltageStatusORV_flg "" VALUE 0x7002200b Scalar_BOOLEAN 0 VBU0428Test_CM_boolean_cnt 0.0 1.0 /end CHARACTERISTIC
/begin CHARACTERISTIC CbBCV_HALFuseVoltageORF_flg "" VALUE 0x7002200c Scalar_BOOLEAN 0 VBU0428Test_CM_boolean_cnt 0.0 1.0 /end CHARACTERISTIC
/begin CHARACTERISTIC CbBCV_HALFuseVoltageStatusORF_flg "" VALUE 0x7002200d Scalar_BOOLEAN 0 VBU0428Test_CM_boolean_cnt 0.0 1.0 /end CHARACTERISTIC
/begin CHARACTERISTIC CbBCV_HALFuseVoltageStatusORV_flg "" VALUE 0x7002200e Scalar_BOOLEAN 0 VBU0428Test_CM_boolean_cnt 0.0 1.0 /end CHARACTERISTIC
/begin CHARACTERISTIC CbBCV_HALPrechargeVoltageORF_flg "" VALUE 0x7002200f Scalar_BOOLEAN 0 VBU0428Test_CM_boolean_cnt 0.0 1.0 /end CHARACTERISTIC
/begin CHARACTERISTIC CbBCV_HALPrechargeVoltageStatusORF_flg "" VALUE 0x70022010 Scalar_BOOLEAN 0 VBU0428Test_CM_boolean_cnt 0.0 1.0 /end CHARACTERISTIC
/begin CHARACTERISTIC CbBCV_HALPrechargeVoltageStatusORV_flg "" VALUE 0x70022011 Scalar_BOOLEAN 0 VBU0428Test_CM_boolean_cnt 0.0 1.0 /end CHARACTERISTIC
/begin CHARACTERISTIC CbBCV_HALVx2VoltageORF_flg "" VALUE 0x70022012 Scalar_BOOLEAN 0 VBU0428Test_CM_boolean_cnt 0.0 1.0 /end CHARACTERISTIC
/begin CHARACTERISTIC CbBCV_HALVx2VoltageStatusORF_flg "" VALUE 0x70022013 Scalar_BOOLEAN 0 VBU0428Test_CM_boolean_cnt 0.0 1.0 /end CHARACTERISTIC
/begin CHARACTERISTIC CbBCV_HALVx2VoltageStatusORV_flg "" VALUE 0x70022014 Scalar_BOOLEAN 0 VBU0428Test_CM_boolean_cnt 0.0 1.0 /end CHARACTERISTIC
/begin CHARACTERISTIC CbBMM_BattSelfLearningRequestDefault_flg "" VALUE 0x70022019 Scalar_BOOLEAN 0 VBU0428Test_CM_boolean_cnt 0.0 1.0 /end CHARACTERISTIC
/begin CHARACTERISTIC CbBMM_DriverIntentionChangeEnable_flg "" VALUE 0x7002201a Scalar_BOOLEAN 0 VBU0428Test_CM_boolean_cnt 0.0 1.0 /end CHARACTERISTIC
/begin CHARACTERISTIC CbBMM_FastChargeWakeupEnable_flg "" VALUE 0x7002201b Scalar_BOOLEAN 0 VBU0428Test_CM_boolean_cnt 0.0 1.0 /end CHARACTERISTIC
/begin CHARACTERISTIC CbCBL_CTMBoardTempValidORF_flg "" VALUE 0x7002201d Scalar_BOOLEAN 0 VBU0428Test_CM_boolean_cnt 0.0 1.0 /end CHARACTERISTIC
/begin CHARACTERISTIC CbCBL_CTMBoardTempValidORV_flg "" VALUE 0x7002201e Scalar_BOOLEAN 0 VBU0428Test_CM_boolean_cnt 0.0 1.0 /end CHARACTERISTIC
/begin CHARACTERISTIC CbCTD_MainFuseBlownFaultEnable_flg "" VALUE 0x70022024 Scalar_BOOLEAN 0 VBU0428Test_CM_boolean_cnt 0.0 1.0 /end CHARACTERISTIC
/begin CHARACTERISTIC CbCTD_PrechargeResistanceBlownFaultEnable_flg "" VALUE 0x7002202d Scalar_BOOLEAN 0 VBU0428Test_CM_boolean_cnt 0.0 1.0 /end CHARACTERISTIC
/begin CHARACTERISTIC CbCTM_CellOverTempEVMFaultEnable_flg "" VALUE 0x70022032 Scalar_BOOLEAN 0 VBU0428Test_CM_boolean_cnt 0.0 1.0 /end CHARACTERISTIC
/begin CHARACTERISTIC CbCTM_CellOverTempFaultEnable_flg "" VALUE 0x70022033 Scalar_BOOLEAN 0 VBU0428Test_CM_boolean_cnt 0.0 1.0 /end CHARACTERISTIC
/begin CHARACTERISTIC CbCTM_CellOverTempWarningFaultEnable_flg "" VALUE 0x70022034 Scalar_BOOLEAN 0 VBU0428Test_CM_boolean_cnt 0.0 1.0 /end CHARACTERISTIC
/begin CHARACTERISTIC CbCTM_CellTempOverDeviationEVMFaultEnable_flg "" VALUE 0x70022035 Scalar_BOOLEAN 0 VBU0428Test_CM_boolean_cnt 0.0 1.0 /end CHARACTERISTIC
/begin CHARACTERISTIC CbCTM_CellTempOverDeviationFaultEnable_flg "" VALUE 0x70022036 Scalar_BOOLEAN 0 VBU0428Test_CM_boolean_cnt 0.0 1.0 /end CHARACTERISTIC
/begin CHARACTERISTIC CbCTM_CellUnderTempFaultEnable_flg "" VALUE 0x70022038 Scalar_BOOLEAN 0 VBU0428Test_CM_boolean_cnt 0.0 1.0 /end CHARACTERISTIC
/begin CHARACTERISTIC CcCBL_CTMBoardTempMaxORF_flg "" VALUE 0x70022131 Scalar_BOOLEAN 0 VBU0428Test_CM_boolean_cnt 0.0 1.0 /end CHARACTERISTIC
/begin CHARACTERISTIC DCH_cBCPNrmCapOvrd_C "" VALUE 0x700221fb Scalar_BOOLEAN 0 VBU0428Test_CM_boolean_cnt 0.0 1.0 /end CHARACTERISTIC
/begin CHARACTERISTIC DCH_cBRMBattRatedCapOvrd_C "" VALUE 0x700221fc Scalar_BOOLEAN 0 VBU0428Test_CM_boolean_cnt 0.0 1.0 /end CHARACTERISTIC
/begin CHARACTERISTIC DCH_flgDSPLChStsOvrd_C "" VALUE 0x7002225b Scalar_BOOLEAN 0 VBU0428Test_CM_boolean_cnt 0.0 1.0 /end CHARACTERISTIC
/begin CHARACTERISTIC DCH_iBCPMaxChCurrOvrd_C "" VALUE 0x70022270 Scalar_BOOLEAN 0 VBU0428Test_CM_boolean_cnt 0.0 1.0 /end CHARACTERISTIC
/begin CHARACTERISTIC DCH_iBCSChCurrMeasureOvrd_C "" VALUE 0x70022271 Scalar_BOOLEAN 0 VBU0428Test_CM_boolean_cnt 0.0 1.0 /end CHARACTERISTIC
/begin CHARACTERISTIC DCH_numBCSMaxCellVltgNumOvrd_C "" VALUE 0x70022272 Scalar_BOOLEAN 0 VBU0428Test_CM_boolean_cnt 0.0 1.0 /end CHARACTERISTIC
/begin CHARACTERISTIC DCH_numBRMBattTypOvrd_C "" VALUE 0x70022279 Scalar_BOOLEAN 0 VBU0428Test_CM_boolean_cnt 0.0 1.0 /end CHARACTERISTIC
/begin CHARACTERISTIC DCH_numBRMProtcVerOvrd_C "" VALUE 0x7002227b Scalar_BOOLEAN 0 VBU0428Test_CM_boolean_cnt 0.0 1.0 /end CHARACTERISTIC
/begin CHARACTERISTIC DCH_pctBCPSocOvrd_C "" VALUE 0x70022281 Scalar_BOOLEAN 0 VBU0428Test_CM_boolean_cnt 0.0 1.0 /end CHARACTERISTIC
/begin CHARACTERISTIC DCH_pctBCSCurrSocOvrd_C "" VALUE 0x70022282 Scalar_BOOLEAN 0 VBU0428Test_CM_boolean_cnt 0.0 1.0 /end CHARACTERISTIC
/begin CHARACTERISTIC DCH_tBCPMaxPermitTempOvrd_C "" VALUE 0x700222dc Scalar_BOOLEAN 0 VBU0428Test_CM_boolean_cnt 0.0 1.0 /end CHARACTERISTIC
/begin CHARACTERISTIC DCH_tiBCSChNeedTOvrd_C "" VALUE 0x700222dd Scalar_BOOLEAN 0 VBU0428Test_CM_boolean_cnt 0.0 1.0 /end CHARACTERISTIC
/begin CHARACTERISTIC DCH_uBCPBattVltgOvrd_C "" VALUE 0x700222de Scalar_BOOLEAN 0 VBU0428Test_CM_boolean_cnt 0.0 1.0 /end CHARACTERISTIC
/begin CHARACTERISTIC DCH_uBCPMaxCellVltgForChOvrd_C "" VALUE 0x700222df Scalar_BOOLEAN 0 VBU0428Test_CM_boolean_cnt 0.0 1.0 /end CHARACTERISTIC
/begin CHARACTERISTIC DCH_uBCPMaxVltgForChOvrd_C "" VALUE 0x700222e0 Scalar_BOOLEAN 0 VBU0428Test_CM_boolean_cnt 0.0 1.0 /end CHARACTERISTIC
/begin CHARACTERISTIC DCH_uBCSChVltgMeasureOvrd_C "" VALUE 0x700222e1 Scalar_BOOLEAN 0 VBU0428Test_CM_boolean_cnt 0.0 1.0 /end CHARACTERISTIC
/begin CHARACTERISTIC DCH_uBCSMaxCellVltgOvrd_C "" VALUE 0x700222e2 Scalar_BOOLEAN 0 VBU0428Test_CM_boolean_cnt 0.0 1.0 /end CHARACTERISTIC
/begin CHARACTERISTIC DCH_uBRMBattRatedVltgOvrd_C "" VALUE 0x700222e3 Scalar_BOOLEAN 0 VBU0428Test_CM_boolean_cnt 0.0 1.0 /end CHARACTERISTIC
/begin CHARACTERISTIC DSPL_flgRegenLimLampFunctionEn_C "" VALUE 0x700222ee Scalar_BOOLEAN 0 VBU0428Test_CM_boolean_flg 0.0 1.0 /end CHARACTERISTIC
/begin CHARACTERISTIC EDIS_flgCurrPwrOvrd_C "" VALUE 0x700222fe Scalar_BOOLEAN 0 VBU0428Test_CM_boolean_cnt 0.0 1.0 /end CHARACTERISTIC
/begin CHARACTERISTIC GATEWAY_STOP_ERROR_REASON_OCOvrd_C "" VALUE 0x70022321 Scalar_BOOLEAN 0 VBU0428Test_CM_boolean_cnt 0.0 1.0 /end CHARACTERISTIC
/begin CHARACTERISTIC GATEWAY_STOP_ERROR_REASON_VOLTOvrd_C "" VALUE 0x70022323 Scalar_BOOLEAN 0 VBU0428Test_CM_boolean_cnt 0.0 1.0 /end CHARACTERISTIC
/begin CHARACTERISTIC GATEWAY_STOP_FAULT_REASON_1Ovrd_C "" VALUE 0x70022325 Scalar_BOOLEAN 0 VBU0428Test_CM_boolean_cnt 0.0 1.0 /end CHARACTERISTIC
/begin CHARACTERISTIC GATEWAY_STOP_FAULT_REASON_2Ovrd_C "" VALUE 0x70022327 Scalar_BOOLEAN 0 VBU0428Test_CM_boolean_cnt 0.0 1.0 /end CHARACTERISTIC
/begin CHARACTERISTIC GATEWAY_STOP_FAULT_REASON_3Ovrd_C "" VALUE 0x70022329 Scalar_BOOLEAN 0 VBU0428Test_CM_boolean_cnt 0.0 1.0 /end CHARACTERISTIC
/begin CHARACTERISTIC GATEWAY_STOP_FAULT_REASON_BMSOTOvrd_C "" VALUE 0x7002232b Scalar_BOOLEAN 0 VBU0428Test_CM_boolean_cnt 0.0 1.0 /end CHARACTERISTIC
/begin CHARACTERISTIC GATEWAY_STOP_FAULT_REASON_CELLOTOvrd_C "" VALUE 0x7002232d Scalar_BOOLEAN 0 VBU0428Test_CM_boolean_cnt 0.0 1.0 /end CHARACTERISTIC
/begin CHARACTERISTIC GATEWAY_STOP_FAULT_REASON_CONNOTOvrd_C "" VALUE 0x7002232f Scalar_BOOLEAN 0 VBU0428Test_CM_boolean_cnt 0.0 1.0 /end CHARACTERISTIC
/begin CHARACTERISTIC GATEWAY_STOP_FAULT_REASON_CONNOvrd_C "" VALUE 0x70022331 Scalar_BOOLEAN 0 VBU0428Test_CM_boolean_cnt 0.0 1.0 /end CHARACTERISTIC
/begin CHARACTERISTIC GATEWAY_STOP_FAULT_REASON_ISOOvrd_C "" VALUE 0x70022333 Scalar_BOOLEAN 0 VBU0428Test_CM_boolean_cnt 0.0 1.0 /end CHARACTERISTIC
/begin CHARACTERISTIC GATEWAY_STOP_REASON_CELLVOLTOvrd_C "" VALUE 0x70022335 Scalar_BOOLEAN 0 VBU0428Test_CM_boolean_cnt 0.0 1.0 /end CHARACTERISTIC
/begin CHARACTERISTIC GATEWAY_STOP_REASON_SOCOvrd_C "" VALUE 0x70022337 Scalar_BOOLEAN 0 VBU0428Test_CM_boolean_cnt 0.0 1.0 /end CHARACTERISTIC
/begin CHARACTERISTIC GATEWAY_STOP_REASON_STATIONOvrd_C "" VALUE 0x70022339 Scalar_BOOLEAN 0 VBU0428Test_CM_boolean_cnt 0.0 1.0 /end CHARACTERISTIC
/begin CHARACTERISTIC GATEWAY_STOP_REASON_TOTALVOLTOvrd_C "" VALUE 0x7002233b Scalar_BOOLEAN 0 VBU0428Test_CM_boolean_cnt 0.0 1.0 /end CHARACTERISTIC
/begin CHARACTERISTIC Gear_flgEPBReqOvrd_C "" VALUE 0x70022340 Scalar_BOOLEAN 0 VBU0428Test_CM_boolean_cnt 0.0 1.0 /end CHARACTERISTIC
/begin CHARACTERISTIC Gear_stCurrentGearDisplayOvrd_C "" VALUE 0x70022347 Scalar_BOOLEAN 0 VBU0428Test_CM_boolean_cnt 0.0 1.0 /end CHARACTERISTIC
/begin CHARACTERISTIC HALIn_MotOverTempOvrdVal_C "" VALUE 0x7002235f Scalar_BOOLEAN 0 VBU0428Test_CM_boolean_cnt 0.0 1.0 /end CHARACTERISTIC
/begin CHARACTERISTIC HALIn_flgMotOverTempOvrd_C "" VALUE 0x70022360 Scalar_BOOLEAN 0 VBU0428Test_CM_boolean_cnt 0.0 1.0 /end CHARACTERISTIC
/begin CHARACTERISTIC HVBattCutOffOvrd_C "" VALUE 0x70022366 Scalar_BOOLEAN 0 VBU0428Test_CM_boolean_cnt 0.0 1.0 /end CHARACTERISTIC
/begin CHARACTERISTIC LVC_flgDCDCReqOvrd_C "" VALUE 0x70022394 Scalar_BOOLEAN 0 VBU0428Test_CM_boolean_cnt 0.0 1.0 /end CHARACTERISTIC
/begin CHARACTERISTIC LVC_flgDcdcCtrlReqOvrdVal_C "" VALUE 0x70022395 Scalar_BOOLEAN 0 VBU0428Test_CM_boolean_cnt 0.0 1.0 /end CHARACTERISTIC
/begin CHARACTERISTIC LVC_flgDcdcCtrlReqOvrd_C "" VALUE 0x70022396 Scalar_BOOLEAN 0 VBU0428Test_CM_boolean_cnt 0.0 1.0 /end CHARACTERISTIC
/begin CHARACTERISTIC LowBatteryWarningOvrd_C "" VALUE 0x7002239c Scalar_BOOLEAN 0 VBU0428Test_CM_boolean_cnt 0.0 1.0 /end CHARACTERISTIC
/begin CHARACTERISTIC MAXIMUM_CELL_TEMPOvrd_C "" VALUE 0x7002239e Scalar_BOOLEAN 0 VBU0428Test_CM_boolean_cnt 0.0 1.0 /end CHARACTERISTIC
/begin CHARACTERISTIC MAXIMUM_CELL_TEMP_BSDOvrd_C "" VALUE 0x700223a0 Scalar_BOOLEAN 0 VBU0428Test_CM_boolean_cnt 0.0 1.0 /end CHARACTERISTIC
/begin CHARACTERISTIC MAXIMUM_CELL_VOLTAGE_BSDOvrd_C "" VALUE 0x700223a2 Scalar_BOOLEAN 0 VBU0428Test_CM_boolean_cnt 0.0 1.0 /end CHARACTERISTIC
/begin CHARACTERISTIC MAXIMUM_CELL_VOLTAGE_NUMBER_BSMOvrd_C "" VALUE 0x700223a4 Scalar_BOOLEAN 0 VBU0428Test_CM_boolean_cnt 0.0 1.0 /end CHARACTERISTIC
/begin CHARACTERISTIC MAXIMUM_TEMP_NUMBEROvrd_C "" VALUE 0x700223a6 Scalar_BOOLEAN 0 VBU0428Test_CM_boolean_cnt 0.0 1.0 /end CHARACTERISTIC
/begin CHARACTERISTIC MINIMUM_CELL_TEMPOvrd_C "" VALUE 0x700223ac Scalar_BOOLEAN 0 VBU0428Test_CM_boolean_cnt 0.0 1.0 /end CHARACTERISTIC
/begin CHARACTERISTIC MINIMUM_CELL_TEMP_BSDOvrd_C "" VALUE 0x700223ae Scalar_BOOLEAN 0 VBU0428Test_CM_boolean_cnt 0.0 1.0 /end CHARACTERISTIC
/begin CHARACTERISTIC MINIMUM_CELL_VOLTAGE_BSDOvrd_C "" VALUE 0x700223b0 Scalar_BOOLEAN 0 VBU0428Test_CM_boolean_cnt 0.0 1.0 /end CHARACTERISTIC
/begin CHARACTERISTIC MINIMUM_TEMP_NUMBEROvrd_C "" VALUE 0x700223b2 Scalar_BOOLEAN 0 VBU0428Test_CM_boolean_cnt 0.0 1.0 /end CHARACTERISTIC
/begin CHARACTERISTIC MotorFaultLevelOvrdVal_C "" VALUE 0x700223b5 Scalar_BOOLEAN 0 VBU0428Test_CM_boolean_cnt 0.0 1.0 /end CHARACTERISTIC
/begin CHARACTERISTIC MotorFaultLevelOvrd_C "" VALUE 0x700223b6 Scalar_BOOLEAN 0 VBU0428Test_CM_boolean_cnt 0.0 1.0 /end CHARACTERISTIC
/begin CHARACTERISTIC OUTP_flgDCRelayStatusORF "" VALUE 0x700223bf Scalar_BOOLEAN 0 VBU0428Test_CM_boolean 0 1 /end CHARACTERISTIC
/begin CHARACTERISTIC OUTP_flgDCRelayStatusORFV "" VALUE 0x700223c0 Scalar_BOOLEAN 0 VBU0428Test_CM_boolean 0 1 /end CHARACTERISTIC
/begin CHARACTERISTIC PMM_flgRMCUActvDisChReqOvrdVal_C "" VALUE 0x700223d5 Scalar_BOOLEAN 0 VBU0428Test_CM_boolean_cnt 0.0 1.0 /end CHARACTERISTIC
/begin CHARACTERISTIC PMM_flgRMCUActvDisChReqOvrd_C "" VALUE 0x700223d6 Scalar_BOOLEAN 0 VBU0428Test_CM_boolean_cnt 0.0 1.0 /end CHARACTERISTIC
/begin CHARACTERISTIC PMM_flgVehRdyOvrdVal_C "" VALUE 0x700223e0 Scalar_BOOLEAN 0 VBU0428Test_CM_boolean_cnt 0.0 1.0 /end CHARACTERISTIC
/begin CHARACTERISTIC PMM_flgVehRdyOvrd_C "" VALUE 0x700223e1 Scalar_BOOLEAN 0 VBU0428Test_CM_boolean_cnt 0.0 1.0 /end CHARACTERISTIC
/begin CHARACTERISTIC PermitVoltageOvrd_C "" VALUE 0x7002240a Scalar_BOOLEAN 0 VBU0428Test_CM_boolean_cnt 0.0 1.0 /end CHARACTERISTIC
/begin CHARACTERISTIC READY_CHARGING_GATEWAYOvrd_C "" VALUE 0x7002240c Scalar_BOOLEAN 0 VBU0428Test_CM_boolean_cnt 0.0 1.0 /end CHARACTERISTIC
/begin CHARACTERISTIC SOC_OVER_UNDEROvrd_C "" VALUE 0x70022413 Scalar_BOOLEAN 0 VBU0428Test_CM_boolean_cnt 0.0 1.0 /end CHARACTERISTIC
/begin CHARACTERISTIC SOC_STOPOvrd_C "" VALUE 0x70022415 Scalar_BOOLEAN 0 VBU0428Test_CM_boolean_cnt 0.0 1.0 /end CHARACTERISTIC
/begin CHARACTERISTIC SPD_vVehSpdOvrd_C "" VALUE 0x70022421 Scalar_BOOLEAN 0 VBU0428Test_CM_boolean_cnt 0.0 1.0 /end CHARACTERISTIC
/begin CHARACTERISTIC TEMP_OVEROvrd_C "" VALUE 0x7002242e Scalar_BOOLEAN 0 VBU0428Test_CM_boolean_cnt 0.0 1.0 /end CHARACTERISTIC
/begin CHARACTERISTIC TQO_flgCtrlRMotrOvrd_C "" VALUE 0x7002245d Scalar_BOOLEAN 0 VBU0428Test_CM_boolean_cnt 0.0 1.0 /end CHARACTERISTIC
/begin CHARACTERISTIC TQO_trqRMotrOvrd_C "" VALUE 0x7002245f Scalar_BOOLEAN 0 VBU0428Test_CM_boolean_cnt 0.0 1.0 /end CHARACTERISTIC
/begin CHARACTERISTIC VCUImdStopDrivingOvrd_C "" VALUE 0x70022466 Scalar_BOOLEAN 0 VBU0428Test_CM_boolean_cnt 0.0 1.0 /end CHARACTERISTIC
/begin CHARACTERISTIC VCURmvAcChgerOvrd_C "" VALUE 0x70022467 Scalar_BOOLEAN 0 VBU0428Test_CM_boolean_cnt 0.0 1.0 /end CHARACTERISTIC
/begin CHARACTERISTIC VIN1VIN2VIN3Ovrd_C "" VALUE 0x70022468 Scalar_BOOLEAN 0 VBU0428Test_CM_boolean_cnt 0.0 1.0 /end CHARACTERISTIC
/begin CHARACTERISTIC VM_flgVehLimActvOvrdVal_C "" VALUE 0x70022469 Scalar_BOOLEAN 0 VBU0428Test_CM_boolean_cnt 0.0 1.0 /end CHARACTERISTIC
/begin CHARACTERISTIC VM_flgVehLimActvOvrd_C "" VALUE 0x7002246a Scalar_BOOLEAN 0 VBU0428Test_CM_boolean_cnt 0.0 1.0 /end CHARACTERISTIC
/begin CHARACTERISTIC VOLTAGE_REQUIREMENTOvrd_C "" VALUE 0x70022472 Scalar_BOOLEAN 0 VBU0428Test_CM_boolean_cnt 0.0 1.0 /end CHARACTERISTIC
/begin CHARACTERISTIC VehPwrLimdLampReqOvrd_C "" VALUE 0x70022477 Scalar_BOOLEAN 0 VBU0428Test_CM_boolean_cnt 0.0 1.0 /end CHARACTERISTIC
/begin CHARACTERISTIC Veh_flgHVILOvrd_C "" VALUE 0x7002247a Scalar_BOOLEAN 0 VBU0428Test_CM_boolean_cnt 0.0 1.0 /end CHARACTERISTIC
/begin CHARACTERISTIC CcCTD_MainFuseBlownFaultFIC_n "" VALUE 0x70022135 Scalar_BYTE 0 VBU0428Test_CM_int8_cnt -128.0 127.0 /end CHARACTERISTIC
/begin CHARACTERISTIC CcCTD_MainFuseBlownFaultPIC_n "" VALUE 0x70022136 Scalar_BYTE 0 VBU0428Test_CM_int8_cnt -128.0 127.0 /end CHARACTERISTIC
/begin CHARACTERISTIC CcCTD_PrechargeResistanceBlownFaultFIC_n "" VALUE 0x70022144 Scalar_BYTE 0 VBU0428Test_CM_int8_cnt -128.0 127.0 /end CHARACTERISTIC
/begin CHARACTERISTIC CcCTD_PrechargeResistanceBlownFaultPIC_n "" VALUE 0x70022145 Scalar_BYTE 0 VBU0428Test_CM_int8_cnt -128.0 127.0 /end CHARACTERISTIC
/begin CHARACTERISTIC CcCTM_BoardOverTempFaultFIC_n "" VALUE 0x7002214c Scalar_BYTE 0 VBU0428Test_CM_int8_cnt -128.0 127.0 /end CHARACTERISTIC
/begin CHARACTERISTIC CcCTM_BoardOverTempFaultPIC_n "" VALUE 0x7002214d Scalar_BYTE 0 VBU0428Test_CM_int8_cnt -128.0 127.0 /end CHARACTERISTIC
/begin CHARACTERISTIC CcCTM_CellOverTempEVMFaultFIC_n "" VALUE 0x7002214f Scalar_BYTE 0 VBU0428Test_CM_int8_cnt -128.0 127.0 /end CHARACTERISTIC
/begin CHARACTERISTIC CcCTM_CellOverTempEVMFaultPIC_n "" VALUE 0x70022150 Scalar_BYTE 0 VBU0428Test_CM_int8_cnt -128.0 127.0 /end CHARACTERISTIC
/begin CHARACTERISTIC CcCTM_CellOverTempFaultFIC_n "" VALUE 0x70022151 Scalar_BYTE 0 VBU0428Test_CM_int8_cnt -128.0 127.0 /end CHARACTERISTIC
/begin CHARACTERISTIC CcCTM_CellOverTempFaultPIC_n "" VALUE 0x70022152 Scalar_BYTE 0 VBU0428Test_CM_int8_cnt -128.0 127.0 /end CHARACTERISTIC
/begin CHARACTERISTIC CcCTM_CellOverTempWarningFaultFIC_n "" VALUE 0x70022153 Scalar_BYTE 0 VBU0428Test_CM_int8_cnt -128.0 127.0 /end CHARACTERISTIC
/begin CHARACTERISTIC CcCTM_CellOverTempWarningFaultPIC_n "" VALUE 0x70022154 Scalar_BYTE 0 VBU0428Test_CM_int8_cnt -128.0 127.0 /end CHARACTERISTIC
/begin CHARACTERISTIC CcCTM_CellTempOverDeviationEVMFaultFIC_n "" VALUE 0x70022156 Scalar_BYTE 0 VBU0428Test_CM_int8_cnt -128.0 127.0 /end CHARACTERISTIC
/begin CHARACTERISTIC CcCTM_CellTempOverDeviationEVMFaultPIC_n "" VALUE 0x70022157 Scalar_BYTE 0 VBU0428Test_CM_int8_cnt -128.0 127.0 /end CHARACTERISTIC
/begin CHARACTERISTIC CcCTM_CellTempOverDeviationFaultFIC_n "" VALUE 0x70022158 Scalar_BYTE 0 VBU0428Test_CM_int8_cnt -128.0 127.0 /end CHARACTERISTIC
/begin CHARACTERISTIC CcCTM_CellTempOverDeviationFaultPIC_n "" VALUE 0x70022159 Scalar_BYTE 0 VBU0428Test_CM_int8_cnt -128.0 127.0 /end CHARACTERISTIC
/begin CHARACTERISTIC CcCTM_CellUnderTempFaultFIC_n "" VALUE 0x7002215c Scalar_BYTE 0 VBU0428Test_CM_int8_cnt -128.0 127.0 /end CHARACTERISTIC
/begin CHARACTERISTIC CcCTM_CellUnderTempFaultPIC_n "" VALUE 0x7002215d Scalar_BYTE 0 VBU0428Test_CM_int8_cnt -128.0 127.0 /end CHARACTERISTIC
/begin CHARACTERISTIC APO_BRMTxEnaOvrdVal_C "" VALUE 0x70021f0f Scalar_UBYTE 0 VBU0428Test_CM_uint8 0 255 /end CHARACTERISTIC
/begin CHARACTERISTIC APO_BRMTxEnaSOvrd_C "" VALUE 0x70021f10 Scalar_UBYTE 0 VBU0428Test_CM_uint8 0 255 /end CHARACTERISTIC
/begin CHARACTERISTIC APO_stBMSChargeStateOvrdVal_C "" VALUE 0x70021f53 Scalar_UBYTE 0 VBU0428Test_CM_uint8_cnt 0.0 255.0 /end CHARACTERISTIC
/begin CHARACTERISTIC APO_stBattPackTempWarningOvrdVal_C "" VALUE 0x70021f56 Scalar_UBYTE 0 VBU0428Test_CM_uint8_cnt 0.0 255.0 /end CHARACTERISTIC
/begin CHARACTERISTIC APO_stHVBattWarningOvrdVal_C "" VALUE 0x70021f57 Scalar_UBYTE 0 VBU0428Test_CM_uint8_cnt 0.0 255.0 /end CHARACTERISTIC
/begin CHARACTERISTIC APO_stHVOnOvrdVal_C "" VALUE 0x70021f58 Scalar_UBYTE 0 VBU0428Test_CM_uint8_cnt 0.0 255.0 /end CHARACTERISTIC
/begin CHARACTERISTIC APO_stIsolutionWarningOvrdVal_C "" VALUE 0x70021f59 Scalar_UBYTE 0 VBU0428Test_CM_uint8_cnt 0.0 255.0 /end CHARACTERISTIC
/begin CHARACTERISTIC BATTERY_DATE_DAYOvrdVal_C "" VALUE 0x70021f5d Scalar_UBYTE 0 VBU0428Test_CM_uint8_cnt 0.0 255.0 /end CHARACTERISTIC
/begin CHARACTERISTIC BATTERY_DATE_MONTHOvrdVal_C "" VALUE 0x70021f5f Scalar_UBYTE 0 VBU0428Test_CM_uint8_cnt 0.0 255.0 /end CHARACTERISTIC
/begin CHARACTERISTIC BATTERY_DATE_YEAROvrdVal_C "" VALUE 0x70021f61 Scalar_UBYTE 0 VBU0428Test_CM_uint8_cnt 0.0 255.0 /end CHARACTERISTIC
/begin CHARACTERISTIC BATTERY_GROUP_NUMBEROvrdVal_C "" VALUE 0x70021f64 Scalar_UBYTE 0 VBU0428Test_CM_uint8_cnt 0.0 255.0 /end CHARACTERISTIC
/begin CHARACTERISTIC BATTERY_ISOLATION_STATEOvrdVal_C "" VALUE 0x70021f66 Scalar_UBYTE 0 VBU0428Test_CM_uint8_cnt 0.0 255.0 /end CHARACTERISTIC
/begin CHARACTERISTIC BATTERY_OUTPUT_CONNECTOR_STATEOvrdVal_C "" VALUE 0x70021f68 Scalar_UBYTE 0 VBU0428Test_CM_uint8_cnt 0.0 255.0 /end CHARACTERISTIC
/begin CHARACTERISTIC BATTERY_PROPERTY_IDENTIFYOvrdVal_C "" VALUE 0x70021f6a Scalar_UBYTE 0 VBU0428Test_CM_uint8_cnt 0.0 255.0 /end CHARACTERISTIC
/begin CHARACTERISTIC BATTERY_SUPPLIEROvrdVal_C "" VALUE 0x70021f6c Scalar_UBYTE 0 VBU0428Test_CM_uint8_cnt 0.0 255.0 /end CHARACTERISTIC
/begin CHARACTERISTIC BMM_VEHICLE_WAKEUP_MODE_FAST_CHARGE "" VALUE 0x70021f81 Scalar_UBYTE 0 VBU0428Test_CM_uint8_cnt 0.0 255.0 /end CHARACTERISTIC
/begin CHARACTERISTIC BMM_VEHICLE_WAKEUP_MODE_IGNITION_ON "" VALUE 0x70021f82 Scalar_UBYTE 0 VBU0428Test_CM_uint8_cnt 0.0 255.0 /end CHARACTERISTIC
/begin CHARACTERISTIC BMM_VEHICLE_WAKEUP_MODE_SOFTWARE_FLASHING "" VALUE 0x70021f83 Scalar_UBYTE 0 VBU0428Test_CM_uint8_cnt 0.0 255.0 /end CHARACTERISTIC
/begin CHARACTERISTIC BMS_SOFTWARE_VERSION1OvrdVal_C "" VALUE 0x70021f84 Scalar_UBYTE 0 VBU0428Test_CM_uint8_cnt 0.0 255.0 /end CHARACTERISTIC
/begin CHARACTERISTIC BMS_SOFTWARE_VERSION2OvrdVal_C "" VALUE 0x70021f86 Scalar_UBYTE 0 VBU0428Test_CM_uint8_cnt 0.0 255.0 /end CHARACTERISTIC
/begin CHARACTERISTIC BRM_RESERVEDOvrdVal_C "" VALUE 0x70021f91 Scalar_UBYTE 0 VBU0428Test_CM_uint8_cnt 0.0 255.0 /end CHARACTERISTIC
/begin CHARACTERISTIC CELL_VOLTAGE_OVER_UNDEROvrdVal_C "" VALUE 0x70021fa2 Scalar_UBYTE 0 VBU0428Test_CM_uint8_cnt 0.0 255.0 /end CHARACTERISTIC
/begin CHARACTERISTIC CGW_stVehDrvModeOvrdVal_C "" VALUE 0x70021fb1 Scalar_UBYTE 0 VBU0428Test_CM_uint8_cnt 0.0 255.0 /end CHARACTERISTIC
/begin CHARACTERISTIC CGW_stVehRgnModeOvrdVal_C "" VALUE 0x70021fb6 Scalar_UBYTE 0 VBU0428Test_CM_uint8_cnt 0.0 255.0 /end CHARACTERISTIC
/begin CHARACTERISTIC CHARGER_MESSAGE_OT_00OvrdVal_C "" VALUE 0x70021fbc Scalar_UBYTE 0 VBU0428Test_CM_uint8_cnt 0.0 255.0 /end CHARACTERISTIC
/begin CHARACTERISTIC CHARGER_MESSAGE_OT_AAOvrdVal_C "" VALUE 0x70021fbe Scalar_UBYTE 0 VBU0428Test_CM_uint8_cnt 0.0 255.0 /end CHARACTERISTIC
/begin CHARACTERISTIC CHARGER_MESSAGE_OT_READYOvrdVal_C "" VALUE 0x70021fc0 Scalar_UBYTE 0 VBU0428Test_CM_uint8_cnt 0.0 255.0 /end CHARACTERISTIC
/begin CHARACTERISTIC CHARGER_MESSAGE_OT_STATEOvrdVal_C "" VALUE 0x70021fc2 Scalar_UBYTE 0 VBU0428Test_CM_uint8_cnt 0.0 255.0 /end CHARACTERISTIC
/begin CHARACTERISTIC CHARGER_MESSAGE_OT_STATISTICSOvrdVal_C "" VALUE 0x70021fc4 Scalar_UBYTE 0 VBU0428Test_CM_uint8_cnt 0.0 255.0 /end CHARACTERISTIC
/begin CHARACTERISTIC CHARGER_MESSAGE_OT_STOPOvrdVal_C "" VALUE 0x70021fc6 Scalar_UBYTE 0 VBU0428Test_CM_uint8_cnt 0.0 255.0 /end CHARACTERISTIC
/begin CHARACTERISTIC CHARGER_MESSAGE_OT_SYNCHRONOUSOvrdVal_C "" VALUE 0x70021fc8 Scalar_UBYTE 0 VBU0428Test_CM_uint8_cnt 0.0 255.0 /end CHARACTERISTIC
/begin CHARACTERISTIC CHARGING_MODEOvrdVal_C "" VALUE 0x70021fca Scalar_UBYTE 0 VBU0428Test_CM_uint8_cnt 0.0 255.0 /end CHARACTERISTIC
/begin CHARACTERISTIC CHARGING_PERMITOvrdVal_C "" VALUE 0x70021fcc Scalar_UBYTE 0 VBU0428Test_CM_uint8_cnt 0.0 255.0 /end CHARACTERISTIC
/begin CHARACTERISTIC CHARGING_TIMEOvrdVal_C "" VALUE 0x70021fce Scalar_UBYTE 0 VBU0428Test_CM_uint8_cnt 0.0 255.0 /end CHARACTERISTIC
/begin CHARACTERISTIC CTD_MAIN_CONTACTOR_STATUS_Open "" VALUE 0x70021fd2 Scalar_UBYTE 0 VBU0428Test_CM_uint8_cnt 0.0 255.0 /end CHARACTERISTIC
/begin CHARACTERISTIC CTD_MAIN_CONTACTOR_STATUS_UNKNOWN "" VALUE 0x70021fd3 Scalar_UBYTE 0 VBU0428Test_CM_uint8_cnt 0.0 255.0 /end CHARACTERISTIC
/begin CHARACTERISTIC CTD_MAIN_FUSE_BLOWN_FAULT "" VALUE 0x70021fd4 Scalar_UBYTE 0 VBU0428Test_CM_uint8_cnt 0.0 255.0 /end CHARACTERISTIC
/begin CHARACTERISTIC CTD_PRECHARGE_STATUS_FAIL "" VALUE 0x70021fd8 Scalar_UBYTE 0 VBU0428Test_CM_uint8_cnt 0.0 255.0 /end CHARACTERISTIC
/begin CHARACTERISTIC CTD_PRECHARGE_STATUS_SUCCESS "" VALUE 0x70021fda Scalar_UBYTE 0 VBU0428Test_CM_uint8_cnt 0.0 255.0 /end CHARACTERISTIC
/begin CHARACTERISTIC CTS_MAIN_CONTACTOR_COMMAND_CLOSE "" VALUE 0x70021fdb Scalar_UBYTE 0 VBU0428Test_CM_uint8_cnt 0.0 255.0 /end CHARACTERISTIC
/begin CHARACTERISTIC CTS_MAIN_CONTACTOR_COMMAND_OPEN "" VALUE 0x70021fdc Scalar_UBYTE 0 VBU0428Test_CM_uint8_cnt 0.0 255.0 /end CHARACTERISTIC
/begin CHARACTERISTIC CTS_PEU_DISCHARGE_ACTIVE "" VALUE 0x70021fdd Scalar_UBYTE 0 VBU0428Test_CM_uint8_cnt 0.0 255.0 /end CHARACTERISTIC
/begin CHARACTERISTIC CTS_STATE_CLOSE_AND_DIAGNOSE_MPR_STUCKOPEN "" VALUE 0x70021fde Scalar_UBYTE 0 VBU0428Test_CM_uint8_cnt 0.0 255.0 /end CHARACTERISTIC
/begin CHARACTERISTIC CTS_STATE_CLOSE_MC_HSD_DIAGNOSE_LSD_STG "" VALUE 0x70021fdf Scalar_UBYTE 0 VBU0428Test_CM_uint8_cnt 0.0 255.0 /end CHARACTERISTIC
/begin CHARACTERISTIC CTS_STATE_CLOSE_MC_LSD_DIAGNOSE_HSD_STB "" VALUE 0x0000 Scalar_UBYTE 0 VBU0428Test_CM_uint8_cnt 0.0 255.0 /end CHARACTERISTIC
/begin CHARACTERISTIC CTS_STATE_CLOSE_MNC_PRECHARGING_MONITORING "" VALUE 0x70021fe0 Scalar_UBYTE 0 VBU0428Test_CM_uint8_cnt 0.0 255.0 /end CHARACTERISTIC
/begin CHARACTERISTIC CTS_STATE_CLOSE_MPC "" VALUE 0x70021fe1 Scalar_UBYTE 0 VBU0428Test_CM_uint8_cnt 0.0 255.0 /end CHARACTERISTIC
/begin CHARACTERISTIC CTS_STATE_DEACTIVATION "" VALUE 0x70021fe2 Scalar_UBYTE 0 VBU0428Test_CM_uint8_cnt 0.0 255.0 /end CHARACTERISTIC
/begin CHARACTERISTIC CTS_STATE_DIAGNOSE_MNC_WELD "" VALUE 0x70021fe3 Scalar_UBYTE 0 VBU0428Test_CM_uint8_cnt 0.0 255.0 /end CHARACTERISTIC
/begin CHARACTERISTIC CTS_STATE_DIAGNOSE_MPC_WELD "" VALUE 0x70021fe4 Scalar_UBYTE 0 VBU0428Test_CM_uint8_cnt 0.0 255.0 /end CHARACTERISTIC
/begin CHARACTERISTIC CTS_STATE_DIAGNOSE_MPC_WELD_POWER_DOWN "" VALUE 0x70021fe5 Scalar_UBYTE 0 VBU0428Test_CM_uint8_cnt 0.0 255.0 /end CHARACTERISTIC
/begin CHARACTERISTIC CTS_STATE_NORMAL_OPERATING "" VALUE 0x70021fe6 Scalar_UBYTE 0 VBU0428Test_CM_uint8_cnt 0.0 255.0 /end CHARACTERISTIC
/begin CHARACTERISTIC CTS_STATE_OPEN_MAIN_POSITIVE_CONTACTOR "" VALUE 0x70021fe7 Scalar_UBYTE 0 VBU0428Test_CM_uint8_cnt 0.0 255.0 /end CHARACTERISTIC
/begin CHARACTERISTIC CTS_STATE_OPEN_MC_AND_DIAGNOSE_WELD "" VALUE 0x70021fe8 Scalar_UBYTE 0 VBU0428Test_CM_uint8_cnt 0.0 255.0 /end CHARACTERISTIC
/begin CHARACTERISTIC CTS_STATE_OPEN_MC_HSD "" VALUE 0x70021fe9 Scalar_UBYTE 0 VBU0428Test_CM_uint8_cnt 0.0 255.0 /end CHARACTERISTIC
/begin CHARACTERISTIC CTS_STATE_OPEN_MPR_AND_DIAGNOSE_MPC_STUCKOPEN "" VALUE 0x70021fea Scalar_UBYTE 0 VBU0428Test_CM_uint8_cnt 0.0 255.0 /end CHARACTERISTIC
/begin CHARACTERISTIC CTS_STATE_STANDBY "" VALUE 0x70021feb Scalar_UBYTE 0 VBU0428Test_CM_uint8_cnt 0.0 255.0 /end CHARACTERISTIC
/begin CHARACTERISTIC CURRENT_OVER_UNDEROvrdVal_C "" VALUE 0x70021fec Scalar_UBYTE 0 VBU0428Test_CM_uint8_cnt 0.0 255.0 /end CHARACTERISTIC
/begin CHARACTERISTIC CURRENT_REQUIREMENTOvrdVal_C "" VALUE 0x70021fee Scalar_UBYTE 0 VBU0428Test_CM_uint8_cnt 0.0 255.0 /end CHARACTERISTIC
/begin CHARACTERISTIC CYCLE_WAKEUP_STATE_ABNORMAL "" VALUE 0x70021ff1 Scalar_UBYTE 0 VBU0428Test_CM_uint8_cnt 0.0 255.0 /end CHARACTERISTIC
/begin CHARACTERISTIC CYCLE_WAKEUP_STATE_INIT "" VALUE 0x70021ff2 Scalar_UBYTE 0 VBU0428Test_CM_uint8_cnt 0.0 255.0 /end CHARACTERISTIC
/begin CHARACTERISTIC CbCTM_BoardOverTempFaultEnable_flg "" VALUE 0x70022031 Scalar_UBYTE 0 VBU0428Test_CM_uint8_cnt 0.0 255.0 /end CHARACTERISTIC
/begin CHARACTERISTIC CbCTS_HvilOpenContactorEnable_flg "" VALUE 0x7002203e Scalar_UBYTE 0 VBU0428Test_CM_uint8_cnt 0.0 255.0 /end CHARACTERISTIC
/begin CHARACTERISTIC CcBMM_MaxWakeUpCounter_n "" VALUE 0x70022130 Scalar_UBYTE 0 VBU0428Test_CM_uint8_cnt 0.0 255.0 /end CHARACTERISTIC
/begin CHARACTERISTIC CcCTM_BoardTempInvalidFault_n "" VALUE 0x7002214e Scalar_UBYTE 0 VBU0428Test_CM_uint8_cnt 0.0 255.0 /end CHARACTERISTIC
/begin CHARACTERISTIC CcCTM_CellTempInvalidFault_n "" VALUE 0x70022155 Scalar_UBYTE 0 VBU0428Test_CM_uint8_cnt 0.0 255.0 /end CHARACTERISTIC
/begin CHARACTERISTIC CcCTS_MaxPrechargeTimes_n "" VALUE 0x70022161 Scalar_UBYTE 0 VBU0428Test_CM_uint8_cnt 0.0 255.0 /end CHARACTERISTIC
/begin CHARACTERISTIC CcCTS_NegativeLoadCurrent_A "" VALUE 0x70022162 Scalar_UBYTE 0 VBU0428Test_CM_uint8_cnt 0.0 255.0 /end CHARACTERISTIC
/begin CHARACTERISTIC CcCTS_PositiveLoadCurrent_A "" VALUE 0x70022163 Scalar_UBYTE 0 VBU0428Test_CM_uint8_cnt 0.0 255.0 /end CHARACTERISTIC
/begin CHARACTERISTIC CcCTS_PrechargeTimesLimitEnable_flg "" VALUE 0x70022164 Scalar_UBYTE 0 VBU0428Test_CM_uint8_cnt 0.0 255.0 /end CHARACTERISTIC
/begin CHARACTERISTIC CcCTS_PrechargeTimesLower_n "" VALUE 0x70022165 Scalar_UBYTE 0 VBU0428Test_CM_uint8_cnt 0.0 255.0 /end CHARACTERISTIC
/begin CHARACTERISTIC CcCTS_PrechargeTimesUpper_n "" VALUE 0x70022166 Scalar_UBYTE 0 VBU0428Test_CM_uint8_cnt 0.0 255.0 /end CHARACTERISTIC
/begin CHARACTERISTIC CmSYS_OpenContactorsDelayFaultCat_enum "" VALUE 0x700221f5 Scalar_UBYTE 0 VBU0428Test_CM_uint8_cnt 0.0 255.0 /end CHARACTERISTIC
/begin CHARACTERISTIC CmSYS_OpenContactorsNowFaultCat_enum "" VALUE 0x700221f6 Scalar_UBYTE 0 VBU0428Test_CM_uint8_cnt 0.0 255.0 /end CHARACTERISTIC
/begin CHARACTERISTIC DCH_numBRMBattTypOvrdVal_C "" VALUE 0x70022278 Scalar_UBYTE 0 VBU0428Test_CM_uint8_cnt 0.0 255.0 /end CHARACTERISTIC
/begin CHARACTERISTIC DCH_numBRMProtcVerOvrdVal_C "" VALUE 0x7002227a Scalar_UBYTE 0 VBU0428Test_CM_uint8_cnt 0.0 255.0 /end CHARACTERISTIC
/begin CHARACTERISTIC DCH_stDSPLChStsOvrdVal_C "" VALUE 0x700222ab Scalar_UBYTE 0 VBU0428Test_CM_uint8_cnt 0.0 255.0 /end CHARACTERISTIC
/begin CHARACTERISTIC DIAGNOSTIC_COMPLETE "" VALUE 0x700222e4 Scalar_UBYTE 0 VBU0428Test_CM_uint8_cnt 0.0 255.0 /end CHARACTERISTIC
/begin CHARACTERISTIC DIAGNOSTIC_CONDITION_NOT_MET "" VALUE 0x700222e5 Scalar_UBYTE 0 VBU0428Test_CM_uint8_cnt 0.0 255.0 /end CHARACTERISTIC
/begin CHARACTERISTIC DSPL_stCurrentGearD_C "" VALUE 0x700222f0 Scalar_UBYTE 0 VBU0428Test_CM_uint8_cnt 0.0 255.0 /end CHARACTERISTIC
/begin CHARACTERISTIC DSPL_stCurrentGearN_C "" VALUE 0x700222f1 Scalar_UBYTE 0 VBU0428Test_CM_uint8_cnt 0.0 255.0 /end CHARACTERISTIC
/begin CHARACTERISTIC DSPL_stCurrentGearP_C "" VALUE 0x700222f2 Scalar_UBYTE 0 VBU0428Test_CM_uint8_cnt 0.0 255.0 /end CHARACTERISTIC
/begin CHARACTERISTIC DSPL_stCurrentGearR_C "" VALUE 0x700222f3 Scalar_UBYTE 0 VBU0428Test_CM_uint8_cnt 0.0 255.0 /end CHARACTERISTIC
/begin CHARACTERISTIC DSPL_stDCDCStsFail_SY "" VALUE 0x700222f4 Scalar_UBYTE 0 VBU0428Test_CM_uint8_cnt 0.0 255.0 /end CHARACTERISTIC
/begin CHARACTERISTIC DSPL_stHVCntctStClosed_SY "" VALUE 0x700222f8 Scalar_UBYTE 0 VBU0428Test_CM_uint8_cnt 0.0 255.0 /end CHARACTERISTIC
/begin CHARACTERISTIC DSPL_stLvBattChrgFail_C "" VALUE 0x700222f9 Scalar_UBYTE 0 VBU0428Test_CM_uint8_cnt 0.0 255.0 /end CHARACTERISTIC
/begin CHARACTERISTIC DSPL_stLvBattChrging_C "" VALUE 0x700222fa Scalar_UBYTE 0 VBU0428Test_CM_uint8_cnt 0.0 255.0 /end CHARACTERISTIC
/begin CHARACTERISTIC DSPL_stLvBattNoChrg_C "" VALUE 0x700222fb Scalar_UBYTE 0 VBU0428Test_CM_uint8_cnt 0.0 255.0 /end CHARACTERISTIC
/begin CHARACTERISTIC DSPL_stPEURMotTempAlarm_SY "" VALUE 0x700222fc Scalar_UBYTE 0 VBU0428Test_CM_uint8_cnt 0.0 255.0 /end CHARACTERISTIC
/begin CHARACTERISTIC FPV_st4WayVlvPosFdbkPosition1_SY "" VALUE 0x7002231d Scalar_UBYTE 0 VBU0428Test_CM_uint8_cnt 0.0 8.0 /end CHARACTERISTIC
/begin CHARACTERISTIC FPV_st4WayVlvPosFdbkPosition2_SY "" VALUE 0x7002231e Scalar_UBYTE 0 VBU0428Test_CM_uint8_cnt 0.0 8.0 /end CHARACTERISTIC
/begin CHARACTERISTIC FPV_st4WayVlvPosFdbkUnknow_SY "" VALUE 0x7002231f Scalar_UBYTE 0 VBU0428Test_CM_uint8_cnt 0.0 8.0 /end CHARACTERISTIC
/begin CHARACTERISTIC GATEWAY_STOP_ERROR_REASON_OCOvrdVal_C "" VALUE 0x70022320 Scalar_UBYTE 0 VBU0428Test_CM_uint8_cnt 0.0 255.0 /end CHARACTERISTIC
/begin CHARACTERISTIC GATEWAY_STOP_ERROR_REASON_VOLTOvrdVal_C "" VALUE 0x70022322 Scalar_UBYTE 0 VBU0428Test_CM_uint8_cnt 0.0 255.0 /end CHARACTERISTIC
/begin CHARACTERISTIC GATEWAY_STOP_FAULT_REASON_1OvrdVal_C "" VALUE 0x70022324 Scalar_UBYTE 0 VBU0428Test_CM_uint8_cnt 0.0 255.0 /end CHARACTERISTIC
/begin CHARACTERISTIC GATEWAY_STOP_FAULT_REASON_2OvrdVal_C "" VALUE 0x70022326 Scalar_UBYTE 0 VBU0428Test_CM_uint8_cnt 0.0 255.0 /end CHARACTERISTIC
/begin CHARACTERISTIC GATEWAY_STOP_FAULT_REASON_3OvrdVal_C "" VALUE 0x70022328 Scalar_UBYTE 0 VBU0428Test_CM_uint8_cnt 0.0 255.0 /end CHARACTERISTIC
/begin CHARACTERISTIC GATEWAY_STOP_FAULT_REASON_BMSOTOvrdVal_C "" VALUE 0x7002232a Scalar_UBYTE 0 VBU0428Test_CM_uint8_cnt 0.0 255.0 /end CHARACTERISTIC
/begin CHARACTERISTIC GATEWAY_STOP_FAULT_REASON_CELLOTOvrdVal_C "" VALUE 0x7002232c Scalar_UBYTE 0 VBU0428Test_CM_uint8_cnt 0.0 255.0 /end CHARACTERISTIC
/begin CHARACTERISTIC GATEWAY_STOP_FAULT_REASON_CONNOTOvrdVal_C "" VALUE 0x7002232e Scalar_UBYTE 0 VBU0428Test_CM_uint8_cnt 0.0 255.0 /end CHARACTERISTIC
/begin CHARACTERISTIC GATEWAY_STOP_FAULT_REASON_CONNOvrdVal_C "" VALUE 0x70022330 Scalar_UBYTE 0 VBU0428Test_CM_uint8_cnt 0.0 255.0 /end CHARACTERISTIC
/begin CHARACTERISTIC GATEWAY_STOP_FAULT_REASON_ISOOvrdVal_C "" VALUE 0x70022332 Scalar_UBYTE 0 VBU0428Test_CM_uint8_cnt 0.0 255.0 /end CHARACTERISTIC
/begin CHARACTERISTIC GATEWAY_STOP_REASON_CELLVOLTOvrdVal_C "" VALUE 0x70022334 Scalar_UBYTE 0 VBU0428Test_CM_uint8_cnt 0.0 255.0 /end CHARACTERISTIC
/begin CHARACTERISTIC GATEWAY_STOP_REASON_SOCOvrdVal_C "" VALUE 0x70022336 Scalar_UBYTE 0 VBU0428Test_CM_uint8_cnt 0.0 255.0 /end CHARACTERISTIC
/begin CHARACTERISTIC GATEWAY_STOP_REASON_STATIONOvrdVal_C "" VALUE 0x70022338 Scalar_UBYTE 0 VBU0428Test_CM_uint8_cnt 0.0 255.0 /end CHARACTERISTIC
/begin CHARACTERISTIC GATEWAY_STOP_REASON_TOTALVOLTOvrdVal_C "" VALUE 0x7002233a Scalar_UBYTE 0 VBU0428Test_CM_uint8_cnt 0.0 255.0 /end CHARACTERISTIC
/begin CHARACTERISTIC Gear_stCurrentGearDisplayOvrdVal_C "" VALUE 0x70022346 Scalar_UBYTE 0 VBU0428Test_CM_uint8_cnt 0.0 255.0 /end CHARACTERISTIC
/begin CHARACTERISTIC Gear_stCurrentGearN_C "" VALUE 0x70022348 Scalar_UBYTE 0 VBU0428Test_CM_uint8_cnt 0.0 15.0 /end CHARACTERISTIC
/begin CHARACTERISTIC Gear_stCurrentGearP_C "" VALUE 0x70022349 Scalar_UBYTE 0 VBU0428Test_CM_uint8_cnt 0.0 255.0 /end CHARACTERISTIC
/begin CHARACTERISTIC Gear_stEPBReqOvrdVal_C "" VALUE 0x70022354 Scalar_UBYTE 0 VBU0428Test_CM_uint8_cnt 0.0 255.0 /end CHARACTERISTIC
/begin CHARACTERISTIC MAXIMUM_CELL_TEMPOvrdVal_C "" VALUE 0x7002239d Scalar_UBYTE 0 VBU0428Test_CM_uint8_cnt 0.0 255.0 /end CHARACTERISTIC
/begin CHARACTERISTIC MAXIMUM_CELL_TEMP_BSDOvrdVal_C "" VALUE 0x7002239f Scalar_UBYTE 0 VBU0428Test_CM_uint8_cnt 0.0 255.0 /end CHARACTERISTIC
/begin CHARACTERISTIC MAXIMUM_CELL_VOLTAGE_BSDOvrdVal_C "" VALUE 0x700223a1 Scalar_UBYTE 0 VBU0428Test_CM_uint8_cnt 0.0 255.0 /end CHARACTERISTIC
/begin CHARACTERISTIC MAXIMUM_CELL_VOLTAGE_NUMBER_BSMOvrdVal_C "" VALUE 0x700223a3 Scalar_UBYTE 0 VBU0428Test_CM_uint8_cnt 0.0 255.0 /end CHARACTERISTIC
/begin CHARACTERISTIC MAXIMUM_TEMP_NUMBEROvrdVal_C "" VALUE 0x700223a5 Scalar_UBYTE 0 VBU0428Test_CM_uint8_cnt 0.0 255.0 /end CHARACTERISTIC
/begin CHARACTERISTIC MINIMUM_CELL_TEMPOvrdVal_C "" VALUE 0x700223ab Scalar_UBYTE 0 VBU0428Test_CM_uint8_cnt 0.0 255.0 /end CHARACTERISTIC
/begin CHARACTERISTIC MINIMUM_CELL_TEMP_BSDOvrdVal_C "" VALUE 0x700223ad Scalar_UBYTE 0 VBU0428Test_CM_uint8_cnt 0.0 255.0 /end CHARACTERISTIC
/begin CHARACTERISTIC MINIMUM_CELL_VOLTAGE_BSDOvrdVal_C "" VALUE 0x700223af Scalar_UBYTE 0 VBU0428Test_CM_uint8_cnt 0.0 255.0 /end CHARACTERISTIC
/begin CHARACTERISTIC MINIMUM_TEMP_NUMBEROvrdVal_C "" VALUE 0x700223b1 Scalar_UBYTE 0 VBU0428Test_CM_uint8_cnt 0.0 255.0 /end CHARACTERISTIC
/begin CHARACTERISTIC PMM_stACTest_SY "" VALUE 0x700223e6 Scalar_UBYTE 0 VBU0428Test_CM_uint8_cnt 0.0 255.0 /end CHARACTERISTIC
/begin CHARACTERISTIC PMM_stActvDisCh_SY "" VALUE 0x700223e8 Scalar_UBYTE 0 VBU0428Test_CM_uint8_cnt 0.0 255.0 /end CHARACTERISTIC
/begin CHARACTERISTIC PMM_stDCDCDisbl_SY "" VALUE 0x700223ea Scalar_UBYTE 0 VBU0428Test_CM_uint8_cnt 0.0 255.0 /end CHARACTERISTIC
/begin CHARACTERISTIC PMM_stHVCntctStClosed_SY "" VALUE 0x700223f2 Scalar_UBYTE 0 VBU0428Test_CM_uint8_cnt 0.0 255.0 /end CHARACTERISTIC
/begin CHARACTERISTIC PMM_stHVCntctStInit_SY "" VALUE 0x700223f3 Scalar_UBYTE 0 VBU0428Test_CM_uint8_cnt 0.0 255.0 /end CHARACTERISTIC
/begin CHARACTERISTIC PMM_stHVCntctStPreCh_SY "" VALUE 0x700223f4 Scalar_UBYTE 0 VBU0428Test_CM_uint8_cnt 0.0 255.0 /end CHARACTERISTIC
/begin CHARACTERISTIC PMM_stHVRlyClose_SY "" VALUE 0x700223f5 Scalar_UBYTE 0 VBU0428Test_CM_uint8_cnt 0.0 255.0 /end CHARACTERISTIC
/begin CHARACTERISTIC PMM_stHVRlyConnReq_SY "" VALUE 0x700223f6 Scalar_UBYTE 0 VBU0428Test_CM_uint8_cnt 0.0 255.0 /end CHARACTERISTIC
/begin CHARACTERISTIC PMM_stHVRlyConn_SY "" VALUE 0x700223f7 Scalar_UBYTE 0 VBU0428Test_CM_uint8_cnt 0.0 255.0 /end CHARACTERISTIC
/begin CHARACTERISTIC PMM_stHVRlyNoReq_SY "" VALUE 0x700223f8 Scalar_UBYTE 0 VBU0428Test_CM_uint8_cnt 0.0 255.0 /end CHARACTERISTIC
/begin CHARACTERISTIC PMM_stHVRlyOpenReq_SY "" VALUE 0x700223f9 Scalar_UBYTE 0 VBU0428Test_CM_uint8_cnt 0.0 255.0 /end CHARACTERISTIC
/begin CHARACTERISTIC PMM_stHVRlyOpen_SY "" VALUE 0x700223fa Scalar_UBYTE 0 VBU0428Test_CM_uint8 0 255 /end CHARACTERISTIC
/begin CHARACTERISTIC PMM_stInitMode_SY "" VALUE 0x700223fd Scalar_UBYTE 0 VBU0428Test_CM_uint8_cnt 0.0 255.0 /end CHARACTERISTIC
/begin CHARACTERISTIC PMM_stInitRst_SY "" VALUE 0x700223fe Scalar_UBYTE 0 VBU0428Test_CM_uint8_cnt 0.0 255.0 /end CHARACTERISTIC
/begin CHARACTERISTIC PMM_stMCUACOff_SY "" VALUE 0x700223ff Scalar_UBYTE 0 VBU0428Test_CM_uint8_cnt 0.0 255.0 /end CHARACTERISTIC
/begin CHARACTERISTIC PMM_stRstKeep_SY "" VALUE 0x70022406 Scalar_UBYTE 0 VBU0428Test_CM_uint8_cnt 0.0 255.0 /end CHARACTERISTIC
/begin CHARACTERISTIC PMM_stShutDown_SY "" VALUE 0x70022407 Scalar_UBYTE 0 VBU0428Test_CM_uint8_cnt 0.0 255.0 /end CHARACTERISTIC
/begin CHARACTERISTIC READY_CHARGING_GATEWAYOvrdVal_C "" VALUE 0x7002240b Scalar_UBYTE 0 VBU0428Test_CM_uint8_cnt 0.0 255.0 /end CHARACTERISTIC
/begin CHARACTERISTIC SOC_OVER_UNDEROvrdVal_C "" VALUE 0x70022412 Scalar_UBYTE 0 VBU0428Test_CM_uint8_cnt 0.0 255.0 /end CHARACTERISTIC
/begin CHARACTERISTIC SOC_STOPOvrdVal_C "" VALUE 0x70022414 Scalar_UBYTE 0 VBU0428Test_CM_uint8_cnt 0.0 255.0 /end CHARACTERISTIC
/begin CHARACTERISTIC TQO_stCtrlRMotrOvrdVal_C "" VALUE 0x7002245e Scalar_UBYTE 0 VBU0428Test_CM_uint8_cnt 0.0 255.0 /end CHARACTERISTIC
/begin CHARACTERISTIC VCR_CONTACTOR_NO_REQUEST "" VALUE 0x70022460 Scalar_UBYTE 0 VBU0428Test_CM_uint8_cnt 0.0 255.0 /end CHARACTERISTIC
/begin CHARACTERISTIC VCR_CONTACTOR_OPEN "" VALUE 0x70022461 Scalar_UBYTE 0 VBU0428Test_CM_uint8_cnt 0.0 255.0 /end CHARACTERISTIC
/begin CHARACTERISTIC VOLTAGE_REQUIREMENTOvrdVal_C "" VALUE 0x70022471 Scalar_UBYTE 0 VBU0428Test_CM_uint8_cnt 0.0 255.0 /end CHARACTERISTIC
/begin CHARACTERISTIC Veh_stIMInverterON_C "" VALUE 0x70022481 Scalar_UBYTE 0 VBU0428Test_CM_uint8_cnt 0.0 15.0 /end CHARACTERISTIC
/begin CHARACTERISTIC Veh_stInverterOFF_C "" VALUE 0x70022482 Scalar_UBYTE 0 VBU0428Test_CM_uint8_cnt 0.0 15.0 /end CHARACTERISTIC
/begin CHARACTERISTIC Veh_stInverterON_C "" VALUE 0x70022483 Scalar_UBYTE 0 VBU0428Test_CM_uint8_cnt 0.0 15.0 /end CHARACTERISTIC
/begin CHARACTERISTIC Veh_stVehTire19_C "" VALUE 0x70022485 Scalar_UBYTE 0 VBU0428Test_CM_uint8_cnt 0.0 15.0 /end CHARACTERISTIC
/begin MEASUREMENT TQD_trqNrmBrkDes "" FLOAT32_IEEE VBU0428Test_CM_single 0 0 -10000.0 10000.0 ECU_ADDRESS 0x6003bea6 /end MEASUREMENT
/begin MEASUREMENT TQD_trqDes "" FLOAT32_IEEE VBU0428Test_CM_single 0 0 -3.4E+38 3.4E+38 ECU_ADDRESS 0x6003bd7a /end MEASUREMENT
/begin MEASUREMENT TQD_trqBrkRgn "" FLOAT32_IEEE VBU0428Test_CM_single 0 0 -3.4E+38 3.4E+38 ECU_ADDRESS 0x6003be8a /end MEASUREMENT
/begin MEASUREMENT THM_rpmCoolingFanSpdReq "" FLOAT32_IEEE VBU0428Test_CM_single 0 0 -3.4E+38 3.4E+38 ECU_ADDRESS 0x90000214 /end MEASUREMENT
/begin MEASUREMENT PMM_tiStDurT "" FLOAT32_IEEE VBU0428Test_CM_single 0 0 -3.4E+38 3.4E+38 ECU_ADDRESS 0x6003bfc2 /end MEASUREMENT
/begin MEASUREMENT CTS_timsPrechargeTimer "" FLOAT32_IEEE VBU0428Test_CM_single 0 0 -3.4E+38 3.4E+38 ECU_ADDRESS 0x900000f8 /end MEASUREMENT
/begin MEASUREMENT CTM_tCellTempMin "" FLOAT32_IEEE VBU0428Test_CM_single 0 0 -3.4E+38 3.4E+38 ECU_ADDRESS 0x6003bade /end MEASUREMENT
/begin MEASUREMENT CTM_tOriginalCellTempMin "" FLOAT32_IEEE VBU0428Test_CM_single 0 0 -3.4E+38 3.4E+38 ECU_ADDRESS 0x6003bf52 /end MEASUREMENT
/begin MEASUREMENT CTM_tCellTempMax "" FLOAT32_IEEE VBU0428Test_CM_single 0 0 -3.4E+38 3.4E+38 ECU_ADDRESS 0x6003bada /end MEASUREMENT
/begin MEASUREMENT CTM_tOriginalCellTempMax "" FLOAT32_IEEE VBU0428Test_CM_single 0 0 -3.4E+38 3.4E+38 ECU_ADDRESS 0x6003bf4e /end MEASUREMENT
/begin MEASUREMENT CTM_tCellTempAve "" FLOAT32_IEEE VBU0428Test_CM_single 0 0 -3.4E+38 3.4E+38 ECU_ADDRESS 0x6003bad6 /end MEASUREMENT
/begin MEASUREMENT CTM_tOriginalCellTempAve "" FLOAT32_IEEE VBU0428Test_CM_single 0 0 -3.4E+38 3.4E+38 ECU_ADDRESS 0x6003bf4a /end MEASUREMENT
/begin MEASUREMENT CTM_tOriginalCellTempSecondMax "" FLOAT32_IEEE VBU0428Test_CM_single 0 0 -40.0 200.0 ECU_ADDRESS 0x6003bae2 /end MEASUREMENT
/begin MEASUREMENT CTD_stMnPosContactorStatus "" FLOAT32_IEEE VBU0428Test_CM_single 0 0 -3.4E+38 3.4E+38 ECU_ADDRESS 0x6003bf3a /end MEASUREMENT
/begin MEASUREMENT CTD_stMnNegContactorStatus "" FLOAT32_IEEE VBU0428Test_CM_single 0 0 -3.4E+38 3.4E+38 ECU_ADDRESS 0x6003bf36 /end MEASUREMENT
/begin MEASUREMENT CTD_stPrechargeContactorStatus "" FLOAT32_IEEE VBU0428Test_CM_single 0 0 -3.4E+38 3.4E+38 ECU_ADDRESS 0x6003bf3e /end MEASUREMENT
/begin MEASUREMENT CTD_stHeatingContactorStatus "" FLOAT32_IEEE VBU0428Test_CM_single 0 0 -3.4E+38 3.4E+38 ECU_ADDRESS 0x6003bf32 /end MEASUREMENT
/begin MEASUREMENT GaCSC_flgCellBalanceRequest "" FLOAT32_IEEE VBU0428Test_CM_single 0 0 -3.4E+38 3.4E+38 ARRAY_SIZE 198 ECU_ADDRESS 0x6003af66 /end MEASUREMENT
/begin MEASUREMENT BCV_iABatteryCurrentRaw "" FLOAT32_IEEE VBU0428Test_CM_single 0 0 -3.4E+38 3.4E+38 ECU_ADDRESS 0x900000dc /end MEASUREMENT
/begin MEASUREMENT CTD_stPrechargeRelayBlown "" UWORD VBU0428Test_CM_uint16 0 0 0 65535 ECU_ADDRESS 0x900014a8 /end MEASUREMENT
/begin MEASUREMENT CTD_stMainFuseBlownFault "" UWORD VBU0428Test_CM_uint16 0 0 0 65535 ECU_ADDRESS 0x900016b4 /end MEASUREMENT
/begin MEASUREMENT BMM_numMonitorLastCycle "" UWORD VBU0428Test_CM_uint16 0 0 0 65535 ECU_ADDRESS 0x900016d6 /end MEASUREMENT
/begin MEASUREMENT PMM_stHVRlyReqTmp "" UBYTE VBU0428Test_CM_uint8 0 0 0 255 ECU_ADDRESS 0x90001f56 /end MEASUREMENT
/begin MEASUREMENT PMM_stPwrModeSt "" UBYTE VBU0428Test_CM_uint8 0 0 0 255 ECU_ADDRESS 0x90001f58 /end MEASUREMENT
/begin MEASUREMENT CTS_stContactorRequest "" UBYTE VBU0428Test_CM_uint8 0 0 0 255 ECU_ADDRESS 0x90001de7 /end MEASUREMENT
/begin MEASUREMENT CTS_stState "" UBYTE VBU0428Test_CM_uint8 0 0 0 255 ECU_ADDRESS 0x90001f34 /end MEASUREMENT
/begin MEASUREMENT CTS_stCmdPrechargeRelay "" UBYTE VBU0428Test_CM_uint8 0 0 0 255 ECU_ADDRESS 0x90001f33 /end MEASUREMENT
/begin MEASUREMENT CTS_stCmdMnNegContactor "" UBYTE VBU0428Test_CM_uint8 0 0 0 255 ECU_ADDRESS 0x90001f31 /end MEASUREMENT
/begin MEASUREMENT CTS_stCmdMnPosContactor "" UBYTE VBU0428Test_CM_uint8 0 0 0 255 ECU_ADDRESS 0x90001f32 /end MEASUREMENT
/begin MEASUREMENT CTM_numOriginalCellTempMinID "" UBYTE VBU0428Test_CM_uint8 0 0 0.0 200.0 ECU_ADDRESS 0x90001cc0 /end MEASUREMENT
/begin MEASUREMENT CTM_numCellTempMinID "" UBYTE VBU0428Test_CM_uint8 0 0 0.0 40.0 ECU_ADDRESS 0x90001cbe /end MEASUREMENT
/begin MEASUREMENT CTM_numOriginalCellTempSecondMaxID "" UBYTE VBU0428Test_CM_uint8 0 0 0.0 40.0 ECU_ADDRESS 0x90001cc1 /end MEASUREMENT
/begin MEASUREMENT CTM_numCellTempMaxID "" UBYTE VBU0428Test_CM_uint8 0 0 0.0 40.0 ECU_ADDRESS 0x90001cbd /end MEASUREMENT
/begin MEASUREMENT CTM_numOriginalCellTempMaxID "" UBYTE VBU0428Test_CM_uint8 0 0 0.0 40.0 ECU_ADDRESS 0x90001cbf /end MEASUREMENT
/begin MEASUREMENT CTD_stMnContactorsStatus "" UBYTE VBU0428Test_CM_uint8 0 0 0 255 ECU_ADDRESS 0x90001cbc /end MEASUREMENT
/begin MEASUREMENT CTC_stResetContactorRequest "" UBYTE VBU0428Test_CM_uint8 0 0 0 255 ECU_ADDRESS 0x90001f69 /end MEASUREMENT
/begin MEASUREMENT CTC_stContactorsCommandStatus "" UBYTE VBU0428Test_CM_uint8 0 0 0 255 ECU_ADDRESS 0x90001f68 /end MEASUREMENT
/begin MEASUREMENT BCV_stBdmCurrentComIndex "" UBYTE VBU0428Test_CM_uint8 0 0 0 255 ECU_ADDRESS 0x90001f5f /end MEASUREMENT
/begin MEASUREMENT BCV_stBdmCurrentPerformanceIndex "" UBYTE VBU0428Test_CM_uint8 0 0 0 255 ECU_ADDRESS 0x90001f60 /end MEASUREMENT
/begin MEASUREMENT BCV_BdmVoltagePerformanceIndex_enum "" UBYTE VBU0428Test_CM_uint8 0 0 0 255 ECU_ADDRESS 0x90001f5d /end MEASUREMENT
/begin MEASUREMENT OD_LsDCChgRly "" UBYTE VBU0428Test_CM_boolean 0 0 0 1 ECU_ADDRESS 0x90001f80 /end MEASUREMENT
/begin MEASUREMENT OP_flgLSDVacuumPump "" UBYTE VBU0428Test_CM_boolean 0 0 0 1 ECU_ADDRESS 0x90001f82 /end MEASUREMENT
/begin MEASUREMENT Veh_flgVacPressWarning "" UBYTE VBU0428Test_CM_boolean 0 0 0 1 ECU_ADDRESS 0x90001f90 /end MEASUREMENT
/begin MEASUREMENT THM_flgFanEnable "" UBYTE VBU0428Test_CM_boolean 0 0 0 1 ECU_ADDRESS 0x90001f8d /end MEASUREMENT
/begin MEASUREMENT PMM_flgPEUACTstReq "" UBYTE VBU0428Test_CM_boolean 0 0 0 1 ECU_ADDRESS 0x90001f4b /end MEASUREMENT
/begin MEASUREMENT PMM_flgHVRLyCloseTimeOut "" UBYTE VBU0428Test_CM_boolean 0 0 0 1 ECU_ADDRESS 0x90001f47 /end MEASUREMENT
/begin MEASUREMENT PMM_flgACTstTimeOut "" UBYTE VBU0428Test_CM_boolean 0 0 0 1 ECU_ADDRESS 0x90001f3d /end MEASUREMENT
/begin MEASUREMENT PMM_flgHVRlyOpenTimeOut "" UBYTE VBU0428Test_CM_boolean 0 0 0 1 ECU_ADDRESS 0x90001f48 /end MEASUREMENT
/begin MEASUREMENT PMM_flgActvDisChTimeOut "" UBYTE VBU0428Test_CM_boolean 0 0 0 1 ECU_ADDRESS 0x90001f40 /end MEASUREMENT
/begin MEASUREMENT PMM_flgOffLoadTimeOut "" UBYTE VBU0428Test_CM_boolean 0 0 0 1 ECU_ADDRESS 0x90001f49 /end MEASUREMENT
/begin MEASUREMENT PMM_flgAccDisable "" UBYTE VBU0428Test_CM_boolean 0 0 0 1 ECU_ADDRESS 0x90001f3f /end MEASUREMENT
/begin MEASUREMENT PMM_flgDCDCEna "" UBYTE VBU0428Test_CM_boolean 0 0 0 1 ECU_ADDRESS 0x90001f42 /end MEASUREMENT
/begin MEASUREMENT LaCBL_flgCellBoardTempAvailable "" UBYTE VBU0428Test_CM_boolean 0 0 0 1 ARRAY_SIZE 198 ECU_ADDRESS 0x90000ffd /end MEASUREMENT
/begin MEASUREMENT CTS_flgCmdOpenContactorsNow "" UBYTE VBU0428Test_CM_boolean 0 0 0 1 ECU_ADDRESS 0x90001de4 /end MEASUREMENT
/begin MEASUREMENT CTS_flgCmdOpenContactorsDelay "" UBYTE VBU0428Test_CM_boolean 0 0 0 1 ECU_ADDRESS 0x90001de3 /end MEASUREMENT
/begin MEASUREMENT CTS_flgRunPrechargeDiagnostic "" UBYTE VBU0428Test_CM_boolean 0 0 0 1 ECU_ADDRESS 0x90001f30 /end MEASUREMENT
/begin MEASUREMENT CTS_flgRunNegContactorWeldCheck "" UBYTE VBU0428Test_CM_boolean 0 0 0 1 ECU_ADDRESS 0x90001f2e /end MEASUREMENT
/begin MEASUREMENT CTS_flgRunPosContactorWeldCheck "" UBYTE VBU0428Test_CM_boolean 0 0 0 1 ECU_ADDRESS 0x90001f2f /end MEASUREMENT
/begin MEASUREMENT CTD_flgPrechargeResistanceBlownFaultTestEnable "" UBYTE VBU0428Test_CM_boolean 0 0 0 1 ECU_ADDRESS 0x90001dd5 /end MEASUREMENT
/begin MEASUREMENT CTD_flgPrechargeResistanceBlownFaultTestFail "" UBYTE VBU0428Test_CM_boolean 0 0 0 1 ECU_ADDRESS 0x90001dd6 /end MEASUREMENT
/begin MEASUREMENT CTD_flgMainFuseBlowFaultTestEnable "" UBYTE VBU0428Test_CM_boolean 0 0 0 1 ECU_ADDRESS 0x90001dd3 /end MEASUREMENT
/begin MEASUREMENT CTD_flgMainFuseBlowFaultTestFail "" UBYTE VBU0428Test_CM_boolean 0 0 0 1 ECU_ADDRESS 0x90001dd4 /end MEASUREMENT
/begin MEASUREMENT CTC_flgHALPrechargeRelay "" UBYTE VBU0428Test_CM_boolean 0 0 0 1 ECU_ADDRESS 0x90001dd1 /end MEASUREMENT
/begin MEASUREMENT CTC_flgHALMnNegContactor "" UBYTE VBU0428Test_CM_boolean 0 0 0 1 ECU_ADDRESS 0x90001dcf /end MEASUREMENT
/begin MEASUREMENT CTC_flgHALMnPosContactor "" UBYTE VBU0428Test_CM_boolean 0 0 0 1 ECU_ADDRESS 0x90001dd0 /end MEASUREMENT
/begin MEASUREMENT BMM_flgEEBlockStoreEnable "" UBYTE VBU0428Test_CM_boolean 0 0 0 1 ECU_ADDRESS 0x90001dc1 /end MEASUREMENT
/begin MEASUREMENT BMM_flgFastChargeWakeup "" UBYTE VBU0428Test_CM_boolean 0 0 0.0 1.0 ECU_ADDRESS 0x90001cb7 /end MEASUREMENT
/begin MEASUREMENT BMM_flgIgnitionOnWakeup "" UBYTE VBU0428Test_CM_boolean 0 0 0.0 1.0 ECU_ADDRESS 0x90001cb9 /end MEASUREMENT
/begin MEASUREMENT BMM_flgHoldAfterrun "" UBYTE VBU0428Test_CM_boolean 0 0 0.0 1.0 ECU_ADDRESS 0x90001cb8 /end MEASUREMENT
/begin MEASUREMENT BCV_flgBatteryCurrentSystemValid "" UBYTE VBU0428Test_CM_boolean 0 0 0 1 ECU_ADDRESS 0x90001f5e /end MEASUREMENT
/begin MEASUREMENT BCV_flgDCContactorOverCurrent "" UBYTE VBU0428Test_CM_boolean 0 0 0 1 ECU_ADDRESS 0x90001f29 /end MEASUREMENT
/begin MEASUREMENT Count "" FLOAT32_IEEE VBU0428Test_CM_single 0 0 -3.4E+38 3.4E+38 ECU_ADDRESS 0x6003bae6 /end MEASUREMENT
/begin MEASUREMENT LcCTS_CloseAndDiagnoseContactorsTimer_ms "" UWORD VBU0428Test_CM_uint16 0 0 0 65535 ECU_ADDRESS 0x9000147c /end MEASUREMENT
/begin MEASUREMENT LcCTS_OpenContactorsDelayTimer_ms "" UWORD VBU0428Test_CM_uint16 0 0 0 65535 ECU_ADDRESS 0x90001486 /end MEASUREMENT
/begin MEASUREMENT LcCTS_StandbyTimer_ms "" UWORD VBU0428Test_CM_uint16 0 0 0 65535 ECU_ADDRESS 0x90001488 /end MEASUREMENT
/begin MEASUREMENT LcCTS_OpenAndDiagnoseWeldTimer_ms "" UWORD VBU0428Test_CM_uint16 0 0 0 65535 ECU_ADDRESS 0x90001484 /end MEASUREMENT
/begin MEASUREMENT LcCTS_DiagnoseMPCWeldcheckDischargeTimer_ms "" UWORD VBU0428Test_CM_uint16 0 0 0 65535 ECU_ADDRESS 0x90001480 /end MEASUREMENT
/begin MEASUREMENT LcCTS_DiagnoseMPCWeldcheckTimer_ms "" UWORD VBU0428Test_CM_uint16 0 0 0 65535 ECU_ADDRESS 0x90001482 /end MEASUREMENT
/begin MEASUREMENT LcCTS_CmdMnPosContactorCounter_ms "" UWORD VBU0428Test_CM_uint16 0 0 0 65535 ECU_ADDRESS 0x9000147e /end MEASUREMENT
/begin COMPU_METHOD VBU0428Test_CM_single_cnt "Q = V" RAT_FUNC "%8.6" "cnt" COEFFS 0 1 0 0 0 1 /end COMPU_METHOD
/begin COMPU_METHOD VBU0428Test_CM_uint16_cnt "Q = V" RAT_FUNC "%5.0" "cnt" COEFFS 0 1 0 0 0 1 /end COMPU_METHOD
/begin COMPU_METHOD VBU0428Test_CM_single_pct "Q = V" RAT_FUNC "%8.6" "pct" COEFFS 0 1 0 0 0 1 /end COMPU_METHOD
/begin COMPU_METHOD VBU0428Test_CM_single_fac "Q = V" RAT_FUNC "%8.6" "fac" COEFFS 0 1 0 0 0 1 /end COMPU_METHOD
/begin COMPU_METHOD VBU0428Test_CM_uint8 "Q = V" RAT_FUNC "%3.0" "" COEFFS 0 1 0 0 0 1 /end COMPU_METHOD
/begin COMPU_METHOD VBU0428Test_CM_uint16 "Q = V" RAT_FUNC "%5.0" "" COEFFS 0 1 0 0 0 1 /end COMPU_METHOD
/begin COMPU_METHOD VBU0428Test_CM_double "Q = V" RAT_FUNC "%15.10" "" COEFFS 0 1 0 0 0 1 /end COMPU_METHOD
/begin COMPU_METHOD VBU0428Test_CM_single "Q = V" RAT_FUNC "%8.6" "" COEFFS 0 1 0 0 0 1 /end COMPU_METHOD
/begin COMPU_METHOD VBU0428Test_CM_single_s "Q = V" RAT_FUNC "%8.6" "s" COEFFS 0 1 0 0 0 1 /end COMPU_METHOD
/begin COMPU_METHOD VBU0428Test_CM_uint32_cnt "Q = V" RAT_FUNC "%10.0" "cnt" COEFFS 0 1 0 0 0 1 /end COMPU_METHOD
/begin COMPU_METHOD VBU0428Test_CM_boolean_flg "Q = V" RAT_FUNC "%1.0" "flg" COEFFS 0 1 0 0 0 1 /end COMPU_METHOD
/begin COMPU_METHOD VBU0428Test_CM_boolean_cnt "Q = V" RAT_FUNC "%1.0" "cnt" COEFFS 0 1 0 0 0 1 /end COMPU_METHOD
/begin COMPU_METHOD VBU0428Test_CM_boolean "Q = V" RAT_FUNC "%1.0" "" COEFFS 0 1 0 0 0 1 /end COMPU_METHOD
/begin COMPU_METHOD VBU0428Test_CM_int8_cnt "Q = V" RAT_FUNC "%3.0" "cnt" COEFFS 0 1 0 0 0 1 /end COMPU_METHOD
/begin COMPU_METHOD VBU0428Test_CM_uint8_cnt "Q = V" RAT_FUNC "%3.0" "cnt" COEFFS 0 1 0 0 0 1 /end COMPU_METHOD
/begin GROUP S3020_VCU_502 "VBU0428Test/VBUSystem/VCU /APO2HAL/PTCAN1Transmit/VCU_502"
 /begin REF_CHARACTERISTIC APO_TotalChargeEnergyOvrdVal_C APO_TotalChargeEnergyOvrd_C APO_TotalDischargeEnergyOvrdVal_C APO_TotalDischargeEnergyOvrd_C /end REF_CHARACTERISTIC
/end GROUP
/begin GROUP S3020_VCU_AC_238 "VBU0428Test/VBUSystem/VCU /APO2HAL/PTCAN1Transmit/VCU_AC_238"
 /begin REF_CHARACTERISTIC APO_ACOvrdVal_C APO_ACOvrd_C APO_ACPowerOvrdVal_C APO_ACPowerOvrd_C APO_ACSpeedOvrdVal_C APO_ACSpeedOvrd_C /end REF_CHARACTERISTIC
/end GROUP
/begin GROUP S3020_VCU_DCDC_250 "VBU0428Test/VBUSystem/VCU /APO2HAL/PTCAN1Transmit/VCU_DCDC_250"
 /begin REF_CHARACTERISTIC LVC_flgDCDCReqOvrd_C LVC_flgDcdcCtrlReqOvrdVal_C LVC_flgDcdcCtrlReqOvrd_C LVC_uDCDCReqOvrdVal_C /end REF_CHARACTERISTIC
/end GROUP
/begin GROUP S3020_VCU_EPB_155 "VBU0428Test/VBUSystem/VCU /APO2HAL/PTCAN1Transmit/VCU_EPB_155"
 /begin REF_CHARACTERISTIC APO_BrkingWhileDrivingOvrdVal_C APO_BrkingWhileDrivingOvrd_C APO_EPBCtrlModeOvrdVal_C APO_EPBCtrlModeOvrd_C Gear_flgEPBReqOvrd_C Gear_stEPBReqOvrdVal_C SPD_vVehSpdOvrdVal_C SPD_vVehSpdOvrd_C /end REF_CHARACTERISTIC
/end GROUP
/begin GROUP S3020_VCU_IC_210 "VBU0428Test/VBUSystem/VCU /APO2HAL/PTCAN1Transmit/VCU_IC_210"
 /begin REF_CHARACTERISTIC APO_BrakWarningOvrdVal_C APO_BrakWarningOvrd_C APO_CruiseStatusOvrdVal_C APO_CruiseStatusOvrd_C APO_EPBFaultOvrdVal_C APO_EPFaultLevelWarningOvrdVal_C APO_EPFaultLevelWarningOvrd_C APO_EPSFaultOvrdVal_C APO_LimpHomeOvrdVal_C APO_LimpHomeOvrd_C APO_OverSpeedOvrdVal_C APO_OverSpeedOvrd_C APO_PlsUSE750VDCOvrdVal_C APO_PlsUSE750VDCOvrd_C APO_PowerModeOvrdVal_C APO_PowerModeOvrd_C APO_VCURemainingRngOvrdVal_C APO_VCURemainingRngOvrd_C APO_VehicleModeOvrdVal_C APO_VehicleModeOvrd_C APO_flgBMSChargeStateOvrd_C APO_flgBattPackTempWarningOvrd_C APO_flgEPBFaultOvrd_C APO_flgEPSFaultOvrd_C APO_flgHVBattWarningOvrd_C APO_flgHVOnOvrd_C APO_flgIsolutionWarningOvrd_C APO_stBMSChargeStateOvrdVal_C APO_stBattPackTempWarningOvrdVal_C APO_stHVBattWarningOvrdVal_C APO_stHVOnOvrdVal_C APO_stIsolutionWarningOvrdVal_C CGW_flgVehDrvModeOvrd_C CGW_stVehDrvModeOvrdVal_C CGW_stVehRgnModeOvrdVal_C CGW_stVehRgnModeOvrd_C DCH_flgDSPLChStsOvrd_C DCH_stDSPLChStsOvrdVal_C EDIS_flgCurrPwrOvrd_C EDIS_pwrCurrPwrOvrdVal_C EPFaultLevelWarning Gear_stCurrentGearDisplayOvrdVal_C Gear_stCurrentGearDisplayOvrd_C HALIn_MotOverTempOvrdVal_C HALIn_flgMotOverTempOvrd_C HVBattCutOffOvrdVal_C HVBattCutOffOvrd_C LowBatteryWarningOvrdVal_C LowBatteryWarningOvrd_C MotorFaultLevelOvrdVal_C MotorFaultLevelOvrd_C PMM_flgVehRdyOvrdVal_C PMM_flgVehRdyOvrd_C VCUImdStopDrivingOvrdVal_C VCUImdStopDrivingOvrd_C VCURmvAcChgerOvrdVal_C VCURmvAcChgerOvrd_C VM_flgVehLimActvOvrdVal_C VM_flgVehLimActvOvrd_C VehPwrLimdLampReqOvrdVal_C VehPwrLimdLampReqOvrd_C Veh_flgHVILOvrdVal_C Veh_flgHVILOvrd_C /end REF_CHARACTERISTIC
/end GROUP
/begin GROUP S3020_VCU_MCU_105 "VBU0428Test/VBUSystem/VCU /APO2HAL/PTCAN1Transmit/VCU_MCU_105"
 /begin REF_CHARACTERISTIC OUTP_flgDCRelayStatusORF OUTP_flgDCRelayStatusORFV PMM_flgRMCUActvDisChReqOvrdVal_C PMM_flgRMCUActvDisChReqOvrd_C TQO_flgCtrlRMotrOvrd_C TQO_stCtrlRMotrOvrdVal_C TQO_trqRMotrOvrdVal_C TQO_trqRMotrOvrd_C /end REF_CHARACTERISTIC
/end GROUP
/begin GROUP S3021_BCL "VBU0428Test/VBUSystem/VCU /APO2HAL/Subsystem1/BCL"
 /begin REF_CHARACTERISTIC CHARGING_MODEOvrdVal_C CHARGING_MODEOvrd_C CURRENT_REQUIREMENTOvrdVal_C CURRENT_REQUIREMENTOvrd_C VOLTAGE_REQUIREMENTOvrdVal_C VOLTAGE_REQUIREMENTOvrd_C /end REF_CHARACTERISTIC
/end GROUP
/begin GROUP S3021_BCP "VBU0428Test/VBUSystem/VCU /APO2HAL/Subsystem1/BCP"
 /begin REF_CHARACTERISTIC DCH_cBCPNrmCapOvrdVal_C DCH_cBCPNrmCapOvrd_C DCH_iBCPMaxChCurrOvrdVal_C DCH_iBCPMaxChCurrOvrd_C DCH_pctBCPSocOvrdVal_C DCH_pctBCPSocOvrd_C DCH_tBCPMaxPermitTempOvrdVal_C DCH_tBCPMaxPermitTempOvrd_C DCH_uBCPBattVltgOvrdVal_C DCH_uBCPBattVltgOvrd_C DCH_uBCPMaxCellVltgForChOvrdVal_C DCH_uBCPMaxCellVltgForChOvrd_C DCH_uBCPMaxVltgForChOvrdVal_C DCH_uBCPMaxVltgForChOvrd_C /end REF_CHARACTERISTIC
/end GROUP
/begin GROUP S3021_BCS "VBU0428Test/VBUSystem/VCU /APO2HAL/Subsystem1/BCS"
 /begin REF_CHARACTERISTIC DCH_iBCSChCurrMeasureOvrdVal_C DCH_iBCSChCurrMeasureOvrd_C DCH_numBCSMaxCellVltgNumOvrdVal_C DCH_numBCSMaxCellVltgNumOvrd_C DCH_pctBCSCurrSocOvrdVal_C DCH_pctBCSCurrSocOvrd_C DCH_tiBCSChNeedTOvrdVal_C DCH_tiBCSChNeedTOvrd_C DCH_uBCSChVltgMeasureOvrdVal_C DCH_uBCSChVltgMeasureOvrd_C DCH_uBCSMaxCellVltgOvrdVal_C DCH_uBCSMaxCellVltgOvrd_C /end REF_CHARACTERISTIC
/end GROUP
/begin GROUP S3021_BEM "VBU0428Test/VBUSystem/VCU /APO2HAL/Subsystem1/BEM"
 /begin REF_CHARACTERISTIC CHARGER_MESSAGE_OT_00OvrdVal_C CHARGER_MESSAGE_OT_00Ovrd_C CHARGER_MESSAGE_OT_AAOvrdVal_C CHARGER_MESSAGE_OT_AAOvrd_C CHARGER_MESSAGE_OT_READYOvrdVal_C CHARGER_MESSAGE_OT_READYOvrd_C CHARGER_MESSAGE_OT_STATEOvrdVal_C CHARGER_MESSAGE_OT_STATEOvrd_C CHARGER_MESSAGE_OT_STATISTICSOvrdVal_C CHARGER_MESSAGE_OT_STATISTICSOvrd_C CHARGER_MESSAGE_OT_STOPOvrdVal_C CHARGER_MESSAGE_OT_STOPOvrd_C CHARGER_MESSAGE_OT_SYNCHRONOUSOvrdVal_C CHARGER_MESSAGE_OT_SYNCHRONOUSOvrd_C /end REF_CHARACTERISTIC
/end GROUP
/begin GROUP S3021_BHM "VBU0428Test/VBUSystem/VCU /APO2HAL/Subsystem1/BHM" /begin REF_CHARACTERISTIC PermitVoltageOvrdVal_C PermitVoltageOvrd_C /end REF_CHARACTERISTIC /end GROUP
/begin GROUP S3021_BRM "VBU0428Test/VBUSystem/VCU /APO2HAL/Subsystem1/BRM"
 /begin REF_CHARACTERISTIC BATTERY_DATE_DAYOvrdVal_C BATTERY_DATE_DAYOvrd_C BATTERY_DATE_MONTHOvrdVal_C BATTERY_DATE_MONTHOvrd_C BATTERY_DATE_YEAROvrdVal_C BATTERY_DATE_YEAROvrd_C BATTERY_GROUP_NUMBEROvrdVal_C BATTERY_GROUP_NUMBEROvrd_C BATTERY_PROPERTY_IDENTIFYOvrdVal_C BATTERY_PROPERTY_IDENTIFYOvrd_C BATTERY_SUPPLIEROvrdVal_C BATTERY_SUPPLIEROvrd_C BMS_SOFTWARE_VERSION1OvrdVal_C BMS_SOFTWARE_VERSION1Ovrd_C BMS_SOFTWARE_VERSION2OvrdVal_C BMS_SOFTWARE_VERSION2Ovrd_C BRM_RESERVEDOvrdVal_C BRM_RESERVEDOvrd_C CHARGING_TIMEOvrdVal_C CHARGING_TIMEOvrd_C DCH_cBRMBattRatedCapOvrdVal_C DCH_cBRMBattRatedCapOvrd_C DCH_numBRMBattTypOvrdVal_C DCH_numBRMBattTypOvrd_C DCH_numBRMProtcVerOvrdVal_C DCH_numBRMProtcVerOvrd_C DCH_uBRMBattRatedVltgOvrdVal_C DCH_uBRMBattRatedVltgOvrd_C VIN1VIN2VIN3OvrdVal_C VIN1VIN2VIN3Ovrd_C /end REF_CHARACTERISTIC
/end GROUP
/begin GROUP S3021_BRO "VBU0428Test/VBUSystem/VCU /APO2HAL/Subsystem1/BRO"
 /begin REF_CHARACTERISTIC READY_CHARGING_GATEWAYOvrdVal_C READY_CHARGING_GATEWAYOvrd_C /end REF_CHARACTERISTIC
/end GROUP
/begin GROUP S3021_BSD "VBU0428Test/VBUSystem/VCU /APO2HAL/Subsystem1/BSD"
 /begin REF_CHARACTERISTIC MAXIMUM_CELL_TEMP_BSDOvrdVal_C MAXIMUM_CELL_TEMP_BSDOvrd_C MAXIMUM_CELL_VOLTAGE_BSDOvrdVal_C MAXIMUM_CELL_VOLTAGE_BSDOvrd_C MINIMUM_CELL_TEMP_BSDOvrdVal_C MINIMUM_CELL_TEMP_BSDOvrd_C MINIMUM_CELL_VOLTAGE_BSDOvrdVal_C MINIMUM_CELL_VOLTAGE_BSDOvrd_C SOC_STOPOvrdVal_C SOC_STOPOvrd_C /end REF_CHARACTERISTIC
/end GROUP
/begin GROUP S3021_BSM "VBU0428Test/VBUSystem/VCU /APO2HAL/Subsystem1/BSM"
 /begin REF_CHARACTERISTIC BATTERY_ISOLATION_STATEOvrdVal_C BATTERY_ISOLATION_STATEOvrd_C BATTERY_OUTPUT_CONNECTOR_STATEOvrdVal_C BATTERY_OUTPUT_CONNECTOR_STATEOvrd_C CELL_VOLTAGE_OVER_UNDEROvrdVal_C CELL_VOLTAGE_OVER_UNDEROvrd_C CHARGING_PERMITOvrdVal_C CHARGING_PERMITOvrd_C CURRENT_OVER_UNDEROvrdVal_C CURRENT_OVER_UNDEROvrd_C MAXIMUM_CELL_TEMPOvrdVal_C MAXIMUM_CELL_TEMPOvrd_C MAXIMUM_CELL_VOLTAGE_NUMBER_BSMOvrdVal_C MAXIMUM_CELL_VOLTAGE_NUMBER_BSMOvrd_C MAXIMUM_TEMP_NUMBEROvrdVal_C MAXIMUM_TEMP_NUMBEROvrd_C MINIMUM_CELL_TEMPOvrdVal_C MINIMUM_CELL_TEMPOvrd_C MINIMUM_TEMP_NUMBEROvrdVal_C MINIMUM_TEMP_NUMBEROvrd_C SOC_OVER_UNDEROvrdVal_C SOC_OVER_UNDEROvrd_C TEMP_OVEROvrdVal_C TEMP_OVEROvrd_C /end REF_CHARACTERISTIC
/end GROUP
/begin GROUP S3021_BST_ "VBU0428Test/VBUSystem/VCU /APO2HAL/Subsystem1/BST "
 /begin REF_CHARACTERISTIC GATEWAY_STOP_ERROR_REASON_OCOvrdVal_C GATEWAY_STOP_ERROR_REASON_OCOvrd_C GATEWAY_STOP_ERROR_REASON_VOLTOvrdVal_C GATEWAY_STOP_ERROR_REASON_VOLTOvrd_C GATEWAY_STOP_FAULT_REASON_1OvrdVal_C GATEWAY_STOP_FAULT_REASON_1Ovrd_C GATEWAY_STOP_FAULT_REASON_2OvrdVal_C GATEWAY_STOP_FAULT_REASON_2Ovrd_C GATEWAY_STOP_FAULT_REASON_3OvrdVal_C GATEWAY_STOP_FAULT_REASON_3Ovrd_C GATEWAY_STOP_FAULT_REASON_BMSOTOvrdVal_C GATEWAY_STOP_FAULT_REASON_BMSOTOvrd_C GATEWAY_STOP_FAULT_REASON_CELLOTOvrdVal_C GATEWAY_STOP_FAULT_REASON_CELLOTOvrd_C GATEWAY_STOP_FAULT_REASON_CONNOTOvrdVal_C GATEWAY_STOP_FAULT_REASON_CONNOTOvrd_C GATEWAY_STOP_FAULT_REASON_CONNOvrdVal_C GATEWAY_STOP_FAULT_REASON_CONNOvrd_C GATEWAY_STOP_FAULT_REASON_ISOOvrdVal_C GATEWAY_STOP_FAULT_REASON_ISOOvrd_C GATEWAY_STOP_REASON_CELLVOLTOvrdVal_C GATEWAY_STOP_REASON_CELLVOLTOvrd_C GATEWAY_STOP_REASON_SOCOvrdVal_C GATEWAY_STOP_REASON_SOCOvrd_C GATEWAY_STOP_REASON_STATIONOvrdVal_C GATEWAY_STOP_REASON_STATIONOvrd_C GATEWAY_STOP_REASON_TOTALVOLTOvrdVal_C GATEWAY_STOP_REASON_TOTALVOLTOvrd_C /end REF_CHARACTERISTIC
/end GROUP
/begin GROUP S3021_J1939TxEna "VBU0428Test/VBUSystem/VCU /APO2HAL/Subsystem1/J1939TxEna" /begin REF_CHARACTERISTIC APO_BRMTxEnaOvrdVal_C APO_BRMTxEnaSOvrd_C /end REF_CHARACTERISTIC /end GROUP
/begin GROUP S3022_Subsystem "VBU0428Test/VBUSystem/VCU /APO2HAL/Subsystem2/Subsystem"
 /begin SUB_GROUP S3191_PropertyConfirm S3191_PropertyConfirm1 S3191_PropertyConfirm10 S3191_PropertyConfirm11 S3191_PropertyConfirm12 S3191_PropertyConfirm13 S3191_PropertyConfirm14 S3191_PropertyConfirm15 S3191_PropertyConfirm4 S3191_PropertyConfirm5 S3191_PropertyConfirm6 S3191_PropertyConfirm8 S3191_PropertyConfirm9 /end SUB_GROUP
 /begin REF_CHARACTERISTIC APO_fACPumpOvrdVal_C APO_fACPumpOvrd_C APO_fFanOvrdVal_C APO_fFanOvrd_C APO_fHVIL1OvrdVal_C APO_fHVIL1Ovrd_C APO_fVacuumPumpOvrdVal_C APO_fVacuumPumpOvrd_C APO_fWaterPump1OvrdVal_C APO_fWaterPump1Ovrd_C APO_fWaterPump2OvrdVal_C APO_fWaterPump2Ovrd_C APO_flgDCChgRlyOvrdVal_C APO_flgDCChgRlyOvrd_C APO_flgFanORF APO_flgHWSleepEnableORF APO_flgMainRlyOvrdVal_C APO_flgMainRlyOvrd_C APO_flgSleepEnableORV APO_flgWakeUp1OvrdVal_C APO_flgWakeUp1Ovrd_C APO_flgWakeUp2OvrdVal_C APO_flgWakeUp2Ovrd_C APO_pctACPumpOvrdVal_C APO_pctACPumpOvrd_C APO_pctFanOvrdVal_C APO_pctHVIL1OvrdVal_C APO_pctHVIL1Ovrd_C APO_pctWaterPump1OvrdVal_C APO_pctWaterPump1Ovrd_C APO_pctWaterPump2OvrdVal_C APO_pctWaterPump2Ovrd_C /end REF_CHARACTERISTIC
 /begin REF_MEASUREMENT OD_LsDCChgRly OP_flgLSDVacuumPump /end REF_MEASUREMENT
/end GROUP
/begin GROUP S3208_DCH_DCChargeCtrlOverall "VBU0428Test/VBUSystem/VCU /DCH/DCH_Overall/DCH_DCChargeCtrlOverall"
 /begin SUB_GROUP S3210_DCH_BMSChgrReq S3210_DCH_DCChargeCtrlStateflow S3210_DCH_Diagnose S3210_DCH_EepromStore S3210_DSPLLight /end SUB_GROUP
/end GROUP
/begin GROUP S3208_DCH_J1939InputProcess "VBU0428Test/VBUSystem/VCU /DCH/DCH_Overall/DCH_J1939InputProcess" /begin SUB_GROUP S3211_DCH_J1939ReceiveProcess /end SUB_GROUP /end GROUP
/begin GROUP S3208_DCH_J1939OutputSignalProcess "VBU0428Test/VBUSystem/VCU /DCH/DCH_Overall/DCH_J1939OutputSignalProcess"
 /begin SUB_GROUP S3212_DCH_J1939OutputProcessBCL S3212_DCH_J1939OutputProcessBCP S3212_DCH_J1939OutputProcessBCS S3212_DCH_J1939OutputProcessBEM S3212_DCH_J1939OutputProcessBRM S3212_DCH_J1939OutputProcessBRO S3212_DCH_J1939OutputProcessBSD S3212_DCH_J1939OutputProcessBSM S3212_DCH_J1939OutputProcessBST /end SUB_GROUP
/end GROUP
/begin GROUP S3333_DriveRange "VBU0428Test/VBUSystem/VCU /DSPL /DSPL/DriveRange" /begin SUB_GROUP S3334_DSPL_Consumption S3334_RemainingRange /end SUB_GROUP /end GROUP
/begin GROUP S3333_Other "VBU0428Test/VBUSystem/VCU /DSPL /DSPL/Other"
 /begin REF_CHARACTERISTIC DSPL_facMtrDrvLT_C DSPL_nMotSpdOvrSpdLower_C DSPL_nMotSpdOvrSpdUpper_C DSPL_pctSocLowWarnLower_C DSPL_pctSocLowWarnUpper_C DSPL_stCurrentGearD_C DSPL_stCurrentGearN_C DSPL_stCurrentGearP_C DSPL_stCurrentGearR_C DSPL_stDCDCStsFail_SY DSPL_stHVCntctStClosed_SY DSPL_stLvBattChrgFail_C DSPL_stLvBattChrging_C DSPL_stLvBattNoChrg_C DSPL_stPEURMotTempAlarm_SY DSPL_tiDCDCStsFail_C DSPL_tiDisableDCDC_C DSPL_tiMotOvrSpd_C DSPL_tiMtrDrvLT_C DSPL_tiSample_SY DSPL_trqMtrDrvLTHi_C DSPL_trqMtrDrvLTLo_C /end REF_CHARACTERISTIC
/end GROUP
/begin GROUP S3333_RegenLight "VBU0428Test/VBUSystem/VCU /DSPL /DSPL/RegenLight"
 /begin REF_CHARACTERISTIC DSPL_facRegenReq_C DSPL_flgRegenLimLampFunctionEn_C DSPL_pctAccPedLe_C DSPL_pctAccPedRe_C DSPL_stCurrentGearD_C DSPL_tiRegenLimDecline_C DSPL_tiRegenLimRise_C DSPL_tiSample_SY DSPL_trqMotReqLe_C DSPL_trqMotReqRe_C DSPL_trqRegenReqLe_C DSPL_trqRegenReqRe_C DSPL_vVehSpdRegenLe_C DSPL_vVehSpdRegenRe_C SYS_facGearRatioF_SY /end REF_CHARACTERISTIC
/end GROUP
/begin GROUP S3476_BatDis_Power_Lim_Calc "VBU0428Test/VBUSystem/VCU /EDIS/EDIS_Ctrl/BatDis_Power_Lim_Calc"
 /begin SUB_GROUP S3477_Drive_Mode_Power_Calculate S3477_Power_Arbitration S3477_Regen_Mode_Power_Calculate /end SUB_GROUP
/end GROUP
/begin GROUP S3476_battery_power_calculate "VBU0428Test/VBUSystem/VCU /EDIS/EDIS_Ctrl/battery_power_calculate"
 /begin SUB_GROUP S3478_charge_power_calculate S3478_discharge_power_calculate /end SUB_GROUP
/end GROUP
/begin GROUP S3476_drive_power_calculate "VBU0428Test/VBUSystem/VCU /EDIS/EDIS_Ctrl/drive_power_calculate" /begin SUB_GROUP S3479_accessory_load_power /end SUB_GROUP /end GROUP
/begin GROUP S3559_LVC_DIAG "VBU0428Test/VBUSystem/VCU /LVC/LVC/LVC_DIAG"
 /begin SUB_GROUP S3560_DSM_DisableFault S3560_DSM_EnableFault S3560_DSM_OutputCurrent S3560_DSM_OutputOverVol S3560_DSM_OutputUnderVol /end SUB_GROUP
/end GROUP
/begin GROUP S3559_LowVoltageBalanceControl "VBU0428Test/VBUSystem/VCU /LVC/LVC/LowVoltageBalanceControl" /begin SUB_GROUP S3561_LVC_DcdcSpCtl S3561_LVC_DcdcStCtl /end SUB_GROUP /end GROUP
/begin GROUP S3604_DrvMod_Ctrl "VBU0428Test/VBUSystem/VCU /PMM/PMM_Ctrl/DrvMod_Ctrl" /begin SUB_GROUP S3605_DVM_PEUShtDwn S3605_DVM_SetRdy S3605_DVM_VehRdy /end SUB_GROUP /end GROUP
/begin GROUP S3604_LvWakeUp_Ctrl "VBU0428Test/VBUSystem/VCU /PMM/PMM_Ctrl/LvWakeUp_Ctrl" /begin SUB_GROUP S3606_LvWakeUp_Mode_Calc S3606_LvWakeUp_State_Calc /end SUB_GROUP /end GROUP
/begin GROUP S3604_PMM_DIAG "VBU0428Test/VBUSystem/VCU /PMM/PMM_Ctrl/PMM_DIAG"
 /begin SUB_GROUP S3607_ActiveDisChFault S3607_PreChargeCheck S3607_UnintendAction /end SUB_GROUP
/end GROUP
/begin GROUP S3604_PwrMod_Ctrl "VBU0428Test/VBUSystem/VCU /PMM/PMM_Ctrl/PwrMod_Ctrl"
 /begin SUB_GROUP S3608_AcTvDisCh S3608_HVRlyCtrl S3608_PwrMod_PowerUp S3608_Routine S3608_RoutineOvrd S3608_SelfRoutine /end SUB_GROUP
 /begin REF_CHARACTERISTIC PMM_stACTest_SY PMM_stActvDisCh_SY PMM_stDCDCDisbl_SY PMM_stHVCntctStClosed_SY PMM_stHVCntctStInit_SY PMM_stHVCntctStPreCh_SY PMM_stHVRlyClose_SY PMM_stHVRlyConnReq_SY PMM_stHVRlyConn_SY PMM_stHVRlyNoReq_SY PMM_stHVRlyOpenReq_SY PMM_stHVRlyOpen_SY PMM_stInitMode_SY PMM_stInitRst_SY PMM_stMCUACOff_SY PMM_stRstKeep_SY PMM_stShutDown_SY PMM_tiACTst_C PMM_tiActvDisCh_C PMM_tiDCDCDisbl_C PMM_tiDlyInitRst_C PMM_tiHVRlyOpenReq_C PMM_tiHVRlyT_C PMM_tiRstKeep_C PMM_tiSmplT_SY /end REF_CHARACTERISTIC
 /begin REF_MEASUREMENT PMM_flgACTstTimeOut PMM_flgAccDisable PMM_flgActvDisChTimeOut PMM_flgDCDCEna PMM_flgHVRLyCloseTimeOut PMM_flgHVRlyOpenTimeOut PMM_flgOffLoadTimeOut PMM_flgPEUACTstReq PMM_stHVRlyReqTmp PMM_stPwrModeSt PMM_tiStDurT /end REF_MEASUREMENT
/end GROUP
/begin GROUP S3717_SignalProcessing_10ms "VBU0428Test/VBUSystem/VCU /SPD/SPD/SignalProcessing_10ms"
 /begin SUB_GROUP S3719_AxleSpeedDiff S3719_Bench S3719_SlopeCal1 S3719_Subsystem1 S3719_VehDir S3719_VehSpdNorm /end SUB_GROUP
/end GROUP
/begin GROUP S3753_EfanControl4PDU "VBU0428Test/VBUSystem/VCU /THM/THM/EfanControl4PDU" /begin REF_CHARACTERISTIC THM_pctFANMax_C THM_pctFANOff_C /end REF_CHARACTERISTIC /begin REF_MEASUREMENT THM_flgFanEnable THM_rpmCoolingFanSpdReq /end REF_MEASUREMENT /end GROUP
/begin GROUP S3753_PumpControl "VBU0428Test/VBUSystem/VCU /THM/THM/PumpControl" /begin REF_CHARACTERISTIC THM_pctMaxEDSFlow THM_pctMaxESSFlow /end REF_CHARACTERISTIC /end GROUP
/begin GROUP S3777_TQC_VehSpdLimit "VBU0428Test/VBUSystem/VCU /TQC/TQC/TQC_VehSpdLimit"
 /begin SUB_GROUP S3778_Subsystem S3778_VLIMCal S3778_VMax S3778_VMaxExt S3778_VMaxServer /end SUB_GROUP
/end GROUP
/begin GROUP S3777_VehInfo1 "VBU0428Test/VBUSystem/VCU /TQC/TQC/VehInfo1" /begin SUB_GROUP S3779_TQC_VehInfoAnalysis S3779_Veh_Drag S3779_Veh_a2Trq /end SUB_GROUP /end GROUP
/begin GROUP S3823_BrkRgn_Cal "VBU0428Test/VBUSystem/VCU /TQD/TrqDem/BrkRgn_Cal" /begin REF_CHARACTERISTIC TQD_trqDrvBrkRgn_MAP_V TQD_trqRvsBrkRgn_MAP_V /end REF_CHARACTERISTIC /begin REF_MEASUREMENT TQD_trqNrmBrkDes /end REF_MEASUREMENT /end GROUP
/begin GROUP S3823_TrqDem_Arb "VBU0428Test/VBUSystem/VCU /TQD/TrqDem/TrqDem_Arb" /begin REF_CHARACTERISTIC TQD_flgBrkRgnConfig_C /end REF_CHARACTERISTIC /begin REF_MEASUREMENT TQD_trqBrkRgn TQD_trqDes /end REF_MEASUREMENT /end GROUP
/begin GROUP S3823_TrqDem_DrvTrq_Cal "VBU0428Test/VBUSystem/VCU /TQD/TrqDem/TrqDem_DrvTrq_Cal"
 /begin SUB_GROUP S3826_TrqDem_DrvTrq_Cal S3826_TrqDem_MinTrq_Cal S3826_TrqDem_TrqDes_Cal /end SUB_GROUP
/end GROUP
/begin GROUP S3823_TrqDem_InputTransfer "VBU0428Test/VBUSystem/VCU /TQD/TrqDem/TrqDem_InputTransfer"
 /begin SUB_GROUP S3827_BrakePressureFilter S3827_TrqDem_AccPdl_Filter S3827_TrqDem_GearDet S3827_TrqDem_VehSpeed_Filter /end SUB_GROUP
/end GROUP
/begin GROUP S3851_STC "VBU0428Test/VBUSystem/VCU /TQO/TQOAll/STC" /begin SUB_GROUP S3853_STC /end SUB_GROUP /end GROUP
/begin GROUP S3851_Schedule "VBU0428Test/VBUSystem/VCU /TQO/TQOAll/Schedule" /begin REF_MEASUREMENT Count /end REF_MEASUREMENT /end GROUP
/begin GROUP S3851_Subsystem "VBU0428Test/VBUSystem/VCU /TQO/TQOAll/Subsystem" /begin SUB_GROUP S3855_TQDMP /end SUB_GROUP /end GROUP
/begin GROUP S3851_TQARB "VBU0428Test/VBUSystem/VCU /TQO/TQOAll/TQARB" /begin SUB_GROUP S3856_TQARB /end SUB_GROUP /end GROUP
/begin GROUP S3851_TQCMP "VBU0428Test/VBUSystem/VCU /TQO/TQOAll/TQCMP" /begin SUB_GROUP S3857_TQCMP /end SUB_GROUP /end GROUP
/begin GROUP S3851_TQDIS "VBU0428Test/VBUSystem/VCU /TQO/TQOAll/TQDIS" /begin SUB_GROUP S3858_TQDIS /end SUB_GROUP /end GROUP
/begin GROUP S3851_TQO "VBU0428Test/VBUSystem/VCU /TQO/TQOAll/TQO" /begin SUB_GROUP S3859_TQO /end SUB_GROUP /end GROUP
/begin GROUP S4014_MTrqLim "VBU0428Test/VBUSystem/VCU /VTQA/Subsystem/MTrqLim"
 /begin SUB_GROUP S4015_TorqueRamp S4015_TrqCapacityArb S4015_TrqCapacityCal S4015_TrqCapacityLim S4015_TrqCapacityOffline /end SUB_GROUP
/end GROUP
/begin GROUP S4014_VehTrqArb "VBU0428Test/VBUSystem/VCU /VTQA/Subsystem/VehTrqArb" /begin SUB_GROUP S4016_BattLim_Transfer S4016_Trq_Arb /end SUB_GROUP /end GROUP
/begin GROUP S4048_APD "VBU0428Test/VBUSystem/VCU /VehINP/VehINP_Logic/APD" /begin SUB_GROUP S4049_APD /end SUB_GROUP /end GROUP
/begin GROUP S4048_DCPortTemp "VBU0428Test/VBUSystem/VCU /VehINP/VehINP_Logic/DCPortTemp" /begin SUB_GROUP S4050_Charge_Port_Temp /end SUB_GROUP /end GROUP
/begin GROUP S4048_FPV "VBU0428Test/VBUSystem/VCU /VehINP/VehINP_Logic/FPV" /begin SUB_GROUP S4051_IF_Then_Else1 /end SUB_GROUP
 /begin REF_CHARACTERISTIC FPV_st4WayVlvPosFdbkPosition1_SY FPV_st4WayVlvPosFdbkPosition2_SY FPV_st4WayVlvPosFdbkUnknow_SY INP_numEXVPosition1Lower_C INP_numEXVPosition1Upper_C INP_numEXVPosition2Upper_C /end REF_CHARACTERISTIC
/end GROUP
/begin GROUP S4048_GearShift "VBU0428Test/VBUSystem/VCU /VehINP/VehINP_Logic/GearShift" /begin SUB_GROUP S4052_Gear1 /end SUB_GROUP /end GROUP
/begin GROUP S4048_Mode "VBU0428Test/VBUSystem/VCU /VehINP/VehINP_Logic/Mode" /begin SUB_GROUP S4053_VehMode /end SUB_GROUP /end GROUP
/begin GROUP S4048_PEU_InverterStatus "VBU0428Test/VBUSystem/VCU /VehINP/VehINP_Logic/PEU_InverterStatus"
 /begin REF_CHARACTERISTIC Veh_stIMInverterON_C Veh_stInverterOFF_C Veh_stInverterON_C /end REF_CHARACTERISTIC
/end GROUP
/begin GROUP S4048_SWReset "VBU0428Test/VBUSystem/VCU /VehINP/VehINP_Logic/SWReset"
 /begin REF_CHARACTERISTIC Gear_stCurrentGearN_C Gear_stCurrentGearP_C Veh_tiHWResetConfirmTime_C Veh_tiHWResetDelayTime_C Veh_tiSampleTime_C Veh_vVehSpdHWReset_C /end REF_CHARACTERISTIC
/end GROUP
/begin GROUP S4048_TireType "VBU0428Test/VBUSystem/VCU /VehINP/VehINP_Logic/TireType" /begin REF_CHARACTERISTIC Veh_stVehTire19_C /end REF_CHARACTERISTIC /end GROUP
/begin GROUP S4048_VacuumPump_Control "VBU0428Test/VBUSystem/VCU /VehINP/VehINP_Logic/VacuumPump Control" /begin SUB_GROUP S4057_Hysteresis_LLC_RHC /end SUB_GROUP /begin REF_CHARACTERISTIC Veh_pVacPumpRun_C Veh_pVacPumpStop_C Veh_pVacPumpWarning_C /end REF_CHARACTERISTIC /begin REF_MEASUREMENT Veh_flgVacPressWarning /end REF_MEASUREMENT /end GROUP
/begin GROUP S4048_VehINP_BPD "VBU0428Test/VBUSystem/VCU /VehINP/VehINP_Logic/VehINP_BPD"
 /begin SUB_GROUP S4058_BPD_BrakePercent S4058_BPD_BrakeSwitch S4058_BPD_BrkSwtPosPlausibilityCheck S4058_VehINP_BrkPedOverride /end SUB_GROUP
/end GROUP
/begin GROUP S4048_Veh_Status "VBU0428Test/VBUSystem/VCU /VehINP/VehINP_Logic/Veh_Status" /begin SUB_GROUP S4059_VehHVIL /end SUB_GROUP /end GROUP
/begin GROUP S35_Calculate_BatteryCurrent "VBU0428Test/VBUSystem/BMS/BCV/BCV/Subsystem/Calculate_BatteryCurrent"
 /begin SUB_GROUP S36_Check_BatteryCurrent_Valid S36_Correct_BatteryCurrent S36_UpdateBatteryCurrent /end SUB_GROUP
/end GROUP
/begin GROUP S35_Calculate_BatteryVoltage "VBU0428Test/VBUSystem/BMS/BCV/BCV/Subsystem/Calculate_BatteryVoltage"
 /begin SUB_GROUP S37_Check_BatteryVoltage_Valid S37_Check_BusNegativeVoltage_Valid S37_Check_BusVoltage_Valid S37_Check_FuseVoltage_Valid S37_Check_PrechargeVoltage_Valid S37_Check_Vx1Voltage_Valid S37_Check_Vx2Voltage_Valid S37_Update_BatteryVoltage S37_Update_BusNegativeVoltage S37_Update_BusVoltage S37_Update_FuseVoltage S37_Update_PrechargeVoltage S37_Update_Vx2Voltage /end SUB_GROUP
/end GROUP
/begin GROUP S35_Calculate_Lifetime_Data "VBU0428Test/VBUSystem/BMS/BCV/BCV/Subsystem/Calculate_Lifetime_Data"
 /begin SUB_GROUP S38_Calculate_FuseProtect_Counter S38_Calculate_LifeTimeCharge S38_Calculate_LifeTimeCoulomb S38_Calculate_LifeTimeDischarge S38_Calculate_LifeTimeFastcharge /end SUB_GROUP
/end GROUP
/begin GROUP S35_Diagnose_BCV_Communication_Fault "VBU0428Test/VBUSystem/BMS/BCV/BCV/Subsystem/Diagnose_BCV_Communication_Fault" /begin SUB_GROUP S39_DIagnose_OutOfRange_Fault /end SUB_GROUP /end GROUP
/begin GROUP S35_Diagnose_BCV_Data_Fault "VBU0428Test/VBUSystem/BMS/BCV/BCV/Subsystem/Diagnose_BCV_Data_Fault"
 /begin SUB_GROUP S40_Diagnose_BatteryBusVoltageMismatch_Fault S40_Diagnose_VoltageCurrent_Fault /end SUB_GROUP
/end GROUP
/begin GROUP S35_Interface_Switch "VBU0428Test/VBUSystem/BMS/BCV/BCV/Subsystem/Interface_Switch"
 /begin REF_CHARACTERISTIC CbBCV_HALBatteryVoltageORF_flg CcBCV_HALBatteryVoltageORV_V /end REF_CHARACTERISTIC
/end GROUP
/begin GROUP S35_Interface_Switch1 "VBU0428Test/VBUSystem/BMS/BCV/BCV/Subsystem/Interface_Switch1"
 /begin REF_CHARACTERISTIC CbBCV_HALBatteryVoltageStatusORF_flg CbBCV_HALBatteryVoltageStatusORV_flg /end REF_CHARACTERISTIC
/end GROUP
/begin GROUP S35_Interface_Switch2 "VBU0428Test/VBUSystem/BMS/BCV/BCV/Subsystem/Interface_Switch2" /begin REF_CHARACTERISTIC CbBCV_HALVx2VoltageORF_flg CcBCV_HALVx2VoltageORV_V /end REF_CHARACTERISTIC /end GROUP
/begin GROUP S35_Interface_Switch3 "VBU0428Test/VBUSystem/BMS/BCV/BCV/Subsystem/Interface_Switch3"
 /begin REF_CHARACTERISTIC CbBCV_HALVx2VoltageStatusORF_flg CbBCV_HALVx2VoltageStatusORV_flg /end REF_CHARACTERISTIC
/end GROUP
/begin GROUP S35_Interface_Switch4 "VBU0428Test/VBUSystem/BMS/BCV/BCV/Subsystem/Interface_Switch4"
 /begin REF_CHARACTERISTIC CbBCV_HALBusNegativeVoltageORF_flg CcBCV_HALBusNegativeVoltageORV_V /end REF_CHARACTERISTIC
/end GROUP
/begin GROUP S35_Interface_Switch5 "VBU0428Test/VBUSystem/BMS/BCV/BCV/Subsystem/Interface_Switch5"
 /begin REF_CHARACTERISTIC CbBCV_HALBusNegativeVoltageStatusORF_flg CbBCV_HALBusNegativeVoltageStatusORV_flg /end REF_CHARACTERISTIC
/end GROUP
/begin GROUP S35_Interface_Switch6 "VBU0428Test/VBUSystem/BMS/BCV/BCV/Subsystem/Interface_Switch6" /begin REF_CHARACTERISTIC CbBCV_HALFuseVoltageORF_flg CcBCV_HALFuseVoltageORV_V /end REF_CHARACTERISTIC /end GROUP
/begin GROUP S35_Interface_Switch7 "VBU0428Test/VBUSystem/BMS/BCV/BCV/Subsystem/Interface_Switch7"
 /begin REF_CHARACTERISTIC CbBCV_HALFuseVoltageStatusORF_flg CbBCV_HALFuseVoltageStatusORV_flg /end REF_CHARACTERISTIC
/end GROUP
/begin GROUP S35_Interface_Switch8 "VBU0428Test/VBUSystem/BMS/BCV/BCV/Subsystem/Interface_Switch8"
 /begin REF_CHARACTERISTIC CbBCV_HALPrechargeVoltageORF_flg CcBCV_HALPrechargeVoltageORV_V /end REF_CHARACTERISTIC
/end GROUP
/begin GROUP S35_Interface_Switch9 "VBU0428Test/VBUSystem/BMS/BCV/BCV/Subsystem/Interface_Switch9"
 /begin REF_CHARACTERISTIC CbBCV_HALPrechargeVoltageStatusORF_flg CbBCV_HALPrechargeVoltageStatusORV_flg /end REF_CHARACTERISTIC
/end GROUP
/begin GROUP S35_Monitor_BCV_Performance "VBU0428Test/VBUSystem/BMS/BCV/BCV/Subsystem/Monitor_BCV_Performance"
 /begin SUB_GROUP S51_Diagnose_BDM_BCV_Communication_Fault S51_Diagnose_BDM_BCV_Data_Fault S51_Diagnose_BDM_FastChargeContactorOverCurrentAlarm /end SUB_GROUP
 /begin REF_CHARACTERISTIC CcBCV_BDMOutputDelayTime_ms /end REF_CHARACTERISTIC
 /begin REF_MEASUREMENT BCV_BdmVoltagePerformanceIndex_enum BCV_flgDCContactorOverCurrent BCV_stBdmCurrentComIndex BCV_stBdmCurrentPerformanceIndex /end REF_MEASUREMENT
/end GROUP
/begin GROUP S35_Unpackage_LEM_Msg "VBU0428Test/VBUSystem/BMS/BCV/BCV/Subsystem/Unpackage_LEM_Msg" /begin REF_CHARACTERISTIC MILIAMPERES_PER_AMPERE_SY /end REF_CHARACTERISTIC /begin REF_MEASUREMENT BCV_flgBatteryCurrentSystemValid BCV_iABatteryCurrentRaw /end REF_MEASUREMENT /end GROUP
/begin GROUP S233_BDM_KL30Voltage_Diagnostic "VBU0428Test/VBUSystem/BMS/BMM/BMM/BMU_PowerOff_Check/BDM_KL30Voltage_Diagnostic" /begin REF_CHARACTERISTIC CcBMM_HALKL30BMUVoltageLow_V /end REF_CHARACTERISTIC /end GROUP
/begin GROUP S233_Monitor_BMM_Performance "VBU0428Test/VBUSystem/BMS/BMM/BMM/BMU_PowerOff_Check/Monitor_BMM_Performance" /begin REF_CHARACTERISTIC CcBMM_BDMOutputDelayTime_ms /end REF_CHARACTERISTIC /end GROUP
/begin GROUP S233_Override1 "VBU0428Test/VBUSystem/BMS/BMM/BMM/BMU_PowerOff_Check/Override1"
 /begin REF_CHARACTERISTIC CaBMM_HALKL30BMUVoltageORF_flg CaBMM_HALKL30BMUVoltageORV_V /end REF_CHARACTERISTIC
/end GROUP
/begin GROUP S236_DetermineSOCJump "VBU0428Test/VBUSystem/BMS/BMM/BMM/DetermineAbnormalEventFlag/DetermineSOCJump"
 /begin REF_CHARACTERISTIC CcBMM_SOCJumpDelayTime_ms CcBMM_SOCJumpPowerOnDelayTime_ms CcBMM_SOCJumpThreshold_pct /end REF_CHARACTERISTIC
/end GROUP
/begin GROUP S237_CycleWakeupStateMachine "VBU0428Test/VBUSystem/BMS/BMM/BMM/DetermineCycleUpload/CycleWakeupStateMachine" /begin REF_CHARACTERISTIC CYCLE_WAKEUP_STATE_ABNORMAL CYCLE_WAKEUP_STATE_INIT /end REF_CHARACTERISTIC /end GROUP
/begin GROUP S237_GetValueInNVM "VBU0428Test/VBUSystem/BMS/BMM/BMM/DetermineCycleUpload/GetValueInNVM"
 /begin REF_CHARACTERISTIC CbBMM_BattSelfLearningRequestDefault_flg CcBMM_MaxWakeUpCounter_n /end REF_CHARACTERISTIC
 /begin REF_MEASUREMENT BMM_numMonitorLastCycle /end REF_MEASUREMENT
/end GROUP
/begin GROUP S238_Determine_HoldAfterrun_Condition "VBU0428Test/VBUSystem/BMS/BMM/BMM/Determine_Hold_Afterrun/Determine_HoldAfterrun_Condition"
 /begin REF_CHARACTERISTIC CbBMM_DriverIntentionChangeEnable_flg CcBMM_MaxAfterrunTime_s /end REF_CHARACTERISTIC
 /begin REF_MEASUREMENT BMM_flgHoldAfterrun /end REF_MEASUREMENT
/end GROUP
/begin GROUP S239_Determine_Wakeup_Bywire "VBU0428Test/VBUSystem/BMS/BMM/BMM/Determine_Wakeup_Mode/Determine_Wakeup_Bywire" /begin SUB_GROUP S280_Delay_FallingEdge /end SUB_GROUP /begin REF_CHARACTERISTIC CcBMM_WakeupLineFEDebounceTime_ms /end REF_CHARACTERISTIC /end GROUP
/begin GROUP S239_Wakeup_Fast_Charge "VBU0428Test/VBUSystem/BMS/BMM/BMM/Determine_Wakeup_Mode/Wakeup_Fast_Charge"
 /begin REF_CHARACTERISTIC BMM_VEHICLE_WAKEUP_MODE_FAST_CHARGE CbBMM_FastChargeWakeupEnable_flg /end REF_CHARACTERISTIC
 /begin REF_MEASUREMENT BMM_flgFastChargeWakeup /end REF_MEASUREMENT
/end GROUP
/begin GROUP S239_Wakeup_Ignition_On "VBU0428Test/VBUSystem/BMS/BMM/BMM/Determine_Wakeup_Mode/Wakeup_Ignition_On"
 /begin REF_CHARACTERISTIC BMM_VEHICLE_WAKEUP_MODE_IGNITION_ON BMM_VEHICLE_WAKEUP_MODE_SOFTWARE_FLASHING /end REF_CHARACTERISTIC
 /begin REF_MEASUREMENT BMM_flgIgnitionOnWakeup /end REF_MEASUREMENT
/end GROUP
/begin GROUP S240_EEPROM_BlockStoreEnable "VBU0428Test/VBUSystem/BMS/BMM/BMM/Subsystem/EEPROM_BlockStoreEnable" /begin REF_MEASUREMENT BMM_flgEEBlockStoreEnable /end REF_MEASUREMENT /end GROUP
/begin GROUP S287_Balance_EnableCondition "VBU0428Test/VBUSystem/BMS/CBL/Subsystem8/Subsystem/Balance_EnableCondition"
 /begin SUB_GROUP S288_DetermineBalance_EnableCondition S288_DetermineSOCBalance_EnableCondition S288_DetermineVoltaageBalance_EnableCondition /end SUB_GROUP
/end GROUP
/begin GROUP S287_Determine_BoardTemAvailableCheck "VBU0428Test/VBUSystem/BMS/CBL/Subsystem8/Subsystem/Determine_BoardTemAvailableCheck"
 /begin REF_CHARACTERISTIC CcCBL_BoardTempBalanceStartMaxHysteresis_C CcCBL_BoardTempBalanceStartMax_C /end REF_CHARACTERISTIC
 /begin REF_MEASUREMENT LaCBL_flgCellBoardTempAvailable /end REF_MEASUREMENT
/end GROUP
/begin GROUP S287_Determine_CSCCellBalanceRequest "VBU0428Test/VBUSystem/BMS/CBL/Subsystem8/Subsystem/Determine_CSCCellBalanceRequest"
 /begin SUB_GROUP S290_Determin_MinSocCellCapacity S290_Determine_CellBalanceNumber S290_Determine_CellBalanceRequest S290_Determine_TotalCellBalanceState S290_Subsystem /end SUB_GROUP
/end GROUP
/begin GROUP S287_Override "VBU0428Test/VBUSystem/BMS/CBL/Subsystem8/Subsystem/Override" /begin SUB_GROUP S291_LOW_HIGH1 S291_LOW_HIGH2 /end SUB_GROUP
 /begin REF_CHARACTERISTIC CbCBL_CTMBoardTempValidORF_flg CbCBL_CTMBoardTempValidORV_flg CcCBL_CTMBoardTempMaxORF_flg CcCBL_CTMBoardTempMaxORV_C /end REF_CHARACTERISTIC
/end GROUP
/begin GROUP S347_LOW_HIGH2 "VBU0428Test/VBUSystem/BMS/CSC/Subsystem7/Determine_Cell_Balance/LOW_HIGH2" /begin REF_MEASUREMENT GaCSC_flgCellBalanceRequest /end REF_MEASUREMENT /end GROUP
/begin GROUP S356_ControlPrechargeRelay "VBU0428Test/VBUSystem/BMS/CTC/Subsystem1/Subsystem/ControlPrechargeRelay" /begin REF_CHARACTERISTIC CTS_MAIN_CONTACTOR_COMMAND_CLOSE /end REF_CHARACTERISTIC /begin REF_MEASUREMENT CTC_flgHALPrechargeRelay /end REF_MEASUREMENT /end GROUP
/begin GROUP S356_ControlResetRelays "VBU0428Test/VBUSystem/BMS/CTC/Subsystem1/Subsystem/ControlResetRelays"
 /begin REF_CHARACTERISTIC CTS_MAIN_CONTACTOR_COMMAND_CLOSE CTS_MAIN_CONTACTOR_COMMAND_OPEN CTS_STATE_DEACTIVATION CTS_STATE_OPEN_MPR_AND_DIAGNOSE_MPC_STUCKOPEN /end REF_CHARACTERISTIC
 /begin REF_MEASUREMENT CTC_stResetContactorRequest /end REF_MEASUREMENT
/end GROUP
/begin GROUP S356_ControlmainNegativeRelay "VBU0428Test/VBUSystem/BMS/CTC/Subsystem1/Subsystem/ControlmainNegativeRelay"
 /begin REF_CHARACTERISTIC CTS_MAIN_CONTACTOR_COMMAND_CLOSE CTS_MAIN_CONTACTOR_COMMAND_OPEN /end REF_CHARACTERISTIC
 /begin REF_MEASUREMENT CTC_flgHALMnNegContactor /end REF_MEASUREMENT
/end GROUP
/begin GROUP S356_ControlmainPositiveRelay "VBU0428Test/VBUSystem/BMS/CTC/Subsystem1/Subsystem/ControlmainPositiveRelay"
 /begin REF_CHARACTERISTIC CTS_MAIN_CONTACTOR_COMMAND_CLOSE CTS_MAIN_CONTACTOR_COMMAND_OPEN /end REF_CHARACTERISTIC
 /begin REF_MEASUREMENT CTC_flgHALMnPosContactor /end REF_MEASUREMENT
/end GROUP
/begin GROUP S356_DetermineRelayCommandStatus "VBU0428Test/VBUSystem/BMS/CTC/Subsystem1/Subsystem/DetermineRelayCommandStatus" /begin SUB_GROUP S361_Cmd_Close S361_Cmd_Open /end SUB_GROUP /begin REF_MEASUREMENT CTC_stContactorsCommandStatus /end REF_MEASUREMENT /end GROUP
/begin GROUP S356_Determine_Openings_Number "VBU0428Test/VBUSystem/BMS/CTC/Subsystem1/Subsystem/Determine_Openings_Number"
 /begin REF_CHARACTERISTIC CTS_MAIN_CONTACTOR_COMMAND_CLOSE CTS_MAIN_CONTACTOR_COMMAND_OPEN /end REF_CHARACTERISTIC
/end GROUP
/begin GROUP S373_Determine_MainContactor_Status "VBU0428Test/VBUSystem/BMS/CTD/Subsystem/Subsystem4/Determine_MainContactor_Status" /begin REF_CHARACTERISTIC CTD_MAIN_CONTACTOR_STATUS_UNKNOWN /end REF_CHARACTERISTIC /begin REF_MEASUREMENT CTD_stMnContactorsStatus /end REF_MEASUREMENT /end GROUP
/begin GROUP S373_DiagnoseRelayWeld "VBU0428Test/VBUSystem/BMS/CTD/Subsystem/Subsystem4/DiagnoseRelayWeld"
 /begin SUB_GROUP S375_DetermineRatioPEUtoBat S375_MNC_Weld_Check S375_MPC_Weld_Check /end SUB_GROUP
/end GROUP
/begin GROUP S373_LV_Battery_Voltage "VBU0428Test/VBUSystem/BMS/CTD/Subsystem/Subsystem4/LV_Battery_Voltage"
 /begin REF_CHARACTERISTIC CcCTD_HALSystemVoltageHighDelta_V CcCTD_HALSystemVoltageHigh_V CcCTD_HALSystemVoltageLowDelta_V CcCTD_HALSystemVoltageLow_V /end REF_CHARACTERISTIC
/end GROUP
/begin GROUP S373_Lockout_Precharge_Process "VBU0428Test/VBUSystem/BMS/CTD/Subsystem/Subsystem4/Lockout_Precharge_Process"
 /begin SUB_GROUP S377_Determine_Fail_Lockout S377_Determine_Lockout_Time S377_Determine_Overload_Lockout S377_HeatProtection_Lockout /end SUB_GROUP
/end GROUP
/begin GROUP S373_MainFuseDiagnostic "VBU0428Test/VBUSystem/BMS/CTD/Subsystem/Subsystem4/MainFuseDiagnostic" /begin SUB_GROUP S378_Determine_Diagnostic_Status /end SUB_GROUP
 /begin REF_CHARACTERISTIC CTD_MAIN_FUSE_BLOWN_FAULT CbCTD_MainFuseBlownFaultEnable_flg CcCTD_MainFuseBlownDeltaVoltage_V CcCTD_MainFuseBlownFaultFIC_n CcCTD_MainFuseBlownFaultPIC_n /end REF_CHARACTERISTIC
 /begin REF_MEASUREMENT CTD_flgMainFuseBlowFaultTestEnable CTD_flgMainFuseBlowFaultTestFail CTD_stMainFuseBlownFault /end REF_MEASUREMENT
/end GROUP
/begin GROUP S373_Precharge_Resistance_Diagnostic "VBU0428Test/VBUSystem/BMS/CTD/Subsystem/Subsystem4/Precharge_Resistance_Diagnostic"
 /begin SUB_GROUP S379_CONTACTOR_STATUS_CLOSED1 S379_CONTACTOR_STATUS_OPENED1 S379_Determine_Diagnostic_Status /end SUB_GROUP
 /begin REF_CHARACTERISTIC CbCTD_PrechargeResistanceBlownFaultEnable_flg CcCTD_PrechargeResistanceBlownDeltaVoltage_V CcCTD_PrechargeResistanceBlownFaultFIC_n CcCTD_PrechargeResistanceBlownFaultPIC_n /end REF_CHARACTERISTIC
 /begin REF_MEASUREMENT CTD_flgPrechargeResistanceBlownFaultTestEnable CTD_flgPrechargeResistanceBlownFaultTestFail CTD_stPrechargeRelayBlown /end REF_MEASUREMENT
/end GROUP
/begin GROUP S373_PrechrgProcessMonitoring "VBU0428Test/VBUSystem/BMS/CTD/Subsystem/Subsystem4/PrechrgProcessMonitoring"
 /begin SUB_GROUP S380_Determine_PrechargeDiag_Disable S380_Determine_Precharge_Timer S380_Determine_Ratio_BusVBatV S380_Precharge_Thermal_Management S380_Precharge_Timeout_Diagnostic S380_Precharging_Process_Monitoring /end SUB_GROUP
/end GROUP
/begin GROUP S373_Stuck_Open_Diagnostic "VBU0428Test/VBUSystem/BMS/CTD/Subsystem/Subsystem4/Stuck_Open_Diagnostic"
 /begin SUB_GROUP S381_MNC_Stuck_Open S381_MPC_Stuck_Open S381_MPR_Stuck_Open S381_StuckOpenAssistantConditons /end SUB_GROUP
/end GROUP
/begin GROUP S373_Subsystem "VBU0428Test/VBUSystem/BMS/CTD/Subsystem/Subsystem4/Subsystem" /begin REF_CHARACTERISTIC CTD_MAIN_CONTACTOR_STATUS_UNKNOWN /end REF_CHARACTERISTIC /begin REF_MEASUREMENT CTD_stMnPosContactorStatus /end REF_MEASUREMENT /end GROUP
/begin GROUP S373_Subsystem1 "VBU0428Test/VBUSystem/BMS/CTD/Subsystem/Subsystem4/Subsystem1"
 /begin REF_CHARACTERISTIC CTD_MAIN_CONTACTOR_STATUS_Open CTD_MAIN_CONTACTOR_STATUS_UNKNOWN /end REF_CHARACTERISTIC
 /begin REF_MEASUREMENT CTD_stPrechargeContactorStatus /end REF_MEASUREMENT
/end GROUP
/begin GROUP S373_Subsystem2 "VBU0428Test/VBUSystem/BMS/CTD/Subsystem/Subsystem4/Subsystem2"
 /begin REF_CHARACTERISTIC CTD_MAIN_CONTACTOR_STATUS_Open CTD_MAIN_CONTACTOR_STATUS_UNKNOWN /end REF_CHARACTERISTIC
 /begin REF_MEASUREMENT CTD_stMnNegContactorStatus /end REF_MEASUREMENT
/end GROUP
/begin GROUP S373_Subsystem3 "VBU0428Test/VBUSystem/BMS/CTD/Subsystem/Subsystem4/Subsystem3"
 /begin REF_CHARACTERISTIC CTD_MAIN_CONTACTOR_STATUS_Open CTD_MAIN_CONTACTOR_STATUS_UNKNOWN /end REF_CHARACTERISTIC
 /begin REF_MEASUREMENT CTD_stHeatingContactorStatus /end REF_MEASUREMENT
/end GROUP
/begin GROUP S541_BoardTemp_ValidCheck "VBU0428Test/VBUSystem/BMS/CTM/CTM/Subsystem/BoardTemp_ValidCheck"
 /begin REF_CHARACTERISTIC CcCTM_BoardTempInvalidFaultDelayTime_ms CcCTM_BoardTempInvalidFault_n SAMPLE_TIME_TASK_D /end REF_CHARACTERISTIC
/end GROUP
/begin GROUP S541_CellTemp_ValidCheck "VBU0428Test/VBUSystem/BMS/CTM/CTM/Subsystem/CellTemp_ValidCheck"
 /begin REF_CHARACTERISTIC CcCTM_CellTempInvalidFaultDelayTime_ms CcCTM_CellTempInvalidFault_n SAMPLE_TIME_TASK_D /end REF_CHARACTERISTIC
/end GROUP
/begin GROUP S541_Determine_BoardTemp_OverUnderFaults "VBU0428Test/VBUSystem/BMS/CTM/CTM/Subsystem/Determine_BoardTemp_OverUnderFaults"
 /begin REF_CHARACTERISTIC CTM_BOARD_OVER_TEMP_FAULT CbCTM_BoardOverTempFaultEnable_flg CcCTM_BoardOverTempFaultFIC_n CcCTM_BoardOverTempFaultPIC_n CcCTM_BoardOverTempFault_C /end REF_CHARACTERISTIC
/end GROUP
/begin GROUP S541_Determine_CellTemp "VBU0428Test/VBUSystem/BMS/CTM/CTM/Subsystem/Determine_CellTemp"
 /begin REF_MEASUREMENT CTM_numCellTempMaxID CTM_numCellTempMinID CTM_numOriginalCellTempMaxID CTM_numOriginalCellTempMinID CTM_numOriginalCellTempSecondMaxID CTM_tCellTempAve CTM_tCellTempMax CTM_tCellTempMin CTM_tOriginalCellTempAve CTM_tOriginalCellTempMax CTM_tOriginalCellTempMin CTM_tOriginalCellTempSecondMax /end REF_MEASUREMENT
/end GROUP
/begin GROUP S541_Determine_CellTemp_OverDeviationFaults "VBU0428Test/VBUSystem/BMS/CTM/CTM/Subsystem/Determine_CellTemp_OverDeviationFaults" /begin SUB_GROUP S547_EVM_FDC_Handler1 /end SUB_GROUP
 /begin REF_CHARACTERISTIC CTM_CELL_TEMP_OVER_DEVIATION_FAULT CbCTM_CellTempOverDeviationEVMFaultEnable_flg CbCTM_CellTempOverDeviationFaultEnable_flg CcCTM_CSCSupplyPowerLowHysteresis_V CcCTM_CSCSupplyPowerLow_V CcCTM_CellTempOverDeviationEVMFaultFIC_n CcCTM_CellTempOverDeviationEVMFaultPIC_n CcCTM_CellTempOverDeviationEVMFault_C CcCTM_CellTempOverDeviationFaultFIC_n CcCTM_CellTempOverDeviationFaultPIC_n CcCTM_CellTempOverDeviationFault_C CcCTM_EnableEVMTempDevDelayTime_ms CcCTM_EnableEVMTempDevThreshold_A SAMPLE_TIME_TASK_D /end REF_CHARACTERISTIC
/end GROUP
/begin GROUP S541_Determine_CellTemp_OverUnderFaults "VBU0428Test/VBUSystem/BMS/CTM/CTM/Subsystem/Determine_CellTemp_OverUnderFaults" /begin SUB_GROUP S548_EVM_FDC_Handler /end SUB_GROUP
 /begin REF_CHARACTERISTIC CTM_CELL_OVER_TEMP_WARNING_FAULT CTM_CELL_UNDER_TEMP_FAULT CbCTM_CellOverTempEVMFaultEnable_flg CbCTM_CellOverTempFaultEnable_flg CbCTM_CellOverTempWarningFaultEnable_flg CbCTM_CellUnderTempFaultEnable_flg CcCTM_CellOverTempEVMFaultFIC_n CcCTM_CellOverTempEVMFaultPIC_n CcCTM_CellOverTempEVMFault_C CcCTM_CellOverTempFaultFIC_n CcCTM_CellOverTempFaultPIC_n CcCTM_CellOverTempFault_C CcCTM_CellOverTempLvl2Fault_C CcCTM_CellOverTempWarningDebounce_ms CcCTM_CellOverTempWarningFaultFIC_n CcCTM_CellOverTempWarningFaultPIC_n CcCTM_CellOverTempWarningFault_C CcCTM_CellUnderTempFaultFIC_n CcCTM_CellUnderTempFaultPIC_n CcCTM_CellUnderTempFault_C SAMPLE_TIME_TASK_D /end REF_CHARACTERISTIC
/end GROUP
/begin GROUP S541_Determine_Thermal_Runaway "VBU0428Test/VBUSystem/BMS/CTM/CTM/Subsystem/Determine_Thermal_Runaway"
 /begin SUB_GROUP S550_CellThermalRunaway_FaultArrayCheck S550_DetermineCellTempOver S550_DetermineTempRiseRate S550_TriggerCycle /end SUB_GROUP
/end GROUP
/begin GROUP S541_PowerOnTempVoltageValid "VBU0428Test/VBUSystem/BMS/CTM/CTM/Subsystem/PowerOnTempVoltageValid" /begin REF_CHARACTERISTIC CcCTM_PowerOnTempVoltageDelay_ms SAMPLE_TIME_TASK_D /end REF_CHARACTERISTIC /end GROUP
/begin GROUP S619_Contactors_Timing_Control "VBU0428Test/VBUSystem/BMS/CTS/CTS/Subsystem/Contactors_Timing_Control"
 /begin REF_CHARACTERISTIC CTD_PRECHARGE_STATUS_FAIL CTD_PRECHARGE_STATUS_SUCCESS CTS_MAIN_CONTACTOR_COMMAND_CLOSE CTS_MAIN_CONTACTOR_COMMAND_OPEN CTS_PEU_DISCHARGE_ACTIVE CTS_STATE_CLOSE_AND_DIAGNOSE_MPR_STUCKOPEN CTS_STATE_CLOSE_MC_LSD_DIAGNOSE_HSD_STB CTS_STATE_CLOSE_MNC_PRECHARGING_MONITORING CTS_STATE_CLOSE_MPC CTS_STATE_DEACTIVATION CTS_STATE_DIAGNOSE_MNC_WELD CTS_STATE_DIAGNOSE_MPC_WELD CTS_STATE_DIAGNOSE_MPC_WELD_POWER_DOWN CTS_STATE_NORMAL_OPERATING CTS_STATE_OPEN_MAIN_POSITIVE_CONTACTOR CTS_STATE_OPEN_MC_AND_DIAGNOSE_WELD CTS_STATE_OPEN_MC_HSD CTS_STATE_OPEN_MPR_AND_DIAGNOSE_MPC_STUCKOPEN CTS_STATE_STANDBY CcCTS_CmdMnPosContactorDelayTime_ms CcCTS_DeltaVoltagePrecharge_V CcCTS_DiagnoseMPCWeldCheckDischargeTime_ms CcCTS_DiagnoseMPCWeldCheckTime_ms CcCTS_MaxCloseAndDiagnoseContactorsTime_ms CcCTS_MaxPrechargeTimes_n CcCTS_MinOpenAndDiagnoseWeldTime_ms CcCTS_NegativeLoadCurrent_A CcCTS_OpenContactorsDelayTime_ms CcCTS_PositiveLoadCurrent_A CcCTS_PrechargeTimesLimitEnable_flg CcSYS_SystemMaxInitialTime_ms DIAGNOSTIC_COMPLETE DIAGNOSTIC_CONDITION_NOT_MET /end REF_CHARACTERISTIC
 /begin REF_MEASUREMENT CTS_flgRunNegContactorWeldCheck CTS_flgRunPosContactorWeldCheck CTS_flgRunPrechargeDiagnostic CTS_stCmdMnNegContactor CTS_stCmdMnPosContactor CTS_stCmdPrechargeRelay CTS_stState LcCTS_CloseAndDiagnoseContactorsTimer_ms LcCTS_CmdMnPosContactorCounter_ms LcCTS_DiagnoseMPCWeldcheckDischargeTimer_ms LcCTS_DiagnoseMPCWeldcheckTimer_ms LcCTS_OpenAndDiagnoseWeldTimer_ms LcCTS_OpenContactorsDelayTimer_ms LcCTS_StandbyTimer_ms /end REF_MEASUREMENT
/end GROUP
/begin GROUP S619_DeterminePrechargeConditions "VBU0428Test/VBUSystem/BMS/CTS/CTS/Subsystem/DeterminePrechargeConditions"
 /begin SUB_GROUP S621_Cell_DataValid_Check S621_Energy_Protection_Check S621_Fault_Check S621_HV_DataValid_Check S621_HV_Safety_Check S621_Precharge_Inhibit_Abort S621_SoC_Initialization_Check /end SUB_GROUP
/end GROUP
/begin GROUP S619_Determine_Contactor_Request "VBU0428Test/VBUSystem/BMS/CTS/CTS/Subsystem/Determine_Contactor_Request"
 /begin SUB_GROUP S622_Close_Comamnd S622_Cmd_Close S622_Cmd_Open S622_Open_Comamnd /end SUB_GROUP
 /begin REF_CHARACTERISTIC VCR_CONTACTOR_NO_REQUEST VCR_CONTACTOR_OPEN /end REF_CHARACTERISTIC
 /begin REF_MEASUREMENT CTS_stContactorRequest /end REF_MEASUREMENT
/end GROUP
/begin GROUP S619_Determine_Emergency_Open "VBU0428Test/VBUSystem/BMS/CTS/CTS/Subsystem/Determine_Emergency_Open"
 /begin REF_CHARACTERISTIC CbCTS_HvilOpenContactorEnable_flg CmSYS_OpenContactorsDelayFaultCat_enum CmSYS_OpenContactorsNowFaultCat_enum /end REF_CHARACTERISTIC
 /begin REF_MEASUREMENT CTS_flgCmdOpenContactorsDelay CTS_flgCmdOpenContactorsNow /end REF_MEASUREMENT
/end GROUP
/begin GROUP S619_Determine_Precharge_Times "VBU0428Test/VBUSystem/BMS/CTS/CTS/Subsystem/Determine_Precharge_Times"
 /begin REF_CHARACTERISTIC CTS_STATE_CLOSE_AND_DIAGNOSE_MPR_STUCKOPEN CTS_STATE_CLOSE_MC_HSD_DIAGNOSE_LSD_STG CTS_STATE_DIAGNOSE_MPC_WELD CTS_STATE_STANDBY CcCTS_PrechargeTimerLimit_ms CcCTS_PrechargeTimerThreshold1_ms CcCTS_PrechargeTimerThreshold2_ms CcCTS_PrechargeTimerThreshold3_ms CcCTS_PrechargeTimer_ms CcCTS_PrechargeTimesLower_n CcCTS_PrechargeTimesUpper_n /end REF_CHARACTERISTIC
 /begin REF_MEASUREMENT CTS_timsPrechargeTimer /end REF_MEASUREMENT
/end GROUP
/begin GROUP S649_CellVoltage_ValidCheck "VBU0428Test/VBUSystem/BMS/CVT/CVT/Subsystem/CellVoltage_ValidCheck" /begin REF_CHARACTERISTIC SAMPLE_TIME_TASK_D /end REF_CHARACTERISTIC /end GROUP
/begin GROUP S649_Determine_CellVoltage_OverUnderFaults "VBU0428Test/VBUSystem/BMS/CVT/CVT/Subsystem/Determine_CellVoltage_OverUnderFaults" /begin REF_CHARACTERISTIC SAMPLE_TIME_TASK_D /end REF_CHARACTERISTIC /end GROUP
/begin GROUP S649_Monitor_CVT_DeviationDynamic "VBU0428Test/VBUSystem/BMS/CVT/CVT/Subsystem/Monitor_CVT_DeviationDynamic" /begin REF_CHARACTERISTIC SAMPLE_TIME_TASK_D /end REF_CHARACTERISTIC /end GROUP
/begin GROUP S649_Monitor_CVT_Performance "VBU0428Test/VBUSystem/BMS/CVT/CVT/Subsystem/Monitor_CVT_Performance" /begin REF_CHARACTERISTIC SAMPLE_TIME_TASK_D /end REF_CHARACTERISTIC /end GROUP
/begin GROUP S741_Fastcharge_State_Management "VBU0428Test/VBUSystem/BMS/FCC /FCC/Subsystem/Fastcharge_State_Management"
 /begin REF_CHARACTERISTIC CTS_MAIN_CONTACTOR_COMMAND_CLOSE CTS_MAIN_CONTACTOR_COMMAND_OPEN SAMPLE_TIME_TASK_D /end REF_CHARACTERISTIC
/end GROUP
/begin GROUP S959_Battery_SoC_Diagnostic "VBU0428Test/VBUSystem/BMS/SOC/Subsystem5/Subsystem/Battery_SoC_Diagnostic" /begin REF_CHARACTERISTIC SAMPLE_TIME_TASK_D /end REF_CHARACTERISTIC /end GROUP
/begin GROUP S959_Determine_Initialization_Condition "VBU0428Test/VBUSystem/BMS/SOC/Subsystem5/Subsystem/Determine_Initialization_Condition" /begin REF_CHARACTERISTIC SAMPLE_TIME_TASK_D /end REF_CHARACTERISTIC /end GROUP
/begin GROUP S1118_Rate_Limit_and_Output "VBU0428Test/VBUSystem/BMS/SOE/Subsystem2/Subsystem/Rate_Limit_and_Output" /begin REF_CHARACTERISTIC SAMPLE_TIME_TASK_D /end REF_CHARACTERISTIC /end GROUP
/begin GROUP S1118_Rate_Limit_and_Output_SOC "VBU0428Test/VBUSystem/BMS/SOE/Subsystem2/Subsystem/Rate_Limit_and_Output_SOC" /begin REF_CHARACTERISTIC SAMPLE_TIME_TASK_D /end REF_CHARACTERISTIC /end GROUP
/begin GROUP S1170_Count_LowTempOverCurrent "VBU0428Test/VBUSystem/BMS/SOF/Subsystem6/Subsystem/Count_LowTempOverCurrent" /begin REF_CHARACTERISTIC SAMPLE_TIME_TASK_D /end REF_CHARACTERISTIC /end GROUP
/begin GROUP S1170_Rate_CurrentLimit "VBU0428Test/VBUSystem/BMS/SOF/Subsystem6/Subsystem/Rate_CurrentLimit" /begin REF_CHARACTERISTIC SAMPLE_TIME_TASK_D /end REF_CHARACTERISTIC /end GROUP
/begin GROUP S1170_Rate_PowerLimit "VBU0428Test/VBUSystem/BMS/SOF/Subsystem6/Subsystem/Rate_PowerLimit" /begin REF_CHARACTERISTIC SAMPLE_TIME_TASK_D /end REF_CHARACTERISTIC /end GROUP
/begin GROUP S1170_SOF_Diagnostic "VBU0428Test/VBUSystem/BMS/SOF/Subsystem6/Subsystem/SOF_Diagnostic" /begin REF_CHARACTERISTIC SAMPLE_TIME_TASK_D /end REF_CHARACTERISTIC /end GROUP
/begin GROUP S3212_DCH_J1939OutputProcessBCP "VBU0428Test/VBUSystem/VCU /DCH/DCH_Overall/DCH_J1939OutputSignalProcess/DCH_J1939OutputProcessBCP"
 /begin REF_CHARACTERISTIC DCH_cBCPNrmCapOvrdVal_C DCH_iBCPMaxChCurrOvrdVal_C DCH_pctBCPSocOvrdVal_C DCH_tBCPMaxPermitTempOvrdVal_C DCH_uBCPBattVltgOvrdVal_C DCH_uBCPMaxCellVltgForChOvrdVal_C DCH_uBCPMaxVltgForChOvrdVal_C /end REF_CHARACTERISTIC
/end GROUP
/begin GROUP S3212_DCH_J1939OutputProcessBCS "VBU0428Test/VBUSystem/VCU /DCH/DCH_Overall/DCH_J1939OutputSignalProcess/DCH_J1939OutputProcessBCS"
 /begin REF_CHARACTERISTIC DCH_iBCSChCurrMeasureOvrdVal_C DCH_numBCSMaxCellVltgNumOvrdVal_C DCH_pctBCSCurrSocOvrdVal_C DCH_tiBCSChNeedTOvrdVal_C DCH_uBCSChVltgMeasureOvrdVal_C DCH_uBCSMaxCellVltgOvrdVal_C /end REF_CHARACTERISTIC
/end GROUP
/begin GROUP S3605_DVM_PEUShtDwn "VBU0428Test/VBUSystem/VCU /PMM/PMM_Ctrl/DrvMod_Ctrl/DVM_PEUShtDwn"
 /begin REF_CHARACTERISTIC PMM_stActvDisCh_SY PMM_stHVRlyConnReq_SY PMM_stHVRlyConn_SY PMM_stInitMode_SY PMM_stMCUACOff_SY PMM_tiSmplT_SY /end REF_CHARACTERISTIC
/end GROUP
/begin GROUP S3605_DVM_SetRdy "VBU0428Test/VBUSystem/VCU /PMM/PMM_Ctrl/DrvMod_Ctrl/DVM_SetRdy" /begin REF_CHARACTERISTIC PMM_flgVehRdyOvrdVal_C /end REF_CHARACTERISTIC /end GROUP
/begin GROUP S3605_DVM_VehRdy "VBU0428Test/VBUSystem/VCU /PMM/PMM_Ctrl/DrvMod_Ctrl/DVM_VehRdy" /begin REF_CHARACTERISTIC PMM_tiSmplT_SY /end REF_CHARACTERISTIC /end GROUP
/begin GROUP S3606_LvWakeUp_Mode_Calc "VBU0428Test/VBUSystem/VCU /PMM/PMM_Ctrl/LvWakeUp_Ctrl/LvWakeUp_Mode_Calc" /begin REF_CHARACTERISTIC PMM_tiSmplT_SY /end REF_CHARACTERISTIC /end GROUP
/begin GROUP S3607_ActiveDisChFault "VBU0428Test/VBUSystem/VCU /PMM/PMM_Ctrl/PMM_DIAG/ActiveDisChFault" /begin REF_CHARACTERISTIC PMM_tiSmplT_SY /end REF_CHARACTERISTIC /end GROUP
/begin GROUP S3607_PreChargeCheck "VBU0428Test/VBUSystem/VCU /PMM/PMM_Ctrl/PMM_DIAG/PreChargeCheck" /begin REF_CHARACTERISTIC PMM_stHVRlyConnReq_SY PMM_tiSmplT_SY /end REF_CHARACTERISTIC /end GROUP
/begin GROUP S3607_UnintendAction "VBU0428Test/VBUSystem/VCU /PMM/PMM_Ctrl/PMM_DIAG/UnintendAction" /begin REF_CHARACTERISTIC PMM_stHVRlyClose_SY PMM_tiSmplT_SY /end REF_CHARACTERISTIC /end GROUP
/begin GROUP S3608_AcTvDisCh "VBU0428Test/VBUSystem/VCU /PMM/PMM_Ctrl/PwrMod_Ctrl/AcTvDisCh" /begin REF_CHARACTERISTIC PMM_stActvDisCh_SY /end REF_CHARACTERISTIC /end GROUP
/begin GROUP S3608_SelfRoutine "VBU0428Test/VBUSystem/VCU /PMM/PMM_Ctrl/PwrMod_Ctrl/SelfRoutine" /begin REF_CHARACTERISTIC PMM_stInitMode_SY PMM_stShutDown_SY PMM_tiSmplT_SY /end REF_CHARACTERISTIC /end GROUP
/begin GROUP S36_Correct_BatteryCurrent "VBU0428Test/VBUSystem/BMS/BCV/BCV/Subsystem/Calculate_BatteryCurrent/Correct_BatteryCurrent"
 /begin REF_CHARACTERISTIC CTS_STATE_CLOSE_MNC_PRECHARGING_MONITORING CTS_STATE_CLOSE_MPC CTS_STATE_NORMAL_OPERATING CTS_STATE_OPEN_MPR_AND_DIAGNOSE_MPC_STUCKOPEN /end REF_CHARACTERISTIC
/end GROUP
/begin GROUP S51_Diagnose_BDM_FastChargeContactorOverCurrentAlarm "VBU0428Test/VBUSystem/BMS/BCV/BCV/Subsystem/Monitor_BCV_Performance/Diagnose_BDM_FastChargeContactorOverCurrentAlarm" /begin REF_CHARACTERISTIC CcBCV_BDMOutputDelayTime_ms /end REF_CHARACTERISTIC /end GROUP
/begin GROUP S361_Cmd_Close "VBU0428Test/VBUSystem/BMS/CTC/Subsystem1/Subsystem/DetermineRelayCommandStatus/Cmd_Close" /begin REF_CHARACTERISTIC CTS_MAIN_CONTACTOR_COMMAND_CLOSE /end REF_CHARACTERISTIC /end GROUP
/begin GROUP S361_Cmd_Open "VBU0428Test/VBUSystem/BMS/CTC/Subsystem1/Subsystem/DetermineRelayCommandStatus/Cmd_Open" /begin REF_CHARACTERISTIC CTS_MAIN_CONTACTOR_COMMAND_OPEN /end REF_CHARACTERISTIC /end GROUP
/begin GROUP S377_Determine_Fail_Lockout "VBU0428Test/VBUSystem/BMS/CTD/Subsystem/Subsystem4/Lockout_Precharge_Process/Determine_Fail_Lockout" /begin REF_CHARACTERISTIC CTD_PRECHARGE_STATUS_FAIL /end REF_CHARACTERISTIC /end GROUP
/begin GROUP S378_Determine_Diagnostic_Status "VBU0428Test/VBUSystem/BMS/CTD/Subsystem/Subsystem4/MainFuseDiagnostic/Determine_Diagnostic_Status" /begin REF_CHARACTERISTIC DIAGNOSTIC_COMPLETE DIAGNOSTIC_CONDITION_NOT_MET /end REF_CHARACTERISTIC /end GROUP
/begin GROUP S379_Determine_Diagnostic_Status "VBU0428Test/VBUSystem/BMS/CTD/Subsystem/Subsystem4/Precharge_Resistance_Diagnostic/Determine_Diagnostic_Status" /begin REF_CHARACTERISTIC DIAGNOSTIC_COMPLETE DIAGNOSTIC_CONDITION_NOT_MET /end REF_CHARACTERISTIC /end GROUP
/begin GROUP S380_Precharge_Timeout_Diagnostic "VBU0428Test/VBUSystem/BMS/CTD/Subsystem/Subsystem4/PrechrgProcessMonitoring/Precharge_Timeout_Diagnostic" /begin REF_CHARACTERISTIC CTD_PRECHARGE_STATUS_FAIL /end REF_CHARACTERISTIC /end GROUP
/begin GROUP S550_CellThermalRunaway_FaultArrayCheck "VBU0428Test/VBUSystem/BMS/CTM/CTM/Subsystem/Determine_Thermal_Runaway/CellThermalRunaway_FaultArrayCheck" /begin REF_CHARACTERISTIC SAMPLE_TIME_TASK_D /end REF_CHARACTERISTIC /end GROUP
/begin GROUP S550_DetermineCellTempOver "VBU0428Test/VBUSystem/BMS/CTM/CTM/Subsystem/Determine_Thermal_Runaway/DetermineCellTempOver" /begin REF_CHARACTERISTIC SAMPLE_TIME_TASK_D /end REF_CHARACTERISTIC /end GROUP
/begin GROUP S550_TriggerCycle "VBU0428Test/VBUSystem/BMS/CTM/CTM/Subsystem/Determine_Thermal_Runaway/TriggerCycle" /begin REF_CHARACTERISTIC SAMPLE_TIME_TASK_D /end REF_CHARACTERISTIC /end GROUP
/begin GROUP S622_Close_Comamnd "VBU0428Test/VBUSystem/BMS/CTS/CTS/Subsystem/Determine_Contactor_Request/Close_Comamnd" /begin REF_CHARACTERISTIC CTS_MAIN_CONTACTOR_COMMAND_CLOSE /end REF_CHARACTERISTIC /end GROUP
/begin GROUP S622_Cmd_Close "VBU0428Test/VBUSystem/BMS/CTS/CTS/Subsystem/Determine_Contactor_Request/Cmd_Close" /begin REF_CHARACTERISTIC CTS_MAIN_CONTACTOR_COMMAND_CLOSE /end REF_CHARACTERISTIC /end GROUP
/begin GROUP S622_Cmd_Open "VBU0428Test/VBUSystem/BMS/CTS/CTS/Subsystem/Determine_Contactor_Request/Cmd_Open" /begin REF_CHARACTERISTIC CTS_MAIN_CONTACTOR_COMMAND_OPEN /end REF_CHARACTERISTIC /end GROUP
/begin GROUP S622_Open_Comamnd "VBU0428Test/VBUSystem/BMS/CTS/CTS/Subsystem/Determine_Contactor_Request/Open_Comamnd" /begin REF_CHARACTERISTIC CTS_MAIN_CONTACTOR_COMMAND_OPEN /end REF_CHARACTERISTIC /end GROUP
/begin GROUP S654_Determine_CSCCellVoltage_DeviationDynamicBDM "VBU0428Test/VBUSystem/BMS/CVT/CVT/Subsystem/Monitor_CVT_DeviationDynamic/Determine_CSCCellVoltage_DeviationDynamicBDM" /begin REF_CHARACTERISTIC SAMPLE_TIME_TASK_D /end REF_CHARACTERISTIC /end GROUP
/begin GROUP S655_Determine_CellVoltage_OverDeviationBDM "VBU0428Test/VBUSystem/BMS/CVT/CVT/Subsystem/Monitor_CVT_Performance/Determine_CellVoltage_OverDeviationBDM" /begin REF_CHARACTERISTIC SAMPLE_TIME_TASK_D /end REF_CHARACTERISTIC /end GROUP
/begin GROUP S655_Determine_CellVoltage_OverUnderBDM "VBU0428Test/VBUSystem/BMS/CVT/CVT/Subsystem/Monitor_CVT_Performance/Determine_CellVoltage_OverUnderBDM" /begin REF_CHARACTERISTIC SAMPLE_TIME_TASK_D /end REF_CHARACTERISTIC /end GROUP
/begin GROUP S742_EightyPercentCustomSOC_EnableInvalidChargeTimeFlag "VBU0428Test/VBUSystem/BMS/FCC /FCC/Subsystem/Calculate_Fastcharge_Time/EightyPercentCustomSOC_EnableInvalidChargeTimeFlag" /begin REF_CHARACTERISTIC SAMPLE_TIME_TASK_D /end REF_CHARACTERISTIC /end GROUP
/begin GROUP S742_EightyPercentCustomSOC_UpdateChargeTimeFlag "VBU0428Test/VBUSystem/BMS/FCC /FCC/Subsystem/Calculate_Fastcharge_Time/EightyPercentCustomSOC_UpdateChargeTimeFlag" /begin REF_CHARACTERISTIC SAMPLE_TIME_TASK_D /end REF_CHARACTERISTIC /end GROUP
/begin GROUP S742_SendInvalidTime_flg "VBU0428Test/VBUSystem/BMS/FCC /FCC/Subsystem/Calculate_Fastcharge_Time/SendInvalidTime_flg" /begin REF_CHARACTERISTIC SAMPLE_TIME_TASK_D /end REF_CHARACTERISTIC /end GROUP
/begin GROUP S742_UpdateTimeTrigger "VBU0428Test/VBUSystem/BMS/FCC /FCC/Subsystem/Calculate_Fastcharge_Time/UpdateTimeTrigger" /begin REF_CHARACTERISTIC SAMPLE_TIME_TASK_D /end REF_CHARACTERISTIC /end GROUP
/begin GROUP S743_Charge_Request_Protection "VBU0428Test/VBUSystem/BMS/FCC /FCC/Subsystem/Determine_Fastcharge_Request/Charge_Request_Protection" /begin REF_CHARACTERISTIC SAMPLE_TIME_TASK_D /end REF_CHARACTERISTIC /end GROUP
/begin GROUP S961_Determine_AhIntegral_Capacity "VBU0428Test/VBUSystem/BMS/SOC/Subsystem5/Subsystem/Determine_AhIntegral_SoC/Determine_AhIntegral_Capacity" /begin REF_CHARACTERISTIC SAMPLE_TIME_TASK_D /end REF_CHARACTERISTIC /end GROUP
/begin GROUP S966_Determine_BatterySOC_ChangeRate "VBU0428Test/VBUSystem/BMS/SOC/Subsystem5/Subsystem/Determine_Display_SOC/Determine_BatterySOC_ChangeRate" /begin REF_CHARACTERISTIC SAMPLE_TIME_TASK_D /end REF_CHARACTERISTIC /end GROUP
/begin GROUP S966_DisplaySOC_Driving_Calculation "VBU0428Test/VBUSystem/BMS/SOC/Subsystem5/Subsystem/Determine_Display_SOC/DisplaySOC_Driving_Calculation" /begin REF_CHARACTERISTIC SAMPLE_TIME_TASK_D /end REF_CHARACTERISTIC /end GROUP
/begin GROUP S967_Determine_FastChargeCorrectionEnable "VBU0428Test/VBUSystem/BMS/SOC/Subsystem5/Subsystem/Determine_FastChargeCorrection_Soc/Determine_FastChargeCorrectionEnable" /begin REF_CHARACTERISTIC SAMPLE_TIME_TASK_D /end REF_CHARACTERISTIC /end GROUP
/begin GROUP S971_Current_Limit_Condition "VBU0428Test/VBUSystem/BMS/SOC/Subsystem5/Subsystem/Determine_ShortTimeCorrection_Condition/Current_Limit_Condition" /begin REF_CHARACTERISTIC SAMPLE_TIME_TASK_D /end REF_CHARACTERISTIC /end GROUP
/begin GROUP S1119_Determine_History_Current_Data "VBU0428Test/VBUSystem/BMS/SOE/Subsystem2/Subsystem/Calculate_History_Average_Current/Determine_History_Current_Data" /begin REF_CHARACTERISTIC SAMPLE_TIME_TASK_D /end REF_CHARACTERISTIC /end GROUP
/begin GROUP S1119_Time_Counter "VBU0428Test/VBUSystem/BMS/SOE/Subsystem2/Subsystem/Calculate_History_Average_Current/Time_Counter" /begin REF_CHARACTERISTIC SAMPLE_TIME_TASK_D /end REF_CHARACTERISTIC /end GROUP
/begin GROUP S1172_Calculate_Pack_OCV "VBU0428Test/VBUSystem/BMS/SOF/Subsystem6/Subsystem/Calculate_PowerLimit/Calculate_Pack_OCV" /begin REF_CHARACTERISTIC SAMPLE_TIME_TASK_D /end REF_CHARACTERISTIC /end GROUP
/begin GROUP S1402_Monitor_SOH_Performance "VBU0428Test/VBUSystem/BMS/SOH/Subsystem4/Subsystem1/SOH_Diagnositic/Monitor_SOH_Performance" /begin REF_CHARACTERISTIC SAMPLE_TIME_TASK_D /end REF_CHARACTERISTIC /end GROUP
/begin GROUP S3338_ChargeConditon "VBU0428Test/VBUSystem/VCU /DSPL /DSPL/DriveRange/RemainingRange/ChargeConditon" /begin REF_CHARACTERISTIC DSPL_tiSample_SY /end REF_CHARACTERISTIC /end GROUP
/begin GROUP S3338_DriveTemp "VBU0428Test/VBUSystem/VCU /DSPL /DSPL/DriveRange/RemainingRange/DriveTemp" /begin REF_CHARACTERISTIC DSPL_tiSample_SY /end REF_CHARACTERISTIC /end GROUP
/begin GROUP S3620_Wakeup "VBU0428Test/VBUSystem/VCU /PMM/PMM_Ctrl/LvWakeUp_Ctrl/LvWakeUp_State_Calc/Wakeup" /begin REF_CHARACTERISTIC PMM_tiSmplT_SY /end REF_CHARACTERISTIC /end GROUP
/begin GROUP S3669_CtrlSht "VBU0428Test/VBUSystem/VCU /PMM/PMM_Ctrl/PwrMod_Ctrl/PwrMod_PowerUp/CtrlSht" /begin REF_CHARACTERISTIC PMM_stInitMode_SY PMM_stShutDown_SY /end REF_CHARACTERISTIC /end GROUP
/begin GROUP S3669_EmgcySht "VBU0428Test/VBUSystem/VCU /PMM/PMM_Ctrl/PwrMod_Ctrl/PwrMod_PowerUp/EmgcySht" /begin REF_CHARACTERISTIC PMM_stInitMode_SY PMM_stShutDown_SY /end REF_CHARACTERISTIC /end GROUP
/begin GROUP S3669_HVClReqSrc "VBU0428Test/VBUSystem/VCU /PMM/PMM_Ctrl/PwrMod_Ctrl/PwrMod_PowerUp/HVClReqSrc" /begin REF_CHARACTERISTIC PMM_tiSmplT_SY /end REF_CHARACTERISTIC /end GROUP
/begin GROUP S3669_VehStsJudgement "VBU0428Test/VBUSystem/VCU /PMM/PMM_Ctrl/PwrMod_Ctrl/PwrMod_PowerUp/VehStsJudgement" /begin REF_CHARACTERISTIC PMM_stHVCntctStClosed_SY /end REF_CHARACTERISTIC /end GROUP
/begin GROUP S3669_stateflowcondition "VBU0428Test/VBUSystem/VCU /PMM/PMM_Ctrl/PwrMod_Ctrl/PwrMod_PowerUp/stateflowcondition" /begin REF_CHARACTERISTIC PMM_tiSmplT_SY /end REF_CHARACTERISTIC /end GROUP
/begin GROUP S3671_PwrUpRoutine "VBU0428Test/VBUSystem/VCU /PMM/PMM_Ctrl/PwrMod_Ctrl/Routine/PwrUpRoutine" /begin REF_CHARACTERISTIC PMM_stHVRlyConn_SY PMM_tiSmplT_SY /end REF_CHARACTERISTIC /end GROUP
/begin GROUP S3671_Routine_PwrDwn "VBU0428Test/VBUSystem/VCU /PMM/PMM_Ctrl/PwrMod_Ctrl/Routine/Routine_PwrDwn" /begin REF_CHARACTERISTIC PMM_stInitMode_SY PMM_stShutDown_SY /end REF_CHARACTERISTIC /end GROUP
/begin GROUP S3671_Rouutine_RActiveDis "VBU0428Test/VBUSystem/VCU /PMM/PMM_Ctrl/PwrMod_Ctrl/Routine/Rouutine_RActiveDis" /begin REF_CHARACTERISTIC PMM_stHVRlyConnReq_SY PMM_stInitMode_SY PMM_stShutDown_SY /end REF_CHARACTERISTIC /end GROUP
/begin GROUP S3725_Normal_VehSpdCal "VBU0428Test/VBUSystem/VCU /SPD/SPD/SignalProcessing_10ms/VehSpdNorm/Normal_VehSpdCal" /begin REF_CHARACTERISTIC SYS_facGearRatioF_SY /end REF_CHARACTERISTIC /end GROUP
/begin GROUP S3725_nMotr2vVeh "VBU0428Test/VBUSystem/VCU /SPD/SPD/SignalProcessing_10ms/VehSpdNorm/nMotr2vVeh" /begin REF_CHARACTERISTIC SYS_facGearRatioF_SY /end REF_CHARACTERISTIC /end GROUP
/begin GROUP S4032_AlxeMax "VBU0428Test/VBUSystem/VCU /VTQA/Subsystem/VehTrqArb/Trq_Arb/AlxeMax" /begin REF_CHARACTERISTIC SYS_facGearRatioF_SY /end REF_CHARACTERISTIC /end GROUP
/begin GROUP S4092_Veh_DCPortTempPlausibility "VBU0428Test/VBUSystem/VCU /VehINP/VehINP_Logic/DCPortTemp/Charge_Port_Temp/Veh_DCPortTempPlausibility" /begin REF_CHARACTERISTIC Veh_tiSampleTime_C /end REF_CHARACTERISTIC /end GROUP
/begin GROUP S54_Calculate_BatteryCurrent_ZeroDrift "VBU0428Test/VBUSystem/BMS/BCV/BCV/Subsystem/Calculate_BatteryCurrent/Correct_BatteryCurrent/Calculate_BatteryCurrent_ZeroDrift"
 /begin REF_CHARACTERISTIC CTS_STATE_CLOSE_MNC_PRECHARGING_MONITORING CTS_STATE_CLOSE_MPC CTS_STATE_NORMAL_OPERATING CTS_STATE_OPEN_MPR_AND_DIAGNOSE_MPC_STUCKOPEN /end REF_CHARACTERISTIC
/end GROUP
/begin GROUP S107_Equal_FASTCHARGE "VBU0428Test/VBUSystem/BMS/BCV/BCV/Subsystem/Calculate_Lifetime_Data/Calculate_LifeTimeFastcharge/Equal_FASTCHARGE" /begin REF_CHARACTERISTIC BMM_VEHICLE_WAKEUP_MODE_FAST_CHARGE /end REF_CHARACTERISTIC /end GROUP
/begin GROUP S188_Equal_FASTCHARGE "VBU0428Test/VBUSystem/BMS/BCV/BCV/Subsystem/Monitor_BCV_Performance/Diagnose_BDM_FastChargeContactorOverCurrentAlarm/Equal_FASTCHARGE" /begin REF_CHARACTERISTIC BMM_VEHICLE_WAKEUP_MODE_FAST_CHARGE /end REF_CHARACTERISTIC /end GROUP
/begin GROUP S387_Determine_Diagnostic_Status "VBU0428Test/VBUSystem/BMS/CTD/Subsystem/Subsystem4/DiagnoseRelayWeld/MNC_Weld_Check/Determine_Diagnostic_Status" /begin REF_CHARACTERISTIC DIAGNOSTIC_COMPLETE DIAGNOSTIC_CONDITION_NOT_MET /end REF_CHARACTERISTIC /end GROUP
/begin GROUP S388_Determine_Diagnostic_Status "VBU0428Test/VBUSystem/BMS/CTD/Subsystem/Subsystem4/DiagnoseRelayWeld/MPC_Weld_Check/Determine_Diagnostic_Status" /begin REF_CHARACTERISTIC DIAGNOSTIC_COMPLETE DIAGNOSTIC_CONDITION_NOT_MET /end REF_CHARACTERISTIC /end GROUP
/begin GROUP S428_Determine_LockPoint_AvaliableHeat "VBU0428Test/VBUSystem/BMS/CTD/Subsystem/Subsystem4/Lockout_Precharge_Process/HeatProtection_Lockout/Determine_LockPoint_AvaliableHeat"
 /begin REF_CHARACTERISTIC CTS_STATE_CLOSE_MC_HSD_DIAGNOSE_LSD_STG CTS_STATE_OPEN_MPR_AND_DIAGNOSE_MPC_STUCKOPEN /end REF_CHARACTERISTIC
/end GROUP
/begin GROUP S456_Status_Fail "VBU0428Test/VBUSystem/BMS/CTD/Subsystem/Subsystem4/PrechrgProcessMonitoring/Precharging_Process_Monitoring/Status_Fail" /begin REF_CHARACTERISTIC CTD_PRECHARGE_STATUS_FAIL /end REF_CHARACTERISTIC /end GROUP
/begin GROUP S456_Status_Success "VBU0428Test/VBUSystem/BMS/CTD/Subsystem/Subsystem4/PrechrgProcessMonitoring/Precharging_Process_Monitoring/Status_Success" /begin REF_CHARACTERISTIC CTD_PRECHARGE_STATUS_SUCCESS /end REF_CHARACTERISTIC /end GROUP
/begin GROUP S478_Determine_Diagnostic_Status "VBU0428Test/VBUSystem/BMS/CTD/Subsystem/Subsystem4/Stuck_Open_Diagnostic/MPR_Stuck_Open/Determine_Diagnostic_Status" /begin REF_CHARACTERISTIC DIAGNOSTIC_COMPLETE DIAGNOSTIC_CONDITION_NOT_MET /end REF_CHARACTERISTIC /end GROUP
/begin GROUP S631_Combine_Precharge_Conditions "VBU0428Test/VBUSystem/BMS/CTS/CTS/Subsystem/DeterminePrechargeConditions/Precharge_Inhibit_Abort/Combine_Precharge_Conditions" /begin REF_CHARACTERISTIC CTD_PRECHARGE_STATUS_FAIL /end REF_CHARACTERISTIC /end GROUP
/begin GROUP S798_Decrease_ChargeCurrentRequest "VBU0428Test/VBUSystem/BMS/FCC /FCC/Subsystem/Determine_Fastcharge_Request/Charge_Request_Protection/Decrease_ChargeCurrentRequest" /begin REF_CHARACTERISTIC SAMPLE_TIME_TASK_D /end REF_CHARACTERISTIC /end GROUP
/begin GROUP S799_Determine_ComputeResistanceCondition "VBU0428Test/VBUSystem/BMS/FCC /FCC/Subsystem/Determine_Fastcharge_Request/DetermineComputeResistancePulseCurrent/Determine_ComputeResistanceCondition" /begin REF_CHARACTERISTIC SAMPLE_TIME_TASK_D /end REF_CHARACTERISTIC /end GROUP
/begin GROUP S832_Cell_Temp_Protection "VBU0428Test/VBUSystem/BMS/FCC /FCC/Subsystem/Fastcharge_Conditions_Check/Condition_Categorize/Cell_Temp_Protection" /begin REF_CHARACTERISTIC SAMPLE_TIME_TASK_D /end REF_CHARACTERISTIC /end GROUP
/begin GROUP S832_Voltage_Protection "VBU0428Test/VBUSystem/BMS/FCC /FCC/Subsystem/Fastcharge_Conditions_Check/Condition_Categorize/Voltage_Protection" /begin REF_CHARACTERISTIC SAMPLE_TIME_TASK_D /end REF_CHARACTERISTIC /end GROUP
/begin GROUP S986_Determine_Cell_Balanced_Capacity "VBU0428Test/VBUSystem/BMS/SOC/Subsystem5/Subsystem/Determine_AhIntegral_SoC/Determine_AhIntegral_Capacity/Determine_Cell_Balanced_Capacity" /begin REF_CHARACTERISTIC SAMPLE_TIME_TASK_D /end REF_CHARACTERISTIC /end GROUP
/begin GROUP S1178_Rate_Limiter "VBU0428Test/VBUSystem/BMS/SOF/Subsystem6/Subsystem/Calculate_PowerLimit/Calculate_Pack_OCV/Rate_Limiter" /begin REF_CHARACTERISTIC SAMPLE_TIME_TASK_D /end REF_CHARACTERISTIC /end GROUP
/begin GROUP S1210_Calculate_CurrentLimit_Base "VBU0428Test/VBUSystem/BMS/SOF/Subsystem6/Subsystem/Determine_Currentlimit_Target/Calculate_CurrentLimit_Target/Calculate_CurrentLimit_Base" /begin REF_CHARACTERISTIC SAMPLE_TIME_TASK_D /end REF_CHARACTERISTIC /end GROUP
/begin GROUP S1407_Determine_SlowCharge "VBU0428Test/VBUSystem/BMS/SOH/Subsystem4/Subsystem1/Calculate_Capacity/Determine_CalculateCellCapacity_Condition/Determine_SlowCharge" /begin REF_CHARACTERISTIC SAMPLE_TIME_TASK_D /end REF_CHARACTERISTIC /end GROUP
/begin GROUP S1407_Determine_SlowChargeStart "VBU0428Test/VBUSystem/BMS/SOH/Subsystem4/Subsystem1/Calculate_Capacity/Determine_CalculateCellCapacity_Condition/Determine_SlowChargeStart" /begin REF_CHARACTERISTIC SAMPLE_TIME_TASK_D /end REF_CHARACTERISTIC /end GROUP
/begin GROUP S3339_DSPL_EnergyComsumptionCal "VBU0428Test/VBUSystem/VCU /DSPL /DSPL/DriveRange/DSPL_Consumption/DSPL_EnergySelfLearn/DSPL_EnergyComsumptionCal" /begin REF_CHARACTERISTIC DSPL_tiSample_SY /end REF_CHARACTERISTIC /end GROUP
/begin GROUP S3340_Comsumption "VBU0428Test/VBUSystem/VCU /DSPL /DSPL/DriveRange/DSPL_Consumption/Range10kmConsumption/Comsumption" /begin REF_CHARACTERISTIC DSPL_tiSample_SY /end REF_CHARACTERISTIC /end GROUP
/begin GROUP S3340_DSPLRange10kmCondition "VBU0428Test/VBUSystem/VCU /DSPL /DSPL/DriveRange/DSPL_Consumption/Range10kmConsumption/DSPLRange10kmCondition" /begin REF_CHARACTERISTIC DSPL_tiSample_SY /end REF_CHARACTERISTIC /end GROUP
/begin GROUP S3341_DSPLRange50kmComsumptionCal "VBU0428Test/VBUSystem/VCU /DSPL /DSPL/DriveRange/DSPL_Consumption/Range50kmConsumption/DSPLRange50kmComsumptionCal" /begin REF_CHARACTERISTIC DSPL_tiSample_SY /end REF_CHARACTERISTIC /end GROUP
/begin GROUP S3341_DSPLRange50kmCondition "VBU0428Test/VBUSystem/VCU /DSPL /DSPL/DriveRange/DSPL_Consumption/Range50kmConsumption/DSPLRange50kmCondition" /begin REF_CHARACTERISTIC DSPL_tiSample_SY /end REF_CHARACTERISTIC /end GROUP
/begin GROUP S3392_SOCDeclineFactorCalculation "VBU0428Test/VBUSystem/VCU /DSPL /DSPL/DriveRange/RemainingRange/FullRangeAndSocDeclineFactor/SOCDeclineFactorCalculation" /begin REF_CHARACTERISTIC DSPL_tiSample_SY /end REF_CHARACTERISTIC /end GROUP
/begin GROUP S3394_Charge "VBU0428Test/VBUSystem/VCU /DSPL /DSPL/DriveRange/RemainingRange/SelectDisplayRange/Charge" /begin REF_CHARACTERISTIC DSPL_tiSample_SY /end REF_CHARACTERISTIC /end GROUP
/begin GROUP S3394_Drive "VBU0428Test/VBUSystem/VCU /DSPL /DSPL/DriveRange/RemainingRange/SelectDisplayRange/Drive" /begin REF_CHARACTERISTIC DSPL_tiSample_SY /end REF_CHARACTERISTIC /end GROUP
/begin GROUP S3394_storeRange "VBU0428Test/VBUSystem/VCU /DSPL /DSPL/DriveRange/RemainingRange/SelectDisplayRange/storeRange" /begin REF_CHARACTERISTIC DSPL_tiSample_SY /end REF_CHARACTERISTIC /end GROUP
/begin GROUP S3623_StopNM "VBU0428Test/VBUSystem/VCU /PMM/PMM_Ctrl/LvWakeUp_Ctrl/LvWakeUp_State_Calc/LVWSrc/StopNM" /begin REF_CHARACTERISTIC PMM_stInitMode_SY PMM_stShutDown_SY PMM_tiSmplT_SY /end REF_CHARACTERISTIC /end GROUP
/begin GROUP S3623_VCUActSrc "VBU0428Test/VBUSystem/VCU /PMM/PMM_Ctrl/LvWakeUp_Ctrl/LvWakeUp_State_Calc/LVWSrc/VCUActSrc" /begin REF_CHARACTERISTIC PMM_stInitMode_SY PMM_stShutDown_SY PMM_tiSmplT_SY /end REF_CHARACTERISTIC /end GROUP
/begin GROUP S3623_VCUWakeUp "VBU0428Test/VBUSystem/VCU /PMM/PMM_Ctrl/LvWakeUp_Ctrl/LvWakeUp_State_Calc/LVWSrc/VCUWakeUp" /begin REF_CHARACTERISTIC PMM_tiSmplT_SY /end REF_CHARACTERISTIC /end GROUP
/begin GROUP S4110_Gear4Reset "VBU0428Test/VBUSystem/VCU /VehINP/VehINP_Logic/GearShift/Gear1/Gear_Status/Gear4Reset" /begin REF_CHARACTERISTIC Gear_stCurrentGearN_C Gear_stCurrentGearP_C /end REF_CHARACTERISTIC /end GROUP
/begin GROUP S4110_Gear_CurrentValid "VBU0428Test/VBUSystem/VCU /VehINP/VehINP_Logic/GearShift/Gear1/Gear_Status/Gear_CurrentValid" /begin REF_CHARACTERISTIC Gear_stCurrentGearN_C Gear_stCurrentGearP_C /end REF_CHARACTERISTIC /end GROUP
/begin GROUP S4110_Gear_DefaultGear "VBU0428Test/VBUSystem/VCU /VehINP/VehINP_Logic/GearShift/Gear1/Gear_Status/Gear_DefaultGear" /begin REF_CHARACTERISTIC Gear_stCurrentGearN_C Gear_stCurrentGearP_C /end REF_CHARACTERISTIC /end GROUP
/begin GROUP S4110_Gear_DriverShiftDReq "VBU0428Test/VBUSystem/VCU /VehINP/VehINP_Logic/GearShift/Gear1/Gear_Status/Gear_DriverShiftDReq" /begin REF_CHARACTERISTIC Gear_stCurrentGearN_C Gear_stCurrentGearP_C /end REF_CHARACTERISTIC /end GROUP
/begin GROUP S4110_Gear_DriverShiftRReq "VBU0428Test/VBUSystem/VCU /VehINP/VehINP_Logic/GearShift/Gear1/Gear_Status/Gear_DriverShiftRReq" /begin REF_CHARACTERISTIC Gear_stCurrentGearN_C Gear_stCurrentGearP_C /end REF_CHARACTERISTIC /end GROUP
/begin GROUP S4110_Gear_InitGear "VBU0428Test/VBUSystem/VCU /VehINP/VehINP_Logic/GearShift/Gear1/Gear_Status/Gear_InitGear" /begin REF_CHARACTERISTIC Gear_stCurrentGearN_C Gear_stCurrentGearP_C /end REF_CHARACTERISTIC /end GROUP
/begin GROUP S4110_Gear_PGear "VBU0428Test/VBUSystem/VCU /VehINP/VehINP_Logic/GearShift/Gear1/Gear_Status/Gear_PGear" /begin REF_CHARACTERISTIC Gear_stCurrentGearN_C Gear_stCurrentGearP_C /end REF_CHARACTERISTIC /end GROUP
/begin GROUP S4110_Gear_PGear1 "VBU0428Test/VBUSystem/VCU /VehINP/VehINP_Logic/GearShift/Gear1/Gear_Status/Gear_PGear1" /begin REF_CHARACTERISTIC Gear_stCurrentGearN_C Gear_stCurrentGearP_C /end REF_CHARACTERISTIC /end GROUP
/begin GROUP S4282_Veh_HVILCheck "VBU0428Test/VBUSystem/VCU /VehINP/VehINP_Logic/Veh_Status/VehHVIL/HVIL/Veh_HVILCheck" /begin REF_CHARACTERISTIC Veh_tiSampleTime_C /end REF_CHARACTERISTIC /end GROUP
/begin GROUP S4282_Veh_VCUHVIL "VBU0428Test/VBUSystem/VCU /VehINP/VehINP_Logic/Veh_Status/VehHVIL/HVIL/Veh_VCUHVIL" /begin REF_CHARACTERISTIC Veh_tiSampleTime_C /end REF_CHARACTERISTIC /end GROUP
/begin GROUP S480_Determine_Diagnostic_Status "VBU0428Test/VBUSystem/BMS/CTD/Subsystem/Subsystem4/Stuck_Open_Diagnostic/MNC_Stuck_Open/MNC_Stuck_Open_With_VehicleSpeed/Determine_Diagnostic_Status" /begin REF_CHARACTERISTIC DIAGNOSTIC_COMPLETE DIAGNOSTIC_CONDITION_NOT_MET /end REF_CHARACTERISTIC /end GROUP
/begin GROUP S504_Determine_Diagnostic_Status "VBU0428Test/VBUSystem/BMS/CTD/Subsystem/Subsystem4/Stuck_Open_Diagnostic/MPC_Stuck_Open/MPC_Stuck_Open_Without_VehicleSpeed/Determine_Diagnostic_Status" /begin REF_CHARACTERISTIC DIAGNOSTIC_COMPLETE DIAGNOSTIC_CONDITION_NOT_MET /end REF_CHARACTERISTIC /end GROUP
/begin GROUP S841_FullCharge_criteria1 "VBU0428Test/VBUSystem/BMS/FCC /FCC/Subsystem/Fastcharge_Conditions_Check/Condition_Categorize/Full_Charge_Determination/FullCharge_criteria1" /begin REF_CHARACTERISTIC SAMPLE_TIME_TASK_D /end REF_CHARACTERISTIC /end GROUP
/begin GROUP S841_FullCharge_criteria2 "VBU0428Test/VBUSystem/BMS/FCC /FCC/Subsystem/Fastcharge_Conditions_Check/Condition_Categorize/Full_Charge_Determination/FullCharge_criteria2" /begin REF_CHARACTERISTIC SAMPLE_TIME_TASK_D /end REF_CHARACTERISTIC /end GROUP
/begin GROUP S841_FullCharge_criteria4 "VBU0428Test/VBUSystem/BMS/FCC /FCC/Subsystem/Fastcharge_Conditions_Check/Condition_Categorize/Full_Charge_Determination/FullCharge_criteria4" /begin REF_CHARACTERISTIC SAMPLE_TIME_TASK_D /end REF_CHARACTERISTIC /end GROUP
/begin GROUP S1053_Calculate_WindowAverage_BatteryCurrent "VBU0428Test/VBUSystem/BMS/SOC/Subsystem5/Subsystem/Determine_FastChargeCorrection_Soc/FastCharge_DynamicCorrection/FastCharge_DynamicCorrection_Enable/Calculate_WindowAverage_BatteryCurrent" /begin REF_CHARACTERISTIC SAMPLE_TIME_TASK_D /end REF_CHARACTERISTIC /end GROUP
/begin GROUP S1053_Determine_CurrentStable_Condition "VBU0428Test/VBUSystem/BMS/SOC/Subsystem5/Subsystem/Determine_FastChargeCorrection_Soc/FastCharge_DynamicCorrection/FastCharge_DynamicCorrection_Enable/Determine_CurrentStable_Condition" /begin REF_CHARACTERISTIC SAMPLE_TIME_TASK_D /end REF_CHARACTERISTIC /end GROUP
/begin GROUP S1197_Determine_SOCP_Condition "VBU0428Test/VBUSystem/BMS/SOF/Subsystem6/Subsystem/Calculate_PowerLimit/Determine_SOCP_PowerLimit/Determine_ContinuousDischargePowerLimitTarget/Determine_SOCP_Condition" /begin REF_CHARACTERISTIC SAMPLE_TIME_TASK_D /end REF_CHARACTERISTIC /end GROUP
/begin GROUP S1198_Determine_SOCP_Condition "VBU0428Test/VBUSystem/BMS/SOF/Subsystem6/Subsystem/Calculate_PowerLimit/Determine_SOCP_PowerLimit/Determine_DischargePowerLimitTarget/Determine_SOCP_Condition" /begin REF_CHARACTERISTIC SAMPLE_TIME_TASK_D /end REF_CHARACTERISTIC /end GROUP
/begin GROUP S1212_Determine_LowVoltageLimitChargeCurrent "VBU0428Test/VBUSystem/BMS/SOF/Subsystem6/Subsystem/Determine_Currentlimit_Target/Calculate_CurrentLimit_Target/Calculate_CurrentLimit_Base/Determine_LowVoltageLimitChargeCurrent" /begin REF_CHARACTERISTIC SAMPLE_TIME_TASK_D /end REF_CHARACTERISTIC /end GROUP
/begin GROUP S1214_FastChrgOneThirdRateCurrentLimitCheck "VBU0428Test/VBUSystem/BMS/SOF/Subsystem6/Subsystem/Determine_Currentlimit_Target/Calculate_CurrentLimit_Target/CurrentLimit_FastCharge_Check/FastChrgOneThirdRateCurrentLimitCheck" /begin REF_CHARACTERISTIC SAMPLE_TIME_TASK_D /end REF_CHARACTERISTIC /end GROUP
/begin GROUP S1215_Determine_StopCharge_Condition "VBU0428Test/VBUSystem/BMS/SOF/Subsystem6/Subsystem/Determine_Currentlimit_Target/Calculate_CurrentLimit_Target/CurrentLimit_Fault_Correct/Determine_StopCharge_Condition" /begin REF_CHARACTERISTIC SAMPLE_TIME_TASK_D /end REF_CHARACTERISTIC /end GROUP
/begin GROUP S1443_Determine_AhIntegral_Q "VBU0428Test/VBUSystem/BMS/SOH/Subsystem4/Subsystem1/Calculate_Capacity/Calculate_CellCapacity_SlowCharge/Determine_AhIntegral_DeltaQ/Determine_AhIntegral_Q" /begin REF_CHARACTERISTIC SAMPLE_TIME_TASK_D /end REF_CHARACTERISTIC /end GROUP
/begin GROUP S1482_DuringStep_AfterStep_Check "VBU0428Test/VBUSystem/BMS/SOH/Subsystem4/Subsystem1/Calculate_Resistance/BasicCellResistance_Calculation_Check/BeforStep_DuringStep_AfterStep_Check/DuringStep_AfterStep_Check" /begin REF_CHARACTERISTIC SAMPLE_TIME_TASK_D /end REF_CHARACTERISTIC /end GROUP
/begin GROUP S1498_Determine_FCCPulseCurrent_Condition "VBU0428Test/VBUSystem/BMS/SOH/Subsystem4/Subsystem1/Calculate_Resistance/Determine_Condition_Calculate_Pulse_Average_CurrentVoltage/Determine_Condition/Determine_FCCPulseCurrent_Condition" /begin REF_CHARACTERISTIC SAMPLE_TIME_TASK_D /end REF_CHARACTERISTIC /end GROUP
/begin GROUP S1498_Determine_OBCPulseCurrent_Condition "VBU0428Test/VBUSystem/BMS/SOH/Subsystem4/Subsystem1/Calculate_Resistance/Determine_Condition_Calculate_Pulse_Average_CurrentVoltage/Determine_Condition/Determine_OBCPulseCurrent_Condition" /begin REF_CHARACTERISTIC SAMPLE_TIME_TASK_D /end REF_CHARACTERISTIC /end GROUP
/begin GROUP S1263_Calculate_Dynamic_DischargeCurrentLimit "VBU0428Test/VBUSystem/BMS/SOF/Subsystem6/Subsystem/Determine_Currentlimit_Target/Calculate_CurrentLimit_Target/Calculate_Dynamic_CurrentLimit/Calculate_Dynamic_DischargeCurrentLimit/Calculate_Dynamic_DischargeCurrentLimit" /begin REF_CHARACTERISTIC SAMPLE_TIME_TASK_D /end REF_CHARACTERISTIC /end GROUP
/begin GROUP S1319_Calculate_CurrentLimit "VBU0428Test/VBUSystem/BMS/SOF/Subsystem6/Subsystem/Determine_Currentlimit_Target/Calculate_CurrentLimit_Target/CurrentLimit_Voltage_Correct/Correct_CurrentLimit/Calculate_CurrentLimit" /begin REF_CHARACTERISTIC SAMPLE_TIME_TASK_D /end REF_CHARACTERISTIC /end GROUP
/begin GROUP S1449_Determine_Cell_Balanced_Capacity "VBU0428Test/VBUSystem/BMS/SOH/Subsystem4/Subsystem1/Calculate_Capacity/Calculate_CellCapacity_SlowCharge/Determine_AhIntegral_DeltaQ/Determine_AhIntegral_Q/Determine_Cell_Balanced_Capacity" /begin REF_CHARACTERISTIC SAMPLE_TIME_TASK_D /end REF_CHARACTERISTIC /end GROUP
/begin GROUP S1264_Calculate_ChargeCurrentLimitBuffer_Use "VBU0428Test/VBUSystem/BMS/SOF/Subsystem6/Subsystem/Determine_Currentlimit_Target/Calculate_CurrentLimit_Target/Calculate_Dynamic_CurrentLimit/Calculate_Dynamic_ChargeCurrentLimit/Calculate_ChargeCurrentLimit_Buff/Calculate_ChargeCurrentLimitBuffer_Use" /begin REF_CHARACTERISTIC SAMPLE_TIME_TASK_D /end REF_CHARACTERISTIC /end GROUP
/begin GROUP S1272_Calculate_DischargeCurrentLimitBuffer_Use "VBU0428Test/VBUSystem/BMS/SOF/Subsystem6/Subsystem/Determine_Currentlimit_Target/Calculate_CurrentLimit_Target/Calculate_Dynamic_CurrentLimit/Calculate_Dynamic_DischargeCurrentLimit/Calculate_DischargeCurrentLimit_Buff/Calculate_DischargeCurrentLimitBuffer_Use" /begin REF_CHARACTERISTIC SAMPLE_TIME_TASK_D /end REF_CHARACTERISTIC /end GROUP
/begin GROUP S1273_Rate_Limiter "VBU0428Test/VBUSystem/BMS/SOF/Subsystem6/Subsystem/Determine_Currentlimit_Target/Calculate_CurrentLimit_Target/Calculate_Dynamic_CurrentLimit/Calculate_Dynamic_DischargeCurrentLimit/Calculate_Dynamic_DischargeCurrentLimit/Rate_Limiter" /begin REF_CHARACTERISTIC SAMPLE_TIME_TASK_D /end REF_CHARACTERISTIC /end GROUP
/begin GROUP S1321_Rate_Limiter1 "VBU0428Test/VBUSystem/BMS/SOF/Subsystem6/Subsystem/Determine_Currentlimit_Target/Calculate_CurrentLimit_Target/CurrentLimit_Voltage_Correct/Correct_CurrentLimit/Calculate_CurrentLimit/Rate_Limiter1" /begin REF_CHARACTERISTIC SAMPLE_TIME_TASK_D /end REF_CHARACTERISTIC /end GROUP
/begin GROUP S1322_Set_ChargeVoltageCorrect_level1 "VBU0428Test/VBUSystem/BMS/SOF/Subsystem6/Subsystem/Determine_Currentlimit_Target/Calculate_CurrentLimit_Target/CurrentLimit_Voltage_Correct/Correct_CurrentLimit/Determine_VoltageCorrect_level/Set_ChargeVoltageCorrect_level1" /begin REF_CHARACTERISTIC SAMPLE_TIME_TASK_D /end REF_CHARACTERISTIC /end GROUP
/begin GROUP S1322_Set_ChargeVoltageCorrect_level2 "VBU0428Test/VBUSystem/BMS/SOF/Subsystem6/Subsystem/Determine_Currentlimit_Target/Calculate_CurrentLimit_Target/CurrentLimit_Voltage_Correct/Correct_CurrentLimit/Determine_VoltageCorrect_level/Set_ChargeVoltageCorrect_level2" /begin REF_CHARACTERISTIC SAMPLE_TIME_TASK_D /end REF_CHARACTERISTIC /end GROUP
/begin GROUP S1322_Set_ChargeVoltageCorrect_level3 "VBU0428Test/VBUSystem/BMS/SOF/Subsystem6/Subsystem/Determine_Currentlimit_Target/Calculate_CurrentLimit_Target/CurrentLimit_Voltage_Correct/Correct_CurrentLimit/Determine_VoltageCorrect_level/Set_ChargeVoltageCorrect_level3" /begin REF_CHARACTERISTIC SAMPLE_TIME_TASK_D /end REF_CHARACTERISTIC /end GROUP
/begin GROUP S1322_Set_ChargeVoltageCorrect_level4 "VBU0428Test/VBUSystem/BMS/SOF/Subsystem6/Subsystem/Determine_Currentlimit_Target/Calculate_CurrentLimit_Target/CurrentLimit_Voltage_Correct/Correct_CurrentLimit/Determine_VoltageCorrect_level/Set_ChargeVoltageCorrect_level4" /begin REF_CHARACTERISTIC SAMPLE_TIME_TASK_D /end REF_CHARACTERISTIC /end GROUP
/begin GROUP S1322_Set_DischargeVoltageCorrect_level1 "VBU0428Test/VBUSystem/BMS/SOF/Subsystem6/Subsystem/Determine_Currentlimit_Target/Calculate_CurrentLimit_Target/CurrentLimit_Voltage_Correct/Correct_CurrentLimit/Determine_VoltageCorrect_level/Set_DischargeVoltageCorrect_level1" /begin REF_CHARACTERISTIC SAMPLE_TIME_TASK_D /end REF_CHARACTERISTIC /end GROUP
/begin GROUP S1322_Set_DischargeVoltageCorrect_level2 "VBU0428Test/VBUSystem/BMS/SOF/Subsystem6/Subsystem/Determine_Currentlimit_Target/Calculate_CurrentLimit_Target/CurrentLimit_Voltage_Correct/Correct_CurrentLimit/Determine_VoltageCorrect_level/Set_DischargeVoltageCorrect_level2" /begin REF_CHARACTERISTIC SAMPLE_TIME_TASK_D /end REF_CHARACTERISTIC /end GROUP
/begin GROUP S1322_Set_DischargeVoltageCorrect_level3 "VBU0428Test/VBUSystem/BMS/SOF/Subsystem6/Subsystem/Determine_Currentlimit_Target/Calculate_CurrentLimit_Target/CurrentLimit_Voltage_Correct/Correct_CurrentLimit/Determine_VoltageCorrect_level/Set_DischargeVoltageCorrect_level3" /begin REF_CHARACTERISTIC SAMPLE_TIME_TASK_D /end REF_CHARACTERISTIC /end GROUP
/begin GROUP S1322_Set_DischargeVoltageCorrect_level4 "VBU0428Test/VBUSystem/BMS/SOF/Subsystem6/Subsystem/Determine_Currentlimit_Target/Calculate_CurrentLimit_Target/CurrentLimit_Voltage_Correct/Correct_CurrentLimit/Determine_VoltageCorrect_level/Set_DischargeVoltageCorrect_level4" /begin REF_CHARACTERISTIC SAMPLE_TIME_TASK_D /end REF_CHARACTERISTIC /end GROUP
/end MODULE
/end PROJECT
