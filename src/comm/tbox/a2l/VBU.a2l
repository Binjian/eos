ASAP2_VERSION 1 31
/begin PROJECT ProjectName "Project Comment Goes Here"
/begin HEADER "Header Comments go here" /end HEADER
/begin MODULE ModuleName "Module Comment Goes Here"
/begin MOD_COMMON "Mod Common Comment Here" BYTE_ORDER MSB_LAST /end MOD_COMMON
/begin RECORD_LAYOUT Scalar_BOOLEAN FNC_VALUES 1 UBYTE COLUMN_DIR DIRECT /end RECORD_LAYOUT
/begin RECORD_LAYOUT Scalar_UBYTE FNC_VALUES 1 UBYTE COLUMN_DIR DIRECT /end RECORD_LAYOUT
/begin RECORD_LAYOUT Scalar_BYTE FNC_VALUES 1 SBYTE COLUMN_DIR DIRECT /end RECORD_LAYOUT
/begin RECORD_LAYOUT Scalar_UWORD FNC_VALUES 1 UWORD COLUMN_DIR DIRECT /end RECORD_LAYOUT
/begin RECORD_LAYOUT Scalar_ULONG FNC_VALUES 1 ULONG COLUMN_DIR DIRECT /end RECORD_LAYOUT
/begin RECORD_LAYOUT Scalar_FLOAT32_IEEE FNC_VALUES 1 FLOAT32_IEEE COLUMN_DIR DIRECT /end RECORD_LAYOUT
/begin RECORD_LAYOUT Scalar_FLOAT64_IEEE FNC_VALUES 1 FLOAT64_IEEE COLUMN_DIR DIRECT /end RECORD_LAYOUT
/begin RECORD_LAYOUT Lookup1D_X_BYTE AXIS_PTS_X 1 SBYTE INDEX_INCR DIRECT /end RECORD_LAYOUT
/begin RECORD_LAYOUT Lookup1D_UBYTE FNC_VALUES 1 UBYTE COLUMN_DIR DIRECT /end RECORD_LAYOUT
/begin RECORD_LAYOUT Lookup1D_FLOAT32_IEEE FNC_VALUES 1 FLOAT32_IEEE COLUMN_DIR DIRECT /end RECORD_LAYOUT
/begin RECORD_LAYOUT Lookup1D_X_FLOAT32_IEEE AXIS_PTS_X 1 FLOAT32_IEEE INDEX_INCR DIRECT /end RECORD_LAYOUT
/begin RECORD_LAYOUT Lookup2D_FLOAT32_IEEE FNC_VALUES 1 FLOAT32_IEEE COLUMN_DIR DIRECT /end RECORD_LAYOUT
/begin RECORD_LAYOUT Lookup2D_X_FLOAT32_IEEE AXIS_PTS_X 1 FLOAT32_IEEE INDEX_INCR DIRECT /end RECORD_LAYOUT
/begin CHARACTERISTIC THM_nComprssrActvCool_v "" CURVE 0x70012272 Lookup1D_FLOAT32_IEEE 0 VBU0513_CM_single_cnt -3.4028234663852886E+38 3.4028234663852886E+38
 /begin AXIS_DESCR COM_AXIS NO_INPUT_QUANTITY VBU0513_CM_single_cnt 6 -3.4028234663852886E+38 3.4028234663852886E+38 AXIS_PTS_REF THM_tActvCoolTarDeltaTemp_x /end AXIS_DESCR
/end CHARACTERISTIC
/begin AXIS_PTS THM_tActvCoolTarDeltaTemp_x "" 0x7001234a NO_INPUT_QUANTITY Lookup1D_X_FLOAT32_IEEE 0 VBU0513_CM_single_cnt 6 -3.4028234663852886E+38 3.4028234663852886E+38 /end AXIS_PTS
/begin CHARACTERISTIC THM_pctEVXDeltaTemp_v "" CURVE 0x700122ba Lookup1D_FLOAT32_IEEE 0 VBU0513_CM_single_cnt -3.4028234663852886E+38 3.4028234663852886E+38
 /begin AXIS_DESCR COM_AXIS NO_INPUT_QUANTITY VBU0513_CM_single_cnt 6 -3.4028234663852886E+38 3.4028234663852886E+38 AXIS_PTS_REF THM_tCoolEVXDeltaTemp_x /end AXIS_DESCR
/end CHARACTERISTIC
/begin AXIS_PTS THM_tCoolEVXDeltaTemp_x "" 0x70012362 NO_INPUT_QUANTITY Lookup1D_X_FLOAT32_IEEE 0 VBU0513_CM_single_cnt 6 -3.4028234663852886E+38 3.4028234663852886E+38 /end AXIS_PTS
/begin CHARACTERISTIC THM_pctFANRearPump_v "" CURVE 0x700122ea Lookup1D_FLOAT32_IEEE 0 VBU0513_CM_single_cnt -3.4028234663852886E+38 3.4028234663852886E+38
 /begin AXIS_DESCR COM_AXIS THM_pctRearPmpCmdRaw VBU0513_CM_single_cnt 6 -3.4028234663852886E+38 3.4028234663852886E+38 AXIS_PTS_REF THM_pctFANRearPump_x /end AXIS_DESCR
/end CHARACTERISTIC
/begin AXIS_PTS THM_pctFANRearPump_x "" 0x70012302 THM_pctRearPmpCmdRaw Lookup1D_X_FLOAT32_IEEE 0 VBU0513_CM_single_cnt 6 -3.4028234663852886E+38 3.4028234663852886E+38 /end AXIS_PTS
/begin CHARACTERISTIC THM_pctFANEDSInletTemp_v "" CURVE 0x700126b6 Lookup1D_FLOAT32_IEEE 0 VBU0513_CM_single_cnt -3.4028234663852886E+38 3.4028234663852886E+38
 /begin AXIS_DESCR COM_AXIS INP_tEDSInletCoolTemp VBU0513_CM_single_cnt 8 -3.4028234663852886E+38 3.4028234663852886E+38 AXIS_PTS_REF THM_tFANEDSInletTemp_x /end AXIS_DESCR
/end CHARACTERISTIC
/begin AXIS_PTS THM_tFANEDSInletTemp_x "" 0x700126d6 INP_tEDSInletCoolTemp Lookup1D_X_FLOAT32_IEEE 0 VBU0513_CM_single_cnt 8 -3.4028234663852886E+38 3.4028234663852886E+38 /end AXIS_PTS
/begin CHARACTERISTIC THM_pctFANACSpdSet_v "" CURVE 0x700122d2 Lookup1D_FLOAT32_IEEE 0 VBU0513_CM_single_cnt -3.4028234663852886E+38 3.4028234663852886E+38
 /begin AXIS_DESCR COM_AXIS THM_nACSpdSet VBU0513_CM_single_cnt 6 -3.4028234663852886E+38 3.4028234663852886E+38 AXIS_PTS_REF THM_nFANACSpdSet_x /end AXIS_DESCR
/end CHARACTERISTIC
/begin AXIS_PTS THM_nFANACSpdSet_x "" 0x7001228a THM_nACSpdSet Lookup1D_X_FLOAT32_IEEE 0 VBU0513_CM_single_cnt 6 -3.4028234663852886E+38 3.4028234663852886E+38 /end AXIS_PTS
/begin CHARACTERISTIC TQD_trqDrvBrkRgn_MAP_V "" MAP 0x70016926 Lookup2D_FLOAT32_IEEE 0 VBU0513_CM_single_Nm -3000.0 2000.0
 /begin AXIS_DESCR COM_AXIS TQD_pBrkPressFlt VBU0513_CM_single_bar 10 0.0 100.0 AXIS_PTS_REF TQD_pBrkDrvPressFlt /end AXIS_DESCR
 /begin AXIS_DESCR COM_AXIS TQD_vVehSpd VBU0513_CM_single_kph 13 0.0 140.0 AXIS_PTS_REF TQD_vBrkPressVehSpd /end AXIS_DESCR
/end CHARACTERISTIC
/begin AXIS_PTS TQD_vBrkPressVehSpd "" 0x70013896 TQD_vVehSpd Lookup2D_X_FLOAT32_IEEE 0 VBU0513_CM_single_kph 13 0.0 140.0 /end AXIS_PTS
/begin AXIS_PTS TQD_pBrkDrvPressFlt "" 0x70012cb6 TQD_pBrkPressFlt Lookup2D_X_FLOAT32_IEEE 0 VBU0513_CM_single_bar 10 0.0 100.0 /end AXIS_PTS
/begin CHARACTERISTIC TQD_trqRvsBrkRgn_MAP_V "" MAP 0x70016b2e Lookup2D_FLOAT32_IEEE 0 VBU0513_CM_single_Nm -3000.0 2000.0
 /begin AXIS_DESCR COM_AXIS TQD_vVehSpd VBU0513_CM_single_cnt 10 0.0 100.0 AXIS_PTS_REF TQD_pBrkRvsPressFlt /end AXIS_DESCR
 /begin AXIS_DESCR COM_AXIS TQD_pBrkPressFlt VBU0513_CM_single_kph 13 0.0 140.0 AXIS_PTS_REF TQD_vBrkPressVehSpd /end AXIS_DESCR
/end CHARACTERISTIC
/begin AXIS_PTS TQD_pBrkRvsPressFlt "" 0x70012cde TQD_vVehSpd Lookup2D_X_FLOAT32_IEEE 0 VBU0513_CM_single_cnt 10 0.0 100.0 /end AXIS_PTS
/begin CHARACTERISTIC CaCVT_CellVoltageOverDeviationCurrentMapZ_A "" MAP 0x700153b2 Lookup2D_FLOAT32_IEEE 0 VBU0513_CM_single_cnt -3.4028234663852886E+38 3.4028234663852886E+38
 /begin AXIS_DESCR COM_AXIS SOC_pctBatterySoc VBU0513_CM_single_cnt 6 -3.4028234663852886E+38 3.4028234663852886E+38 AXIS_PTS_REF CaCVT_CellVoltageOverDeviationCurrentMapY_pct /end AXIS_DESCR
 /begin AXIS_DESCR COM_AXIS CTM_tCellTempMin VBU0513_CM_single_cnt 8 -3.4028234663852886E+38 3.4028234663852886E+38 AXIS_PTS_REF CaCVT_CellVoltageOverDeviationCurrentMapX_C /end AXIS_DESCR
/end CHARACTERISTIC
/begin AXIS_PTS CaCVT_CellVoltageOverDeviationCurrentMapX_C "" 0x700125f6 CTM_tCellTempMin Lookup2D_X_FLOAT32_IEEE 0 VBU0513_CM_single_cnt 8 -3.4028234663852886E+38 3.4028234663852886E+38 /end AXIS_PTS
/begin AXIS_PTS CaCVT_CellVoltageOverDeviationCurrentMapY_pct "" 0x70012122 SOC_pctBatterySoc Lookup2D_X_FLOAT32_IEEE 0 VBU0513_CM_single_cnt 6 -3.4028234663852886E+38 3.4028234663852886E+38 /end AXIS_PTS
/begin CHARACTERISTIC CaFCC_ChargeCurrentOverFactorMapY_nbr "" CURVE 0x70011bfa Lookup1D_FLOAT32_IEEE 0 VBU0513_CM_single_cnt -3.4028234663852886E+38 3.4028234663852886E+38
 /begin AXIS_DESCR COM_AXIS CTM_tCellTempMin VBU0513_CM_single_cnt 4 -3.4028234663852886E+38 3.4028234663852886E+38 AXIS_PTS_REF CaFCC_ChargeCurrentOverFactorMapX_C /end AXIS_DESCR
/end CHARACTERISTIC
/begin AXIS_PTS CaFCC_ChargeCurrentOverFactorMapX_C "" 0x70011bea CTM_tCellTempMin Lookup1D_X_FLOAT32_IEEE 0 VBU0513_CM_single_cnt 4 -3.4028234663852886E+38 3.4028234663852886E+38 /end AXIS_PTS
/begin CHARACTERISTIC TQD_flgBrkRgnConfig_C "" VALUE 0x700118c0 Scalar_FLOAT64_IEEE 0 VBU0513_CM_double -1.7E+308 1.7E+308 /end CHARACTERISTIC
/begin CHARACTERISTIC APO_fACPumpOvrdVal_C "" VALUE 0x7001021c Scalar_FLOAT32_IEEE 0 VBU0513_CM_single_cnt -3.4028234663852886E+38 3.4028234663852886E+38 /end CHARACTERISTIC
/begin CHARACTERISTIC APO_fFanOvrdVal_C "" VALUE 0x70010220 Scalar_FLOAT32_IEEE 0 VBU0513_CM_single_cnt -3.4028234663852886E+38 3.4028234663852886E+38 /end CHARACTERISTIC
/begin CHARACTERISTIC APO_fHVIL1OvrdVal_C "" VALUE 0x70010224 Scalar_FLOAT32_IEEE 0 VBU0513_CM_single_cnt -3.4028234663852886E+38 3.4028234663852886E+38 /end CHARACTERISTIC
/begin CHARACTERISTIC APO_fVacuumPumpOvrdVal_C "" VALUE 0x70010228 Scalar_FLOAT32_IEEE 0 VBU0513_CM_single_cnt -3.4028234663852886E+38 3.4028234663852886E+38 /end CHARACTERISTIC
/begin CHARACTERISTIC APO_fWaterPump1OvrdVal_C "" VALUE 0x7001022c Scalar_FLOAT32_IEEE 0 VBU0513_CM_single_cnt -3.4028234663852886E+38 3.4028234663852886E+38 /end CHARACTERISTIC
/begin CHARACTERISTIC APO_fWaterPump2OvrdVal_C "" VALUE 0x70010230 Scalar_FLOAT32_IEEE 0 VBU0513_CM_single_cnt -3.4028234663852886E+38 3.4028234663852886E+38 /end CHARACTERISTIC
/begin CHARACTERISTIC APO_pctACPumpOvrdVal_C "" VALUE 0x70010244 Scalar_FLOAT32_IEEE 0 VBU0513_CM_single_cnt -3.4028234663852886E+38 3.4028234663852886E+38 /end CHARACTERISTIC
/begin CHARACTERISTIC APO_pctFanOvrdVal_C "" VALUE 0x70010258 Scalar_FLOAT32_IEEE 0 VBU0513_CM_single_cnt -3.4028234663852886E+38 3.4028234663852886E+38 /end CHARACTERISTIC
/begin CHARACTERISTIC APO_pctHVIL1OvrdVal_C "" VALUE 0x7001025c Scalar_FLOAT32_IEEE 0 VBU0513_CM_single_cnt -3.4028234663852886E+38 3.4028234663852886E+38 /end CHARACTERISTIC
/begin CHARACTERISTIC APO_pctWaterPump1OvrdVal_C "" VALUE 0x70010260 Scalar_FLOAT32_IEEE 0 VBU0513_CM_single_cnt -3.4028234663852886E+38 3.4028234663852886E+38 /end CHARACTERISTIC
/begin CHARACTERISTIC APO_pctWaterPump2OvrdVal_C "" VALUE 0x70010264 Scalar_FLOAT32_IEEE 0 VBU0513_CM_single_cnt -3.4028234663852886E+38 3.4028234663852886E+38 /end CHARACTERISTIC
/begin CHARACTERISTIC CaBMM_HALKL30BMUVoltageORV_V "" VAL_BLK 0x70012a86 Scalar_FLOAT32_IEEE 0 VBU0513_CM_single_cnt -3.4028234663852886E+38 3.4028234663852886E+38 NUMBER 10 /end CHARACTERISTIC
/begin CHARACTERISTIC CcBCV_HALBatteryVoltageORV_V "" VALUE 0x70010538 Scalar_FLOAT32_IEEE 0 VBU0513_CM_single_cnt -3.4028234663852886E+38 3.4028234663852886E+38 /end CHARACTERISTIC
/begin CHARACTERISTIC CcBCV_HALBusNegativeVoltageORV_V "" VALUE 0x7001053c Scalar_FLOAT32_IEEE 0 VBU0513_CM_single_cnt -3.4028234663852886E+38 3.4028234663852886E+38 /end CHARACTERISTIC
/begin CHARACTERISTIC CcBCV_HALFuseVoltageORV_V "" VALUE 0x70010540 Scalar_FLOAT32_IEEE 0 VBU0513_CM_single_cnt -3.4028234663852886E+38 3.4028234663852886E+38 /end CHARACTERISTIC
/begin CHARACTERISTIC CcBCV_HALPrechargeVoltageORV_V "" VALUE 0x70010544 Scalar_FLOAT32_IEEE 0 VBU0513_CM_single_cnt -3.4028234663852886E+38 3.4028234663852886E+38 /end CHARACTERISTIC
/begin CHARACTERISTIC CcBCV_HALVx2VoltageORV_V "" VALUE 0x70010548 Scalar_FLOAT32_IEEE 0 VBU0513_CM_single_cnt -3.4028234663852886E+38 3.4028234663852886E+38 /end CHARACTERISTIC
/begin CHARACTERISTIC CcBMM_HALKL30BMUVoltageLow_V "" VALUE 0x70010554 Scalar_FLOAT32_IEEE 0 VBU0513_CM_single_cnt -3.4028234663852886E+38 3.4028234663852886E+38 /end CHARACTERISTIC
/begin CHARACTERISTIC CcBMM_SOCJumpThreshold_pct "" VALUE 0x7001055c Scalar_FLOAT32_IEEE 0 VBU0513_CM_single_cnt -3.4028234663852886E+38 3.4028234663852886E+38 /end CHARACTERISTIC
/begin CHARACTERISTIC CcCBL_BoardTempBalanceStartMaxHysteresis_C "" VALUE 0x70010578 Scalar_FLOAT32_IEEE 0 VBU0513_CM_single_cnt -3.4028234663852886E+38 3.4028234663852886E+38 /end CHARACTERISTIC
/begin CHARACTERISTIC CcCBL_BoardTempBalanceStartMax_C "" VALUE 0x7001057c Scalar_FLOAT32_IEEE 0 VBU0513_CM_single_cnt -3.4028234663852886E+38 3.4028234663852886E+38 /end CHARACTERISTIC
/begin CHARACTERISTIC CcCBL_CTMBoardTempMaxORV_C "" VALUE 0x70010580 Scalar_FLOAT32_IEEE 0 VBU0513_CM_single_cnt -3.4028234663852886E+38 3.4028234663852886E+38 /end CHARACTERISTIC
/begin CHARACTERISTIC CcCTD_HALSystemVoltageHighDelta_V "" VALUE 0x700105b8 Scalar_FLOAT32_IEEE 0 VBU0513_CM_single_cnt -3.4028234663852886E+38 3.4028234663852886E+38 /end CHARACTERISTIC
/begin CHARACTERISTIC CcCTD_HALSystemVoltageHigh_V "" VALUE 0x700105bc Scalar_FLOAT32_IEEE 0 VBU0513_CM_single_cnt -3.4028234663852886E+38 3.4028234663852886E+38 /end CHARACTERISTIC
/begin CHARACTERISTIC CcCTD_HALSystemVoltageLowDelta_V "" VALUE 0x700105c0 Scalar_FLOAT32_IEEE 0 VBU0513_CM_single_cnt -3.4028234663852886E+38 3.4028234663852886E+38 /end CHARACTERISTIC
/begin CHARACTERISTIC CcCTD_HALSystemVoltageLow_V "" VALUE 0x700105c4 Scalar_FLOAT32_IEEE 0 VBU0513_CM_single_cnt -3.4028234663852886E+38 3.4028234663852886E+38 /end CHARACTERISTIC
/begin CHARACTERISTIC CcCTD_MainFuseBlownDeltaVoltage_V "" VALUE 0x700105cc Scalar_FLOAT32_IEEE 0 VBU0513_CM_single_cnt -3.4028234663852886E+38 3.4028234663852886E+38 /end CHARACTERISTIC
/begin CHARACTERISTIC CcCTD_PrechargeResistanceBlownDeltaVoltage_V "" VALUE 0x70010610 Scalar_FLOAT32_IEEE 0 VBU0513_CM_single_cnt -3.4028234663852886E+38 3.4028234663852886E+38 /end CHARACTERISTIC
/begin CHARACTERISTIC CcCTM_BoardOverTempFault_C "" VALUE 0x70010630 Scalar_FLOAT32_IEEE 0 VBU0513_CM_single_cnt -3.4028234663852886E+38 3.4028234663852886E+38 /end CHARACTERISTIC
/begin CHARACTERISTIC CcCTM_BoardTempInvalidFaultDelayTime_ms "" VALUE 0x70010634 Scalar_FLOAT32_IEEE 0 VBU0513_CM_single_cnt -3.4028234663852886E+38 3.4028234663852886E+38 /end CHARACTERISTIC
/begin CHARACTERISTIC CcCTM_CSCSupplyPowerLowHysteresis_V "" VALUE 0x70010638 Scalar_FLOAT32_IEEE 0 VBU0513_CM_single_cnt -3.4028234663852886E+38 3.4028234663852886E+38 /end CHARACTERISTIC
/begin CHARACTERISTIC CcCTM_CSCSupplyPowerLow_V "" VALUE 0x7001063c Scalar_FLOAT32_IEEE 0 VBU0513_CM_single_cnt -3.4028234663852886E+38 3.4028234663852886E+38 /end CHARACTERISTIC
/begin CHARACTERISTIC CcCTM_CellOverTempEVMFault_C "" VALUE 0x70010640 Scalar_FLOAT32_IEEE 0 VBU0513_CM_single_cnt -3.4028234663852886E+38 3.4028234663852886E+38 /end CHARACTERISTIC
/begin CHARACTERISTIC CcCTM_CellOverTempFault_C "" VALUE 0x70010644 Scalar_FLOAT32_IEEE 0 VBU0513_CM_single_cnt -3.4028234663852886E+38 3.4028234663852886E+38 /end CHARACTERISTIC
/begin CHARACTERISTIC CcCTM_CellOverTempLvl2Fault_C "" VALUE 0x70010648 Scalar_FLOAT32_IEEE 0 VBU0513_CM_single_cnt -3.4028234663852886E+38 3.4028234663852886E+38 /end CHARACTERISTIC
/begin CHARACTERISTIC CcCTM_CellOverTempWarningFault_C "" VALUE 0x70010650 Scalar_FLOAT32_IEEE 0 VBU0513_CM_single_cnt -3.4028234663852886E+38 3.4028234663852886E+38 /end CHARACTERISTIC
/begin CHARACTERISTIC CcCTM_CellTempInvalidFaultDelayTime_ms "" VALUE 0x70010654 Scalar_FLOAT32_IEEE 0 VBU0513_CM_single_cnt -3.4028234663852886E+38 3.4028234663852886E+38 /end CHARACTERISTIC
/begin CHARACTERISTIC CcCTM_CellTempOverDeviationEVMFault_C "" VALUE 0x70010658 Scalar_FLOAT32_IEEE 0 VBU0513_CM_single_cnt -3.4028234663852886E+38 3.4028234663852886E+38 /end CHARACTERISTIC
/begin CHARACTERISTIC CcCTM_CellUnderTempFault_C "" VALUE 0x70010660 Scalar_FLOAT32_IEEE 0 VBU0513_CM_single_cnt -3.4028234663852886E+38 3.4028234663852886E+38 /end CHARACTERISTIC
/begin CHARACTERISTIC CcCTM_EnableEVMTempDevDelayTime_ms "" VALUE 0x70010664 Scalar_FLOAT32_IEEE 0 VBU0513_CM_single_cnt -3.4028234663852886E+38 3.4028234663852886E+38 /end CHARACTERISTIC
/begin CHARACTERISTIC CcCTM_EnableEVMTempDevThreshold_A "" VALUE 0x70010668 Scalar_FLOAT32_IEEE 0 VBU0513_CM_single_cnt -3.4028234663852886E+38 3.4028234663852886E+38 /end CHARACTERISTIC
/begin CHARACTERISTIC CcCTM_PowerOnTempVoltageDelay_ms "" VALUE 0x7001066c Scalar_FLOAT32_IEEE 0 VBU0513_CM_single_cnt -3.4028234663852886E+38 3.4028234663852886E+38 /end CHARACTERISTIC
/begin CHARACTERISTIC CcCTS_DeltaVoltagePrecharge_V "" VALUE 0x70010690 Scalar_FLOAT32_IEEE 0 VBU0513_CM_single_cnt 0.0 800.0 /end CHARACTERISTIC
/begin CHARACTERISTIC CcCTS_OpenContactorsDelayTime_ms "" VALUE 0x70010694 Scalar_FLOAT32_IEEE 0 VBU0513_CM_single_cnt -3.4028234663852886E+38 3.4028234663852886E+38 /end CHARACTERISTIC
/begin CHARACTERISTIC CcCTS_PrechargeTimerLimit_ms "" VALUE 0x70010698 Scalar_FLOAT32_IEEE 0 VBU0513_CM_single_cnt -3.4028234663852886E+38 3.4028234663852886E+38 /end CHARACTERISTIC
/begin CHARACTERISTIC CcCTS_PrechargeTimer_ms "" VALUE 0x7001069c Scalar_FLOAT32_IEEE 0 VBU0513_CM_single_cnt -3.4028234663852886E+38 3.4028234663852886E+38 /end CHARACTERISTIC
/begin CHARACTERISTIC CcCVT_CSCSupplyPowerLowHysteresis_V "" VALUE 0x700106a8 Scalar_FLOAT32_IEEE 0 VBU0513_CM_single_V -3.4028234663852886E+38 3.4028234663852886E+38 /end CHARACTERISTIC
/begin CHARACTERISTIC CcCVT_CSCSupplyPowerLow_V "" VALUE 0x700106ac Scalar_FLOAT32_IEEE 0 VBU0513_CM_single_V -3.4028234663852886E+38 3.4028234663852886E+38 /end CHARACTERISTIC
/begin CHARACTERISTIC CcCVT_CellUnderVoltageLowTemp_C "" VALUE 0x700106b4 Scalar_FLOAT32_IEEE 0 VBU0513_CM_single_cnt -3.4028234663852886E+38 3.4028234663852886E+38 /end CHARACTERISTIC
/begin CHARACTERISTIC CcCVT_CellVoltageOverDeviationDisableCrrnt_A "" VALUE 0x700106b8 Scalar_FLOAT32_IEEE 0 VBU0513_CM_single_A -3.4028234663852886E+38 3.4028234663852886E+38 /end CHARACTERISTIC
/begin CHARACTERISTIC CcFCC_ChargeAbortDelayTime_s "" VALUE 0x700106e8 Scalar_FLOAT32_IEEE 0 VBU0513_CM_single_cnt -3.4028234663852886E+38 3.4028234663852886E+38 /end CHARACTERISTIC
/begin CHARACTERISTIC CcFCC_ChargeCurrentOverDelta_A "" VALUE 0x700106fc Scalar_FLOAT32_IEEE 0 VBU0513_CM_single_cnt -3.4028234663852886E+38 3.4028234663852886E+38 /end CHARACTERISTIC
/begin CHARACTERISTIC CcFCC_ChargeCurrentOver_A "" VALUE 0x70010700 Scalar_FLOAT32_IEEE 0 VBU0513_CM_single_cnt -3.4028234663852886E+38 3.4028234663852886E+38 /end CHARACTERISTIC
/begin CHARACTERISTIC CcFCC_ChargeFaultDelayTime_s "" VALUE 0x70010708 Scalar_FLOAT32_IEEE 0 VBU0513_CM_single_cnt -3.4028234663852886E+38 3.4028234663852886E+38 /end CHARACTERISTIC
/begin CHARACTERISTIC CcFCC_ChargeFullDelayTime_s "" VALUE 0x7001070c Scalar_FLOAT32_IEEE 0 VBU0513_CM_single_cnt -3.4028234663852886E+38 3.4028234663852886E+38 /end CHARACTERISTIC
/begin CHARACTERISTIC CcFCC_ChargeProtectDelayTime_s "" VALUE 0x70010718 Scalar_FLOAT32_IEEE 0 VBU0513_CM_single_cnt -3.4028234663852886E+38 3.4028234663852886E+38 /end CHARACTERISTIC
/begin CHARACTERISTIC CcFCC_EightyCustomSOC_pct "" VALUE 0x7001073c Scalar_FLOAT32_IEEE 0 VBU0513_CM_single_cnt -3.4028234663852886E+38 3.4028234663852886E+38 /end CHARACTERISTIC
/begin CHARACTERISTIC CcFCC_EstimateChargeInvalidTime_min "" VALUE 0x70010740 Scalar_FLOAT32_IEEE 0 VBU0513_CM_single_cnt -3.4028234663852886E+38 3.4028234663852886E+38 /end CHARACTERISTIC
/begin CHARACTERISTIC DCH_cBRMBattRatedCapOvrdVal_C "" VALUE 0x70010c9c Scalar_FLOAT32_IEEE 0 VBU0513_CM_single_cnt -3.4028234663852886E+38 3.4028234663852886E+38 /end CHARACTERISTIC
/begin CHARACTERISTIC DCH_uBRMBattRatedVltgOvrdVal_C "" VALUE 0x70010e44 Scalar_FLOAT32_IEEE 0 VBU0513_CM_single_cnt -3.4028234663852886E+38 3.4028234663852886E+38 /end CHARACTERISTIC
/begin CHARACTERISTIC DSPL_facMtrDrvLT_C "" VALUE 0x70010fa4 Scalar_FLOAT32_IEEE 0 VBU0513_CM_single_fac 0.0 1.0 /end CHARACTERISTIC
/begin CHARACTERISTIC DSPL_facRegenReq_C "" VALUE 0x70010fa8 Scalar_FLOAT32_IEEE 0 VBU0513_CM_single_fac 0.0 1.0 /end CHARACTERISTIC
/begin CHARACTERISTIC DSPL_nMotSpdOvrSpdLower_C "" VALUE 0x70011004 Scalar_FLOAT32_IEEE 0 VBU0513_CM_single_cnt 0.0 1.0E+23 /end CHARACTERISTIC
/begin CHARACTERISTIC DSPL_pctAccPedLe_C "" VALUE 0x7001100c Scalar_FLOAT32_IEEE 0 VBU0513_CM_single_pct 0.0 100.0 /end CHARACTERISTIC
/begin CHARACTERISTIC DSPL_pctAccPedRe_C "" VALUE 0x70011010 Scalar_FLOAT32_IEEE 0 VBU0513_CM_single_pct 0.0 100.0 /end CHARACTERISTIC
/begin CHARACTERISTIC DSPL_pctSocLowWarnLower_C "" VALUE 0x70011048 Scalar_FLOAT32_IEEE 0 VBU0513_CM_single_pct 0.0 100.0 /end CHARACTERISTIC
/begin CHARACTERISTIC DSPL_pctSocLowWarnUpper_C "" VALUE 0x7001104c Scalar_FLOAT32_IEEE 0 VBU0513_CM_single_pct 0.0 100.0 /end CHARACTERISTIC
/begin CHARACTERISTIC DSPL_tiDCDCStsFail_C "" VALUE 0x7001106c Scalar_FLOAT32_IEEE 0 VBU0513_CM_single_s 0.0 1.0E+23 /end CHARACTERISTIC
/begin CHARACTERISTIC DSPL_tiDisableDCDC_C "" VALUE 0x70011078 Scalar_FLOAT32_IEEE 0 VBU0513_CM_single_s 0.0 1.0E+23 /end CHARACTERISTIC
/begin CHARACTERISTIC DSPL_tiMotOvrSpd_C "" VALUE 0x7001108c Scalar_FLOAT32_IEEE 0 VBU0513_CM_single_s 0.0 1.0E+23 /end CHARACTERISTIC
/begin CHARACTERISTIC DSPL_tiMtrDrvLT_C "" VALUE 0x70011090 Scalar_FLOAT32_IEEE 0 VBU0513_CM_single_s 0.0 1.0E+23 /end CHARACTERISTIC
/begin CHARACTERISTIC DSPL_tiRegenLimDecline_C "" VALUE 0x70011094 Scalar_FLOAT32_IEEE 0 VBU0513_CM_single_s 0.0 1.0E+23 /end CHARACTERISTIC
/begin CHARACTERISTIC DSPL_tiRegenLimRise_C "" VALUE 0x70011098 Scalar_FLOAT32_IEEE 0 VBU0513_CM_single_s 0.0 1.0E+23 /end CHARACTERISTIC
/begin CHARACTERISTIC DSPL_tiSample_SY "" VALUE 0x700110a4 Scalar_FLOAT32_IEEE 0 VBU0513_CM_single_s 0.0 1.0E+23 /end CHARACTERISTIC
/begin CHARACTERISTIC DSPL_trqMotReqLe_C "" VALUE 0x700110a8 Scalar_FLOAT32_IEEE 0 VBU0513_CM_single_cnt 0.0 1.0E+23 /end CHARACTERISTIC
/begin CHARACTERISTIC DSPL_trqMotReqRe_C "" VALUE 0x700110ac Scalar_FLOAT32_IEEE 0 VBU0513_CM_single_cnt 0.0 1.0E+23 /end CHARACTERISTIC
/begin CHARACTERISTIC DSPL_trqMtrDrvLTHi_C "" VALUE 0x700110b0 Scalar_FLOAT32_IEEE 0 VBU0513_CM_single_cnt 0.0 1.0E+23 /end CHARACTERISTIC
/begin CHARACTERISTIC DSPL_trqMtrDrvLTLo_C "" VALUE 0x700110b4 Scalar_FLOAT32_IEEE 0 VBU0513_CM_single_cnt 0.0 1.0E+23 /end CHARACTERISTIC
/begin CHARACTERISTIC DSPL_trqRegenReqLe_C "" VALUE 0x700110b8 Scalar_FLOAT32_IEEE 0 VBU0513_CM_single_cnt 0.0 1.0E+23 /end CHARACTERISTIC
/begin CHARACTERISTIC DSPL_trqRegenReqRe_C "" VALUE 0x700110bc Scalar_FLOAT32_IEEE 0 VBU0513_CM_single_cnt 0.0 1.0E+23 /end CHARACTERISTIC
/begin CHARACTERISTIC DSPL_vVehSpdRegenLe_C "" VALUE 0x700110cc Scalar_FLOAT32_IEEE 0 VBU0513_CM_single_cnt 0.0 1.0E+23 /end CHARACTERISTIC
/begin CHARACTERISTIC DSPL_vVehSpdRegenRe_C "" VALUE 0x700110d0 Scalar_FLOAT32_IEEE 0 VBU0513_CM_single_cnt 0.0 1.0E+23 /end CHARACTERISTIC
/begin CHARACTERISTIC PMM_tiACTst_C "" VALUE 0x70011544 Scalar_FLOAT32_IEEE 0 VBU0513_CM_single_cnt -3.4028234663852886E+38 3.4028234663852886E+38 /end CHARACTERISTIC
/begin CHARACTERISTIC PMM_tiActvDisCh_C "" VALUE 0x70011548 Scalar_FLOAT32_IEEE 0 VBU0513_CM_single_cnt -3.4028234663852886E+38 3.4028234663852886E+38 /end CHARACTERISTIC
/begin CHARACTERISTIC PMM_tiDCDCDisbl_C "" VALUE 0x70011550 Scalar_FLOAT32_IEEE 0 VBU0513_CM_single_cnt -3.4028234663852886E+38 3.4028234663852886E+38 /end CHARACTERISTIC
/begin CHARACTERISTIC PMM_tiDlyInitRst_C "" VALUE 0x70011584 Scalar_FLOAT32_IEEE 0 VBU0513_CM_single_cnt -3.4028234663852886E+38 3.4028234663852886E+38 /end CHARACTERISTIC
/begin CHARACTERISTIC PMM_tiHVRlyOpenReq_C "" VALUE 0x700115c0 Scalar_FLOAT32_IEEE 0 VBU0513_CM_single_cnt -3.4028234663852886E+38 3.4028234663852886E+38 /end CHARACTERISTIC
/begin CHARACTERISTIC PMM_tiHVRlyT_C "" VALUE 0x700115c4 Scalar_FLOAT32_IEEE 0 VBU0513_CM_single_cnt -3.4028234663852886E+38 3.4028234663852886E+38 /end CHARACTERISTIC
/begin CHARACTERISTIC PMM_tiRstKeep_C "" VALUE 0x700115d4 Scalar_FLOAT32_IEEE 0 VBU0513_CM_single_cnt -3.4028234663852886E+38 3.4028234663852886E+38 /end CHARACTERISTIC
/begin CHARACTERISTIC PMM_tiSmplT_SY "" VALUE 0x700115d8 Scalar_FLOAT32_IEEE 0 VBU0513_CM_single_cnt -3.4028234663852886E+38 3.4028234663852886E+38 /end CHARACTERISTIC
/begin CHARACTERISTIC PermitVoltageOvrdVal_C "" VALUE 0x700115f8 Scalar_FLOAT32_IEEE 0 VBU0513_CM_single_cnt -3.4028234663852886E+38 3.4028234663852886E+38 /end CHARACTERISTIC
/begin CHARACTERISTIC SYS_facGearRatioF_SY "" VALUE 0x70011650 Scalar_FLOAT32_IEEE 0 VBU0513_CM_single_cnt -3.4028234663852886E+38 3.4028234663852886E+38 /end CHARACTERISTIC
/begin CHARACTERISTIC TEMP_OVEROvrdVal_C "" VALUE 0x7001166c Scalar_FLOAT32_IEEE 0 VBU0513_CM_single_cnt -3.4028234663852886E+38 3.4028234663852886E+38 /end CHARACTERISTIC
/begin CHARACTERISTIC THM_fFANfrecuencyORV "" VALUE 0x900046c0 Scalar_FLOAT32_IEEE 0 VBU0513_CM_single -3.4E+38 3.4E+38 /end CHARACTERISTIC
/begin CHARACTERISTIC THM_fPump1frecuencyORV "" VALUE 0x900046c4 Scalar_FLOAT32_IEEE 0 VBU0513_CM_single -3.4E+38 3.4E+38 /end CHARACTERISTIC
/begin CHARACTERISTIC THM_fPump2frecuencyORV "" VALUE 0x900046c8 Scalar_FLOAT32_IEEE 0 VBU0513_CM_single -3.4E+38 3.4E+38 /end CHARACTERISTIC
/begin CHARACTERISTIC THM_flgPump2frecuencyORF "" VALUE 0x900046cc Scalar_FLOAT32_IEEE 0 VBU0513_CM_single -3.4E+38 3.4E+38 /end CHARACTERISTIC
/begin CHARACTERISTIC THM_nComprssrDecGrad_C "" VALUE 0x70011684 Scalar_FLOAT32_IEEE 0 VBU0513_CM_single_cnt -3.4028234663852886E+38 3.4028234663852886E+38 /end CHARACTERISTIC
/begin CHARACTERISTIC THM_nComprssrDrvrACOn_C "" VALUE 0x70011688 Scalar_FLOAT32_IEEE 0 VBU0513_CM_single_cnt -3.4028234663852886E+38 3.4028234663852886E+38 /end CHARACTERISTIC
/begin CHARACTERISTIC THM_nComprssrIncGrad_C "" VALUE 0x7001168c Scalar_FLOAT32_IEEE 0 VBU0513_CM_single_cnt -3.4028234663852886E+38 3.4028234663852886E+38 /end CHARACTERISTIC
/begin CHARACTERISTIC THM_nMinComprssrStrt_C "" VALUE 0x70011690 Scalar_FLOAT32_IEEE 0 VBU0513_CM_single_cnt -3.4028234663852886E+38 3.4028234663852886E+38 /end CHARACTERISTIC
/begin CHARACTERISTIC THM_pctEVXMax_C "" VALUE 0x70011698 Scalar_FLOAT32_IEEE 0 VBU0513_CM_single_cnt -3.4028234663852886E+38 3.4028234663852886E+38 /end CHARACTERISTIC
/begin CHARACTERISTIC THM_pctEVXMin_C "" VALUE 0x7001169c Scalar_FLOAT32_IEEE 0 VBU0513_CM_single_cnt -3.4028234663852886E+38 3.4028234663852886E+38 /end CHARACTERISTIC
/begin CHARACTERISTIC THM_pctFANACMidPresSwtActv_C "" VALUE 0x700116a0 Scalar_FLOAT32_IEEE 0 VBU0513_CM_single_cnt -3.4028234663852886E+38 3.4028234663852886E+38 /end CHARACTERISTIC
/begin CHARACTERISTIC THM_pctOverrideESSPmpCmd "" VALUE 0x700116a4 Scalar_FLOAT32_IEEE 0 VBU0513_CM_single_pct 0.0 100.0 /end CHARACTERISTIC
/begin CHARACTERISTIC THM_pctOverrideRearPmpCmd "" VALUE 0x700116a8 Scalar_FLOAT32_IEEE 0 VBU0513_CM_single_pct 0.0 100.0 /end CHARACTERISTIC
/begin CHARACTERISTIC THM_pctOverridevalueChillerPos "" VALUE 0x700116ac Scalar_FLOAT32_IEEE 0 VBU0513_CM_single_pct 0.0 100.0 /end CHARACTERISTIC
/begin CHARACTERISTIC THM_pctOverridevalueFAN "" VALUE 0x700116b0 Scalar_FLOAT32_IEEE 0 VBU0513_CM_single_pct 0.0 100.0 /end CHARACTERISTIC
/begin CHARACTERISTIC THM_rpmOverridevalueACCmpCmd "" VALUE 0x700116b8 Scalar_FLOAT32_IEEE 0 VBU0513_CM_single_cnt 0.0 1.0E+23 /end CHARACTERISTIC
/begin CHARACTERISTIC THM_tiDlyEVXDisbl_C "" VALUE 0x700116f8 Scalar_FLOAT32_IEEE 0 VBU0513_CM_single_cnt -3.4028234663852886E+38 3.4028234663852886E+38 /end CHARACTERISTIC
/begin CHARACTERISTIC THM_tiSmplTime_SY "" VALUE 0x700116fc Scalar_FLOAT32_IEEE 0 VBU0513_CM_single_s 0.0 1.0E+23 /end CHARACTERISTIC
/begin CHARACTERISTIC VIN1VIN2VIN3OvrdVal_C "" VALUE 0x70011910 Scalar_FLOAT32_IEEE 0 VBU0513_CM_single_cnt -3.4028234663852886E+38 3.4028234663852886E+38 /end CHARACTERISTIC
/begin CHARACTERISTIC Veh_pVacPumpRun_C "" VALUE 0x700119c4 Scalar_FLOAT32_IEEE 0 VBU0513_CM_single_cnt 0.0 1.0E+23 /end CHARACTERISTIC
/begin CHARACTERISTIC Veh_pVacPumpStop_C "" VALUE 0x700119c8 Scalar_FLOAT32_IEEE 0 VBU0513_CM_single_cnt 0.0 1.0E+23 /end CHARACTERISTIC
/begin CHARACTERISTIC Veh_pVacPumpWarning_C "" VALUE 0x700119cc Scalar_FLOAT32_IEEE 0 VBU0513_CM_single_cnt 0.0 1.0E+23 /end CHARACTERISTIC
/begin CHARACTERISTIC Veh_tiHWResetConfirmTime_C "" VALUE 0x700119e0 Scalar_FLOAT32_IEEE 0 VBU0513_CM_single_cnt -3.4028234663852886E+38 3.4028234663852886E+38 /end CHARACTERISTIC
/begin CHARACTERISTIC Veh_tiHWResetDelayTime_C "" VALUE 0x700119e4 Scalar_FLOAT32_IEEE 0 VBU0513_CM_single_cnt -3.4028234663852886E+38 3.4028234663852886E+38 /end CHARACTERISTIC
/begin CHARACTERISTIC Veh_tiSampleTime_C "" VALUE 0x700119f0 Scalar_FLOAT32_IEEE 0 VBU0513_CM_single_cnt -3.4028234663852886E+38 3.4028234663852886E+38 /end CHARACTERISTIC
/begin CHARACTERISTIC Veh_vVehSpdHWReset_C "" VALUE 0x70011a04 Scalar_FLOAT32_IEEE 0 VBU0513_CM_single_cnt -3.4028234663852886E+38 3.4028234663852886E+38 /end CHARACTERISTIC
/begin CHARACTERISTIC CaCVT_CellVoltageOverDeviationCurrentMapDimension_n "" VAL_BLK 0x70011a12 Scalar_ULONG 0 VBU0513_CM_uint32_cnt 0.0 4.294967295E+9 NUMBER 2 /end CHARACTERISTIC
/begin CHARACTERISTIC CcCTM_CellOverTempWarningDebounce_ms "" VALUE 0x7001064c Scalar_ULONG 0 VBU0513_CM_uint32_cnt 0.0 4.294967295E+9 /end CHARACTERISTIC
/begin CHARACTERISTIC CcCVT_CellOverVoltageWarningDebounce_ms "" VALUE 0x700106b0 Scalar_ULONG 0 VBU0513_CM_uint32_ms 0.0 4.294967295E+9 /end CHARACTERISTIC
/begin CHARACTERISTIC CTM_BOARD_OVER_TEMP_FAULT "" VALUE 0x70010018 Scalar_UWORD 0 VBU0513_CM_uint16_cnt 0.0 65535.0 /end CHARACTERISTIC
/begin CHARACTERISTIC CTM_CELL_OVER_TEMP_WARNING_FAULT "" VALUE 0x7001001c Scalar_UWORD 0 VBU0513_CM_uint16_cnt 0.0 65535.0 /end CHARACTERISTIC
/begin CHARACTERISTIC CTM_CELL_TEMP_OVER_DEVIATION_FAULT "" VALUE 0x7001001e Scalar_UWORD 0 VBU0513_CM_uint16_cnt 0.0 65535.0 /end CHARACTERISTIC
/begin CHARACTERISTIC CTM_CELL_UNDER_TEMP_FAULT "" VALUE 0x70010022 Scalar_UWORD 0 VBU0513_CM_uint16_cnt 0.0 65535.0 /end CHARACTERISTIC
/begin CHARACTERISTIC CcBCV_BDMOutputDelayTime_ms "" VALUE 0x70010028 Scalar_UWORD 0 VBU0513_CM_uint16_cnt 0.0 65535.0 /end CHARACTERISTIC
/begin CHARACTERISTIC CcBMM_BDMOutputDelayTime_ms "" VALUE 0x70010038 Scalar_UWORD 0 VBU0513_CM_uint16_cnt 0.0 65535.0 /end CHARACTERISTIC
/begin CHARACTERISTIC CcBMM_MaxAfterrunTime_s "" VALUE 0x7001003e Scalar_UWORD 0 VBU0513_CM_uint16_cnt 0.0 65535.0 /end CHARACTERISTIC
/begin CHARACTERISTIC CcBMM_SOCJumpDelayTime_ms "" VALUE 0x70010042 Scalar_UWORD 0 VBU0513_CM_uint16_cnt 0.0 65535.0 /end CHARACTERISTIC
/begin CHARACTERISTIC CcBMM_SOCJumpPowerOnDelayTime_ms "" VALUE 0x70010044 Scalar_UWORD 0 VBU0513_CM_uint16_cnt 0.0 65535.0 /end CHARACTERISTIC
/begin CHARACTERISTIC CcBMM_WakeupLineFEDebounceTime_ms "" VALUE 0x70010046 Scalar_UWORD 0 VBU0513_CM_uint16_cnt 0.0 65535.0 /end CHARACTERISTIC
/begin CHARACTERISTIC CcCTM_CellTempOverDeviationFault_C "" VALUE 0x7001005e Scalar_UWORD 0 VBU0513_CM_uint16_cnt 0.0 65535.0 /end CHARACTERISTIC
/begin CHARACTERISTIC CcCTS_CmdMnPosContactorDelayTime_ms "" VALUE 0x70010060 Scalar_UWORD 0 VBU0513_CM_uint16_cnt 0.0 65535.0 /end CHARACTERISTIC
/begin CHARACTERISTIC CcCTS_DiagnoseMPCWeldCheckDischargeTime_ms "" VALUE 0x70010064 Scalar_UWORD 0 VBU0513_CM_uint16_cnt 0.0 65535.0 /end CHARACTERISTIC
/begin CHARACTERISTIC CcCTS_DiagnoseMPCWeldCheckTime_ms "" VALUE 0x70010066 Scalar_UWORD 0 VBU0513_CM_uint16_cnt 0.0 65535.0 /end CHARACTERISTIC
/begin CHARACTERISTIC CcCTS_MaxCloseAndDiagnoseContactorsTime_ms "" VALUE 0x70010068 Scalar_UWORD 0 VBU0513_CM_uint16_cnt 0.0 65535.0 /end CHARACTERISTIC
/begin CHARACTERISTIC CcCTS_MinOpenAndDiagnoseWeldTime_ms "" VALUE 0x7001006a Scalar_UWORD 0 VBU0513_CM_uint16_cnt 0.0 65535.0 /end CHARACTERISTIC
/begin CHARACTERISTIC CcCTS_PrechargeTimerThreshold1_ms "" VALUE 0x7001006c Scalar_UWORD 0 VBU0513_CM_uint16_cnt 0.0 65535.0 /end CHARACTERISTIC
/begin CHARACTERISTIC CcCTS_PrechargeTimerThreshold2_ms "" VALUE 0x7001006e Scalar_UWORD 0 VBU0513_CM_uint16_cnt 0.0 65535.0 /end CHARACTERISTIC
/begin CHARACTERISTIC CcCTS_PrechargeTimerThreshold3_ms "" VALUE 0x70010070 Scalar_UWORD 0 VBU0513_CM_uint16_cnt 0.0 65535.0 /end CHARACTERISTIC
/begin CHARACTERISTIC CcCVT_BDMOutputDelayTime_ms "" VALUE 0x70010072 Scalar_UWORD 0 VBU0513_CM_uint16_ms 0.0 65535.0 /end CHARACTERISTIC
/begin CHARACTERISTIC CcCVT_CellOverVoltageEVMFault_mV "" VALUE 0x7001007e Scalar_UWORD 0 VBU0513_CM_uint16_mV 0.0 65535.0 /end CHARACTERISTIC
/begin CHARACTERISTIC CcCVT_CellOverVoltageFault_mV "" VALUE 0x70010080 Scalar_UWORD 0 VBU0513_CM_uint16_mV 0.0 65535.0 /end CHARACTERISTIC
/begin CHARACTERISTIC CcCVT_CellOverVoltageWarningFault_mV "" VALUE 0x70010082 Scalar_UWORD 0 VBU0513_CM_uint16_mV 0.0 65535.0 /end CHARACTERISTIC
/begin CHARACTERISTIC CcCVT_CellUnderVoltageEVMFault_mV "" VALUE 0x70010084 Scalar_UWORD 0 VBU0513_CM_uint16_mV 0.0 65535.0 /end CHARACTERISTIC
/begin CHARACTERISTIC CcCVT_CellUnderVoltageFaultLevel2_mV "" VALUE 0x70010086 Scalar_UWORD 0 VBU0513_CM_uint16_mV 0.0 65535.0 /end CHARACTERISTIC
/begin CHARACTERISTIC CcCVT_CellUnderVoltageFault_mV "" VALUE 0x70010088 Scalar_UWORD 0 VBU0513_CM_uint16_mV 0.0 65535.0 /end CHARACTERISTIC
/begin CHARACTERISTIC CcCVT_CellVoltageInvalidFaultDelayTime_ms "" VALUE 0x7001008a Scalar_UWORD 0 VBU0513_CM_uint16_ms 0.0 65535.0 /end CHARACTERISTIC
/begin CHARACTERISTIC CcCVT_CellVoltageOverDeviationCurrentDelay_s "" VALUE 0x7001008c Scalar_UWORD 0 VBU0513_CM_uint16_s 0.0 65535.0 /end CHARACTERISTIC
/begin CHARACTERISTIC CcCVT_CellVoltageOverDeviationEVMFault_mV "" VALUE 0x7001008e Scalar_UWORD 0 VBU0513_CM_uint16_mV 0.0 65535.0 /end CHARACTERISTIC
/begin CHARACTERISTIC CcCVT_CellVoltageOverDeviationFault_mV "" VALUE 0x70010090 Scalar_UWORD 0 VBU0513_CM_uint16_mV 0.0 65535.0 /end CHARACTERISTIC
/begin CHARACTERISTIC CcDSM_DiverCycleflgDelayTime_ms "" VALUE 0x70010092 Scalar_UWORD 0 VBU0513_CM_uint16_cnt 0.0 65535.0 /end CHARACTERISTIC
/begin CHARACTERISTIC CcFCC_ChargeCompleteComfirmDelay_ms "" VALUE 0x7001009a Scalar_UWORD 0 VBU0513_CM_uint16_cnt 0.0 65535.0 /end CHARACTERISTIC
/begin CHARACTERISTIC CcSYS_SystemMaxInitialTime_ms "" VALUE 0x7001011a Scalar_UWORD 0 VBU0513_CM_uint16_cnt 0.0 65535.0 /end CHARACTERISTIC
/begin CHARACTERISTIC DSPL_nMotSpdOvrSpdUpper_C "" VALUE 0x70010128 Scalar_UWORD 0 VBU0513_CM_uint16_cnt 0.0 65535.0 /end CHARACTERISTIC
/begin CHARACTERISTIC INP_numEXVPosition1Lower_C "" VALUE 0x7001012e Scalar_UWORD 0 VBU0513_CM_uint16_cnt 0.0 480.0 /end CHARACTERISTIC
/begin CHARACTERISTIC INP_numEXVPosition1Upper_C "" VALUE 0x70010130 Scalar_UWORD 0 VBU0513_CM_uint16_cnt 0.0 480.0 /end CHARACTERISTIC
/begin CHARACTERISTIC INP_numEXVPosition2Upper_C "" VALUE 0x70010132 Scalar_UWORD 0 VBU0513_CM_uint16_cnt 0.0 480.0 /end CHARACTERISTIC
/begin CHARACTERISTIC MILIAMPERES_PER_AMPERE_SY "" VALUE 0x70010134 Scalar_UWORD 0 VBU0513_CM_uint16_cnt 0.0 65535.0 /end CHARACTERISTIC
/begin CHARACTERISTIC SAMPLE_TIME_TASK_D "" VALUE 0x70010140 Scalar_UWORD 0 VBU0513_CM_uint16_cnt 0.0 65535.0 /end CHARACTERISTIC
/begin CHARACTERISTIC APO_fACPumpOvrd_C "" VALUE 0x700209c4 Scalar_BOOLEAN 0 VBU0513_CM_boolean_cnt 0.0 1.0 /end CHARACTERISTIC
/begin CHARACTERISTIC APO_fFanOvrd_C "" VALUE 0x700209c5 Scalar_BOOLEAN 0 VBU0513_CM_boolean_cnt 0.0 1.0 /end CHARACTERISTIC
/begin CHARACTERISTIC APO_fHVIL1Ovrd_C "" VALUE 0x700209c6 Scalar_BOOLEAN 0 VBU0513_CM_boolean_cnt 0.0 1.0 /end CHARACTERISTIC
/begin CHARACTERISTIC APO_fVacuumPumpOvrd_C "" VALUE 0x700209c7 Scalar_BOOLEAN 0 VBU0513_CM_boolean_cnt 0.0 1.0 /end CHARACTERISTIC
/begin CHARACTERISTIC APO_fWaterPump1Ovrd_C "" VALUE 0x700209c8 Scalar_BOOLEAN 0 VBU0513_CM_boolean_cnt 0.0 1.0 /end CHARACTERISTIC
/begin CHARACTERISTIC APO_fWaterPump2Ovrd_C "" VALUE 0x700209c9 Scalar_BOOLEAN 0 VBU0513_CM_boolean_cnt 0.0 1.0 /end CHARACTERISTIC
/begin CHARACTERISTIC APO_flgBCLTxEnaOvrdVal_C "" VALUE 0x700209cc Scalar_BOOLEAN 0 VBU0513_CM_boolean 0 1 /end CHARACTERISTIC
/begin CHARACTERISTIC APO_flgBCLTxEnaOvrd_C "" VALUE 0x700209cd Scalar_BOOLEAN 0 VBU0513_CM_boolean 0 1 /end CHARACTERISTIC
/begin CHARACTERISTIC APO_flgBCPTxEnaOvrdVal_C "" VALUE 0x700209ce Scalar_BOOLEAN 0 VBU0513_CM_boolean 0 1 /end CHARACTERISTIC
/begin CHARACTERISTIC APO_flgBCPTxEnaOvrd_C "" VALUE 0x700209cf Scalar_BOOLEAN 0 VBU0513_CM_boolean 0 1 /end CHARACTERISTIC
/begin CHARACTERISTIC APO_flgBCSTxEnaOvrdVal_C "" VALUE 0x700209d0 Scalar_BOOLEAN 0 VBU0513_CM_boolean 0 1 /end CHARACTERISTIC
/begin CHARACTERISTIC APO_flgBCSTxEnaOvrd_C "" VALUE 0x700209d1 Scalar_BOOLEAN 0 VBU0513_CM_boolean 0 1 /end CHARACTERISTIC
/begin CHARACTERISTIC APO_flgBEMTxEnaOvrdVal_C "" VALUE 0x700209d2 Scalar_BOOLEAN 0 VBU0513_CM_boolean 0 1 /end CHARACTERISTIC
/begin CHARACTERISTIC APO_flgBEMTxEnaOvrd_C "" VALUE 0x700209d3 Scalar_BOOLEAN 0 VBU0513_CM_boolean 0 1 /end CHARACTERISTIC
/begin CHARACTERISTIC APO_flgBHMTxEnaOvrdVal_C "" VALUE 0x700209d4 Scalar_BOOLEAN 0 VBU0513_CM_boolean 0 1 /end CHARACTERISTIC
/begin CHARACTERISTIC APO_flgBHMTxEnaOvrd_C "" VALUE 0x700209d5 Scalar_BOOLEAN 0 VBU0513_CM_boolean 0 1 /end CHARACTERISTIC
/begin CHARACTERISTIC APO_flgBRMTxEnaOvrdVal_C "" VALUE 0x700209e2 Scalar_BOOLEAN 0 VBU0513_CM_boolean 0 1 /end CHARACTERISTIC
/begin CHARACTERISTIC APO_flgBRMTxEnaOvrd_C "" VALUE 0x700209e3 Scalar_BOOLEAN 0 VBU0513_CM_boolean 0 1 /end CHARACTERISTIC
/begin CHARACTERISTIC APO_flgBROTxEnaOvrdVal_C "" VALUE 0x700209e4 Scalar_BOOLEAN 0 VBU0513_CM_boolean 0 1 /end CHARACTERISTIC
/begin CHARACTERISTIC APO_flgBROTxEnaOvrd_C "" VALUE 0x700209e5 Scalar_BOOLEAN 0 VBU0513_CM_boolean 0 1 /end CHARACTERISTIC
/begin CHARACTERISTIC APO_flgBSDTxEnaOvrdVal_C "" VALUE 0x700209e6 Scalar_BOOLEAN 0 VBU0513_CM_boolean 0 1 /end CHARACTERISTIC
/begin CHARACTERISTIC APO_flgBSDTxEnaOvrd_C "" VALUE 0x700209e7 Scalar_BOOLEAN 0 VBU0513_CM_boolean 0 1 /end CHARACTERISTIC
/begin CHARACTERISTIC APO_flgBSMTxEnaOvrdVal_C "" VALUE 0x700209e8 Scalar_BOOLEAN 0 VBU0513_CM_boolean 0 1 /end CHARACTERISTIC
/begin CHARACTERISTIC APO_flgBSMTxEnaOvrd_C "" VALUE 0x700209e9 Scalar_BOOLEAN 0 VBU0513_CM_boolean 0 1 /end CHARACTERISTIC
/begin CHARACTERISTIC APO_flgBSTTxEnaOvrdVal_C "" VALUE 0x700209ea Scalar_BOOLEAN 0 VBU0513_CM_boolean 0 1 /end CHARACTERISTIC
/begin CHARACTERISTIC APO_flgBSTTxEnaOvrd_C "" VALUE 0x700209eb Scalar_BOOLEAN 0 VBU0513_CM_boolean 0 1 /end CHARACTERISTIC
/begin CHARACTERISTIC APO_flgDCChgRlyOvrdVal_C "" VALUE 0x700209f1 Scalar_BOOLEAN 0 VBU0513_CM_boolean_cnt 0.0 1.0 /end CHARACTERISTIC
/begin CHARACTERISTIC APO_flgDCChgRlyOvrd_C "" VALUE 0x700209f2 Scalar_BOOLEAN 0 VBU0513_CM_boolean_cnt 0.0 1.0 /end CHARACTERISTIC
/begin CHARACTERISTIC APO_flgFanORF "" VALUE 0x700209f6 Scalar_BOOLEAN 0 VBU0513_CM_boolean 0 1 /end CHARACTERISTIC
/begin CHARACTERISTIC APO_flgHWSleepEnableORF "" VALUE 0x700209f9 Scalar_BOOLEAN 0 VBU0513_CM_boolean 0 1 /end CHARACTERISTIC
/begin CHARACTERISTIC APO_flgMainRlyOvrdVal_C "" VALUE 0x700209fc Scalar_BOOLEAN 0 VBU0513_CM_boolean_cnt 0.0 1.0 /end CHARACTERISTIC
/begin CHARACTERISTIC APO_flgMainRlyOvrd_C "" VALUE 0x700209fd Scalar_BOOLEAN 0 VBU0513_CM_boolean_cnt 0.0 1.0 /end CHARACTERISTIC
/begin CHARACTERISTIC APO_flgSleepEnableORV "" VALUE 0x700209fe Scalar_BOOLEAN 0 VBU0513_CM_boolean 0 1 /end CHARACTERISTIC
/begin CHARACTERISTIC APO_flgWakeUp1OvrdVal_C "" VALUE 0x700209ff Scalar_BOOLEAN 0 VBU0513_CM_boolean_cnt 0.0 1.0 /end CHARACTERISTIC
/begin CHARACTERISTIC APO_flgWakeUp1Ovrd_C "" VALUE 0x70020a00 Scalar_BOOLEAN 0 VBU0513_CM_boolean_cnt 0.0 1.0 /end CHARACTERISTIC
/begin CHARACTERISTIC APO_flgWakeUp2OvrdVal_C "" VALUE 0x70020a01 Scalar_BOOLEAN 0 VBU0513_CM_boolean_cnt 0.0 1.0 /end CHARACTERISTIC
/begin CHARACTERISTIC APO_flgWakeUp2Ovrd_C "" VALUE 0x70020a02 Scalar_BOOLEAN 0 VBU0513_CM_boolean_cnt 0.0 1.0 /end CHARACTERISTIC
/begin CHARACTERISTIC APO_pctACPumpOvrd_C "" VALUE 0x70020a03 Scalar_BOOLEAN 0 VBU0513_CM_boolean_cnt 0.0 1.0 /end CHARACTERISTIC
/begin CHARACTERISTIC APO_pctHVIL1Ovrd_C "" VALUE 0x70020a04 Scalar_BOOLEAN 0 VBU0513_CM_boolean_cnt 0.0 1.0 /end CHARACTERISTIC
/begin CHARACTERISTIC APO_pctWaterPump1Ovrd_C "" VALUE 0x70020a05 Scalar_BOOLEAN 0 VBU0513_CM_boolean_cnt 0.0 1.0 /end CHARACTERISTIC
/begin CHARACTERISTIC APO_pctWaterPump2Ovrd_C "" VALUE 0x70020a06 Scalar_BOOLEAN 0 VBU0513_CM_boolean_cnt 0.0 1.0 /end CHARACTERISTIC
/begin CHARACTERISTIC BATTERY_DATE_DAYOvrd_C "" VALUE 0x70020a12 Scalar_BOOLEAN 0 VBU0513_CM_boolean_cnt 0.0 1.0 /end CHARACTERISTIC
/begin CHARACTERISTIC BATTERY_DATE_MONTHOvrd_C "" VALUE 0x70020a14 Scalar_BOOLEAN 0 VBU0513_CM_boolean_cnt 0.0 1.0 /end CHARACTERISTIC
/begin CHARACTERISTIC BATTERY_DATE_YEAROvrd_C "" VALUE 0x70020a16 Scalar_BOOLEAN 0 VBU0513_CM_boolean_cnt 0.0 1.0 /end CHARACTERISTIC
/begin CHARACTERISTIC BATTERY_GROUP_NUMBEROvrd_C "" VALUE 0x70020a19 Scalar_BOOLEAN 0 VBU0513_CM_boolean_cnt 0.0 1.0 /end CHARACTERISTIC
/begin CHARACTERISTIC BATTERY_ISOLATION_STATEOvrd_C "" VALUE 0x70020a1b Scalar_BOOLEAN 0 VBU0513_CM_boolean_cnt 0.0 1.0 /end CHARACTERISTIC
/begin CHARACTERISTIC BATTERY_OUTPUT_CONNECTOR_STATEOvrd_C "" VALUE 0x70020a1d Scalar_BOOLEAN 0 VBU0513_CM_boolean_cnt 0.0 1.0 /end CHARACTERISTIC
/begin CHARACTERISTIC BATTERY_PROPERTY_IDENTIFYOvrd_C "" VALUE 0x70020a1f Scalar_BOOLEAN 0 VBU0513_CM_boolean_cnt 0.0 1.0 /end CHARACTERISTIC
/begin CHARACTERISTIC BATTERY_SUPPLIEROvrd_C "" VALUE 0x70020a21 Scalar_BOOLEAN 0 VBU0513_CM_boolean_cnt 0.0 1.0 /end CHARACTERISTIC
/begin CHARACTERISTIC BMS_SOFTWARE_VERSION1Ovrd_C "" VALUE 0x70020a39 Scalar_BOOLEAN 0 VBU0513_CM_boolean_cnt 0.0 1.0 /end CHARACTERISTIC
/begin CHARACTERISTIC BMS_SOFTWARE_VERSION2Ovrd_C "" VALUE 0x70020a3b Scalar_BOOLEAN 0 VBU0513_CM_boolean_cnt 0.0 1.0 /end CHARACTERISTIC
/begin CHARACTERISTIC BRM_RESERVEDOvrd_C "" VALUE 0x70020a46 Scalar_BOOLEAN 0 VBU0513_CM_boolean_cnt 0.0 1.0 /end CHARACTERISTIC
/begin CHARACTERISTIC CELL_VOLTAGE_OVER_UNDEROvrd_C "" VALUE 0x70020a57 Scalar_BOOLEAN 0 VBU0513_CM_boolean_cnt 0.0 1.0 /end CHARACTERISTIC
/begin CHARACTERISTIC CHARGER_MESSAGE_OT_00Ovrd_C "" VALUE 0x70020a71 Scalar_BOOLEAN 0 VBU0513_CM_boolean_cnt 0.0 1.0 /end CHARACTERISTIC
/begin CHARACTERISTIC CHARGER_MESSAGE_OT_AAOvrd_C "" VALUE 0x70020a73 Scalar_BOOLEAN 0 VBU0513_CM_boolean_cnt 0.0 1.0 /end CHARACTERISTIC
/begin CHARACTERISTIC CHARGER_MESSAGE_OT_READYOvrd_C "" VALUE 0x70020a75 Scalar_BOOLEAN 0 VBU0513_CM_boolean_cnt 0.0 1.0 /end CHARACTERISTIC
/begin CHARACTERISTIC CHARGER_MESSAGE_OT_STATEOvrd_C "" VALUE 0x70020a77 Scalar_BOOLEAN 0 VBU0513_CM_boolean_cnt 0.0 1.0 /end CHARACTERISTIC
/begin CHARACTERISTIC CHARGER_MESSAGE_OT_STATISTICSOvrd_C "" VALUE 0x70020a79 Scalar_BOOLEAN 0 VBU0513_CM_boolean_cnt 0.0 1.0 /end CHARACTERISTIC
/begin CHARACTERISTIC CHARGER_MESSAGE_OT_STOPOvrd_C "" VALUE 0x70020a7b Scalar_BOOLEAN 0 VBU0513_CM_boolean_cnt 0.0 1.0 /end CHARACTERISTIC
/begin CHARACTERISTIC CHARGER_MESSAGE_OT_SYNCHRONOUSOvrd_C "" VALUE 0x70020a7d Scalar_BOOLEAN 0 VBU0513_CM_boolean_cnt 0.0 1.0 /end CHARACTERISTIC
/begin CHARACTERISTIC CHARGING_PERMITOvrd_C "" VALUE 0x70020a81 Scalar_BOOLEAN 0 VBU0513_CM_boolean_cnt 0.0 1.0 /end CHARACTERISTIC
/begin CHARACTERISTIC CHARGING_TIMEOvrd_C "" VALUE 0x70020a83 Scalar_BOOLEAN 0 VBU0513_CM_boolean_cnt 0.0 1.0 /end CHARACTERISTIC
/begin CHARACTERISTIC CURRENT_OVER_UNDEROvrd_C "" VALUE 0x70020aa1 Scalar_BOOLEAN 0 VBU0513_CM_boolean_cnt 0.0 1.0 /end CHARACTERISTIC
/begin CHARACTERISTIC CaBMM_HALKL30BMUVoltageORF_flg "" VAL_BLK 0x70020f42 Scalar_BOOLEAN 0 VBU0513_CM_boolean_cnt 0.0 1.0 NUMBER 10 /end CHARACTERISTIC
/begin CHARACTERISTIC CbBCV_HALBatteryVoltageORF_flg "" VALUE 0x70020aba Scalar_BOOLEAN 0 VBU0513_CM_boolean_cnt 0.0 1.0 /end CHARACTERISTIC
/begin CHARACTERISTIC CbBCV_HALBatteryVoltageStatusORF_flg "" VALUE 0x70020abb Scalar_BOOLEAN 0 VBU0513_CM_boolean_cnt 0.0 1.0 /end CHARACTERISTIC
/begin CHARACTERISTIC CbBCV_HALBatteryVoltageStatusORV_flg "" VALUE 0x70020abc Scalar_BOOLEAN 0 VBU0513_CM_boolean_cnt 0.0 1.0 /end CHARACTERISTIC
/begin CHARACTERISTIC CbBCV_HALBusNegativeVoltageORF_flg "" VALUE 0x70020abd Scalar_BOOLEAN 0 VBU0513_CM_boolean_cnt 0.0 1.0 /end CHARACTERISTIC
/begin CHARACTERISTIC CbBCV_HALBusNegativeVoltageStatusORF_flg "" VALUE 0x70020abe Scalar_BOOLEAN 0 VBU0513_CM_boolean_cnt 0.0 1.0 /end CHARACTERISTIC
/begin CHARACTERISTIC CbBCV_HALBusNegativeVoltageStatusORV_flg "" VALUE 0x70020abf Scalar_BOOLEAN 0 VBU0513_CM_boolean_cnt 0.0 1.0 /end CHARACTERISTIC
/begin CHARACTERISTIC CbBCV_HALFuseVoltageORF_flg "" VALUE 0x70020ac0 Scalar_BOOLEAN 0 VBU0513_CM_boolean_cnt 0.0 1.0 /end CHARACTERISTIC
/begin CHARACTERISTIC CbBCV_HALFuseVoltageStatusORF_flg "" VALUE 0x70020ac1 Scalar_BOOLEAN 0 VBU0513_CM_boolean_cnt 0.0 1.0 /end CHARACTERISTIC
/begin CHARACTERISTIC CbBCV_HALFuseVoltageStatusORV_flg "" VALUE 0x70020ac2 Scalar_BOOLEAN 0 VBU0513_CM_boolean_cnt 0.0 1.0 /end CHARACTERISTIC
/begin CHARACTERISTIC CbBCV_HALPrechargeVoltageORF_flg "" VALUE 0x70020ac3 Scalar_BOOLEAN 0 VBU0513_CM_boolean_cnt 0.0 1.0 /end CHARACTERISTIC
/begin CHARACTERISTIC CbBCV_HALPrechargeVoltageStatusORF_flg "" VALUE 0x70020ac4 Scalar_BOOLEAN 0 VBU0513_CM_boolean_cnt 0.0 1.0 /end CHARACTERISTIC
/begin CHARACTERISTIC CbBCV_HALPrechargeVoltageStatusORV_flg "" VALUE 0x70020ac5 Scalar_BOOLEAN 0 VBU0513_CM_boolean_cnt 0.0 1.0 /end CHARACTERISTIC
/begin CHARACTERISTIC CbBCV_HALVx2VoltageORF_flg "" VALUE 0x70020ac6 Scalar_BOOLEAN 0 VBU0513_CM_boolean_cnt 0.0 1.0 /end CHARACTERISTIC
/begin CHARACTERISTIC CbBCV_HALVx2VoltageStatusORF_flg "" VALUE 0x70020ac7 Scalar_BOOLEAN 0 VBU0513_CM_boolean_cnt 0.0 1.0 /end CHARACTERISTIC
/begin CHARACTERISTIC CbBCV_HALVx2VoltageStatusORV_flg "" VALUE 0x70020ac8 Scalar_BOOLEAN 0 VBU0513_CM_boolean_cnt 0.0 1.0 /end CHARACTERISTIC
/begin CHARACTERISTIC CbBMM_BattSelfLearningRequestDefault_flg "" VALUE 0x70020acd Scalar_BOOLEAN 0 VBU0513_CM_boolean_cnt 0.0 1.0 /end CHARACTERISTIC
/begin CHARACTERISTIC CbBMM_DriverIntentionChangeEnable_flg "" VALUE 0x70020ace Scalar_BOOLEAN 0 VBU0513_CM_boolean_cnt 0.0 1.0 /end CHARACTERISTIC
/begin CHARACTERISTIC CbBMM_FastChargeWakeupEnable_flg "" VALUE 0x70020acf Scalar_BOOLEAN 0 VBU0513_CM_boolean_cnt 0.0 1.0 /end CHARACTERISTIC
/begin CHARACTERISTIC CbCBL_CTMBoardTempValidORF_flg "" VALUE 0x70020ad1 Scalar_BOOLEAN 0 VBU0513_CM_boolean_cnt 0.0 1.0 /end CHARACTERISTIC
/begin CHARACTERISTIC CbCBL_CTMBoardTempValidORV_flg "" VALUE 0x70020ad2 Scalar_BOOLEAN 0 VBU0513_CM_boolean_cnt 0.0 1.0 /end CHARACTERISTIC
/begin CHARACTERISTIC CbCTD_MainFuseBlownFaultEnable_flg "" VALUE 0x70020ad8 Scalar_BOOLEAN 0 VBU0513_CM_boolean_cnt 0.0 1.0 /end CHARACTERISTIC
/begin CHARACTERISTIC CbCTD_PrechargeResistanceBlownFaultEnable_flg "" VALUE 0x70020ae1 Scalar_BOOLEAN 0 VBU0513_CM_boolean_cnt 0.0 1.0 /end CHARACTERISTIC
/begin CHARACTERISTIC CbCTM_CellOverTempEVMFaultEnable_flg "" VALUE 0x70020ae6 Scalar_BOOLEAN 0 VBU0513_CM_boolean_cnt 0.0 1.0 /end CHARACTERISTIC
/begin CHARACTERISTIC CbCTM_CellOverTempFaultEnable_flg "" VALUE 0x70020ae7 Scalar_BOOLEAN 0 VBU0513_CM_boolean_cnt 0.0 1.0 /end CHARACTERISTIC
/begin CHARACTERISTIC CbCTM_CellOverTempWarningFaultEnable_flg "" VALUE 0x70020ae8 Scalar_BOOLEAN 0 VBU0513_CM_boolean_cnt 0.0 1.0 /end CHARACTERISTIC
/begin CHARACTERISTIC CbCTM_CellTempOverDeviationEVMFaultEnable_flg "" VALUE 0x70020ae9 Scalar_BOOLEAN 0 VBU0513_CM_boolean_cnt 0.0 1.0 /end CHARACTERISTIC
/begin CHARACTERISTIC CbCTM_CellTempOverDeviationFaultEnable_flg "" VALUE 0x70020aea Scalar_BOOLEAN 0 VBU0513_CM_boolean_cnt 0.0 1.0 /end CHARACTERISTIC
/begin CHARACTERISTIC CbCTM_CellUnderTempFaultEnable_flg "" VALUE 0x70020aec Scalar_BOOLEAN 0 VBU0513_CM_boolean_cnt 0.0 1.0 /end CHARACTERISTIC
/begin CHARACTERISTIC CbDSM_AbnormalEventOvrValue_flg "" VALUE 0x70020afd Scalar_BOOLEAN 0 VBU0513_CM_boolean_cnt 0.0 1.0 /end CHARACTERISTIC
/begin CHARACTERISTIC CbDSM_AbnormalEventOvr_flg "" VALUE 0x70020afe Scalar_BOOLEAN 0 VBU0513_CM_boolean_cnt 0.0 1.0 /end CHARACTERISTIC
/begin CHARACTERISTIC CbDSM_ClearFaultData_flg "" VALUE 0x70020aff Scalar_BOOLEAN 0 VBU0513_CM_boolean_cnt 0.0 1.0 /end CHARACTERISTIC
/begin CHARACTERISTIC CbDSM_CscValueUncertainOvrValue_flg "" VALUE 0x70020b00 Scalar_BOOLEAN 0 VBU0513_CM_boolean_cnt 0.0 1.0 /end CHARACTERISTIC
/begin CHARACTERISTIC CbDSM_CscValueUncertainOvr_flg "" VALUE 0x70020b01 Scalar_BOOLEAN 0 VBU0513_CM_boolean_cnt 0.0 1.0 /end CHARACTERISTIC
/begin CHARACTERISTIC CbDSM_NoChargeOvrValue_flg "" VALUE 0x70020b02 Scalar_BOOLEAN 0 VBU0513_CM_boolean_cnt 0.0 1.0 /end CHARACTERISTIC
/begin CHARACTERISTIC CbDSM_NoChargeOvr_flg "" VALUE 0x70020b03 Scalar_BOOLEAN 0 VBU0513_CM_boolean_cnt 0.0 1.0 /end CHARACTERISTIC
/begin CHARACTERISTIC CbDSM_NoRestartOverride_flg "" VALUE 0x70020b04 Scalar_BOOLEAN 0 VBU0513_CM_boolean_cnt 0.0 1.0 /end CHARACTERISTIC
/begin CHARACTERISTIC CbDSM_NoRestartOvrValue_flg "" VALUE 0x70020b05 Scalar_BOOLEAN 0 VBU0513_CM_boolean_cnt 0.0 1.0 /end CHARACTERISTIC
/begin CHARACTERISTIC CbFCC_ChargeCurrentOverFaultEnable_flg "" VALUE 0x70020b09 Scalar_BOOLEAN 0 VBU0513_CM_boolean_cnt 0.0 1.0 /end CHARACTERISTIC
/begin CHARACTERISTIC CcCBL_CTMBoardTempMaxORF_flg "" VALUE 0x70020be4 Scalar_BOOLEAN 0 VBU0513_CM_boolean_cnt 0.0 1.0 /end CHARACTERISTIC
/begin CHARACTERISTIC DCH_cBRMBattRatedCapOvrd_C "" VALUE 0x70020caf Scalar_BOOLEAN 0 VBU0513_CM_boolean_cnt 0.0 1.0 /end CHARACTERISTIC
/begin CHARACTERISTIC DCH_numBRMBattTypOvrd_C "" VALUE 0x70020d2c Scalar_BOOLEAN 0 VBU0513_CM_boolean_cnt 0.0 1.0 /end CHARACTERISTIC
/begin CHARACTERISTIC DCH_numBRMProtcVerOvrd_C "" VALUE 0x70020d2e Scalar_BOOLEAN 0 VBU0513_CM_boolean_cnt 0.0 1.0 /end CHARACTERISTIC
/begin CHARACTERISTIC DCH_uBRMBattRatedVltgOvrd_C "" VALUE 0x70020d96 Scalar_BOOLEAN 0 VBU0513_CM_boolean_cnt 0.0 1.0 /end CHARACTERISTIC
/begin CHARACTERISTIC DSPL_flgRegenLimLampFunctionEn_C "" VALUE 0x70020da1 Scalar_BOOLEAN 0 VBU0513_CM_boolean_flg 0.0 1.0 /end CHARACTERISTIC
/begin CHARACTERISTIC GATEWAY_STOP_ERROR_REASON_OCOvrd_C "" VALUE 0x70020dd4 Scalar_BOOLEAN 0 VBU0513_CM_boolean_cnt 0.0 1.0 /end CHARACTERISTIC
/begin CHARACTERISTIC GATEWAY_STOP_ERROR_REASON_VOLTOvrd_C "" VALUE 0x70020dd6 Scalar_BOOLEAN 0 VBU0513_CM_boolean_cnt 0.0 1.0 /end CHARACTERISTIC
/begin CHARACTERISTIC GATEWAY_STOP_FAULT_REASON_1Ovrd_C "" VALUE 0x70020dd8 Scalar_BOOLEAN 0 VBU0513_CM_boolean_cnt 0.0 1.0 /end CHARACTERISTIC
/begin CHARACTERISTIC GATEWAY_STOP_FAULT_REASON_2Ovrd_C "" VALUE 0x70020dda Scalar_BOOLEAN 0 VBU0513_CM_boolean_cnt 0.0 1.0 /end CHARACTERISTIC
/begin CHARACTERISTIC GATEWAY_STOP_FAULT_REASON_3Ovrd_C "" VALUE 0x70020ddc Scalar_BOOLEAN 0 VBU0513_CM_boolean_cnt 0.0 1.0 /end CHARACTERISTIC
/begin CHARACTERISTIC GATEWAY_STOP_FAULT_REASON_BMSOTOvrd_C "" VALUE 0x70020dde Scalar_BOOLEAN 0 VBU0513_CM_boolean_cnt 0.0 1.0 /end CHARACTERISTIC
/begin CHARACTERISTIC GATEWAY_STOP_FAULT_REASON_CELLOTOvrd_C "" VALUE 0x70020de0 Scalar_BOOLEAN 0 VBU0513_CM_boolean_cnt 0.0 1.0 /end CHARACTERISTIC
/begin CHARACTERISTIC GATEWAY_STOP_FAULT_REASON_CONNOTOvrd_C "" VALUE 0x70020de2 Scalar_BOOLEAN 0 VBU0513_CM_boolean_cnt 0.0 1.0 /end CHARACTERISTIC
/begin CHARACTERISTIC GATEWAY_STOP_FAULT_REASON_CONNOvrd_C "" VALUE 0x70020de4 Scalar_BOOLEAN 0 VBU0513_CM_boolean_cnt 0.0 1.0 /end CHARACTERISTIC
/begin CHARACTERISTIC GATEWAY_STOP_FAULT_REASON_ISOOvrd_C "" VALUE 0x70020de6 Scalar_BOOLEAN 0 VBU0513_CM_boolean_cnt 0.0 1.0 /end CHARACTERISTIC
/begin CHARACTERISTIC GATEWAY_STOP_REASON_CELLVOLTOvrd_C "" VALUE 0x70020de8 Scalar_BOOLEAN 0 VBU0513_CM_boolean_cnt 0.0 1.0 /end CHARACTERISTIC
/begin CHARACTERISTIC GATEWAY_STOP_REASON_SOCOvrd_C "" VALUE 0x70020dea Scalar_BOOLEAN 0 VBU0513_CM_boolean_cnt 0.0 1.0 /end CHARACTERISTIC
/begin CHARACTERISTIC GATEWAY_STOP_REASON_STATIONOvrd_C "" VALUE 0x70020dec Scalar_BOOLEAN 0 VBU0513_CM_boolean_cnt 0.0 1.0 /end CHARACTERISTIC
/begin CHARACTERISTIC GATEWAY_STOP_REASON_TOTALVOLTOvrd_C "" VALUE 0x70020dee Scalar_BOOLEAN 0 VBU0513_CM_boolean_cnt 0.0 1.0 /end CHARACTERISTIC
/begin CHARACTERISTIC MAXIMUM_CELL_TEMPOvrd_C "" VALUE 0x70020e51 Scalar_BOOLEAN 0 VBU0513_CM_boolean_cnt 0.0 1.0 /end CHARACTERISTIC
/begin CHARACTERISTIC MAXIMUM_CELL_TEMP_BSDOvrd_C "" VALUE 0x70020e53 Scalar_BOOLEAN 0 VBU0513_CM_boolean_cnt 0.0 1.0 /end CHARACTERISTIC
/begin CHARACTERISTIC MAXIMUM_CELL_VOLTAGE_BSDOvrd_C "" VALUE 0x70020e55 Scalar_BOOLEAN 0 VBU0513_CM_boolean_cnt 0.0 1.0 /end CHARACTERISTIC
/begin CHARACTERISTIC MAXIMUM_CELL_VOLTAGE_NUMBER_BSMOvrd_C "" VALUE 0x70020e57 Scalar_BOOLEAN 0 VBU0513_CM_boolean_cnt 0.0 1.0 /end CHARACTERISTIC
/begin CHARACTERISTIC MAXIMUM_TEMP_NUMBEROvrd_C "" VALUE 0x70020e59 Scalar_BOOLEAN 0 VBU0513_CM_boolean_cnt 0.0 1.0 /end CHARACTERISTIC
/begin CHARACTERISTIC MINIMUM_CELL_TEMPOvrd_C "" VALUE 0x70020e5f Scalar_BOOLEAN 0 VBU0513_CM_boolean_cnt 0.0 1.0 /end CHARACTERISTIC
/begin CHARACTERISTIC MINIMUM_CELL_TEMP_BSDOvrd_C "" VALUE 0x70020e61 Scalar_BOOLEAN 0 VBU0513_CM_boolean_cnt 0.0 1.0 /end CHARACTERISTIC
/begin CHARACTERISTIC MINIMUM_CELL_VOLTAGE_BSDOvrd_C "" VALUE 0x70020e63 Scalar_BOOLEAN 0 VBU0513_CM_boolean_cnt 0.0 1.0 /end CHARACTERISTIC
/begin CHARACTERISTIC MINIMUM_TEMP_NUMBEROvrd_C "" VALUE 0x70020e65 Scalar_BOOLEAN 0 VBU0513_CM_boolean_cnt 0.0 1.0 /end CHARACTERISTIC
/begin CHARACTERISTIC PermitVoltageOvrd_C "" VALUE 0x70020ebd Scalar_BOOLEAN 0 VBU0513_CM_boolean_cnt 0.0 1.0 /end CHARACTERISTIC
/begin CHARACTERISTIC READY_CHARGING_GATEWAYOvrd_C "" VALUE 0x70020ebf Scalar_BOOLEAN 0 VBU0513_CM_boolean_cnt 0.0 1.0 /end CHARACTERISTIC
/begin CHARACTERISTIC SOC_OVER_UNDEROvrd_C "" VALUE 0x70020ec6 Scalar_BOOLEAN 0 VBU0513_CM_boolean_cnt 0.0 1.0 /end CHARACTERISTIC
/begin CHARACTERISTIC SOC_STOPOvrd_C "" VALUE 0x70020ec8 Scalar_BOOLEAN 0 VBU0513_CM_boolean_cnt 0.0 1.0 /end CHARACTERISTIC
/begin CHARACTERISTIC TEMP_OVEROvrd_C "" VALUE 0x70020edc Scalar_BOOLEAN 0 VBU0513_CM_boolean_cnt 0.0 1.0 /end CHARACTERISTIC
/begin CHARACTERISTIC THM_flgEXVInitORF "" VALUE 0x70020edd Scalar_BOOLEAN 0 VBU0513_CM_boolean 0 1 /end CHARACTERISTIC
/begin CHARACTERISTIC THM_flgEXVInitORV "" VALUE 0x70020ede Scalar_BOOLEAN 0 VBU0513_CM_boolean 0 1 /end CHARACTERISTIC
/begin CHARACTERISTIC THM_flgEXVPosReqEnableORF "" VALUE 0x70020edf Scalar_BOOLEAN 0 VBU0513_CM_boolean 0 1 /end CHARACTERISTIC
/begin CHARACTERISTIC THM_flgEXVPosReqEnableORV "" VALUE 0x70020ee0 Scalar_BOOLEAN 0 VBU0513_CM_boolean 0 1 /end CHARACTERISTIC
/begin CHARACTERISTIC THM_flgFANfrecuencyORF "" VALUE 0x90004b50 Scalar_BOOLEAN 0 VBU0513_CM_boolean 0 1 /end CHARACTERISTIC
/begin CHARACTERISTIC THM_flgFPVEnableORF "" VALUE 0x70020ee1 Scalar_BOOLEAN 0 VBU0513_CM_boolean 0 1 /end CHARACTERISTIC
/begin CHARACTERISTIC THM_flgFPVEnableORV "" VALUE 0x70020ee2 Scalar_BOOLEAN 0 VBU0513_CM_boolean 0 1 /end CHARACTERISTIC
/begin CHARACTERISTIC THM_flgFPVPosReqORF "" VALUE 0x70020ee3 Scalar_BOOLEAN 0 VBU0513_CM_boolean 0 1 /end CHARACTERISTIC
/begin CHARACTERISTIC THM_flgOverrideACCmpCmd "" VALUE 0x70020ee4 Scalar_BOOLEAN 0 VBU0513_CM_boolean_flg 0.0 1.0 /end CHARACTERISTIC
/begin CHARACTERISTIC THM_flgOverrideACCmpValid "" VALUE 0x70020ee5 Scalar_BOOLEAN 0 VBU0513_CM_boolean_flg 0.0 1.0 /end CHARACTERISTIC
/begin CHARACTERISTIC THM_flgOverrideACCmpVlv "" VALUE 0x70020ee6 Scalar_BOOLEAN 0 VBU0513_CM_boolean_flg 0.0 1.0 /end CHARACTERISTIC
/begin CHARACTERISTIC THM_flgOverrideBattPTCCmd "" VALUE 0x70020ee7 Scalar_BOOLEAN 0 VBU0513_CM_boolean_flg 0.0 1.0 /end CHARACTERISTIC
/begin CHARACTERISTIC THM_flgOverrideChillerPos "" VALUE 0x70020ee8 Scalar_BOOLEAN 0 VBU0513_CM_boolean_flg 0.0 1.0 /end CHARACTERISTIC
/begin CHARACTERISTIC THM_flgOverrideESSPmpCmd "" VALUE 0x70020ee9 Scalar_BOOLEAN 0 VBU0513_CM_boolean_flg 0.0 1.0 /end CHARACTERISTIC
/begin CHARACTERISTIC THM_flgOverrideFAN "" VALUE 0x70020eea Scalar_BOOLEAN 0 VBU0513_CM_boolean_flg 0.0 1.0 /end CHARACTERISTIC
/begin CHARACTERISTIC THM_flgOverrideRearPmpCmd "" VALUE 0x70020eeb Scalar_BOOLEAN 0 VBU0513_CM_boolean_flg 0.0 1.0 /end CHARACTERISTIC
/begin CHARACTERISTIC THM_flgOverridevalueACCmpValid "" VALUE 0x70020eec Scalar_BOOLEAN 0 VBU0513_CM_boolean_flg 0.0 1.0 /end CHARACTERISTIC
/begin CHARACTERISTIC THM_flgOverridevalueBattPTCCmd "" VALUE 0x70020eed Scalar_BOOLEAN 0 VBU0513_CM_boolean_flg 0.0 1.0 /end CHARACTERISTIC
/begin CHARACTERISTIC THM_flgPump1frecuencyORF "" VALUE 0x90004b51 Scalar_BOOLEAN 0 VBU0513_CM_boolean 0 1 /end CHARACTERISTIC
/begin CHARACTERISTIC VIN1VIN2VIN3Ovrd_C "" VALUE 0x70020f12 Scalar_BOOLEAN 0 VBU0513_CM_boolean_cnt 0.0 1.0 /end CHARACTERISTIC
/begin CHARACTERISTIC CcCTD_MainFuseBlownFaultFIC_n "" VALUE 0x70020be8 Scalar_BYTE 0 VBU0513_CM_int8_cnt -128.0 127.0 /end CHARACTERISTIC
/begin CHARACTERISTIC CcCTD_MainFuseBlownFaultPIC_n "" VALUE 0x70020be9 Scalar_BYTE 0 VBU0513_CM_int8_cnt -128.0 127.0 /end CHARACTERISTIC
/begin CHARACTERISTIC CcCTD_PrechargeResistanceBlownFaultFIC_n "" VALUE 0x70020bf7 Scalar_BYTE 0 VBU0513_CM_int8_cnt -128.0 127.0 /end CHARACTERISTIC
/begin CHARACTERISTIC CcCTD_PrechargeResistanceBlownFaultPIC_n "" VALUE 0x70020bf8 Scalar_BYTE 0 VBU0513_CM_int8_cnt -128.0 127.0 /end CHARACTERISTIC
/begin CHARACTERISTIC CcCTM_BoardOverTempFaultFIC_n "" VALUE 0x70020bff Scalar_BYTE 0 VBU0513_CM_int8_cnt -128.0 127.0 /end CHARACTERISTIC
/begin CHARACTERISTIC CcCTM_BoardOverTempFaultPIC_n "" VALUE 0x70020c00 Scalar_BYTE 0 VBU0513_CM_int8_cnt -128.0 127.0 /end CHARACTERISTIC
/begin CHARACTERISTIC CcCTM_CellOverTempEVMFaultFIC_n "" VALUE 0x70020c02 Scalar_BYTE 0 VBU0513_CM_int8_cnt -128.0 127.0 /end CHARACTERISTIC
/begin CHARACTERISTIC CcCTM_CellOverTempEVMFaultPIC_n "" VALUE 0x70020c03 Scalar_BYTE 0 VBU0513_CM_int8_cnt -128.0 127.0 /end CHARACTERISTIC
/begin CHARACTERISTIC CcCTM_CellOverTempFaultFIC_n "" VALUE 0x70020c04 Scalar_BYTE 0 VBU0513_CM_int8_cnt -128.0 127.0 /end CHARACTERISTIC
/begin CHARACTERISTIC CcCTM_CellOverTempFaultPIC_n "" VALUE 0x70020c05 Scalar_BYTE 0 VBU0513_CM_int8_cnt -128.0 127.0 /end CHARACTERISTIC
/begin CHARACTERISTIC CcCTM_CellOverTempWarningFaultFIC_n "" VALUE 0x70020c06 Scalar_BYTE 0 VBU0513_CM_int8_cnt -128.0 127.0 /end CHARACTERISTIC
/begin CHARACTERISTIC CcCTM_CellOverTempWarningFaultPIC_n "" VALUE 0x70020c07 Scalar_BYTE 0 VBU0513_CM_int8_cnt -128.0 127.0 /end CHARACTERISTIC
/begin CHARACTERISTIC CcCTM_CellTempOverDeviationEVMFaultFIC_n "" VALUE 0x70020c09 Scalar_BYTE 0 VBU0513_CM_int8_cnt -128.0 127.0 /end CHARACTERISTIC
/begin CHARACTERISTIC CcCTM_CellTempOverDeviationEVMFaultPIC_n "" VALUE 0x70020c0a Scalar_BYTE 0 VBU0513_CM_int8_cnt -128.0 127.0 /end CHARACTERISTIC
/begin CHARACTERISTIC CcCTM_CellTempOverDeviationFaultFIC_n "" VALUE 0x70020c0b Scalar_BYTE 0 VBU0513_CM_int8_cnt -128.0 127.0 /end CHARACTERISTIC
/begin CHARACTERISTIC CcCTM_CellTempOverDeviationFaultPIC_n "" VALUE 0x70020c0c Scalar_BYTE 0 VBU0513_CM_int8_cnt -128.0 127.0 /end CHARACTERISTIC
/begin CHARACTERISTIC CcCTM_CellUnderTempFaultFIC_n "" VALUE 0x70020c0f Scalar_BYTE 0 VBU0513_CM_int8_cnt -128.0 127.0 /end CHARACTERISTIC
/begin CHARACTERISTIC CcCTM_CellUnderTempFaultPIC_n "" VALUE 0x70020c10 Scalar_BYTE 0 VBU0513_CM_int8_cnt -128.0 127.0 /end CHARACTERISTIC
/begin CHARACTERISTIC CcCVT_CellOverVoltageEVMFaultFIC_n "" VALUE 0x70020c21 Scalar_BYTE 0 VBU0513_CM_int8_n -128.0 127.0 /end CHARACTERISTIC
/begin CHARACTERISTIC CcCVT_CellOverVoltageEVMFaultPIC_n "" VALUE 0x70020c22 Scalar_BYTE 0 VBU0513_CM_int8_n -128.0 127.0 /end CHARACTERISTIC
/begin CHARACTERISTIC CcCVT_CellOverVoltageFaultPIC_n "" VALUE 0x70020c24 Scalar_BYTE 0 VBU0513_CM_int8_n -128.0 127.0 /end CHARACTERISTIC
/begin CHARACTERISTIC CcCVT_CellUnderVoltageEVMFaultFIC_n "" VALUE 0x70020c25 Scalar_BYTE 0 VBU0513_CM_int8_n -128.0 127.0 /end CHARACTERISTIC
/begin CHARACTERISTIC CcCVT_CellUnderVoltageEVMFaultPIC_n "" VALUE 0x70020c26 Scalar_BYTE 0 VBU0513_CM_int8_n -128.0 127.0 /end CHARACTERISTIC
/begin CHARACTERISTIC CcCVT_CellUnderVoltageFaultFIC_n "" VALUE 0x70020c27 Scalar_BYTE 0 VBU0513_CM_int8_n -128.0 127.0 /end CHARACTERISTIC
/begin CHARACTERISTIC CcCVT_CellUnderVoltageFaultPIC_n "" VALUE 0x70020c28 Scalar_BYTE 0 VBU0513_CM_int8_n -128.0 127.0 /end CHARACTERISTIC
/begin CHARACTERISTIC CcCVT_CellVoltageOverDeviationEVMFaultFIC_n "" VALUE 0x70020c2a Scalar_BYTE 0 VBU0513_CM_int8_n -128.0 127.0 /end CHARACTERISTIC
/begin CHARACTERISTIC CcCVT_CellVoltageOverDeviationEVMFaultPIC_n "" VALUE 0x70020c2b Scalar_BYTE 0 VBU0513_CM_int8_n -128.0 127.0 /end CHARACTERISTIC
/begin CHARACTERISTIC CcCVT_CellVoltageOverDeviationFaultFIC_n "" VALUE 0x70020c2c Scalar_BYTE 0 VBU0513_CM_int8_n -128.0 127.0 /end CHARACTERISTIC
/begin CHARACTERISTIC CcCVT_CellVoltageOverDeviationFaultPIC_n "" VALUE 0x70020c2d Scalar_BYTE 0 VBU0513_CM_int8_n -128.0 127.0 /end CHARACTERISTIC
/begin CHARACTERISTIC CcFCC_ChargeCurrentOverFaultFIC_n "" VALUE 0x70020c2f Scalar_BYTE 0 VBU0513_CM_int8_cnt -128.0 127.0 /end CHARACTERISTIC
/begin CHARACTERISTIC CcFCC_ChargeCurrentOverFaultPIC_n "" VALUE 0x70020c30 Scalar_BYTE 0 VBU0513_CM_int8_cnt -128.0 127.0 /end CHARACTERISTIC
/begin CHARACTERISTIC BATTERY_DATE_DAYOvrdVal_C "" VALUE 0x70020a11 Scalar_UBYTE 0 VBU0513_CM_uint8_cnt 0.0 255.0 /end CHARACTERISTIC
/begin CHARACTERISTIC BATTERY_DATE_MONTHOvrdVal_C "" VALUE 0x70020a13 Scalar_UBYTE 0 VBU0513_CM_uint8_cnt 0.0 255.0 /end CHARACTERISTIC
/begin CHARACTERISTIC BATTERY_DATE_YEAROvrdVal_C "" VALUE 0x70020a15 Scalar_UBYTE 0 VBU0513_CM_uint8_cnt 0.0 255.0 /end CHARACTERISTIC
/begin CHARACTERISTIC BATTERY_GROUP_NUMBEROvrdVal_C "" VALUE 0x70020a18 Scalar_UBYTE 0 VBU0513_CM_uint8_cnt 0.0 255.0 /end CHARACTERISTIC
/begin CHARACTERISTIC BATTERY_ISOLATION_STATEOvrdVal_C "" VALUE 0x70020a1a Scalar_UBYTE 0 VBU0513_CM_uint8_cnt 0.0 255.0 /end CHARACTERISTIC
/begin CHARACTERISTIC BATTERY_OUTPUT_CONNECTOR_STATEOvrdVal_C "" VALUE 0x70020a1c Scalar_UBYTE 0 VBU0513_CM_uint8_cnt 0.0 255.0 /end CHARACTERISTIC
/begin CHARACTERISTIC BATTERY_PROPERTY_IDENTIFYOvrdVal_C "" VALUE 0x70020a1e Scalar_UBYTE 0 VBU0513_CM_uint8_cnt 0.0 255.0 /end CHARACTERISTIC
/begin CHARACTERISTIC BATTERY_SUPPLIEROvrdVal_C "" VALUE 0x70020a20 Scalar_UBYTE 0 VBU0513_CM_uint8_cnt 0.0 255.0 /end CHARACTERISTIC
/begin CHARACTERISTIC BMM_VEHICLE_WAKEUP_MODE_FAST_CHARGE "" VALUE 0x70020a35 Scalar_UBYTE 0 VBU0513_CM_uint8_cnt 0.0 255.0 /end CHARACTERISTIC
/begin CHARACTERISTIC BMM_VEHICLE_WAKEUP_MODE_IGNITION_ON "" VALUE 0x70020a36 Scalar_UBYTE 0 VBU0513_CM_uint8_cnt 0.0 255.0 /end CHARACTERISTIC
/begin CHARACTERISTIC BMM_VEHICLE_WAKEUP_MODE_SOFTWARE_FLASHING "" VALUE 0x70020a37 Scalar_UBYTE 0 VBU0513_CM_uint8_cnt 0.0 255.0 /end CHARACTERISTIC
/begin CHARACTERISTIC BMS_SOFTWARE_VERSION1OvrdVal_C "" VALUE 0x70020a38 Scalar_UBYTE 0 VBU0513_CM_uint8_cnt 0.0 255.0 /end CHARACTERISTIC
/begin CHARACTERISTIC BMS_SOFTWARE_VERSION2OvrdVal_C "" VALUE 0x70020a3a Scalar_UBYTE 0 VBU0513_CM_uint8_cnt 0.0 255.0 /end CHARACTERISTIC
/begin CHARACTERISTIC BRM_RESERVEDOvrdVal_C "" VALUE 0x70020a45 Scalar_UBYTE 0 VBU0513_CM_uint8_cnt 0.0 255.0 /end CHARACTERISTIC
/begin CHARACTERISTIC CELL_VOLTAGE_OVER_UNDEROvrdVal_C "" VALUE 0x70020a56 Scalar_UBYTE 0 VBU0513_CM_uint8_cnt 0.0 255.0 /end CHARACTERISTIC
/begin CHARACTERISTIC CHARGER_MESSAGE_OT_00OvrdVal_C "" VALUE 0x70020a70 Scalar_UBYTE 0 VBU0513_CM_uint8_cnt 0.0 255.0 /end CHARACTERISTIC
/begin CHARACTERISTIC CHARGER_MESSAGE_OT_AAOvrdVal_C "" VALUE 0x70020a72 Scalar_UBYTE 0 VBU0513_CM_uint8_cnt 0.0 255.0 /end CHARACTERISTIC
/begin CHARACTERISTIC CHARGER_MESSAGE_OT_READYOvrdVal_C "" VALUE 0x70020a74 Scalar_UBYTE 0 VBU0513_CM_uint8_cnt 0.0 255.0 /end CHARACTERISTIC
/begin CHARACTERISTIC CHARGER_MESSAGE_OT_STATEOvrdVal_C "" VALUE 0x70020a76 Scalar_UBYTE 0 VBU0513_CM_uint8_cnt 0.0 255.0 /end CHARACTERISTIC
/begin CHARACTERISTIC CHARGER_MESSAGE_OT_STATISTICSOvrdVal_C "" VALUE 0x70020a78 Scalar_UBYTE 0 VBU0513_CM_uint8_cnt 0.0 255.0 /end CHARACTERISTIC
/begin CHARACTERISTIC CHARGER_MESSAGE_OT_STOPOvrdVal_C "" VALUE 0x70020a7a Scalar_UBYTE 0 VBU0513_CM_uint8_cnt 0.0 255.0 /end CHARACTERISTIC
/begin CHARACTERISTIC CHARGER_MESSAGE_OT_SYNCHRONOUSOvrdVal_C "" VALUE 0x70020a7c Scalar_UBYTE 0 VBU0513_CM_uint8_cnt 0.0 255.0 /end CHARACTERISTIC
/begin CHARACTERISTIC CHARGING_PERMITOvrdVal_C "" VALUE 0x70020a80 Scalar_UBYTE 0 VBU0513_CM_uint8_cnt 0.0 255.0 /end CHARACTERISTIC
/begin CHARACTERISTIC CHARGING_TIMEOvrdVal_C "" VALUE 0x70020a82 Scalar_UBYTE 0 VBU0513_CM_uint8_cnt 0.0 255.0 /end CHARACTERISTIC
/begin CHARACTERISTIC CTD_MAIN_CONTACTOR_STATUS_Open "" VALUE 0x70020a86 Scalar_UBYTE 0 VBU0513_CM_uint8_cnt 0.0 255.0 /end CHARACTERISTIC
/begin CHARACTERISTIC CTD_MAIN_CONTACTOR_STATUS_UNKNOWN "" VALUE 0x70020a87 Scalar_UBYTE 0 VBU0513_CM_uint8_cnt 0.0 255.0 /end CHARACTERISTIC
/begin CHARACTERISTIC CTD_MAIN_FUSE_BLOWN_FAULT "" VALUE 0x70020a88 Scalar_UBYTE 0 VBU0513_CM_uint8_cnt 0.0 255.0 /end CHARACTERISTIC
/begin CHARACTERISTIC CTD_PRECHARGE_STATUS_FAIL "" VALUE 0x70020a8c Scalar_UBYTE 0 VBU0513_CM_uint8_cnt 0.0 255.0 /end CHARACTERISTIC
/begin CHARACTERISTIC CTD_PRECHARGE_STATUS_SUCCESS "" VALUE 0x70020a8e Scalar_UBYTE 0 VBU0513_CM_uint8_cnt 0.0 255.0 /end CHARACTERISTIC
/begin CHARACTERISTIC CTS_MAIN_CONTACTOR_COMMAND_CLOSE "" VALUE 0x70020a8f Scalar_UBYTE 0 VBU0513_CM_uint8_cnt 0.0 255.0 /end CHARACTERISTIC
/begin CHARACTERISTIC CTS_MAIN_CONTACTOR_COMMAND_OPEN "" VALUE 0x70020a90 Scalar_UBYTE 0 VBU0513_CM_uint8_cnt 0.0 255.0 /end CHARACTERISTIC
/begin CHARACTERISTIC CTS_PEU_DISCHARGE_ACTIVE "" VALUE 0x70020a91 Scalar_UBYTE 0 VBU0513_CM_uint8_cnt 0.0 255.0 /end CHARACTERISTIC
/begin CHARACTERISTIC CTS_STATE_CLOSE_AND_DIAGNOSE_MPR_STUCKOPEN "" VALUE 0x70020a92 Scalar_UBYTE 0 VBU0513_CM_uint8_cnt 0.0 255.0 /end CHARACTERISTIC
/begin CHARACTERISTIC CTS_STATE_CLOSE_MC_HSD_DIAGNOSE_LSD_STG "" VALUE 0x70020a93 Scalar_UBYTE 0 VBU0513_CM_uint8_cnt 0.0 255.0 /end CHARACTERISTIC
/begin CHARACTERISTIC CTS_STATE_CLOSE_MC_LSD_DIAGNOSE_HSD_STB "" VALUE 0x0000 Scalar_UBYTE 0 VBU0513_CM_uint8_cnt 0.0 255.0 /end CHARACTERISTIC
/begin CHARACTERISTIC CTS_STATE_CLOSE_MNC_PRECHARGING_MONITORING "" VALUE 0x70020a94 Scalar_UBYTE 0 VBU0513_CM_uint8_cnt 0.0 255.0 /end CHARACTERISTIC
/begin CHARACTERISTIC CTS_STATE_CLOSE_MPC "" VALUE 0x70020a95 Scalar_UBYTE 0 VBU0513_CM_uint8_cnt 0.0 255.0 /end CHARACTERISTIC
/begin CHARACTERISTIC CTS_STATE_DEACTIVATION "" VALUE 0x70020a96 Scalar_UBYTE 0 VBU0513_CM_uint8_cnt 0.0 255.0 /end CHARACTERISTIC
/begin CHARACTERISTIC CTS_STATE_DIAGNOSE_MNC_WELD "" VALUE 0x70020a97 Scalar_UBYTE 0 VBU0513_CM_uint8_cnt 0.0 255.0 /end CHARACTERISTIC
/begin CHARACTERISTIC CTS_STATE_DIAGNOSE_MPC_WELD "" VALUE 0x70020a98 Scalar_UBYTE 0 VBU0513_CM_uint8_cnt 0.0 255.0 /end CHARACTERISTIC
/begin CHARACTERISTIC CTS_STATE_DIAGNOSE_MPC_WELD_POWER_DOWN "" VALUE 0x70020a99 Scalar_UBYTE 0 VBU0513_CM_uint8_cnt 0.0 255.0 /end CHARACTERISTIC
/begin CHARACTERISTIC CTS_STATE_NORMAL_OPERATING "" VALUE 0x70020a9a Scalar_UBYTE 0 VBU0513_CM_uint8_cnt 0.0 255.0 /end CHARACTERISTIC
/begin CHARACTERISTIC CTS_STATE_OPEN_MAIN_POSITIVE_CONTACTOR "" VALUE 0x70020a9b Scalar_UBYTE 0 VBU0513_CM_uint8_cnt 0.0 255.0 /end CHARACTERISTIC
/begin CHARACTERISTIC CTS_STATE_OPEN_MC_AND_DIAGNOSE_WELD "" VALUE 0x70020a9c Scalar_UBYTE 0 VBU0513_CM_uint8_cnt 0.0 255.0 /end CHARACTERISTIC
/begin CHARACTERISTIC CTS_STATE_OPEN_MC_HSD "" VALUE 0x70020a9d Scalar_UBYTE 0 VBU0513_CM_uint8_cnt 0.0 255.0 /end CHARACTERISTIC
/begin CHARACTERISTIC CTS_STATE_OPEN_MPR_AND_DIAGNOSE_MPC_STUCKOPEN "" VALUE 0x70020a9e Scalar_UBYTE 0 VBU0513_CM_uint8_cnt 0.0 255.0 /end CHARACTERISTIC
/begin CHARACTERISTIC CTS_STATE_STANDBY "" VALUE 0x70020a9f Scalar_UBYTE 0 VBU0513_CM_uint8_cnt 0.0 255.0 /end CHARACTERISTIC
/begin CHARACTERISTIC CURRENT_OVER_UNDEROvrdVal_C "" VALUE 0x70020aa0 Scalar_UBYTE 0 VBU0513_CM_uint8_cnt 0.0 255.0 /end CHARACTERISTIC
/begin CHARACTERISTIC CVT_CELL_VOLTAGE_OVER_DEVIATION_FAULT "" VALUE 0x70020aa4 Scalar_UBYTE 0 VBU0513_CM_uint8_cnt 0.0 255.0 /end CHARACTERISTIC
/begin CHARACTERISTIC CYCLE_WAKEUP_STATE_ABNORMAL "" VALUE 0x70020aa5 Scalar_UBYTE 0 VBU0513_CM_uint8_cnt 0.0 255.0 /end CHARACTERISTIC
/begin CHARACTERISTIC CYCLE_WAKEUP_STATE_INIT "" VALUE 0x70020aa6 Scalar_UBYTE 0 VBU0513_CM_uint8_cnt 0.0 255.0 /end CHARACTERISTIC
/begin CHARACTERISTIC CaDSM_FaultCat_enum "" VAL_BLK 0x7002136c Scalar_UBYTE 0 VBU0513_CM_uint8_cnt 0.0 255.0 NUMBER 330 /end CHARACTERISTIC
/begin CHARACTERISTIC CbCTM_BoardOverTempFaultEnable_flg "" VALUE 0x70020ae5 Scalar_UBYTE 0 VBU0513_CM_uint8_cnt 0.0 255.0 /end CHARACTERISTIC
/begin CHARACTERISTIC CbCTS_HvilOpenContactorEnable_flg "" VALUE 0x70020af2 Scalar_UBYTE 0 VBU0513_CM_uint8_cnt 0.0 255.0 /end CHARACTERISTIC
/begin CHARACTERISTIC CbCVT_CellOverVoltageEVMFaultEnable_flg "" VALUE 0x70020af7 Scalar_UBYTE 0 VBU0513_CM_uint8_cnt 0.0 255.0 /end CHARACTERISTIC
/begin CHARACTERISTIC CbCVT_CellOverVoltageFaultEnable_flg "" VALUE 0x70020af8 Scalar_UBYTE 0 VBU0513_CM_uint8_cnt 0.0 255.0 /end CHARACTERISTIC
/begin CHARACTERISTIC CbCVT_CellUnderVoltageEVMFaultEnable_flg "" VALUE 0x70020af9 Scalar_UBYTE 0 VBU0513_CM_uint8_cnt 0.0 255.0 /end CHARACTERISTIC
/begin CHARACTERISTIC CbCVT_CellUnderVoltageFaultEnable_flg "" VALUE 0x70020afa Scalar_UBYTE 0 VBU0513_CM_uint8_cnt 0.0 255.0 /end CHARACTERISTIC
/begin CHARACTERISTIC CbCVT_CellVoltageOverDeviationEVMFaultEnable_flg "" VALUE 0x70020afb Scalar_UBYTE 0 VBU0513_CM_uint8_cnt 0.0 255.0 /end CHARACTERISTIC
/begin CHARACTERISTIC CbCVT_CellVoltageOverDeviationFaultEnable_flg "" VALUE 0x70020afc Scalar_UBYTE 0 VBU0513_CM_uint8_cnt 0.0 255.0 /end CHARACTERISTIC
/begin CHARACTERISTIC CcBMM_MaxWakeUpCounter_n "" VALUE 0x70020be3 Scalar_UBYTE 0 VBU0513_CM_uint8_cnt 0.0 255.0 /end CHARACTERISTIC
/begin CHARACTERISTIC CcCTM_BoardTempInvalidFault_n "" VALUE 0x70020c01 Scalar_UBYTE 0 VBU0513_CM_uint8_cnt 0.0 255.0 /end CHARACTERISTIC
/begin CHARACTERISTIC CcCTM_CellTempInvalidFault_n "" VALUE 0x70020c08 Scalar_UBYTE 0 VBU0513_CM_uint8_cnt 0.0 255.0 /end CHARACTERISTIC
/begin CHARACTERISTIC CcCTS_MaxPrechargeTimes_n "" VALUE 0x70020c14 Scalar_UBYTE 0 VBU0513_CM_uint8_cnt 0.0 255.0 /end CHARACTERISTIC
/begin CHARACTERISTIC CcCTS_NegativeLoadCurrent_A "" VALUE 0x70020c15 Scalar_UBYTE 0 VBU0513_CM_uint8_cnt 0.0 255.0 /end CHARACTERISTIC
/begin CHARACTERISTIC CcCTS_PositiveLoadCurrent_A "" VALUE 0x70020c16 Scalar_UBYTE 0 VBU0513_CM_uint8_cnt 0.0 255.0 /end CHARACTERISTIC
/begin CHARACTERISTIC CcCTS_PrechargeTimesLimitEnable_flg "" VALUE 0x70020c17 Scalar_UBYTE 0 VBU0513_CM_uint8_cnt 0.0 255.0 /end CHARACTERISTIC
/begin CHARACTERISTIC CcCTS_PrechargeTimesLower_n "" VALUE 0x70020c18 Scalar_UBYTE 0 VBU0513_CM_uint8_cnt 0.0 255.0 /end CHARACTERISTIC
/begin CHARACTERISTIC CcCTS_PrechargeTimesUpper_n "" VALUE 0x70020c19 Scalar_UBYTE 0 VBU0513_CM_uint8_cnt 0.0 255.0 /end CHARACTERISTIC
/begin CHARACTERISTIC CcCVT_CellOverVoltageFaultFIC_n "" VALUE 0x70020c23 Scalar_UBYTE 0 VBU0513_CM_uint8_n 0.0 255.0 /end CHARACTERISTIC
/begin CHARACTERISTIC CcCVT_CellVoltageInvalidFault_n "" VALUE 0x70020c29 Scalar_UBYTE 0 VBU0513_CM_uint8_n 0.0 255.0 /end CHARACTERISTIC
/begin CHARACTERISTIC CmSYS_OpenContactorsDelayFaultCat_enum "" VALUE 0x70020ca8 Scalar_UBYTE 0 VBU0513_CM_uint8_cnt 0.0 255.0 /end CHARACTERISTIC
/begin CHARACTERISTIC CmSYS_OpenContactorsNowFaultCat_enum "" VALUE 0x70020ca9 Scalar_UBYTE 0 VBU0513_CM_uint8_cnt 0.0 255.0 /end CHARACTERISTIC
/begin CHARACTERISTIC DCH_numBRMBattTypOvrdVal_C "" VALUE 0x70020d2b Scalar_UBYTE 0 VBU0513_CM_uint8_cnt 0.0 255.0 /end CHARACTERISTIC
/begin CHARACTERISTIC DCH_numBRMProtcVerOvrdVal_C "" VALUE 0x70020d2d Scalar_UBYTE 0 VBU0513_CM_uint8_cnt 0.0 255.0 /end CHARACTERISTIC
/begin CHARACTERISTIC DIAGNOSTIC_COMPLETE "" VALUE 0x70020d97 Scalar_UBYTE 0 VBU0513_CM_uint8_cnt 0.0 255.0 /end CHARACTERISTIC
/begin CHARACTERISTIC DIAGNOSTIC_CONDITION_NOT_MET "" VALUE 0x70020d98 Scalar_UBYTE 0 VBU0513_CM_uint8_cnt 0.0 255.0 /end CHARACTERISTIC
/begin CHARACTERISTIC DSPL_stCurrentGearD_C "" VALUE 0x70020da3 Scalar_UBYTE 0 VBU0513_CM_uint8_cnt 0.0 255.0 /end CHARACTERISTIC
/begin CHARACTERISTIC DSPL_stCurrentGearN_C "" VALUE 0x70020da4 Scalar_UBYTE 0 VBU0513_CM_uint8_cnt 0.0 255.0 /end CHARACTERISTIC
/begin CHARACTERISTIC DSPL_stCurrentGearP_C "" VALUE 0x70020da5 Scalar_UBYTE 0 VBU0513_CM_uint8_cnt 0.0 255.0 /end CHARACTERISTIC
/begin CHARACTERISTIC DSPL_stCurrentGearR_C "" VALUE 0x70020da6 Scalar_UBYTE 0 VBU0513_CM_uint8_cnt 0.0 255.0 /end CHARACTERISTIC
/begin CHARACTERISTIC DSPL_stDCDCStsFail_SY "" VALUE 0x70020da7 Scalar_UBYTE 0 VBU0513_CM_uint8_cnt 0.0 255.0 /end CHARACTERISTIC
/begin CHARACTERISTIC DSPL_stHVCntctStClosed_SY "" VALUE 0x70020dab Scalar_UBYTE 0 VBU0513_CM_uint8_cnt 0.0 255.0 /end CHARACTERISTIC
/begin CHARACTERISTIC DSPL_stLvBattChrgFail_C "" VALUE 0x70020dac Scalar_UBYTE 0 VBU0513_CM_uint8_cnt 0.0 255.0 /end CHARACTERISTIC
/begin CHARACTERISTIC DSPL_stLvBattChrging_C "" VALUE 0x70020dad Scalar_UBYTE 0 VBU0513_CM_uint8_cnt 0.0 255.0 /end CHARACTERISTIC
/begin CHARACTERISTIC DSPL_stLvBattNoChrg_C "" VALUE 0x70020dae Scalar_UBYTE 0 VBU0513_CM_uint8_cnt 0.0 255.0 /end CHARACTERISTIC
/begin CHARACTERISTIC DSPL_stPEURMotTempAlarm_SY "" VALUE 0x70020daf Scalar_UBYTE 0 VBU0513_CM_uint8_cnt 0.0 255.0 /end CHARACTERISTIC
/begin CHARACTERISTIC FCC_STATE_ABORT_CHARGE "" VALUE 0x70020dc6 Scalar_UBYTE 0 VBU0513_CM_uint8_cnt 0.0 255.0 /end CHARACTERISTIC
/begin CHARACTERISTIC FCC_STATE_BMS_CLOSE_CONTACTORS "" VALUE 0x70020dc7 Scalar_UBYTE 0 VBU0513_CM_uint8_cnt 0.0 255.0 /end CHARACTERISTIC
/begin CHARACTERISTIC FCC_STATE_CHARGE_FAULT "" VALUE 0x70020dc8 Scalar_UBYTE 0 VBU0513_CM_uint8_cnt 0.0 255.0 /end CHARACTERISTIC
/begin CHARACTERISTIC FCC_STATE_CHARGE_FULL "" VALUE 0x70020dc9 Scalar_UBYTE 0 VBU0513_CM_uint8_cnt 0.0 255.0 /end CHARACTERISTIC
/begin CHARACTERISTIC FCC_STATE_CHARGE_PROTECTION "" VALUE 0x70020dca Scalar_UBYTE 0 VBU0513_CM_uint8_cnt 0.0 255.0 /end CHARACTERISTIC
/begin CHARACTERISTIC FCC_STATE_CHARGING "" VALUE 0x70020dcb Scalar_UBYTE 0 VBU0513_CM_uint8_cnt 0.0 255.0 /end CHARACTERISTIC
/begin CHARACTERISTIC FCC_STATE_DEACTIVATE_DEVICES "" VALUE 0x70020dcc Scalar_UBYTE 0 VBU0513_CM_uint8_cnt 0.0 255.0 /end CHARACTERISTIC
/begin CHARACTERISTIC FCC_STATE_STANDBY "" VALUE 0x70020dcd Scalar_UBYTE 0 VBU0513_CM_uint8_cnt 0.0 255.0 /end CHARACTERISTIC
/begin CHARACTERISTIC FCC_STATE_SYSTEM_STATUS_CHECK "" VALUE 0x70020dce Scalar_UBYTE 0 VBU0513_CM_uint8_cnt 0.0 255.0 /end CHARACTERISTIC
/begin CHARACTERISTIC FCC_STATE_WAIT_VCU_COMMAND "" VALUE 0x70020dcf Scalar_UBYTE 0 VBU0513_CM_uint8_cnt 0.0 255.0 /end CHARACTERISTIC
/begin CHARACTERISTIC FPV_st4WayVlvPosFdbkPosition1_SY "" VALUE 0x70020dd0 Scalar_UBYTE 0 VBU0513_CM_uint8_cnt 0.0 8.0 /end CHARACTERISTIC
/begin CHARACTERISTIC FPV_st4WayVlvPosFdbkPosition2_SY "" VALUE 0x70020dd1 Scalar_UBYTE 0 VBU0513_CM_uint8_cnt 0.0 8.0 /end CHARACTERISTIC
/begin CHARACTERISTIC FPV_st4WayVlvPosFdbkUnknow_SY "" VALUE 0x70020dd2 Scalar_UBYTE 0 VBU0513_CM_uint8_cnt 0.0 8.0 /end CHARACTERISTIC
/begin CHARACTERISTIC GATEWAY_STOP_ERROR_REASON_OCOvrdVal_C "" VALUE 0x70020dd3 Scalar_UBYTE 0 VBU0513_CM_uint8_cnt 0.0 255.0 /end CHARACTERISTIC
/begin CHARACTERISTIC GATEWAY_STOP_ERROR_REASON_VOLTOvrdVal_C "" VALUE 0x70020dd5 Scalar_UBYTE 0 VBU0513_CM_uint8_cnt 0.0 255.0 /end CHARACTERISTIC
/begin CHARACTERISTIC GATEWAY_STOP_FAULT_REASON_1OvrdVal_C "" VALUE 0x70020dd7 Scalar_UBYTE 0 VBU0513_CM_uint8_cnt 0.0 255.0 /end CHARACTERISTIC
/begin CHARACTERISTIC GATEWAY_STOP_FAULT_REASON_2OvrdVal_C "" VALUE 0x70020dd9 Scalar_UBYTE 0 VBU0513_CM_uint8_cnt 0.0 255.0 /end CHARACTERISTIC
/begin CHARACTERISTIC GATEWAY_STOP_FAULT_REASON_3OvrdVal_C "" VALUE 0x70020ddb Scalar_UBYTE 0 VBU0513_CM_uint8_cnt 0.0 255.0 /end CHARACTERISTIC
/begin CHARACTERISTIC GATEWAY_STOP_FAULT_REASON_BMSOTOvrdVal_C "" VALUE 0x70020ddd Scalar_UBYTE 0 VBU0513_CM_uint8_cnt 0.0 255.0 /end CHARACTERISTIC
/begin CHARACTERISTIC GATEWAY_STOP_FAULT_REASON_CELLOTOvrdVal_C "" VALUE 0x70020ddf Scalar_UBYTE 0 VBU0513_CM_uint8_cnt 0.0 255.0 /end CHARACTERISTIC
/begin CHARACTERISTIC GATEWAY_STOP_FAULT_REASON_CONNOTOvrdVal_C "" VALUE 0x70020de1 Scalar_UBYTE 0 VBU0513_CM_uint8_cnt 0.0 255.0 /end CHARACTERISTIC
/begin CHARACTERISTIC GATEWAY_STOP_FAULT_REASON_CONNOvrdVal_C "" VALUE 0x70020de3 Scalar_UBYTE 0 VBU0513_CM_uint8_cnt 0.0 255.0 /end CHARACTERISTIC
/begin CHARACTERISTIC GATEWAY_STOP_FAULT_REASON_ISOOvrdVal_C "" VALUE 0x70020de5 Scalar_UBYTE 0 VBU0513_CM_uint8_cnt 0.0 255.0 /end CHARACTERISTIC
/begin CHARACTERISTIC GATEWAY_STOP_REASON_CELLVOLTOvrdVal_C "" VALUE 0x70020de7 Scalar_UBYTE 0 VBU0513_CM_uint8_cnt 0.0 255.0 /end CHARACTERISTIC
/begin CHARACTERISTIC GATEWAY_STOP_REASON_SOCOvrdVal_C "" VALUE 0x70020de9 Scalar_UBYTE 0 VBU0513_CM_uint8_cnt 0.0 255.0 /end CHARACTERISTIC
/begin CHARACTERISTIC GATEWAY_STOP_REASON_STATIONOvrdVal_C "" VALUE 0x70020deb Scalar_UBYTE 0 VBU0513_CM_uint8_cnt 0.0 255.0 /end CHARACTERISTIC
/begin CHARACTERISTIC GATEWAY_STOP_REASON_TOTALVOLTOvrdVal_C "" VALUE 0x70020ded Scalar_UBYTE 0 VBU0513_CM_uint8_cnt 0.0 255.0 /end CHARACTERISTIC
/begin CHARACTERISTIC Gear_stCurrentGearN_C "" VALUE 0x70020dfb Scalar_UBYTE 0 VBU0513_CM_uint8_cnt 0.0 15.0 /end CHARACTERISTIC
/begin CHARACTERISTIC Gear_stCurrentGearP_C "" VALUE 0x70020dfc Scalar_UBYTE 0 VBU0513_CM_uint8_cnt 0.0 255.0 /end CHARACTERISTIC
/begin CHARACTERISTIC MAXIMUM_CELL_TEMPOvrdVal_C "" VALUE 0x70020e50 Scalar_UBYTE 0 VBU0513_CM_uint8_cnt 0.0 255.0 /end CHARACTERISTIC
/begin CHARACTERISTIC MAXIMUM_CELL_TEMP_BSDOvrdVal_C "" VALUE 0x70020e52 Scalar_UBYTE 0 VBU0513_CM_uint8_cnt 0.0 255.0 /end CHARACTERISTIC
/begin CHARACTERISTIC MAXIMUM_CELL_VOLTAGE_BSDOvrdVal_C "" VALUE 0x70020e54 Scalar_UBYTE 0 VBU0513_CM_uint8_cnt 0.0 255.0 /end CHARACTERISTIC
/begin CHARACTERISTIC MAXIMUM_CELL_VOLTAGE_NUMBER_BSMOvrdVal_C "" VALUE 0x70020e56 Scalar_UBYTE 0 VBU0513_CM_uint8_cnt 0.0 255.0 /end CHARACTERISTIC
/begin CHARACTERISTIC MAXIMUM_TEMP_NUMBEROvrdVal_C "" VALUE 0x70020e58 Scalar_UBYTE 0 VBU0513_CM_uint8_cnt 0.0 255.0 /end CHARACTERISTIC
/begin CHARACTERISTIC MINIMUM_CELL_TEMPOvrdVal_C "" VALUE 0x70020e5e Scalar_UBYTE 0 VBU0513_CM_uint8_cnt 0.0 255.0 /end CHARACTERISTIC
/begin CHARACTERISTIC MINIMUM_CELL_TEMP_BSDOvrdVal_C "" VALUE 0x70020e60 Scalar_UBYTE 0 VBU0513_CM_uint8_cnt 0.0 255.0 /end CHARACTERISTIC
/begin CHARACTERISTIC MINIMUM_CELL_VOLTAGE_BSDOvrdVal_C "" VALUE 0x70020e62 Scalar_UBYTE 0 VBU0513_CM_uint8_cnt 0.0 255.0 /end CHARACTERISTIC
/begin CHARACTERISTIC MINIMUM_TEMP_NUMBEROvrdVal_C "" VALUE 0x70020e64 Scalar_UBYTE 0 VBU0513_CM_uint8_cnt 0.0 255.0 /end CHARACTERISTIC
/begin CHARACTERISTIC PMM_stACTest_SY "" VALUE 0x70020e99 Scalar_UBYTE 0 VBU0513_CM_uint8_cnt 0.0 255.0 /end CHARACTERISTIC
/begin CHARACTERISTIC PMM_stActvDisCh_SY "" VALUE 0x70020e9b Scalar_UBYTE 0 VBU0513_CM_uint8_cnt 0.0 255.0 /end CHARACTERISTIC
/begin CHARACTERISTIC PMM_stDCDCDisbl_SY "" VALUE 0x70020e9d Scalar_UBYTE 0 VBU0513_CM_uint8_cnt 0.0 255.0 /end CHARACTERISTIC
/begin CHARACTERISTIC PMM_stHVCntctStClosed_SY "" VALUE 0x70020ea5 Scalar_UBYTE 0 VBU0513_CM_uint8_cnt 0.0 255.0 /end CHARACTERISTIC
/begin CHARACTERISTIC PMM_stHVCntctStInit_SY "" VALUE 0x70020ea6 Scalar_UBYTE 0 VBU0513_CM_uint8_cnt 0.0 255.0 /end CHARACTERISTIC
/begin CHARACTERISTIC PMM_stHVCntctStPreCh_SY "" VALUE 0x70020ea7 Scalar_UBYTE 0 VBU0513_CM_uint8_cnt 0.0 255.0 /end CHARACTERISTIC
/begin CHARACTERISTIC PMM_stHVRlyClose_SY "" VALUE 0x70020ea8 Scalar_UBYTE 0 VBU0513_CM_uint8_cnt 0.0 255.0 /end CHARACTERISTIC
/begin CHARACTERISTIC PMM_stHVRlyConnReq_SY "" VALUE 0x70020ea9 Scalar_UBYTE 0 VBU0513_CM_uint8_cnt 0.0 255.0 /end CHARACTERISTIC
/begin CHARACTERISTIC PMM_stHVRlyConn_SY "" VALUE 0x70020eaa Scalar_UBYTE 0 VBU0513_CM_uint8_cnt 0.0 255.0 /end CHARACTERISTIC
/begin CHARACTERISTIC PMM_stHVRlyNoReq_SY "" VALUE 0x70020eab Scalar_UBYTE 0 VBU0513_CM_uint8_cnt 0.0 255.0 /end CHARACTERISTIC
/begin CHARACTERISTIC PMM_stHVRlyOpenReq_SY "" VALUE 0x70020eac Scalar_UBYTE 0 VBU0513_CM_uint8_cnt 0.0 255.0 /end CHARACTERISTIC
/begin CHARACTERISTIC PMM_stHVRlyOpen_SY "" VALUE 0x70020ead Scalar_UBYTE 0 VBU0513_CM_uint8 0 255 /end CHARACTERISTIC
/begin CHARACTERISTIC PMM_stInitMode_SY "" VALUE 0x70020eb0 Scalar_UBYTE 0 VBU0513_CM_uint8_cnt 0.0 255.0 /end CHARACTERISTIC
/begin CHARACTERISTIC PMM_stInitRst_SY "" VALUE 0x70020eb1 Scalar_UBYTE 0 VBU0513_CM_uint8_cnt 0.0 255.0 /end CHARACTERISTIC
/begin CHARACTERISTIC PMM_stMCUACOff_SY "" VALUE 0x70020eb2 Scalar_UBYTE 0 VBU0513_CM_uint8_cnt 0.0 255.0 /end CHARACTERISTIC
/begin CHARACTERISTIC PMM_stRstKeep_SY "" VALUE 0x70020eb9 Scalar_UBYTE 0 VBU0513_CM_uint8_cnt 0.0 255.0 /end CHARACTERISTIC
/begin CHARACTERISTIC PMM_stShutDown_SY "" VALUE 0x70020eba Scalar_UBYTE 0 VBU0513_CM_uint8_cnt 0.0 255.0 /end CHARACTERISTIC
/begin CHARACTERISTIC READY_CHARGING_GATEWAYOvrdVal_C "" VALUE 0x70020ebe Scalar_UBYTE 0 VBU0513_CM_uint8_cnt 0.0 255.0 /end CHARACTERISTIC
/begin CHARACTERISTIC SOC_OVER_UNDEROvrdVal_C "" VALUE 0x70020ec5 Scalar_UBYTE 0 VBU0513_CM_uint8_cnt 0.0 255.0 /end CHARACTERISTIC
/begin CHARACTERISTIC SOC_STOPOvrdVal_C "" VALUE 0x70020ec7 Scalar_UBYTE 0 VBU0513_CM_uint8_cnt 0.0 255.0 /end CHARACTERISTIC
/begin CHARACTERISTIC THM_stFPVPosORV "" VALUE 0x70020eee Scalar_UBYTE 0 VBU0513_CM_uint8 0 255 /end CHARACTERISTIC
/begin CHARACTERISTIC THM_stOverridevalueACVlvOnoff "" VALUE 0x70020eef Scalar_UBYTE 0 VBU0513_CM_uint8_cnt 0.0 255.0 /end CHARACTERISTIC
/begin CHARACTERISTIC VCR_CONTACTOR_NO_REQUEST "" VALUE 0x70020f0a Scalar_UBYTE 0 VBU0513_CM_uint8_cnt 0.0 255.0 /end CHARACTERISTIC
/begin CHARACTERISTIC VCR_CONTACTOR_OPEN "" VALUE 0x70020f0b Scalar_UBYTE 0 VBU0513_CM_uint8_cnt 0.0 255.0 /end CHARACTERISTIC
/begin CHARACTERISTIC Veh_stIMInverterON_C "" VALUE 0x70020f2b Scalar_UBYTE 0 VBU0513_CM_uint8_cnt 0.0 15.0 /end CHARACTERISTIC
/begin CHARACTERISTIC Veh_stInverterOFF_C "" VALUE 0x70020f2c Scalar_UBYTE 0 VBU0513_CM_uint8_cnt 0.0 15.0 /end CHARACTERISTIC
/begin CHARACTERISTIC Veh_stInverterON_C "" VALUE 0x70020f2d Scalar_UBYTE 0 VBU0513_CM_uint8_cnt 0.0 15.0 /end CHARACTERISTIC
/begin CHARACTERISTIC Veh_stVehTire19_C "" VALUE 0x70020f2f Scalar_UBYTE 0 VBU0513_CM_uint8_cnt 0.0 15.0 /end CHARACTERISTIC
/begin MEASUREMENT FCC_timinEstimateChargeTime "" ULONG VBU0513_CM_uint32 0 0 0 4294967295 ECU_ADDRESS 0x90001ee6 /end MEASUREMENT
/begin MEASUREMENT FCC_timinEstimatePercTime "" ULONG VBU0513_CM_uint32 0 0 0 4294967295 ECU_ADDRESS 0x90001eea /end MEASUREMENT
/begin MEASUREMENT THM_pctEVXPosReq "" FLOAT32_IEEE VBU0513_CM_single 0 0 -3.4E+38 3.4E+38 ECU_ADDRESS 0x90002006 /end MEASUREMENT
/begin MEASUREMENT THM_phiEXVPosReq "" FLOAT32_IEEE VBU0513_CM_single 0 0 -3.4E+38 3.4E+38 ECU_ADDRESS 0x90002506 /end MEASUREMENT
/begin MEASUREMENT THM_pctFANRaw "" FLOAT32_IEEE VBU0513_CM_single 0 0 -3.4E+38 3.4E+38 ECU_ADDRESS 0x9000200a /end MEASUREMENT
/begin MEASUREMENT THM_rpmACCompCmd "" FLOAT32_IEEE VBU0513_CM_single 0 0 -3.4E+38 3.4E+38 ECU_ADDRESS 0x9000250a /end MEASUREMENT
/begin MEASUREMENT THM_flgACVlvOnOff "" FLOAT32_IEEE VBU0513_CM_single 0 0 -3.4E+38 3.4E+38 ECU_ADDRESS 0x900024fa /end MEASUREMENT
/begin MEASUREMENT THM_pctChillerPos "" FLOAT32_IEEE VBU0513_CM_single 0 0 -3.4E+38 3.4E+38 ECU_ADDRESS 0x90002502 /end MEASUREMENT
/begin MEASUREMENT TQD_trqNrmBrkDes "" FLOAT32_IEEE VBU0513_CM_single 0 0 -10000.0 10000.0 ECU_ADDRESS 0x900021e2 /end MEASUREMENT
/begin MEASUREMENT TQD_trqAPDDes "" FLOAT32_IEEE VBU0513_CM_single 0 0 -3.4E+38 3.4E+38 ECU_ADDRESS 0x90002522 /end MEASUREMENT
/begin MEASUREMENT TQD_trqBrkRgn "" FLOAT32_IEEE VBU0513_CM_single 0 0 -3.4E+38 3.4E+38 ECU_ADDRESS 0x900021c6 /end MEASUREMENT
/begin MEASUREMENT TQD_trqDes "" FLOAT32_IEEE VBU0513_CM_single 0 0 -3.4E+38 3.4E+38 ECU_ADDRESS 0x900020b6 /end MEASUREMENT
/begin MEASUREMENT PMM_tiStDurT "" FLOAT32_IEEE VBU0513_CM_single 0 0 -3.4E+38 3.4E+38 ECU_ADDRESS 0x900022fe /end MEASUREMENT
/begin MEASUREMENT FCC_tisChargeFaultTimer "" FLOAT32_IEEE VBU0513_CM_single 0 0 -3.4E+38 3.4E+38 ECU_ADDRESS 0x900022be /end MEASUREMENT
/begin MEASUREMENT FCC_tisChargeProtectTimer "" FLOAT32_IEEE VBU0513_CM_single 0 0 -3.4E+38 3.4E+38 ECU_ADDRESS 0x900022c6 /end MEASUREMENT
/begin MEASUREMENT FCC_tisChargeFullTimer "" FLOAT32_IEEE VBU0513_CM_single 0 0 -3.4E+38 3.4E+38 ECU_ADDRESS 0x900022c2 /end MEASUREMENT
/begin MEASUREMENT FCC_tisChargeAbortTimer "" FLOAT32_IEEE VBU0513_CM_single 0 0 -3.4E+38 3.4E+38 ECU_ADDRESS 0x900022ba /end MEASUREMENT
/begin MEASUREMENT FCC_timinActualRemainChargeTime "" FLOAT32_IEEE VBU0513_CM_single 0 0 -3.4E+38 3.4E+38 ECU_ADDRESS 0x90002436 /end MEASUREMENT
/begin MEASUREMENT CVT_uCellVoltagePack "" FLOAT32_IEEE VBU0513_CM_single 0 0 -3.4E+38 3.4E+38 ECU_ADDRESS 0x900023f6 /end MEASUREMENT
/begin MEASUREMENT CTS_timsPrechargeTimer "" FLOAT32_IEEE VBU0513_CM_single 0 0 -3.4E+38 3.4E+38 ECU_ADDRESS 0x900023f2 /end MEASUREMENT
/begin MEASUREMENT CTM_tCellTempMin "" FLOAT32_IEEE VBU0513_CM_single 0 0 -3.4E+38 3.4E+38 ECU_ADDRESS 0x90001e46 /end MEASUREMENT
/begin MEASUREMENT CTM_tOriginalCellTempMin "" FLOAT32_IEEE VBU0513_CM_single 0 0 -3.4E+38 3.4E+38 ECU_ADDRESS 0x9000228e /end MEASUREMENT
/begin MEASUREMENT CTM_tCellTempMax "" FLOAT32_IEEE VBU0513_CM_single 0 0 -3.4E+38 3.4E+38 ECU_ADDRESS 0x90001e42 /end MEASUREMENT
/begin MEASUREMENT CTM_tOriginalCellTempMax "" FLOAT32_IEEE VBU0513_CM_single 0 0 -3.4E+38 3.4E+38 ECU_ADDRESS 0x9000228a /end MEASUREMENT
/begin MEASUREMENT CTM_tCellTempAve "" FLOAT32_IEEE VBU0513_CM_single 0 0 -3.4E+38 3.4E+38 ECU_ADDRESS 0x90001e3e /end MEASUREMENT
/begin MEASUREMENT CTM_tOriginalCellTempAve "" FLOAT32_IEEE VBU0513_CM_single 0 0 -3.4E+38 3.4E+38 ECU_ADDRESS 0x90002286 /end MEASUREMENT
/begin MEASUREMENT CTM_tOriginalCellTempSecondMax "" FLOAT32_IEEE VBU0513_CM_single 0 0 -40.0 200.0 ECU_ADDRESS 0x90001e4a /end MEASUREMENT
/begin MEASUREMENT CTD_stMnPosContactorStatus "" FLOAT32_IEEE VBU0513_CM_single 0 0 -3.4E+38 3.4E+38 ECU_ADDRESS 0x90002276 /end MEASUREMENT
/begin MEASUREMENT CTD_stMnNegContactorStatus "" FLOAT32_IEEE VBU0513_CM_single 0 0 -3.4E+38 3.4E+38 ECU_ADDRESS 0x90002272 /end MEASUREMENT
/begin MEASUREMENT CTD_stPrechargeContactorStatus "" FLOAT32_IEEE VBU0513_CM_single 0 0 -3.4E+38 3.4E+38 ECU_ADDRESS 0x9000227a /end MEASUREMENT
/begin MEASUREMENT CTD_stHeatingContactorStatus "" FLOAT32_IEEE VBU0513_CM_single 0 0 -3.4E+38 3.4E+38 ECU_ADDRESS 0x9000226e /end MEASUREMENT
/begin MEASUREMENT GaCSC_flgCellBalanceRequest "" FLOAT32_IEEE VBU0513_CM_single 0 0 -3.4E+38 3.4E+38 ARRAY_SIZE 198 ECU_ADDRESS 0x90000ca0 /end MEASUREMENT
/begin MEASUREMENT BCV_iABatteryCurrentRaw "" FLOAT32_IEEE VBU0513_CM_single 0 0 -3.4E+38 3.4E+38 ECU_ADDRESS 0x900023d6 /end MEASUREMENT
/begin MEASUREMENT THM_pctFAN "" UWORD VBU0513_CM_uint16 0 0 0 65535 ECU_ADDRESS 0x900039ec /end MEASUREMENT
/begin MEASUREMENT THM_pctESSPmpCmd "" UWORD VBU0513_CM_uint16 0 0 0 65535 ECU_ADDRESS 0x900039ea /end MEASUREMENT
/begin MEASUREMENT THM_pctRearPmpCmd "" UWORD VBU0513_CM_uint16 0 0 0 65535 ECU_ADDRESS 0x900039ee /end MEASUREMENT
/begin MEASUREMENT GaCVT_CellVoltage_mV "" UWORD VBU0513_CM_uint16 0 0 0.0 5000.0 ARRAY_SIZE 198 ECU_ADDRESS 0x90001aa4 /end MEASUREMENT
/begin MEASUREMENT CVT_mvCellVoltageSecondMin "" UWORD VBU0513_CM_uint16 0 0 0 65535 ECU_ADDRESS 0x900039dc /end MEASUREMENT
/begin MEASUREMENT CVT_mvCellVoltageSecondMax "" UWORD VBU0513_CM_uint16 0 0 0 65535 ECU_ADDRESS 0x900039da /end MEASUREMENT
/begin MEASUREMENT CVT_mvCellVoltageMin "" UWORD VBU0513_CM_uint16 0 0 0.0 5000.0 ECU_ADDRESS 0x90002f92 /end MEASUREMENT
/begin MEASUREMENT CVT_mvCellVoltageMax "" UWORD VBU0513_CM_uint16 0 0 0.0 5000.0 ECU_ADDRESS 0x90002f8a /end MEASUREMENT
/begin MEASUREMENT CVT_mvCellVoltageAve "" UWORD VBU0513_CM_uint16 0 0 0 65535 ECU_ADDRESS 0x90003772 /end MEASUREMENT
/begin MEASUREMENT CTD_stPrechargeRelayBlown "" UWORD VBU0513_CM_uint16 0 0 0 65535 ECU_ADDRESS 0x900037a0 /end MEASUREMENT
/begin MEASUREMENT CTD_stMainFuseBlownFault "" UWORD VBU0513_CM_uint16 0 0 0 65535 ECU_ADDRESS 0x900039ac /end MEASUREMENT
/begin MEASUREMENT BMM_numMonitorLastCycle "" UWORD VBU0513_CM_uint16 0 0 0 65535 ECU_ADDRESS 0x900039ce /end MEASUREMENT
/begin MEASUREMENT THM_stEXVInitReq "" UBYTE VBU0513_CM_uint8 0 0 0 255 ECU_ADDRESS 0x90004080 /end MEASUREMENT
/begin MEASUREMENT THM_stEXVInitial "" UBYTE VBU0513_CM_uint8 0 0 0 255 ECU_ADDRESS 0x900042be /end MEASUREMENT
/begin MEASUREMENT THM_stFPVPosition_Req "" UBYTE VBU0513_CM_uint8 0 0 0 255 ECU_ADDRESS 0x900042bf /end MEASUREMENT
/begin MEASUREMENT PMM_stHVRlyReqTmp "" UBYTE VBU0513_CM_uint8 0 0 0 255 ECU_ADDRESS 0x90004286 /end MEASUREMENT
/begin MEASUREMENT PMM_stPwrModeSt "" UBYTE VBU0513_CM_uint8 0 0 0 255 ECU_ADDRESS 0x90004288 /end MEASUREMENT
/begin MEASUREMENT FCC_stChargeState "" UBYTE VBU0513_CM_uint8 0 0 0 255 ECU_ADDRESS 0x90004267 /end MEASUREMENT
/begin MEASUREMENT FCC_stContactorRequest "" UBYTE VBU0513_CM_uint8 0 0 0 255 ECU_ADDRESS 0x90004268 /end MEASUREMENT
/begin MEASUREMENT CVT_numCellVoltageSecondMinID "" UBYTE VBU0513_CM_uint8 0 0 0 255 ECU_ADDRESS 0x900042a1 /end MEASUREMENT
/begin MEASUREMENT CVT_numCellVoltageSecondMaxID "" UBYTE VBU0513_CM_uint8 0 0 0 255 ECU_ADDRESS 0x900042a0 /end MEASUREMENT
/begin MEASUREMENT CVT_numCellVoltageMinID "" UBYTE VBU0513_CM_uint8 0 0 0 255 ECU_ADDRESS 0x9000429f /end MEASUREMENT
/begin MEASUREMENT CVT_numCellVoltageMaxID "" UBYTE VBU0513_CM_uint8 0 0 0 255 ECU_ADDRESS 0x9000429e /end MEASUREMENT
/begin MEASUREMENT CVT_numInvalidCellVoltages "" UBYTE VBU0513_CM_uint8 0 0 0 255 ECU_ADDRESS 0x900042a2 /end MEASUREMENT
/begin MEASUREMENT CTS_stContactorRequest "" UBYTE VBU0513_CM_uint8 0 0 0 255 ECU_ADDRESS 0x90004117 /end MEASUREMENT
/begin MEASUREMENT CTS_stState "" UBYTE VBU0513_CM_uint8 0 0 0 255 ECU_ADDRESS 0x90004264 /end MEASUREMENT
/begin MEASUREMENT CTS_stCmdPrechargeRelay "" UBYTE VBU0513_CM_uint8 0 0 0 255 ECU_ADDRESS 0x90004263 /end MEASUREMENT
/begin MEASUREMENT CTS_stCmdMnNegContactor "" UBYTE VBU0513_CM_uint8 0 0 0 255 ECU_ADDRESS 0x90004261 /end MEASUREMENT
/begin MEASUREMENT CTS_stCmdMnPosContactor "" UBYTE VBU0513_CM_uint8 0 0 0 255 ECU_ADDRESS 0x90004262 /end MEASUREMENT
/begin MEASUREMENT CTM_numOriginalCellTempMinID "" UBYTE VBU0513_CM_uint8 0 0 0.0 200.0 ECU_ADDRESS 0x90003fe9 /end MEASUREMENT
/begin MEASUREMENT CTM_numCellTempMinID "" UBYTE VBU0513_CM_uint8 0 0 0.0 40.0 ECU_ADDRESS 0x90003fe7 /end MEASUREMENT
/begin MEASUREMENT CTM_numOriginalCellTempSecondMaxID "" UBYTE VBU0513_CM_uint8 0 0 0.0 40.0 ECU_ADDRESS 0x90003fea /end MEASUREMENT
/begin MEASUREMENT CTM_numCellTempMaxID "" UBYTE VBU0513_CM_uint8 0 0 0.0 40.0 ECU_ADDRESS 0x90003fe6 /end MEASUREMENT
/begin MEASUREMENT CTM_numOriginalCellTempMaxID "" UBYTE VBU0513_CM_uint8 0 0 0.0 40.0 ECU_ADDRESS 0x90003fe8 /end MEASUREMENT
/begin MEASUREMENT CTD_stMnContactorsStatus "" UBYTE VBU0513_CM_uint8 0 0 0 255 ECU_ADDRESS 0x90003fe5 /end MEASUREMENT
/begin MEASUREMENT CTC_stResetContactorRequest "" UBYTE VBU0513_CM_uint8 0 0 0 255 ECU_ADDRESS 0x90004299 /end MEASUREMENT
/begin MEASUREMENT CTC_stContactorsCommandStatus "" UBYTE VBU0513_CM_uint8 0 0 0 255 ECU_ADDRESS 0x90004298 /end MEASUREMENT
/begin MEASUREMENT BCV_stBdmCurrentComIndex "" UBYTE VBU0513_CM_uint8 0 0 0 255 ECU_ADDRESS 0x9000428f /end MEASUREMENT
/begin MEASUREMENT BCV_stBdmCurrentPerformanceIndex "" UBYTE VBU0513_CM_uint8 0 0 0 255 ECU_ADDRESS 0x90004290 /end MEASUREMENT
/begin MEASUREMENT BCV_BdmVoltagePerformanceIndex_enum "" UBYTE VBU0513_CM_uint8 0 0 0 255 ECU_ADDRESS 0x9000428d /end MEASUREMENT
/begin MEASUREMENT THM_flgActvCool "" UBYTE VBU0513_CM_boolean 0 0 0.0 1.0 ECU_ADDRESS 0x9000407b /end MEASUREMENT
/begin MEASUREMENT THM_flgEXVPosReqEnable "" UBYTE VBU0513_CM_boolean 0 0 0 1 ECU_ADDRESS 0x900042bd /end MEASUREMENT
/begin MEASUREMENT THM_flgFPVReqRaw "" UBYTE VBU0513_CM_boolean 0 0 0.0 1.0 ECU_ADDRESS 0x9000407f /end MEASUREMENT
/begin MEASUREMENT OD_LsDCChgRly "" UBYTE VBU0513_CM_boolean 0 0 0 1 ECU_ADDRESS 0x900042b0 /end MEASUREMENT
/begin MEASUREMENT THM_flgActvHeat "" UBYTE VBU0513_CM_boolean 0 0 0.0 1.0 ECU_ADDRESS 0x9000407c /end MEASUREMENT
/begin MEASUREMENT OP_flgLSDVacuumPump "" UBYTE VBU0513_CM_boolean 0 0 0 1 ECU_ADDRESS 0x900042b2 /end MEASUREMENT
/begin MEASUREMENT THM_flgACEnable "" UBYTE VBU0513_CM_boolean 0 0 0 1 ECU_ADDRESS 0x900042bb /end MEASUREMENT
/begin MEASUREMENT THM_flgACCompCmd "" UBYTE VBU0513_CM_boolean 0 0 0 1 ECU_ADDRESS 0x900042ba /end MEASUREMENT
/begin MEASUREMENT Veh_flgVacPressWarning "" UBYTE VBU0513_CM_boolean 0 0 0 1 ECU_ADDRESS 0x900042c0 /end MEASUREMENT
/begin MEASUREMENT THM_flgBattPTCCmdRaw "" UBYTE VBU0513_CM_boolean 0 0 0.0 1.0 ECU_ADDRESS 0x9000407d /end MEASUREMENT
/begin MEASUREMENT THM_flgBattPTCCmd "" UBYTE VBU0513_CM_boolean 0 0 0 1 ECU_ADDRESS 0x900042bc /end MEASUREMENT
/begin MEASUREMENT PMM_flgPEUACTstReq "" UBYTE VBU0513_CM_boolean 0 0 0 1 ECU_ADDRESS 0x9000427b /end MEASUREMENT
/begin MEASUREMENT PMM_flgHVRLyCloseTimeOut "" UBYTE VBU0513_CM_boolean 0 0 0 1 ECU_ADDRESS 0x90004277 /end MEASUREMENT
/begin MEASUREMENT PMM_flgACTstTimeOut "" UBYTE VBU0513_CM_boolean 0 0 0 1 ECU_ADDRESS 0x9000426d /end MEASUREMENT
/begin MEASUREMENT PMM_flgHVRlyOpenTimeOut "" UBYTE VBU0513_CM_boolean 0 0 0 1 ECU_ADDRESS 0x90004278 /end MEASUREMENT
/begin MEASUREMENT PMM_flgActvDisChTimeOut "" UBYTE VBU0513_CM_boolean 0 0 0 1 ECU_ADDRESS 0x90004270 /end MEASUREMENT
/begin MEASUREMENT PMM_flgOffLoadTimeOut "" UBYTE VBU0513_CM_boolean 0 0 0 1 ECU_ADDRESS 0x90004279 /end MEASUREMENT
/begin MEASUREMENT PMM_flgAccDisable "" UBYTE VBU0513_CM_boolean 0 0 0 1 ECU_ADDRESS 0x9000426f /end MEASUREMENT
/begin MEASUREMENT PMM_flgDCDCEna "" UBYTE VBU0513_CM_boolean 0 0 0 1 ECU_ADDRESS 0x90004272 /end MEASUREMENT
/begin MEASUREMENT LaCBL_flgCellBoardTempAvailable "" UBYTE VBU0513_CM_boolean 0 0 0 1 ARRAY_SIZE 198 ECU_ADDRESS 0x90003301 /end MEASUREMENT
/begin MEASUREMENT FCC_flgChargeTerminated "" UBYTE VBU0513_CM_boolean 0 0 0.0 1.0 ECU_ADDRESS 0x90004031 /end MEASUREMENT
/begin MEASUREMENT DSM_flgNoRestart "" UBYTE VBU0513_CM_boolean 0 0 0.0 1.0 ECU_ADDRESS 0x90004265 /end MEASUREMENT
/begin MEASUREMENT DSM_flgNoCharge "" UBYTE VBU0513_CM_boolean 0 0 0 1 ECU_ADDRESS 0x90004027 /end MEASUREMENT
/begin MEASUREMENT DSM_flgDriverCycleActive "" UBYTE VBU0513_CM_boolean 0 0 0.0 1.0 ECU_ADDRESS 0x90004025 /end MEASUREMENT
/begin MEASUREMENT DSM_flgCscValueUncertain "" UBYTE VBU0513_CM_boolean 0 0 0 1 ECU_ADDRESS 0x90004024 /end MEASUREMENT
/begin MEASUREMENT DSM_flgCycleUploadAbnormalEvent "" UBYTE VBU0513_CM_boolean 0 0 0 1 ECU_ADDRESS 0x90004128 /end MEASUREMENT
/begin MEASUREMENT GaCVT_CellVoltageValid_flg "" UBYTE VBU0513_CM_boolean 0 0 0.0 1.0 ARRAY_SIZE 198 ECU_ADDRESS 0x9000323b /end MEASUREMENT
/begin MEASUREMENT CTS_flgCmdOpenContactorsNow "" UBYTE VBU0513_CM_boolean 0 0 0 1 ECU_ADDRESS 0x90004114 /end MEASUREMENT
/begin MEASUREMENT CTS_flgCmdOpenContactorsDelay "" UBYTE VBU0513_CM_boolean 0 0 0 1 ECU_ADDRESS 0x90004113 /end MEASUREMENT
/begin MEASUREMENT CTS_flgRunPrechargeDiagnostic "" UBYTE VBU0513_CM_boolean 0 0 0 1 ECU_ADDRESS 0x90004260 /end MEASUREMENT
/begin MEASUREMENT CTS_flgRunNegContactorWeldCheck "" UBYTE VBU0513_CM_boolean 0 0 0 1 ECU_ADDRESS 0x9000425e /end MEASUREMENT
/begin MEASUREMENT CTS_flgRunPosContactorWeldCheck "" UBYTE VBU0513_CM_boolean 0 0 0 1 ECU_ADDRESS 0x9000425f /end MEASUREMENT
/begin MEASUREMENT CTD_flgPrechargeResistanceBlownFaultTestEnable "" UBYTE VBU0513_CM_boolean 0 0 0 1 ECU_ADDRESS 0x90004105 /end MEASUREMENT
/begin MEASUREMENT CTD_flgPrechargeResistanceBlownFaultTestFail "" UBYTE VBU0513_CM_boolean 0 0 0 1 ECU_ADDRESS 0x90004106 /end MEASUREMENT
/begin MEASUREMENT CTD_flgMainFuseBlowFaultTestEnable "" UBYTE VBU0513_CM_boolean 0 0 0 1 ECU_ADDRESS 0x90004103 /end MEASUREMENT
/begin MEASUREMENT CTD_flgMainFuseBlowFaultTestFail "" UBYTE VBU0513_CM_boolean 0 0 0 1 ECU_ADDRESS 0x90004104 /end MEASUREMENT
/begin MEASUREMENT CTC_flgHALPrechargeRelay "" UBYTE VBU0513_CM_boolean 0 0 0 1 ECU_ADDRESS 0x90004101 /end MEASUREMENT
/begin MEASUREMENT CTC_flgHALMnNegContactor "" UBYTE VBU0513_CM_boolean 0 0 0 1 ECU_ADDRESS 0x900040ff /end MEASUREMENT
/begin MEASUREMENT CTC_flgHALMnPosContactor "" UBYTE VBU0513_CM_boolean 0 0 0 1 ECU_ADDRESS 0x90004100 /end MEASUREMENT
/begin MEASUREMENT BMM_flgEEBlockStoreEnable "" UBYTE VBU0513_CM_boolean 0 0 0 1 ECU_ADDRESS 0x900040f1 /end MEASUREMENT
/begin MEASUREMENT BMM_flgFastChargeWakeup "" UBYTE VBU0513_CM_boolean 0 0 0.0 1.0 ECU_ADDRESS 0x90003fe0 /end MEASUREMENT
/begin MEASUREMENT BMM_flgIgnitionOnWakeup "" UBYTE VBU0513_CM_boolean 0 0 0.0 1.0 ECU_ADDRESS 0x90003fe2 /end MEASUREMENT
/begin MEASUREMENT BMM_flgHoldAfterrun "" UBYTE VBU0513_CM_boolean 0 0 0.0 1.0 ECU_ADDRESS 0x90003fe1 /end MEASUREMENT
/begin MEASUREMENT BCV_flgBatteryCurrentSystemValid "" UBYTE VBU0513_CM_boolean 0 0 0 1 ECU_ADDRESS 0x9000428e /end MEASUREMENT
/begin MEASUREMENT BCV_flgDCContactorOverCurrent "" UBYTE VBU0513_CM_boolean 0 0 0 1 ECU_ADDRESS 0x90004259 /end MEASUREMENT
/begin MEASUREMENT Count "" FLOAT32_IEEE VBU0513_CM_single 0 0 -3.4E+38 3.4E+38 ECU_ADDRESS 0x90001e4e /end MEASUREMENT
/begin MEASUREMENT LcCTS_CloseAndDiagnoseContactorsTimer_ms "" UWORD VBU0513_CM_uint16 0 0 0 65535 ECU_ADDRESS 0x90003774 /end MEASUREMENT
/begin MEASUREMENT LcCTS_OpenContactorsDelayTimer_ms "" UWORD VBU0513_CM_uint16 0 0 0 65535 ECU_ADDRESS 0x9000377e /end MEASUREMENT
/begin MEASUREMENT LcCTS_StandbyTimer_ms "" UWORD VBU0513_CM_uint16 0 0 0 65535 ECU_ADDRESS 0x90003780 /end MEASUREMENT
/begin MEASUREMENT LcCTS_OpenAndDiagnoseWeldTimer_ms "" UWORD VBU0513_CM_uint16 0 0 0 65535 ECU_ADDRESS 0x9000377c /end MEASUREMENT
/begin MEASUREMENT LcCTS_DiagnoseMPCWeldcheckDischargeTimer_ms "" UWORD VBU0513_CM_uint16 0 0 0 65535 ECU_ADDRESS 0x90003778 /end MEASUREMENT
/begin MEASUREMENT LcCTS_DiagnoseMPCWeldcheckTimer_ms "" UWORD VBU0513_CM_uint16 0 0 0 65535 ECU_ADDRESS 0x9000377a /end MEASUREMENT
/begin MEASUREMENT LcCTS_CmdMnPosContactorCounter_ms "" UWORD VBU0513_CM_uint16 0 0 0 65535 ECU_ADDRESS 0x90003776 /end MEASUREMENT
/begin COMPU_METHOD VBU0513_CM_single_cnt "Q = V" RAT_FUNC "%8.6" "cnt" COEFFS 0 1 0 0 0 1 /end COMPU_METHOD
/begin COMPU_METHOD VBU0513_CM_single_Nm "Q = V" RAT_FUNC "%8.6" "Nm" COEFFS 0 1 0 0 0 1 /end COMPU_METHOD
/begin COMPU_METHOD VBU0513_CM_single_bar "Q = V" RAT_FUNC "%8.6" "bar" COEFFS 0 1 0 0 0 1 /end COMPU_METHOD
/begin COMPU_METHOD VBU0513_CM_single_kph "Q = V" RAT_FUNC "%8.6" "kph" COEFFS 0 1 0 0 0 1 /end COMPU_METHOD
/begin COMPU_METHOD VBU0513_CM_uint16_cnt "Q = V" RAT_FUNC "%5.0" "cnt" COEFFS 0 1 0 0 0 1 /end COMPU_METHOD
/begin COMPU_METHOD VBU0513_CM_single_pct "Q = V" RAT_FUNC "%8.6" "pct" COEFFS 0 1 0 0 0 1 /end COMPU_METHOD
/begin COMPU_METHOD VBU0513_CM_single_A "Q = V" RAT_FUNC "%8.6" "A" COEFFS 0 1 0 0 0 1 /end COMPU_METHOD
/begin COMPU_METHOD VBU0513_CM_single_fac "Q = V" RAT_FUNC "%8.6" "fac" COEFFS 0 1 0 0 0 1 /end COMPU_METHOD
/begin COMPU_METHOD VBU0513_CM_uint8 "Q = V" RAT_FUNC "%3.0" "" COEFFS 0 1 0 0 0 1 /end COMPU_METHOD
/begin COMPU_METHOD VBU0513_CM_single_V "Q = V" RAT_FUNC "%8.6" "V" COEFFS 0 1 0 0 0 1 /end COMPU_METHOD
/begin COMPU_METHOD VBU0513_CM_uint16 "Q = V" RAT_FUNC "%5.0" "" COEFFS 0 1 0 0 0 1 /end COMPU_METHOD
/begin COMPU_METHOD VBU0513_CM_double "Q = V" RAT_FUNC "%15.10" "" COEFFS 0 1 0 0 0 1 /end COMPU_METHOD
/begin COMPU_METHOD VBU0513_CM_single "Q = V" RAT_FUNC "%8.6" "" COEFFS 0 1 0 0 0 1 /end COMPU_METHOD
/begin COMPU_METHOD VBU0513_CM_single_s "Q = V" RAT_FUNC "%8.6" "s" COEFFS 0 1 0 0 0 1 /end COMPU_METHOD
/begin COMPU_METHOD VBU0513_CM_uint32_cnt "Q = V" RAT_FUNC "%10.0" "cnt" COEFFS 0 1 0 0 0 1 /end COMPU_METHOD
/begin COMPU_METHOD VBU0513_CM_uint32_ms "Q = V" RAT_FUNC "%10.0" "ms" COEFFS 0 1 0 0 0 1 /end COMPU_METHOD
/begin COMPU_METHOD VBU0513_CM_uint32 "Q = V" RAT_FUNC "%10.0" "" COEFFS 0 1 0 0 0 1 /end COMPU_METHOD
/begin COMPU_METHOD VBU0513_CM_uint16_ms "Q = V" RAT_FUNC "%5.0" "ms" COEFFS 0 1 0 0 0 1 /end COMPU_METHOD
/begin COMPU_METHOD VBU0513_CM_uint16_mV "Q = V" RAT_FUNC "%5.0" "mV" COEFFS 0 1 0 0 0 1 /end COMPU_METHOD
/begin COMPU_METHOD VBU0513_CM_uint16_s "Q = V" RAT_FUNC "%5.0" "s" COEFFS 0 1 0 0 0 1 /end COMPU_METHOD
/begin COMPU_METHOD VBU0513_CM_boolean_flg "Q = V" RAT_FUNC "%1.0" "flg" COEFFS 0 1 0 0 0 1 /end COMPU_METHOD
/begin COMPU_METHOD VBU0513_CM_boolean_cnt "Q = V" RAT_FUNC "%1.0" "cnt" COEFFS 0 1 0 0 0 1 /end COMPU_METHOD
/begin COMPU_METHOD VBU0513_CM_boolean "Q = V" RAT_FUNC "%1.0" "" COEFFS 0 1 0 0 0 1 /end COMPU_METHOD
/begin COMPU_METHOD VBU0513_CM_int8_cnt "Q = V" RAT_FUNC "%3.0" "cnt" COEFFS 0 1 0 0 0 1 /end COMPU_METHOD
/begin COMPU_METHOD VBU0513_CM_int8_n "Q = V" RAT_FUNC "%3.0" "n" COEFFS 0 1 0 0 0 1 /end COMPU_METHOD
/begin COMPU_METHOD VBU0513_CM_uint8_cnt "Q = V" RAT_FUNC "%3.0" "cnt" COEFFS 0 1 0 0 0 1 /end COMPU_METHOD
/begin COMPU_METHOD VBU0513_CM_uint8_n "Q = V" RAT_FUNC "%3.0" "n" COEFFS 0 1 0 0 0 1 /end COMPU_METHOD
/begin GROUP S3039_BEM "VBU0513/VBUSystem/VCU /APO2HAL/Subsystem1/BEM"
 /begin REF_CHARACTERISTIC CHARGER_MESSAGE_OT_00OvrdVal_C CHARGER_MESSAGE_OT_00Ovrd_C CHARGER_MESSAGE_OT_AAOvrdVal_C CHARGER_MESSAGE_OT_AAOvrd_C CHARGER_MESSAGE_OT_READYOvrdVal_C CHARGER_MESSAGE_OT_READYOvrd_C CHARGER_MESSAGE_OT_STATEOvrdVal_C CHARGER_MESSAGE_OT_STATEOvrd_C CHARGER_MESSAGE_OT_STATISTICSOvrdVal_C CHARGER_MESSAGE_OT_STATISTICSOvrd_C CHARGER_MESSAGE_OT_STOPOvrdVal_C CHARGER_MESSAGE_OT_STOPOvrd_C CHARGER_MESSAGE_OT_SYNCHRONOUSOvrdVal_C CHARGER_MESSAGE_OT_SYNCHRONOUSOvrd_C /end REF_CHARACTERISTIC
/end GROUP
/begin GROUP S3039_BHM "VBU0513/VBUSystem/VCU /APO2HAL/Subsystem1/BHM" /begin REF_CHARACTERISTIC PermitVoltageOvrdVal_C PermitVoltageOvrd_C /end REF_CHARACTERISTIC /end GROUP
/begin GROUP S3039_BRM "VBU0513/VBUSystem/VCU /APO2HAL/Subsystem1/BRM"
 /begin REF_CHARACTERISTIC BATTERY_DATE_DAYOvrdVal_C BATTERY_DATE_DAYOvrd_C BATTERY_DATE_MONTHOvrdVal_C BATTERY_DATE_MONTHOvrd_C BATTERY_DATE_YEAROvrdVal_C BATTERY_DATE_YEAROvrd_C BATTERY_GROUP_NUMBEROvrdVal_C BATTERY_GROUP_NUMBEROvrd_C BATTERY_PROPERTY_IDENTIFYOvrdVal_C BATTERY_PROPERTY_IDENTIFYOvrd_C BATTERY_SUPPLIEROvrdVal_C BATTERY_SUPPLIEROvrd_C BMS_SOFTWARE_VERSION1OvrdVal_C BMS_SOFTWARE_VERSION1Ovrd_C BMS_SOFTWARE_VERSION2OvrdVal_C BMS_SOFTWARE_VERSION2Ovrd_C BRM_RESERVEDOvrdVal_C BRM_RESERVEDOvrd_C CHARGING_TIMEOvrdVal_C CHARGING_TIMEOvrd_C DCH_cBRMBattRatedCapOvrdVal_C DCH_cBRMBattRatedCapOvrd_C DCH_numBRMBattTypOvrdVal_C DCH_numBRMBattTypOvrd_C DCH_numBRMProtcVerOvrdVal_C DCH_numBRMProtcVerOvrd_C DCH_uBRMBattRatedVltgOvrdVal_C DCH_uBRMBattRatedVltgOvrd_C VIN1VIN2VIN3OvrdVal_C VIN1VIN2VIN3Ovrd_C /end REF_CHARACTERISTIC
/end GROUP
/begin GROUP S3039_BRO "VBU0513/VBUSystem/VCU /APO2HAL/Subsystem1/BRO"
 /begin REF_CHARACTERISTIC READY_CHARGING_GATEWAYOvrdVal_C READY_CHARGING_GATEWAYOvrd_C /end REF_CHARACTERISTIC
/end GROUP
/begin GROUP S3039_BSD "VBU0513/VBUSystem/VCU /APO2HAL/Subsystem1/BSD"
 /begin REF_CHARACTERISTIC MAXIMUM_CELL_TEMP_BSDOvrdVal_C MAXIMUM_CELL_TEMP_BSDOvrd_C MAXIMUM_CELL_VOLTAGE_BSDOvrdVal_C MAXIMUM_CELL_VOLTAGE_BSDOvrd_C MINIMUM_CELL_TEMP_BSDOvrdVal_C MINIMUM_CELL_TEMP_BSDOvrd_C MINIMUM_CELL_VOLTAGE_BSDOvrdVal_C MINIMUM_CELL_VOLTAGE_BSDOvrd_C SOC_STOPOvrdVal_C SOC_STOPOvrd_C /end REF_CHARACTERISTIC
/end GROUP
/begin GROUP S3039_BSM "VBU0513/VBUSystem/VCU /APO2HAL/Subsystem1/BSM"
 /begin REF_CHARACTERISTIC BATTERY_ISOLATION_STATEOvrdVal_C BATTERY_ISOLATION_STATEOvrd_C BATTERY_OUTPUT_CONNECTOR_STATEOvrdVal_C BATTERY_OUTPUT_CONNECTOR_STATEOvrd_C CELL_VOLTAGE_OVER_UNDEROvrdVal_C CELL_VOLTAGE_OVER_UNDEROvrd_C CHARGING_PERMITOvrdVal_C CHARGING_PERMITOvrd_C CURRENT_OVER_UNDEROvrdVal_C CURRENT_OVER_UNDEROvrd_C MAXIMUM_CELL_TEMPOvrdVal_C MAXIMUM_CELL_TEMPOvrd_C MAXIMUM_CELL_VOLTAGE_NUMBER_BSMOvrdVal_C MAXIMUM_CELL_VOLTAGE_NUMBER_BSMOvrd_C MAXIMUM_TEMP_NUMBEROvrdVal_C MAXIMUM_TEMP_NUMBEROvrd_C MINIMUM_CELL_TEMPOvrdVal_C MINIMUM_CELL_TEMPOvrd_C MINIMUM_TEMP_NUMBEROvrdVal_C MINIMUM_TEMP_NUMBEROvrd_C SOC_OVER_UNDEROvrdVal_C SOC_OVER_UNDEROvrd_C TEMP_OVEROvrdVal_C TEMP_OVEROvrd_C /end REF_CHARACTERISTIC
/end GROUP
/begin GROUP S3039_BST_ "VBU0513/VBUSystem/VCU /APO2HAL/Subsystem1/BST "
 /begin REF_CHARACTERISTIC GATEWAY_STOP_ERROR_REASON_OCOvrdVal_C GATEWAY_STOP_ERROR_REASON_OCOvrd_C GATEWAY_STOP_ERROR_REASON_VOLTOvrdVal_C GATEWAY_STOP_ERROR_REASON_VOLTOvrd_C GATEWAY_STOP_FAULT_REASON_1OvrdVal_C GATEWAY_STOP_FAULT_REASON_1Ovrd_C GATEWAY_STOP_FAULT_REASON_2OvrdVal_C GATEWAY_STOP_FAULT_REASON_2Ovrd_C GATEWAY_STOP_FAULT_REASON_3OvrdVal_C GATEWAY_STOP_FAULT_REASON_3Ovrd_C GATEWAY_STOP_FAULT_REASON_BMSOTOvrdVal_C GATEWAY_STOP_FAULT_REASON_BMSOTOvrd_C GATEWAY_STOP_FAULT_REASON_CELLOTOvrdVal_C GATEWAY_STOP_FAULT_REASON_CELLOTOvrd_C GATEWAY_STOP_FAULT_REASON_CONNOTOvrdVal_C GATEWAY_STOP_FAULT_REASON_CONNOTOvrd_C GATEWAY_STOP_FAULT_REASON_CONNOvrdVal_C GATEWAY_STOP_FAULT_REASON_CONNOvrd_C GATEWAY_STOP_FAULT_REASON_ISOOvrdVal_C GATEWAY_STOP_FAULT_REASON_ISOOvrd_C GATEWAY_STOP_REASON_CELLVOLTOvrdVal_C GATEWAY_STOP_REASON_CELLVOLTOvrd_C GATEWAY_STOP_REASON_SOCOvrdVal_C GATEWAY_STOP_REASON_SOCOvrd_C GATEWAY_STOP_REASON_STATIONOvrdVal_C GATEWAY_STOP_REASON_STATIONOvrd_C GATEWAY_STOP_REASON_TOTALVOLTOvrdVal_C GATEWAY_STOP_REASON_TOTALVOLTOvrd_C /end REF_CHARACTERISTIC
/end GROUP
/begin GROUP S3039_J1939TxEna "VBU0513/VBUSystem/VCU /APO2HAL/Subsystem1/J1939TxEna"
 /begin REF_CHARACTERISTIC APO_flgBCLTxEnaOvrdVal_C APO_flgBCLTxEnaOvrd_C APO_flgBCPTxEnaOvrdVal_C APO_flgBCPTxEnaOvrd_C APO_flgBCSTxEnaOvrdVal_C APO_flgBCSTxEnaOvrd_C APO_flgBEMTxEnaOvrdVal_C APO_flgBEMTxEnaOvrd_C APO_flgBHMTxEnaOvrdVal_C APO_flgBHMTxEnaOvrd_C APO_flgBRMTxEnaOvrdVal_C APO_flgBRMTxEnaOvrd_C APO_flgBROTxEnaOvrdVal_C APO_flgBROTxEnaOvrd_C APO_flgBSDTxEnaOvrdVal_C APO_flgBSDTxEnaOvrd_C APO_flgBSMTxEnaOvrdVal_C APO_flgBSMTxEnaOvrd_C APO_flgBSTTxEnaOvrdVal_C APO_flgBSTTxEnaOvrd_C /end REF_CHARACTERISTIC
/end GROUP
/begin GROUP S3040_Subsystem "VBU0513/VBUSystem/VCU /APO2HAL/Subsystem2/Subsystem"
 /begin SUB_GROUP S3218_PropertyConfirm S3218_PropertyConfirm1 S3218_PropertyConfirm10 S3218_PropertyConfirm11 S3218_PropertyConfirm12 S3218_PropertyConfirm13 S3218_PropertyConfirm14 S3218_PropertyConfirm15 S3218_PropertyConfirm4 S3218_PropertyConfirm5 S3218_PropertyConfirm6 S3218_PropertyConfirm8 S3218_PropertyConfirm9 /end SUB_GROUP
 /begin REF_CHARACTERISTIC APO_fACPumpOvrdVal_C APO_fACPumpOvrd_C APO_fFanOvrdVal_C APO_fFanOvrd_C APO_fHVIL1OvrdVal_C APO_fHVIL1Ovrd_C APO_fVacuumPumpOvrdVal_C APO_fVacuumPumpOvrd_C APO_fWaterPump1OvrdVal_C APO_fWaterPump1Ovrd_C APO_fWaterPump2OvrdVal_C APO_fWaterPump2Ovrd_C APO_flgDCChgRlyOvrdVal_C APO_flgDCChgRlyOvrd_C APO_flgFanORF APO_flgHWSleepEnableORF APO_flgMainRlyOvrdVal_C APO_flgMainRlyOvrd_C APO_flgSleepEnableORV APO_flgWakeUp1OvrdVal_C APO_flgWakeUp1Ovrd_C APO_flgWakeUp2OvrdVal_C APO_flgWakeUp2Ovrd_C APO_pctACPumpOvrdVal_C APO_pctACPumpOvrd_C APO_pctFanOvrdVal_C APO_pctHVIL1OvrdVal_C APO_pctHVIL1Ovrd_C APO_pctWaterPump1OvrdVal_C APO_pctWaterPump1Ovrd_C APO_pctWaterPump2OvrdVal_C APO_pctWaterPump2Ovrd_C /end REF_CHARACTERISTIC
 /begin REF_MEASUREMENT OD_LsDCChgRly OP_flgLSDVacuumPump /end REF_MEASUREMENT
/end GROUP
/begin GROUP S3235_DCH_DCChargeCtrlOverall "VBU0513/VBUSystem/VCU /DCH/DCH_Overall/DCH_DCChargeCtrlOverall"
 /begin SUB_GROUP S3237_DCH_BMSChgrReq S3237_DCH_DCChargeCtrlStateflow S3237_DCH_Diagnose S3237_DCH_EepromStore S3237_DSPLLight /end SUB_GROUP
/end GROUP
/begin GROUP S3235_DCH_J1939InputProcess "VBU0513/VBUSystem/VCU /DCH/DCH_Overall/DCH_J1939InputProcess" /begin SUB_GROUP S3238_DCH_J1939ReceiveProcess /end SUB_GROUP /end GROUP
/begin GROUP S3235_DCH_J1939OutputSignalProcess "VBU0513/VBUSystem/VCU /DCH/DCH_Overall/DCH_J1939OutputSignalProcess"
 /begin SUB_GROUP S3239_DCH_J1939OutputProcessBCL S3239_DCH_J1939OutputProcessBCP S3239_DCH_J1939OutputProcessBCS S3239_DCH_J1939OutputProcessBEM S3239_DCH_J1939OutputProcessBRM S3239_DCH_J1939OutputProcessBRO S3239_DCH_J1939OutputProcessBSD S3239_DCH_J1939OutputProcessBSM S3239_DCH_J1939OutputProcessBST /end SUB_GROUP
/end GROUP
/begin GROUP S3360_DriveRange "VBU0513/VBUSystem/VCU /DSPL /DSPL/DriveRange" /begin SUB_GROUP S3361_DSPL_Consumption S3361_RemainingRange /end SUB_GROUP /end GROUP
/begin GROUP S3360_Other "VBU0513/VBUSystem/VCU /DSPL /DSPL/Other"
 /begin REF_CHARACTERISTIC DSPL_facMtrDrvLT_C DSPL_nMotSpdOvrSpdLower_C DSPL_nMotSpdOvrSpdUpper_C DSPL_pctSocLowWarnLower_C DSPL_pctSocLowWarnUpper_C DSPL_stCurrentGearD_C DSPL_stCurrentGearN_C DSPL_stCurrentGearP_C DSPL_stCurrentGearR_C DSPL_stDCDCStsFail_SY DSPL_stHVCntctStClosed_SY DSPL_stLvBattChrgFail_C DSPL_stLvBattChrging_C DSPL_stLvBattNoChrg_C DSPL_stPEURMotTempAlarm_SY DSPL_tiDCDCStsFail_C DSPL_tiDisableDCDC_C DSPL_tiMotOvrSpd_C DSPL_tiMtrDrvLT_C DSPL_tiSample_SY DSPL_trqMtrDrvLTHi_C DSPL_trqMtrDrvLTLo_C /end REF_CHARACTERISTIC
/end GROUP
/begin GROUP S3360_RegenLight "VBU0513/VBUSystem/VCU /DSPL /DSPL/RegenLight"
 /begin REF_CHARACTERISTIC DSPL_facRegenReq_C DSPL_flgRegenLimLampFunctionEn_C DSPL_pctAccPedLe_C DSPL_pctAccPedRe_C DSPL_stCurrentGearD_C DSPL_tiRegenLimDecline_C DSPL_tiRegenLimRise_C DSPL_tiSample_SY DSPL_trqMotReqLe_C DSPL_trqMotReqRe_C DSPL_trqRegenReqLe_C DSPL_trqRegenReqRe_C DSPL_vVehSpdRegenLe_C DSPL_vVehSpdRegenRe_C SYS_facGearRatioF_SY /end REF_CHARACTERISTIC
/end GROUP
/begin GROUP S3503_BatDis_Power_Lim_Calc "VBU0513/VBUSystem/VCU /EDIS/EDIS_Ctrl/BatDis_Power_Lim_Calc"
 /begin SUB_GROUP S3504_Drive_Mode_Power_Calculate S3504_Power_Arbitration S3504_Regen_Mode_Power_Calculate /end SUB_GROUP
/end GROUP
/begin GROUP S3503_battery_power_calculate "VBU0513/VBUSystem/VCU /EDIS/EDIS_Ctrl/battery_power_calculate"
 /begin SUB_GROUP S3505_charge_power_calculate S3505_discharge_power_calculate /end SUB_GROUP
/end GROUP
/begin GROUP S3503_drive_power_calculate "VBU0513/VBUSystem/VCU /EDIS/EDIS_Ctrl/drive_power_calculate" /begin SUB_GROUP S3506_accessory_load_power /end SUB_GROUP /end GROUP
/begin GROUP S3586_LVC_DIAG "VBU0513/VBUSystem/VCU /LVC/LVC/LVC_DIAG"
 /begin SUB_GROUP S3587_DSM_DisableFault S3587_DSM_EnableFault S3587_DSM_OutputCurrent S3587_DSM_OutputOverVol S3587_DSM_OutputUnderVol /end SUB_GROUP
/end GROUP
/begin GROUP S3586_LowVoltageBalanceControl "VBU0513/VBUSystem/VCU /LVC/LVC/LowVoltageBalanceControl" /begin SUB_GROUP S3588_LVC_DcdcSpCtl S3588_LVC_DcdcStCtl /end SUB_GROUP /end GROUP
/begin GROUP S3631_DrvMod_Ctrl "VBU0513/VBUSystem/VCU /PMM/PMM_Ctrl/DrvMod_Ctrl" /begin SUB_GROUP S3632_DVM_PEUShtDwn S3632_DVM_SetRdy S3632_DVM_VehRdy /end SUB_GROUP /end GROUP
/begin GROUP S3631_LvWakeUp_Ctrl "VBU0513/VBUSystem/VCU /PMM/PMM_Ctrl/LvWakeUp_Ctrl" /begin SUB_GROUP S3633_LvWakeUp_Mode_Calc S3633_LvWakeUp_State_Calc /end SUB_GROUP /end GROUP
/begin GROUP S3631_PMM_DIAG "VBU0513/VBUSystem/VCU /PMM/PMM_Ctrl/PMM_DIAG"
 /begin SUB_GROUP S3634_ActiveDisChFault S3634_PreChargeCheck S3634_UnintendAction /end SUB_GROUP
/end GROUP
/begin GROUP S3631_PwrMod_Ctrl "VBU0513/VBUSystem/VCU /PMM/PMM_Ctrl/PwrMod_Ctrl"
 /begin SUB_GROUP S3635_AcTvDisCh S3635_HVRlyCtrl S3635_PwrMod_PowerUp S3635_Routine S3635_RoutineOvrd S3635_SelfRoutine /end SUB_GROUP
 /begin REF_CHARACTERISTIC PMM_stACTest_SY PMM_stActvDisCh_SY PMM_stDCDCDisbl_SY PMM_stHVCntctStClosed_SY PMM_stHVCntctStInit_SY PMM_stHVCntctStPreCh_SY PMM_stHVRlyClose_SY PMM_stHVRlyConnReq_SY PMM_stHVRlyConn_SY PMM_stHVRlyNoReq_SY PMM_stHVRlyOpenReq_SY PMM_stHVRlyOpen_SY PMM_stInitMode_SY PMM_stInitRst_SY PMM_stMCUACOff_SY PMM_stRstKeep_SY PMM_stShutDown_SY PMM_tiACTst_C PMM_tiActvDisCh_C PMM_tiDCDCDisbl_C PMM_tiDlyInitRst_C PMM_tiHVRlyOpenReq_C PMM_tiHVRlyT_C PMM_tiRstKeep_C PMM_tiSmplT_SY /end REF_CHARACTERISTIC
 /begin REF_MEASUREMENT PMM_flgACTstTimeOut PMM_flgAccDisable PMM_flgActvDisChTimeOut PMM_flgDCDCEna PMM_flgHVRLyCloseTimeOut PMM_flgHVRlyOpenTimeOut PMM_flgOffLoadTimeOut PMM_flgPEUACTstReq PMM_stHVRlyReqTmp PMM_stPwrModeSt PMM_tiStDurT /end REF_MEASUREMENT
/end GROUP
/begin GROUP S3744_SignalProcessing_10ms "VBU0513/VBUSystem/VCU /SPD/SPD/SignalProcessing_10ms"
 /begin SUB_GROUP S3746_AxleSpeedDiff S3746_Bench S3746_SlopeCal1 S3746_Subsystem1 S3746_VehDir S3746_VehSpdNorm /end SUB_GROUP
/end GROUP
/begin GROUP S3779_AC "VBU0513/VBUSystem/VCU /THM/Subsystem/AC"
 /begin REF_CHARACTERISTIC THM_flgOverrideACCmpCmd THM_flgOverrideACCmpValid THM_flgOverridevalueACCmpValid THM_rpmOverridevalueACCmpCmd /end REF_CHARACTERISTIC
 /begin REF_MEASUREMENT THM_flgACCompCmd THM_rpmACCompCmd /end REF_MEASUREMENT
/end GROUP
/begin GROUP S3779_EVX "VBU0513/VBUSystem/VCU /THM/Subsystem/EVX"
 /begin REF_CHARACTERISTIC THM_flgEXVInitORF THM_flgEXVInitORV THM_flgEXVPosReqEnableORF THM_flgEXVPosReqEnableORV THM_flgFPVEnableORF THM_flgFPVEnableORV /end REF_CHARACTERISTIC
 /begin REF_MEASUREMENT THM_flgEXVPosReqEnable THM_phiEXVPosReq THM_stEXVInitial /end REF_MEASUREMENT
/end GROUP
/begin GROUP S3779_FAN "VBU0513/VBUSystem/VCU /THM/Subsystem/FAN"
 /begin REF_CHARACTERISTIC THM_fFANfrecuencyORV THM_flgFANfrecuencyORF THM_flgOverrideFAN THM_pctOverridevalueFAN /end REF_CHARACTERISTIC
 /begin REF_MEASUREMENT THM_pctFAN /end REF_MEASUREMENT
/end GROUP
/begin GROUP S3779_FPV "VBU0513/VBUSystem/VCU /THM/Subsystem/FPV" /begin REF_CHARACTERISTIC THM_flgFPVPosReqORF THM_stFPVPosORV /end REF_CHARACTERISTIC /begin REF_MEASUREMENT THM_stFPVPosition_Req /end REF_MEASUREMENT /end GROUP
/begin GROUP S3779_Others "VBU0513/VBUSystem/VCU /THM/Subsystem/Others"
 /begin REF_CHARACTERISTIC THM_flgOverrideACCmpVlv THM_flgOverrideChillerPos THM_pctOverridevalueChillerPos THM_stOverridevalueACVlvOnoff /end REF_CHARACTERISTIC
 /begin REF_MEASUREMENT THM_flgACVlvOnOff THM_pctChillerPos /end REF_MEASUREMENT
/end GROUP
/begin GROUP S3779_PTC "VBU0513/VBUSystem/VCU /THM/Subsystem/PTC" /begin REF_CHARACTERISTIC THM_flgOverrideBattPTCCmd THM_flgOverridevalueBattPTCCmd /end REF_CHARACTERISTIC /begin REF_MEASUREMENT THM_flgBattPTCCmd /end REF_MEASUREMENT /end GROUP
/begin GROUP S3779_Pump "VBU0513/VBUSystem/VCU /THM/Subsystem/Pump"
 /begin REF_CHARACTERISTIC THM_fPump1frecuencyORV THM_fPump2frecuencyORV THM_flgOverrideESSPmpCmd THM_flgOverrideRearPmpCmd THM_flgPump1frecuencyORF THM_flgPump2frecuencyORF THM_pctOverrideESSPmpCmd THM_pctOverrideRearPmpCmd /end REF_CHARACTERISTIC
 /begin REF_MEASUREMENT THM_pctESSPmpCmd THM_pctRearPmpCmd /end REF_MEASUREMENT
/end GROUP
/begin GROUP S3780_Active "VBU0513/VBUSystem/VCU /THM/THM/Active" /begin REF_MEASUREMENT THM_flgActvCool THM_flgActvHeat /end REF_MEASUREMENT /end GROUP
/begin GROUP S3780_Compre "VBU0513/VBUSystem/VCU /THM/THM/Compre" /begin SUB_GROUP S3792_GradientLimiter /end SUB_GROUP
 /begin REF_CHARACTERISTIC THM_nComprssrActvCool_v THM_nComprssrDecGrad_C THM_nComprssrDrvrACOn_C THM_nComprssrIncGrad_C THM_nMinComprssrStrt_C /end REF_CHARACTERISTIC
 /begin REF_MEASUREMENT THM_flgACEnable /end REF_MEASUREMENT
/end GROUP
/begin GROUP S3780_EVXRaw "VBU0513/VBUSystem/VCU /THM/THM/EVXRaw" /begin SUB_GROUP S3793_Turn_Off_Delay_Time /end SUB_GROUP
 /begin REF_CHARACTERISTIC THM_pctEVXDeltaTemp_v THM_pctEVXMax_C THM_pctEVXMin_C THM_tiDlyEVXDisbl_C THM_tiSmplTime_SY /end REF_CHARACTERISTIC
 /begin REF_MEASUREMENT THM_pctEVXPosReq THM_stEXVInitReq /end REF_MEASUREMENT
/end GROUP
/begin GROUP S3780_FANRaw "VBU0513/VBUSystem/VCU /THM/THM/FANRaw"
 /begin REF_CHARACTERISTIC THM_pctFANACMidPresSwtActv_C THM_pctFANACSpdSet_v THM_pctFANEDSInletTemp_v THM_pctFANRearPump_v /end REF_CHARACTERISTIC
 /begin REF_MEASUREMENT THM_pctFANRaw /end REF_MEASUREMENT
/end GROUP
/begin GROUP S3780_FPVRaw "VBU0513/VBUSystem/VCU /THM/THM/FPVRaw" /begin REF_MEASUREMENT THM_flgFPVReqRaw /end REF_MEASUREMENT /end GROUP
/begin GROUP S3780_PTC "VBU0513/VBUSystem/VCU /THM/THM/PTC" /begin REF_MEASUREMENT THM_flgBattPTCCmdRaw /end REF_MEASUREMENT /end GROUP
/begin GROUP S3780_PumpRaw "VBU0513/VBUSystem/VCU /THM/THM/PumpRaw" /begin SUB_GROUP S3797_ESSPmpCmdRaw S3797_PumpCmd S3797_RearPmpCmdRaw /end SUB_GROUP /end GROUP
/begin GROUP S3780_ThermalMode "VBU0513/VBUSystem/VCU /THM/THM/ThermalMode" /begin SUB_GROUP S3798_OperateCycle S3798_OperateMode S3798_TempTar /end SUB_GROUP /end GROUP
/begin GROUP S3827_TQC_VehSpdLimit "VBU0513/VBUSystem/VCU /TQC/TQC/TQC_VehSpdLimit"
 /begin SUB_GROUP S3828_Subsystem S3828_VLIMCal S3828_VMax S3828_VMaxExt S3828_VMaxServer /end SUB_GROUP
/end GROUP
/begin GROUP S3827_VehInfo1 "VBU0513/VBUSystem/VCU /TQC/TQC/VehInfo1" /begin SUB_GROUP S3829_TQC_VehInfoAnalysis S3829_Veh_Drag S3829_Veh_a2Trq /end SUB_GROUP /end GROUP
/begin GROUP S3873_BrkRgn_Cal "VBU0513/VBUSystem/VCU /TQD/TrqDem/BrkRgn_Cal" /begin REF_CHARACTERISTIC TQD_trqDrvBrkRgn_MAP_V TQD_trqRvsBrkRgn_MAP_V /end REF_CHARACTERISTIC /begin REF_MEASUREMENT TQD_trqNrmBrkDes /end REF_MEASUREMENT /end GROUP
/begin GROUP S3873_TrqDem_Arb "VBU0513/VBUSystem/VCU /TQD/TrqDem/TrqDem_Arb" /begin REF_CHARACTERISTIC TQD_flgBrkRgnConfig_C /end REF_CHARACTERISTIC /begin REF_MEASUREMENT TQD_trqAPDDes TQD_trqBrkRgn TQD_trqDes /end REF_MEASUREMENT /end GROUP
/begin GROUP S3873_TrqDem_DrvTrq_Cal "VBU0513/VBUSystem/VCU /TQD/TrqDem/TrqDem_DrvTrq_Cal"
 /begin SUB_GROUP S3876_TrqDem_DrvTrq_Cal S3876_TrqDem_MinTrq_Cal S3876_TrqDem_TrqDes_Cal /end SUB_GROUP
/end GROUP
/begin GROUP S3873_TrqDem_InputTransfer "VBU0513/VBUSystem/VCU /TQD/TrqDem/TrqDem_InputTransfer"
 /begin SUB_GROUP S3877_BrakePressureFilter S3877_TrqDem_AccPdl_Filter S3877_TrqDem_GearDet S3877_TrqDem_VehSpeed_Filter /end SUB_GROUP
/end GROUP
/begin GROUP S3899_STC "VBU0513/VBUSystem/VCU /TQO/TQOAll/STC" /begin SUB_GROUP S3901_STC /end SUB_GROUP /end GROUP
/begin GROUP S3899_Schedule "VBU0513/VBUSystem/VCU /TQO/TQOAll/Schedule" /begin REF_MEASUREMENT Count /end REF_MEASUREMENT /end GROUP
/begin GROUP S3899_TQARB "VBU0513/VBUSystem/VCU /TQO/TQOAll/TQARB" /begin SUB_GROUP S3903_TQARB /end SUB_GROUP /end GROUP
/begin GROUP S3899_TQCMP "VBU0513/VBUSystem/VCU /TQO/TQOAll/TQCMP" /begin SUB_GROUP S3904_TQCMP /end SUB_GROUP /end GROUP
/begin GROUP S3899_TQDIS "VBU0513/VBUSystem/VCU /TQO/TQOAll/TQDIS" /begin SUB_GROUP S3905_TQDIS /end SUB_GROUP /end GROUP
/begin GROUP S3899_TQDMP "VBU0513/VBUSystem/VCU /TQO/TQOAll/TQDMP" /begin SUB_GROUP S3906_TQDMP /end SUB_GROUP /end GROUP
/begin GROUP S3899_TQO "VBU0513/VBUSystem/VCU /TQO/TQOAll/TQO" /begin SUB_GROUP S3907_TQO /end SUB_GROUP /end GROUP
/begin GROUP S4018_MTrqLim "VBU0513/VBUSystem/VCU /VTQA/Subsystem/MTrqLim"
 /begin SUB_GROUP S4019_TorqueRamp S4019_TrqCapacityArb S4019_TrqCapacityCal S4019_TrqCapacityLim S4019_TrqCapacityOffline /end SUB_GROUP
/end GROUP
/begin GROUP S4018_VehTrqArb "VBU0513/VBUSystem/VCU /VTQA/Subsystem/VehTrqArb" /begin SUB_GROUP S4020_BattLim_Transfer S4020_Trq_Arb /end SUB_GROUP /end GROUP
/begin GROUP S4052_APD "VBU0513/VBUSystem/VCU /VehINP/VehINP_Logic/APD" /begin SUB_GROUP S4053_APD /end SUB_GROUP /end GROUP
/begin GROUP S4052_DCPortTemp "VBU0513/VBUSystem/VCU /VehINP/VehINP_Logic/DCPortTemp" /begin SUB_GROUP S4054_Charge_Port_Temp /end SUB_GROUP /end GROUP
/begin GROUP S4052_FPV "VBU0513/VBUSystem/VCU /VehINP/VehINP_Logic/FPV" /begin SUB_GROUP S4055_IF_Then_Else1 /end SUB_GROUP
 /begin REF_CHARACTERISTIC FPV_st4WayVlvPosFdbkPosition1_SY FPV_st4WayVlvPosFdbkPosition2_SY FPV_st4WayVlvPosFdbkUnknow_SY INP_numEXVPosition1Lower_C INP_numEXVPosition1Upper_C INP_numEXVPosition2Upper_C /end REF_CHARACTERISTIC
/end GROUP
/begin GROUP S4052_GearShift "VBU0513/VBUSystem/VCU /VehINP/VehINP_Logic/GearShift" /begin SUB_GROUP S4056_Gear1 /end SUB_GROUP /end GROUP
/begin GROUP S4052_Mode "VBU0513/VBUSystem/VCU /VehINP/VehINP_Logic/Mode" /begin SUB_GROUP S4057_VehMode /end SUB_GROUP /end GROUP
/begin GROUP S4052_PEU_InverterStatus "VBU0513/VBUSystem/VCU /VehINP/VehINP_Logic/PEU_InverterStatus"
 /begin REF_CHARACTERISTIC Veh_stIMInverterON_C Veh_stInverterOFF_C Veh_stInverterON_C /end REF_CHARACTERISTIC
/end GROUP
/begin GROUP S4052_SWReset "VBU0513/VBUSystem/VCU /VehINP/VehINP_Logic/SWReset"
 /begin REF_CHARACTERISTIC Gear_stCurrentGearN_C Gear_stCurrentGearP_C Veh_tiHWResetConfirmTime_C Veh_tiHWResetDelayTime_C Veh_tiSampleTime_C Veh_vVehSpdHWReset_C /end REF_CHARACTERISTIC
/end GROUP
/begin GROUP S4052_TireType "VBU0513/VBUSystem/VCU /VehINP/VehINP_Logic/TireType" /begin REF_CHARACTERISTIC Veh_stVehTire19_C /end REF_CHARACTERISTIC /end GROUP
/begin GROUP S4052_VacuumPump_Control "VBU0513/VBUSystem/VCU /VehINP/VehINP_Logic/VacuumPump Control" /begin SUB_GROUP S4061_Hysteresis_LLC_RHC /end SUB_GROUP /begin REF_CHARACTERISTIC Veh_pVacPumpRun_C Veh_pVacPumpStop_C Veh_pVacPumpWarning_C /end REF_CHARACTERISTIC /begin REF_MEASUREMENT Veh_flgVacPressWarning /end REF_MEASUREMENT /end GROUP
/begin GROUP S4052_VehINP_BPD "VBU0513/VBUSystem/VCU /VehINP/VehINP_Logic/VehINP_BPD"
 /begin SUB_GROUP S4062_BPD_BrakePercent S4062_BPD_BrakeSwitch S4062_BPD_BrkSwtPosPlausibilityCheck S4062_VehINP_BrkPedOverride /end SUB_GROUP
/end GROUP
/begin GROUP S4052_Veh_Status "VBU0513/VBUSystem/VCU /VehINP/VehINP_Logic/Veh_Status" /begin SUB_GROUP S4063_VehHVIL /end SUB_GROUP /end GROUP
/begin GROUP S35_Calculate_BatteryCurrent "VBU0513/VBUSystem/BMS/BCV/BCV/Subsystem/Calculate_BatteryCurrent"
 /begin SUB_GROUP S36_Check_BatteryCurrent_Valid S36_Correct_BatteryCurrent S36_UpdateBatteryCurrent /end SUB_GROUP
/end GROUP
/begin GROUP S35_Calculate_BatteryVoltage "VBU0513/VBUSystem/BMS/BCV/BCV/Subsystem/Calculate_BatteryVoltage"
 /begin SUB_GROUP S37_Check_BatteryVoltage_Valid S37_Check_BusNegativeVoltage_Valid S37_Check_BusVoltage_Valid S37_Check_FuseVoltage_Valid S37_Check_PrechargeVoltage_Valid S37_Check_Vx1Voltage_Valid S37_Check_Vx2Voltage_Valid S37_Update_BatteryVoltage S37_Update_BusNegativeVoltage S37_Update_BusVoltage S37_Update_FuseVoltage S37_Update_PrechargeVoltage S37_Update_Vx2Voltage /end SUB_GROUP
/end GROUP
/begin GROUP S35_Calculate_Lifetime_Data "VBU0513/VBUSystem/BMS/BCV/BCV/Subsystem/Calculate_Lifetime_Data"
 /begin SUB_GROUP S38_Calculate_FuseProtect_Counter S38_Calculate_LifeTimeCharge S38_Calculate_LifeTimeCoulomb S38_Calculate_LifeTimeDischarge S38_Calculate_LifeTimeFastcharge /end SUB_GROUP
/end GROUP
/begin GROUP S35_Diagnose_BCV_Communication_Fault "VBU0513/VBUSystem/BMS/BCV/BCV/Subsystem/Diagnose_BCV_Communication_Fault" /begin SUB_GROUP S39_DIagnose_OutOfRange_Fault /end SUB_GROUP /end GROUP
/begin GROUP S35_Diagnose_BCV_Data_Fault "VBU0513/VBUSystem/BMS/BCV/BCV/Subsystem/Diagnose_BCV_Data_Fault"
 /begin SUB_GROUP S40_Diagnose_BatteryBusVoltageMismatch_Fault S40_Diagnose_VoltageCurrent_Fault /end SUB_GROUP
/end GROUP
/begin GROUP S35_Interface_Switch "VBU0513/VBUSystem/BMS/BCV/BCV/Subsystem/Interface_Switch"
 /begin REF_CHARACTERISTIC CbBCV_HALBatteryVoltageORF_flg CcBCV_HALBatteryVoltageORV_V /end REF_CHARACTERISTIC
/end GROUP
/begin GROUP S35_Interface_Switch1 "VBU0513/VBUSystem/BMS/BCV/BCV/Subsystem/Interface_Switch1"
 /begin REF_CHARACTERISTIC CbBCV_HALBatteryVoltageStatusORF_flg CbBCV_HALBatteryVoltageStatusORV_flg /end REF_CHARACTERISTIC
/end GROUP
/begin GROUP S35_Interface_Switch2 "VBU0513/VBUSystem/BMS/BCV/BCV/Subsystem/Interface_Switch2" /begin REF_CHARACTERISTIC CbBCV_HALVx2VoltageORF_flg CcBCV_HALVx2VoltageORV_V /end REF_CHARACTERISTIC /end GROUP
/begin GROUP S35_Interface_Switch3 "VBU0513/VBUSystem/BMS/BCV/BCV/Subsystem/Interface_Switch3"
 /begin REF_CHARACTERISTIC CbBCV_HALVx2VoltageStatusORF_flg CbBCV_HALVx2VoltageStatusORV_flg /end REF_CHARACTERISTIC
/end GROUP
/begin GROUP S35_Interface_Switch4 "VBU0513/VBUSystem/BMS/BCV/BCV/Subsystem/Interface_Switch4"
 /begin REF_CHARACTERISTIC CbBCV_HALBusNegativeVoltageORF_flg CcBCV_HALBusNegativeVoltageORV_V /end REF_CHARACTERISTIC
/end GROUP
/begin GROUP S35_Interface_Switch5 "VBU0513/VBUSystem/BMS/BCV/BCV/Subsystem/Interface_Switch5"
 /begin REF_CHARACTERISTIC CbBCV_HALBusNegativeVoltageStatusORF_flg CbBCV_HALBusNegativeVoltageStatusORV_flg /end REF_CHARACTERISTIC
/end GROUP
/begin GROUP S35_Interface_Switch6 "VBU0513/VBUSystem/BMS/BCV/BCV/Subsystem/Interface_Switch6" /begin REF_CHARACTERISTIC CbBCV_HALFuseVoltageORF_flg CcBCV_HALFuseVoltageORV_V /end REF_CHARACTERISTIC /end GROUP
/begin GROUP S35_Interface_Switch7 "VBU0513/VBUSystem/BMS/BCV/BCV/Subsystem/Interface_Switch7"
 /begin REF_CHARACTERISTIC CbBCV_HALFuseVoltageStatusORF_flg CbBCV_HALFuseVoltageStatusORV_flg /end REF_CHARACTERISTIC
/end GROUP
/begin GROUP S35_Interface_Switch8 "VBU0513/VBUSystem/BMS/BCV/BCV/Subsystem/Interface_Switch8"
 /begin REF_CHARACTERISTIC CbBCV_HALPrechargeVoltageORF_flg CcBCV_HALPrechargeVoltageORV_V /end REF_CHARACTERISTIC
/end GROUP
/begin GROUP S35_Interface_Switch9 "VBU0513/VBUSystem/BMS/BCV/BCV/Subsystem/Interface_Switch9"
 /begin REF_CHARACTERISTIC CbBCV_HALPrechargeVoltageStatusORF_flg CbBCV_HALPrechargeVoltageStatusORV_flg /end REF_CHARACTERISTIC
/end GROUP
/begin GROUP S35_Monitor_BCV_Performance "VBU0513/VBUSystem/BMS/BCV/BCV/Subsystem/Monitor_BCV_Performance"
 /begin SUB_GROUP S51_Diagnose_BDM_BCV_Communication_Fault S51_Diagnose_BDM_BCV_Data_Fault S51_Diagnose_BDM_FastChargeContactorOverCurrentAlarm /end SUB_GROUP
 /begin REF_CHARACTERISTIC CcBCV_BDMOutputDelayTime_ms /end REF_CHARACTERISTIC
 /begin REF_MEASUREMENT BCV_BdmVoltagePerformanceIndex_enum BCV_flgDCContactorOverCurrent BCV_stBdmCurrentComIndex BCV_stBdmCurrentPerformanceIndex /end REF_MEASUREMENT
/end GROUP
/begin GROUP S35_Unpackage_LEM_Msg "VBU0513/VBUSystem/BMS/BCV/BCV/Subsystem/Unpackage_LEM_Msg" /begin REF_CHARACTERISTIC MILIAMPERES_PER_AMPERE_SY /end REF_CHARACTERISTIC /begin REF_MEASUREMENT BCV_flgBatteryCurrentSystemValid BCV_iABatteryCurrentRaw /end REF_MEASUREMENT /end GROUP
/begin GROUP S233_BDM_KL30Voltage_Diagnostic "VBU0513/VBUSystem/BMS/BMM/BMM/BMU_PowerOff_Check/BDM_KL30Voltage_Diagnostic" /begin REF_CHARACTERISTIC CcBMM_HALKL30BMUVoltageLow_V /end REF_CHARACTERISTIC /end GROUP
/begin GROUP S233_Monitor_BMM_Performance "VBU0513/VBUSystem/BMS/BMM/BMM/BMU_PowerOff_Check/Monitor_BMM_Performance" /begin REF_CHARACTERISTIC CcBMM_BDMOutputDelayTime_ms /end REF_CHARACTERISTIC /end GROUP
/begin GROUP S233_Override1 "VBU0513/VBUSystem/BMS/BMM/BMM/BMU_PowerOff_Check/Override1"
 /begin REF_CHARACTERISTIC CaBMM_HALKL30BMUVoltageORF_flg CaBMM_HALKL30BMUVoltageORV_V /end REF_CHARACTERISTIC
/end GROUP
/begin GROUP S236_DetermineSOCJump "VBU0513/VBUSystem/BMS/BMM/BMM/DetermineAbnormalEventFlag/DetermineSOCJump"
 /begin REF_CHARACTERISTIC CcBMM_SOCJumpDelayTime_ms CcBMM_SOCJumpPowerOnDelayTime_ms CcBMM_SOCJumpThreshold_pct /end REF_CHARACTERISTIC
/end GROUP
/begin GROUP S237_CycleWakeupStateMachine "VBU0513/VBUSystem/BMS/BMM/BMM/DetermineCycleUpload/CycleWakeupStateMachine" /begin REF_CHARACTERISTIC CYCLE_WAKEUP_STATE_ABNORMAL CYCLE_WAKEUP_STATE_INIT /end REF_CHARACTERISTIC /end GROUP
/begin GROUP S237_GetValueInNVM "VBU0513/VBUSystem/BMS/BMM/BMM/DetermineCycleUpload/GetValueInNVM"
 /begin REF_CHARACTERISTIC CbBMM_BattSelfLearningRequestDefault_flg CcBMM_MaxWakeUpCounter_n /end REF_CHARACTERISTIC
 /begin REF_MEASUREMENT BMM_numMonitorLastCycle /end REF_MEASUREMENT
/end GROUP
/begin GROUP S238_Determine_HoldAfterrun_Condition "VBU0513/VBUSystem/BMS/BMM/BMM/Determine_Hold_Afterrun/Determine_HoldAfterrun_Condition"
 /begin REF_CHARACTERISTIC CbBMM_DriverIntentionChangeEnable_flg CcBMM_MaxAfterrunTime_s /end REF_CHARACTERISTIC
 /begin REF_MEASUREMENT BMM_flgHoldAfterrun /end REF_MEASUREMENT
/end GROUP
/begin GROUP S239_Determine_Wakeup_Bywire "VBU0513/VBUSystem/BMS/BMM/BMM/Determine_Wakeup_Mode/Determine_Wakeup_Bywire" /begin SUB_GROUP S280_Delay_FallingEdge /end SUB_GROUP /begin REF_CHARACTERISTIC CcBMM_WakeupLineFEDebounceTime_ms /end REF_CHARACTERISTIC /end GROUP
/begin GROUP S239_Wakeup_Fast_Charge "VBU0513/VBUSystem/BMS/BMM/BMM/Determine_Wakeup_Mode/Wakeup_Fast_Charge"
 /begin REF_CHARACTERISTIC BMM_VEHICLE_WAKEUP_MODE_FAST_CHARGE CbBMM_FastChargeWakeupEnable_flg /end REF_CHARACTERISTIC
 /begin REF_MEASUREMENT BMM_flgFastChargeWakeup /end REF_MEASUREMENT
/end GROUP
/begin GROUP S239_Wakeup_Ignition_On "VBU0513/VBUSystem/BMS/BMM/BMM/Determine_Wakeup_Mode/Wakeup_Ignition_On"
 /begin REF_CHARACTERISTIC BMM_VEHICLE_WAKEUP_MODE_IGNITION_ON BMM_VEHICLE_WAKEUP_MODE_SOFTWARE_FLASHING /end REF_CHARACTERISTIC
 /begin REF_MEASUREMENT BMM_flgIgnitionOnWakeup /end REF_MEASUREMENT
/end GROUP
/begin GROUP S240_EEPROM_BlockStoreEnable "VBU0513/VBUSystem/BMS/BMM/BMM/Subsystem/EEPROM_BlockStoreEnable" /begin REF_MEASUREMENT BMM_flgEEBlockStoreEnable /end REF_MEASUREMENT /end GROUP
/begin GROUP S287_Balance_EnableCondition "VBU0513/VBUSystem/BMS/CBL/Subsystem8/Subsystem/Balance_EnableCondition"
 /begin SUB_GROUP S288_DetermineBalance_EnableCondition S288_DetermineSOCBalance_EnableCondition S288_DetermineVoltaageBalance_EnableCondition /end SUB_GROUP
/end GROUP
/begin GROUP S287_Determine_BoardTemAvailableCheck "VBU0513/VBUSystem/BMS/CBL/Subsystem8/Subsystem/Determine_BoardTemAvailableCheck"
 /begin REF_CHARACTERISTIC CcCBL_BoardTempBalanceStartMaxHysteresis_C CcCBL_BoardTempBalanceStartMax_C /end REF_CHARACTERISTIC
 /begin REF_MEASUREMENT LaCBL_flgCellBoardTempAvailable /end REF_MEASUREMENT
/end GROUP
/begin GROUP S287_Determine_CSCCellBalanceRequest "VBU0513/VBUSystem/BMS/CBL/Subsystem8/Subsystem/Determine_CSCCellBalanceRequest"
 /begin SUB_GROUP S290_Determin_MinSocCellCapacity S290_Determine_CellBalanceNumber S290_Determine_CellBalanceRequest S290_Determine_TotalCellBalanceState S290_Subsystem /end SUB_GROUP
/end GROUP
/begin GROUP S287_Override "VBU0513/VBUSystem/BMS/CBL/Subsystem8/Subsystem/Override" /begin SUB_GROUP S291_LOW_HIGH1 S291_LOW_HIGH2 /end SUB_GROUP
 /begin REF_CHARACTERISTIC CbCBL_CTMBoardTempValidORF_flg CbCBL_CTMBoardTempValidORV_flg CcCBL_CTMBoardTempMaxORF_flg CcCBL_CTMBoardTempMaxORV_C /end REF_CHARACTERISTIC
/end GROUP
/begin GROUP S347_LOW_HIGH2 "VBU0513/VBUSystem/BMS/CSC/Subsystem7/Determine_Cell_Balance/LOW_HIGH2" /begin REF_MEASUREMENT GaCSC_flgCellBalanceRequest /end REF_MEASUREMENT /end GROUP
/begin GROUP S356_ControlPrechargeRelay "VBU0513/VBUSystem/BMS/CTC/Subsystem1/Subsystem/ControlPrechargeRelay" /begin REF_CHARACTERISTIC CTS_MAIN_CONTACTOR_COMMAND_CLOSE /end REF_CHARACTERISTIC /begin REF_MEASUREMENT CTC_flgHALPrechargeRelay /end REF_MEASUREMENT /end GROUP
/begin GROUP S356_ControlResetRelays "VBU0513/VBUSystem/BMS/CTC/Subsystem1/Subsystem/ControlResetRelays"
 /begin REF_CHARACTERISTIC CTS_MAIN_CONTACTOR_COMMAND_CLOSE CTS_MAIN_CONTACTOR_COMMAND_OPEN CTS_STATE_DEACTIVATION CTS_STATE_OPEN_MPR_AND_DIAGNOSE_MPC_STUCKOPEN /end REF_CHARACTERISTIC
 /begin REF_MEASUREMENT CTC_stResetContactorRequest /end REF_MEASUREMENT
/end GROUP
/begin GROUP S356_ControlmainNegativeRelay "VBU0513/VBUSystem/BMS/CTC/Subsystem1/Subsystem/ControlmainNegativeRelay"
 /begin REF_CHARACTERISTIC CTS_MAIN_CONTACTOR_COMMAND_CLOSE CTS_MAIN_CONTACTOR_COMMAND_OPEN /end REF_CHARACTERISTIC
 /begin REF_MEASUREMENT CTC_flgHALMnNegContactor /end REF_MEASUREMENT
/end GROUP
/begin GROUP S356_ControlmainPositiveRelay "VBU0513/VBUSystem/BMS/CTC/Subsystem1/Subsystem/ControlmainPositiveRelay"
 /begin REF_CHARACTERISTIC CTS_MAIN_CONTACTOR_COMMAND_CLOSE CTS_MAIN_CONTACTOR_COMMAND_OPEN /end REF_CHARACTERISTIC
 /begin REF_MEASUREMENT CTC_flgHALMnPosContactor /end REF_MEASUREMENT
/end GROUP
/begin GROUP S356_DetermineRelayCommandStatus "VBU0513/VBUSystem/BMS/CTC/Subsystem1/Subsystem/DetermineRelayCommandStatus" /begin SUB_GROUP S361_Cmd_Close S361_Cmd_Open /end SUB_GROUP /begin REF_MEASUREMENT CTC_stContactorsCommandStatus /end REF_MEASUREMENT /end GROUP
/begin GROUP S356_Determine_Openings_Number "VBU0513/VBUSystem/BMS/CTC/Subsystem1/Subsystem/Determine_Openings_Number"
 /begin REF_CHARACTERISTIC CTS_MAIN_CONTACTOR_COMMAND_CLOSE CTS_MAIN_CONTACTOR_COMMAND_OPEN /end REF_CHARACTERISTIC
/end GROUP
/begin GROUP S373_Determine_MainContactor_Status "VBU0513/VBUSystem/BMS/CTD/Subsystem/Subsystem4/Determine_MainContactor_Status" /begin REF_CHARACTERISTIC CTD_MAIN_CONTACTOR_STATUS_UNKNOWN /end REF_CHARACTERISTIC /begin REF_MEASUREMENT CTD_stMnContactorsStatus /end REF_MEASUREMENT /end GROUP
/begin GROUP S373_DiagnoseRelayWeld "VBU0513/VBUSystem/BMS/CTD/Subsystem/Subsystem4/DiagnoseRelayWeld"
 /begin SUB_GROUP S375_DetermineRatioPEUtoBat S375_MNC_Weld_Check S375_MPC_Weld_Check /end SUB_GROUP
/end GROUP
/begin GROUP S373_LV_Battery_Voltage "VBU0513/VBUSystem/BMS/CTD/Subsystem/Subsystem4/LV_Battery_Voltage"
 /begin REF_CHARACTERISTIC CcCTD_HALSystemVoltageHighDelta_V CcCTD_HALSystemVoltageHigh_V CcCTD_HALSystemVoltageLowDelta_V CcCTD_HALSystemVoltageLow_V /end REF_CHARACTERISTIC
/end GROUP
/begin GROUP S373_Lockout_Precharge_Process "VBU0513/VBUSystem/BMS/CTD/Subsystem/Subsystem4/Lockout_Precharge_Process"
 /begin SUB_GROUP S377_Determine_Fail_Lockout S377_Determine_Lockout_Time S377_Determine_Overload_Lockout S377_HeatProtection_Lockout /end SUB_GROUP
/end GROUP
/begin GROUP S373_MainFuseDiagnostic "VBU0513/VBUSystem/BMS/CTD/Subsystem/Subsystem4/MainFuseDiagnostic" /begin SUB_GROUP S378_Determine_Diagnostic_Status /end SUB_GROUP
 /begin REF_CHARACTERISTIC CTD_MAIN_FUSE_BLOWN_FAULT CbCTD_MainFuseBlownFaultEnable_flg CcCTD_MainFuseBlownDeltaVoltage_V CcCTD_MainFuseBlownFaultFIC_n CcCTD_MainFuseBlownFaultPIC_n /end REF_CHARACTERISTIC
 /begin REF_MEASUREMENT CTD_flgMainFuseBlowFaultTestEnable CTD_flgMainFuseBlowFaultTestFail CTD_stMainFuseBlownFault /end REF_MEASUREMENT
/end GROUP
/begin GROUP S373_Precharge_Resistance_Diagnostic "VBU0513/VBUSystem/BMS/CTD/Subsystem/Subsystem4/Precharge_Resistance_Diagnostic"
 /begin SUB_GROUP S379_CONTACTOR_STATUS_CLOSED1 S379_CONTACTOR_STATUS_OPENED1 S379_Determine_Diagnostic_Status /end SUB_GROUP
 /begin REF_CHARACTERISTIC CbCTD_PrechargeResistanceBlownFaultEnable_flg CcCTD_PrechargeResistanceBlownDeltaVoltage_V CcCTD_PrechargeResistanceBlownFaultFIC_n CcCTD_PrechargeResistanceBlownFaultPIC_n /end REF_CHARACTERISTIC
 /begin REF_MEASUREMENT CTD_flgPrechargeResistanceBlownFaultTestEnable CTD_flgPrechargeResistanceBlownFaultTestFail CTD_stPrechargeRelayBlown /end REF_MEASUREMENT
/end GROUP
/begin GROUP S373_PrechrgProcessMonitoring "VBU0513/VBUSystem/BMS/CTD/Subsystem/Subsystem4/PrechrgProcessMonitoring"
 /begin SUB_GROUP S380_Determine_PrechargeDiag_Disable S380_Determine_Precharge_Timer S380_Determine_Ratio_BusVBatV S380_Precharge_Thermal_Management S380_Precharge_Timeout_Diagnostic S380_Precharging_Process_Monitoring /end SUB_GROUP
/end GROUP
/begin GROUP S373_Stuck_Open_Diagnostic "VBU0513/VBUSystem/BMS/CTD/Subsystem/Subsystem4/Stuck_Open_Diagnostic"
 /begin SUB_GROUP S381_MNC_Stuck_Open S381_MPC_Stuck_Open S381_MPR_Stuck_Open S381_StuckOpenAssistantConditons /end SUB_GROUP
/end GROUP
/begin GROUP S373_Subsystem "VBU0513/VBUSystem/BMS/CTD/Subsystem/Subsystem4/Subsystem" /begin REF_CHARACTERISTIC CTD_MAIN_CONTACTOR_STATUS_UNKNOWN /end REF_CHARACTERISTIC /begin REF_MEASUREMENT CTD_stMnPosContactorStatus /end REF_MEASUREMENT /end GROUP
/begin GROUP S373_Subsystem1 "VBU0513/VBUSystem/BMS/CTD/Subsystem/Subsystem4/Subsystem1"
 /begin REF_CHARACTERISTIC CTD_MAIN_CONTACTOR_STATUS_Open CTD_MAIN_CONTACTOR_STATUS_UNKNOWN /end REF_CHARACTERISTIC
 /begin REF_MEASUREMENT CTD_stPrechargeContactorStatus /end REF_MEASUREMENT
/end GROUP
/begin GROUP S373_Subsystem2 "VBU0513/VBUSystem/BMS/CTD/Subsystem/Subsystem4/Subsystem2"
 /begin REF_CHARACTERISTIC CTD_MAIN_CONTACTOR_STATUS_Open CTD_MAIN_CONTACTOR_STATUS_UNKNOWN /end REF_CHARACTERISTIC
 /begin REF_MEASUREMENT CTD_stMnNegContactorStatus /end REF_MEASUREMENT
/end GROUP
/begin GROUP S373_Subsystem3 "VBU0513/VBUSystem/BMS/CTD/Subsystem/Subsystem4/Subsystem3"
 /begin REF_CHARACTERISTIC CTD_MAIN_CONTACTOR_STATUS_Open CTD_MAIN_CONTACTOR_STATUS_UNKNOWN /end REF_CHARACTERISTIC
 /begin REF_MEASUREMENT CTD_stHeatingContactorStatus /end REF_MEASUREMENT
/end GROUP
/begin GROUP S541_BoardTemp_ValidCheck "VBU0513/VBUSystem/BMS/CTM/CTM/Subsystem/BoardTemp_ValidCheck"
 /begin REF_CHARACTERISTIC CcCTM_BoardTempInvalidFaultDelayTime_ms CcCTM_BoardTempInvalidFault_n SAMPLE_TIME_TASK_D /end REF_CHARACTERISTIC
/end GROUP
/begin GROUP S541_CellTemp_ValidCheck "VBU0513/VBUSystem/BMS/CTM/CTM/Subsystem/CellTemp_ValidCheck"
 /begin REF_CHARACTERISTIC CcCTM_CellTempInvalidFaultDelayTime_ms CcCTM_CellTempInvalidFault_n SAMPLE_TIME_TASK_D /end REF_CHARACTERISTIC
/end GROUP
/begin GROUP S541_Determine_BoardTemp_OverUnderFaults "VBU0513/VBUSystem/BMS/CTM/CTM/Subsystem/Determine_BoardTemp_OverUnderFaults"
 /begin REF_CHARACTERISTIC CTM_BOARD_OVER_TEMP_FAULT CbCTM_BoardOverTempFaultEnable_flg CcCTM_BoardOverTempFaultFIC_n CcCTM_BoardOverTempFaultPIC_n CcCTM_BoardOverTempFault_C /end REF_CHARACTERISTIC
/end GROUP
/begin GROUP S541_Determine_CellTemp "VBU0513/VBUSystem/BMS/CTM/CTM/Subsystem/Determine_CellTemp"
 /begin REF_MEASUREMENT CTM_numCellTempMaxID CTM_numCellTempMinID CTM_numOriginalCellTempMaxID CTM_numOriginalCellTempMinID CTM_numOriginalCellTempSecondMaxID CTM_tCellTempAve CTM_tCellTempMax CTM_tCellTempMin CTM_tOriginalCellTempAve CTM_tOriginalCellTempMax CTM_tOriginalCellTempMin CTM_tOriginalCellTempSecondMax /end REF_MEASUREMENT
/end GROUP
/begin GROUP S541_Determine_CellTemp_OverDeviationFaults "VBU0513/VBUSystem/BMS/CTM/CTM/Subsystem/Determine_CellTemp_OverDeviationFaults" /begin SUB_GROUP S547_EVM_FDC_Handler1 /end SUB_GROUP
 /begin REF_CHARACTERISTIC CTM_CELL_TEMP_OVER_DEVIATION_FAULT CbCTM_CellTempOverDeviationEVMFaultEnable_flg CbCTM_CellTempOverDeviationFaultEnable_flg CcCTM_CSCSupplyPowerLowHysteresis_V CcCTM_CSCSupplyPowerLow_V CcCTM_CellTempOverDeviationEVMFaultFIC_n CcCTM_CellTempOverDeviationEVMFaultPIC_n CcCTM_CellTempOverDeviationEVMFault_C CcCTM_CellTempOverDeviationFaultFIC_n CcCTM_CellTempOverDeviationFaultPIC_n CcCTM_CellTempOverDeviationFault_C CcCTM_EnableEVMTempDevDelayTime_ms CcCTM_EnableEVMTempDevThreshold_A SAMPLE_TIME_TASK_D /end REF_CHARACTERISTIC
/end GROUP
/begin GROUP S541_Determine_CellTemp_OverUnderFaults "VBU0513/VBUSystem/BMS/CTM/CTM/Subsystem/Determine_CellTemp_OverUnderFaults" /begin SUB_GROUP S548_EVM_FDC_Handler /end SUB_GROUP
 /begin REF_CHARACTERISTIC CTM_CELL_OVER_TEMP_WARNING_FAULT CTM_CELL_UNDER_TEMP_FAULT CbCTM_CellOverTempEVMFaultEnable_flg CbCTM_CellOverTempFaultEnable_flg CbCTM_CellOverTempWarningFaultEnable_flg CbCTM_CellUnderTempFaultEnable_flg CcCTM_CellOverTempEVMFaultFIC_n CcCTM_CellOverTempEVMFaultPIC_n CcCTM_CellOverTempEVMFault_C CcCTM_CellOverTempFaultFIC_n CcCTM_CellOverTempFaultPIC_n CcCTM_CellOverTempFault_C CcCTM_CellOverTempLvl2Fault_C CcCTM_CellOverTempWarningDebounce_ms CcCTM_CellOverTempWarningFaultFIC_n CcCTM_CellOverTempWarningFaultPIC_n CcCTM_CellOverTempWarningFault_C CcCTM_CellUnderTempFaultFIC_n CcCTM_CellUnderTempFaultPIC_n CcCTM_CellUnderTempFault_C SAMPLE_TIME_TASK_D /end REF_CHARACTERISTIC
/end GROUP
/begin GROUP S541_Determine_Thermal_Runaway "VBU0513/VBUSystem/BMS/CTM/CTM/Subsystem/Determine_Thermal_Runaway"
 /begin SUB_GROUP S550_CellThermalRunaway_FaultArrayCheck S550_DetermineCellTempOver S550_DetermineTempRiseRate S550_TriggerCycle /end SUB_GROUP
/end GROUP
/begin GROUP S541_PowerOnTempVoltageValid "VBU0513/VBUSystem/BMS/CTM/CTM/Subsystem/PowerOnTempVoltageValid" /begin REF_CHARACTERISTIC CcCTM_PowerOnTempVoltageDelay_ms SAMPLE_TIME_TASK_D /end REF_CHARACTERISTIC /end GROUP
/begin GROUP S619_Contactors_Timing_Control "VBU0513/VBUSystem/BMS/CTS/CTS/Subsystem/Contactors_Timing_Control"
 /begin REF_CHARACTERISTIC CTD_PRECHARGE_STATUS_FAIL CTD_PRECHARGE_STATUS_SUCCESS CTS_MAIN_CONTACTOR_COMMAND_CLOSE CTS_MAIN_CONTACTOR_COMMAND_OPEN CTS_PEU_DISCHARGE_ACTIVE CTS_STATE_CLOSE_AND_DIAGNOSE_MPR_STUCKOPEN CTS_STATE_CLOSE_MC_LSD_DIAGNOSE_HSD_STB CTS_STATE_CLOSE_MNC_PRECHARGING_MONITORING CTS_STATE_CLOSE_MPC CTS_STATE_DEACTIVATION CTS_STATE_DIAGNOSE_MNC_WELD CTS_STATE_DIAGNOSE_MPC_WELD CTS_STATE_DIAGNOSE_MPC_WELD_POWER_DOWN CTS_STATE_NORMAL_OPERATING CTS_STATE_OPEN_MAIN_POSITIVE_CONTACTOR CTS_STATE_OPEN_MC_AND_DIAGNOSE_WELD CTS_STATE_OPEN_MC_HSD CTS_STATE_OPEN_MPR_AND_DIAGNOSE_MPC_STUCKOPEN CTS_STATE_STANDBY CcCTS_CmdMnPosContactorDelayTime_ms CcCTS_DeltaVoltagePrecharge_V CcCTS_DiagnoseMPCWeldCheckDischargeTime_ms CcCTS_DiagnoseMPCWeldCheckTime_ms CcCTS_MaxCloseAndDiagnoseContactorsTime_ms CcCTS_MaxPrechargeTimes_n CcCTS_MinOpenAndDiagnoseWeldTime_ms CcCTS_NegativeLoadCurrent_A CcCTS_OpenContactorsDelayTime_ms CcCTS_PositiveLoadCurrent_A CcCTS_PrechargeTimesLimitEnable_flg CcSYS_SystemMaxInitialTime_ms DIAGNOSTIC_COMPLETE DIAGNOSTIC_CONDITION_NOT_MET /end REF_CHARACTERISTIC
 /begin REF_MEASUREMENT CTS_flgRunNegContactorWeldCheck CTS_flgRunPosContactorWeldCheck CTS_flgRunPrechargeDiagnostic CTS_stCmdMnNegContactor CTS_stCmdMnPosContactor CTS_stCmdPrechargeRelay CTS_stState LcCTS_CloseAndDiagnoseContactorsTimer_ms LcCTS_CmdMnPosContactorCounter_ms LcCTS_DiagnoseMPCWeldcheckDischargeTimer_ms LcCTS_DiagnoseMPCWeldcheckTimer_ms LcCTS_OpenAndDiagnoseWeldTimer_ms LcCTS_OpenContactorsDelayTimer_ms LcCTS_StandbyTimer_ms /end REF_MEASUREMENT
/end GROUP
/begin GROUP S619_DeterminePrechargeConditions "VBU0513/VBUSystem/BMS/CTS/CTS/Subsystem/DeterminePrechargeConditions"
 /begin SUB_GROUP S621_Cell_DataValid_Check S621_Energy_Protection_Check S621_Fault_Check S621_HV_DataValid_Check S621_HV_Safety_Check S621_Precharge_Inhibit_Abort S621_SoC_Initialization_Check /end SUB_GROUP
/end GROUP
/begin GROUP S619_Determine_Contactor_Request "VBU0513/VBUSystem/BMS/CTS/CTS/Subsystem/Determine_Contactor_Request"
 /begin SUB_GROUP S622_Close_Comamnd S622_Cmd_Close S622_Cmd_Open S622_Open_Comamnd /end SUB_GROUP
 /begin REF_CHARACTERISTIC VCR_CONTACTOR_NO_REQUEST VCR_CONTACTOR_OPEN /end REF_CHARACTERISTIC
 /begin REF_MEASUREMENT CTS_stContactorRequest /end REF_MEASUREMENT
/end GROUP
/begin GROUP S619_Determine_Emergency_Open "VBU0513/VBUSystem/BMS/CTS/CTS/Subsystem/Determine_Emergency_Open"
 /begin REF_CHARACTERISTIC CbCTS_HvilOpenContactorEnable_flg CmSYS_OpenContactorsDelayFaultCat_enum CmSYS_OpenContactorsNowFaultCat_enum /end REF_CHARACTERISTIC
 /begin REF_MEASUREMENT CTS_flgCmdOpenContactorsDelay CTS_flgCmdOpenContactorsNow /end REF_MEASUREMENT
/end GROUP
/begin GROUP S619_Determine_Precharge_Times "VBU0513/VBUSystem/BMS/CTS/CTS/Subsystem/Determine_Precharge_Times"
 /begin REF_CHARACTERISTIC CTS_STATE_CLOSE_AND_DIAGNOSE_MPR_STUCKOPEN CTS_STATE_CLOSE_MC_HSD_DIAGNOSE_LSD_STG CTS_STATE_DIAGNOSE_MPC_WELD CTS_STATE_STANDBY CcCTS_PrechargeTimerLimit_ms CcCTS_PrechargeTimerThreshold1_ms CcCTS_PrechargeTimerThreshold2_ms CcCTS_PrechargeTimerThreshold3_ms CcCTS_PrechargeTimer_ms CcCTS_PrechargeTimesLower_n CcCTS_PrechargeTimesUpper_n /end REF_CHARACTERISTIC
 /begin REF_MEASUREMENT CTS_timsPrechargeTimer /end REF_MEASUREMENT
/end GROUP
/begin GROUP S649_CellVoltage_ValidCheck "VBU0513/VBUSystem/BMS/CVT/CVT/Subsystem/CellVoltage_ValidCheck"
 /begin REF_CHARACTERISTIC CcCVT_CellVoltageInvalidFaultDelayTime_ms CcCVT_CellVoltageInvalidFault_n SAMPLE_TIME_TASK_D /end REF_CHARACTERISTIC
/end GROUP
/begin GROUP S649_Determine_CellVoltage_ExtremeData "VBU0513/VBUSystem/BMS/CVT/CVT/Subsystem/Determine_CellVoltage_ExtremeData"
 /begin REF_MEASUREMENT CVT_mvCellVoltageAve CVT_mvCellVoltageMax CVT_mvCellVoltageMin CVT_mvCellVoltageSecondMax CVT_mvCellVoltageSecondMin CVT_numCellVoltageMaxID CVT_numCellVoltageMinID CVT_numCellVoltageSecondMaxID CVT_numCellVoltageSecondMinID CVT_numInvalidCellVoltages CVT_uCellVoltagePack GaCVT_CellVoltageValid_flg GaCVT_CellVoltage_mV /end REF_MEASUREMENT
/end GROUP
/begin GROUP S649_Determine_CellVoltage_OverUnderFaults "VBU0513/VBUSystem/BMS/CVT/CVT/Subsystem/Determine_CellVoltage_OverUnderFaults"
 /begin SUB_GROUP S652_EVM_FDC_Handler S652_EVM_FDC_Handler1 S652_EVM_FDC_Handler2 /end SUB_GROUP
 /begin REF_CHARACTERISTIC CVT_CELL_VOLTAGE_OVER_DEVIATION_FAULT CaCVT_CellVoltageOverDeviationCurrentMapDimension_n CaCVT_CellVoltageOverDeviationCurrentMapZ_A CbCVT_CellOverVoltageEVMFaultEnable_flg CbCVT_CellOverVoltageFaultEnable_flg CbCVT_CellUnderVoltageEVMFaultEnable_flg CbCVT_CellUnderVoltageFaultEnable_flg CbCVT_CellVoltageOverDeviationEVMFaultEnable_flg CbCVT_CellVoltageOverDeviationFaultEnable_flg CcCVT_CSCSupplyPowerLowHysteresis_V CcCVT_CSCSupplyPowerLow_V CcCVT_CellOverVoltageEVMFaultFIC_n CcCVT_CellOverVoltageEVMFaultPIC_n CcCVT_CellOverVoltageEVMFault_mV CcCVT_CellOverVoltageFaultFIC_n CcCVT_CellOverVoltageFaultPIC_n CcCVT_CellOverVoltageFault_mV CcCVT_CellOverVoltageWarningDebounce_ms CcCVT_CellOverVoltageWarningFault_mV CcCVT_CellUnderVoltageEVMFaultFIC_n CcCVT_CellUnderVoltageEVMFaultPIC_n CcCVT_CellUnderVoltageEVMFault_mV CcCVT_CellUnderVoltageFaultFIC_n CcCVT_CellUnderVoltageFaultLevel2_mV CcCVT_CellUnderVoltageFaultPIC_n CcCVT_CellUnderVoltageFault_mV CcCVT_CellUnderVoltageLowTemp_C CcCVT_CellVoltageOverDeviationCurrentDelay_s CcCVT_CellVoltageOverDeviationDisableCrrnt_A CcCVT_CellVoltageOverDeviationEVMFaultFIC_n CcCVT_CellVoltageOverDeviationEVMFaultPIC_n CcCVT_CellVoltageOverDeviationEVMFault_mV CcCVT_CellVoltageOverDeviationFaultFIC_n CcCVT_CellVoltageOverDeviationFaultPIC_n CcCVT_CellVoltageOverDeviationFault_mV SAMPLE_TIME_TASK_D /end REF_CHARACTERISTIC
/end GROUP
/begin GROUP S649_Monitor_CVT_DeviationDynamic "VBU0513/VBUSystem/BMS/CVT/CVT/Subsystem/Monitor_CVT_DeviationDynamic" /begin SUB_GROUP S654_Determine_CSCCellVoltage_DeviationDynamicBDM /end SUB_GROUP /begin REF_CHARACTERISTIC CcCVT_BDMOutputDelayTime_ms SAMPLE_TIME_TASK_D /end REF_CHARACTERISTIC /end GROUP
/begin GROUP S649_Monitor_CVT_Performance "VBU0513/VBUSystem/BMS/CVT/CVT/Subsystem/Monitor_CVT_Performance"
 /begin SUB_GROUP S655_Determine_CellVoltage_OverDeviationBDM S655_Determine_CellVoltage_OverUnderBDM /end SUB_GROUP
 /begin REF_CHARACTERISTIC CcCVT_BDMOutputDelayTime_ms SAMPLE_TIME_TASK_D /end REF_CHARACTERISTIC
/end GROUP
/begin GROUP S709_Clear_Fault_Data "VBU0513/VBUSystem/BMS/DSM/Subsystem10/Subsystem/Clear_Fault_Data" /begin REF_CHARACTERISTIC CbDSM_ClearFaultData_flg /end REF_CHARACTERISTIC /end GROUP
/begin GROUP S709_Determine_Abnormal_In_PeriodicalUpload "VBU0513/VBUSystem/BMS/DSM/Subsystem10/Subsystem/Determine_Abnormal_In_PeriodicalUpload" /begin SUB_GROUP S711_For_Iterator_Subsystem /end SUB_GROUP /begin REF_CHARACTERISTIC CbDSM_AbnormalEventOvrValue_flg CbDSM_AbnormalEventOvr_flg /end REF_CHARACTERISTIC /begin REF_MEASUREMENT DSM_flgCycleUploadAbnormalEvent /end REF_MEASUREMENT /end GROUP
/begin GROUP S709_Determine_CSC_Inhibit "VBU0513/VBUSystem/BMS/DSM/Subsystem10/Subsystem/Determine_CSC_Inhibit" /begin SUB_GROUP S712_For_Iterator_Subsystem /end SUB_GROUP
 /begin REF_CHARACTERISTIC CbDSM_CscValueUncertainOvrValue_flg CbDSM_CscValueUncertainOvr_flg /end REF_CHARACTERISTIC
 /begin REF_MEASUREMENT DSM_flgCscValueUncertain /end REF_MEASUREMENT
/end GROUP
/begin GROUP S709_Determine_Drive_Cycle "VBU0513/VBUSystem/BMS/DSM/Subsystem10/Subsystem/Determine_Drive_Cycle" /begin REF_CHARACTERISTIC CcDSM_DiverCycleflgDelayTime_ms /end REF_CHARACTERISTIC /begin REF_MEASUREMENT DSM_flgDriverCycleActive /end REF_MEASUREMENT /end GROUP
/begin GROUP S709_Determine_Fault_Category "VBU0513/VBUSystem/BMS/DSM/Subsystem10/Subsystem/Determine_Fault_Category" /begin SUB_GROUP S714_Clear_Fault_Category /end SUB_GROUP /begin REF_CHARACTERISTIC CaDSM_FaultCat_enum /end REF_CHARACTERISTIC /end GROUP
/begin GROUP S709_Determine_MIL_Request "VBU0513/VBUSystem/BMS/DSM/Subsystem10/Subsystem/Determine_MIL_Request" /begin SUB_GROUP S716_Clear_MIL_Request S716_Determine_Local_MILRequest /end SUB_GROUP /end GROUP
/begin GROUP S709_Determine_No_Charge "VBU0513/VBUSystem/BMS/DSM/Subsystem10/Subsystem/Determine_No_Charge" /begin SUB_GROUP S717_For_Iterator_Subsystem /end SUB_GROUP /begin REF_CHARACTERISTIC CbDSM_NoChargeOvrValue_flg CbDSM_NoChargeOvr_flg /end REF_CHARACTERISTIC /begin REF_MEASUREMENT DSM_flgNoCharge /end REF_MEASUREMENT /end GROUP
/begin GROUP S709_Determine_No_Restart "VBU0513/VBUSystem/BMS/DSM/Subsystem10/Subsystem/Determine_No_Restart" /begin REF_CHARACTERISTIC CbDSM_NoRestartOverride_flg CbDSM_NoRestartOvrValue_flg /end REF_CHARACTERISTIC /begin REF_MEASUREMENT DSM_flgNoRestart /end REF_MEASUREMENT /end GROUP
/begin GROUP S741_Calculate_Fastcharge_Time "VBU0513/VBUSystem/BMS/FCC /FCC/Subsystem/Calculate_Fastcharge_Time"
 /begin SUB_GROUP S742_Calculate_FastChargeBaseRemainTime S742_EightyPercentCustomSOC_CaculateChargeTime S742_EightyPercentCustomSOC_EnableInvalidChargeTimeFlag S742_EightyPercentCustomSOC_UpdateChargeTimeFlag S742_EstimateChargeTime_CellVoltageMax_Coefficient S742_EstimateChargeTime_CellVoltageMax_Slop S742_SOC_Mapping S742_SendInvalidTime_flg S742_UpdateTimeTrigger S742_Update_CustomSOC100RemainTime S742_Update_CustomSOC80RemainTime /end SUB_GROUP
 /begin REF_CHARACTERISTIC CcFCC_EightyCustomSOC_pct CcFCC_EstimateChargeInvalidTime_min /end REF_CHARACTERISTIC
 /begin REF_MEASUREMENT FCC_timinActualRemainChargeTime FCC_timinEstimateChargeTime FCC_timinEstimatePercTime /end REF_MEASUREMENT
/end GROUP
/begin GROUP S741_Determine_Fastcharge_Request "VBU0513/VBUSystem/BMS/FCC /FCC/Subsystem/Determine_Fastcharge_Request"
 /begin SUB_GROUP S743_Charge_Request_Protection S743_DetermineComputeResistancePulseCurrent S743_Determine_Base_ChargeRequest S743_Determine_DiagnosedAndLimitedChargeRequestCurrent /end SUB_GROUP
/end GROUP
/begin GROUP S741_Fastcharge_Conditions_Check "VBU0513/VBUSystem/BMS/FCC /FCC/Subsystem/Fastcharge_Conditions_Check" /begin SUB_GROUP S744_Condition_Categorize S744_Determine_NoCharge_Cause /end SUB_GROUP /end GROUP
/begin GROUP S741_Fastcharge_State_Management "VBU0513/VBUSystem/BMS/FCC /FCC/Subsystem/Fastcharge_State_Management"
 /begin REF_CHARACTERISTIC CTS_MAIN_CONTACTOR_COMMAND_CLOSE CTS_MAIN_CONTACTOR_COMMAND_OPEN CcFCC_ChargeAbortDelayTime_s CcFCC_ChargeCompleteComfirmDelay_ms CcFCC_ChargeFaultDelayTime_s CcFCC_ChargeFullDelayTime_s CcFCC_ChargeProtectDelayTime_s FCC_STATE_ABORT_CHARGE FCC_STATE_BMS_CLOSE_CONTACTORS FCC_STATE_CHARGE_FAULT FCC_STATE_CHARGE_FULL FCC_STATE_CHARGE_PROTECTION FCC_STATE_CHARGING FCC_STATE_DEACTIVATE_DEVICES FCC_STATE_STANDBY FCC_STATE_SYSTEM_STATUS_CHECK FCC_STATE_WAIT_VCU_COMMAND SAMPLE_TIME_TASK_D /end REF_CHARACTERISTIC
 /begin REF_MEASUREMENT FCC_flgChargeTerminated FCC_stChargeState FCC_stContactorRequest FCC_tisChargeAbortTimer FCC_tisChargeFaultTimer FCC_tisChargeFullTimer FCC_tisChargeProtectTimer /end REF_MEASUREMENT
/end GROUP
/begin GROUP S741_Fastcharge_Violation_Diagnostic "VBU0513/VBUSystem/BMS/FCC /FCC/Subsystem/Fastcharge_Violation_Diagnostic"
 /begin REF_CHARACTERISTIC CaFCC_ChargeCurrentOverFactorMapY_nbr CbFCC_ChargeCurrentOverFaultEnable_flg CcFCC_ChargeCurrentOverDelta_A CcFCC_ChargeCurrentOverFaultFIC_n CcFCC_ChargeCurrentOverFaultPIC_n CcFCC_ChargeCurrentOver_A /end REF_CHARACTERISTIC
/end GROUP
/begin GROUP S959_Battery_SoC_Diagnostic "VBU0513/VBUSystem/BMS/SOC/Subsystem5/Subsystem/Battery_SoC_Diagnostic" /begin REF_CHARACTERISTIC SAMPLE_TIME_TASK_D /end REF_CHARACTERISTIC /end GROUP
/begin GROUP S959_Determine_Initialization_Condition "VBU0513/VBUSystem/BMS/SOC/Subsystem5/Subsystem/Determine_Initialization_Condition" /begin REF_CHARACTERISTIC SAMPLE_TIME_TASK_D /end REF_CHARACTERISTIC /end GROUP
/begin GROUP S1136_Rate_Limit_and_Output "VBU0513/VBUSystem/BMS/SOE/Subsystem2/Subsystem/Rate_Limit_and_Output" /begin REF_CHARACTERISTIC SAMPLE_TIME_TASK_D /end REF_CHARACTERISTIC /end GROUP
/begin GROUP S1136_Rate_Limit_and_Output_SOC "VBU0513/VBUSystem/BMS/SOE/Subsystem2/Subsystem/Rate_Limit_and_Output_SOC" /begin REF_CHARACTERISTIC SAMPLE_TIME_TASK_D /end REF_CHARACTERISTIC /end GROUP
/begin GROUP S1188_Count_LowTempOverCurrent "VBU0513/VBUSystem/BMS/SOF/Subsystem6/Subsystem/Count_LowTempOverCurrent" /begin REF_CHARACTERISTIC SAMPLE_TIME_TASK_D /end REF_CHARACTERISTIC /end GROUP
/begin GROUP S1188_Rate_CurrentLimit "VBU0513/VBUSystem/BMS/SOF/Subsystem6/Subsystem/Rate_CurrentLimit" /begin REF_CHARACTERISTIC SAMPLE_TIME_TASK_D /end REF_CHARACTERISTIC /end GROUP
/begin GROUP S1188_Rate_PowerLimit "VBU0513/VBUSystem/BMS/SOF/Subsystem6/Subsystem/Rate_PowerLimit" /begin REF_CHARACTERISTIC SAMPLE_TIME_TASK_D /end REF_CHARACTERISTIC /end GROUP
/begin GROUP S1188_SOF_Diagnostic "VBU0513/VBUSystem/BMS/SOF/Subsystem6/Subsystem/SOF_Diagnostic" /begin REF_CHARACTERISTIC SAMPLE_TIME_TASK_D /end REF_CHARACTERISTIC /end GROUP
/begin GROUP S1415_Subsystem "VBU0513/VBUSystem/BMS/SOH/Subsystem4/Subsystem1/Subsystem"
 /begin REF_CHARACTERISTIC FCC_STATE_CHARGE_FAULT FCC_STATE_CHARGE_FULL FCC_STATE_CHARGING /end REF_CHARACTERISTIC
/end GROUP
/begin GROUP S3632_DVM_PEUShtDwn "VBU0513/VBUSystem/VCU /PMM/PMM_Ctrl/DrvMod_Ctrl/DVM_PEUShtDwn"
 /begin REF_CHARACTERISTIC PMM_stActvDisCh_SY PMM_stHVRlyConnReq_SY PMM_stHVRlyConn_SY PMM_stInitMode_SY PMM_stMCUACOff_SY PMM_tiSmplT_SY /end REF_CHARACTERISTIC
/end GROUP
/begin GROUP S3632_DVM_VehRdy "VBU0513/VBUSystem/VCU /PMM/PMM_Ctrl/DrvMod_Ctrl/DVM_VehRdy" /begin REF_CHARACTERISTIC PMM_tiSmplT_SY /end REF_CHARACTERISTIC /end GROUP
/begin GROUP S3633_LvWakeUp_Mode_Calc "VBU0513/VBUSystem/VCU /PMM/PMM_Ctrl/LvWakeUp_Ctrl/LvWakeUp_Mode_Calc" /begin REF_CHARACTERISTIC PMM_tiSmplT_SY /end REF_CHARACTERISTIC /end GROUP
/begin GROUP S3634_ActiveDisChFault "VBU0513/VBUSystem/VCU /PMM/PMM_Ctrl/PMM_DIAG/ActiveDisChFault" /begin REF_CHARACTERISTIC PMM_tiSmplT_SY /end REF_CHARACTERISTIC /end GROUP
/begin GROUP S3634_PreChargeCheck "VBU0513/VBUSystem/VCU /PMM/PMM_Ctrl/PMM_DIAG/PreChargeCheck" /begin REF_CHARACTERISTIC PMM_stHVRlyConnReq_SY PMM_tiSmplT_SY /end REF_CHARACTERISTIC /end GROUP
/begin GROUP S3634_UnintendAction "VBU0513/VBUSystem/VCU /PMM/PMM_Ctrl/PMM_DIAG/UnintendAction" /begin REF_CHARACTERISTIC PMM_stHVRlyClose_SY PMM_tiSmplT_SY /end REF_CHARACTERISTIC /end GROUP
/begin GROUP S3635_AcTvDisCh "VBU0513/VBUSystem/VCU /PMM/PMM_Ctrl/PwrMod_Ctrl/AcTvDisCh" /begin REF_CHARACTERISTIC PMM_stActvDisCh_SY /end REF_CHARACTERISTIC /end GROUP
/begin GROUP S3635_SelfRoutine "VBU0513/VBUSystem/VCU /PMM/PMM_Ctrl/PwrMod_Ctrl/SelfRoutine" /begin REF_CHARACTERISTIC PMM_stInitMode_SY PMM_stShutDown_SY PMM_tiSmplT_SY /end REF_CHARACTERISTIC /end GROUP
/begin GROUP S36_Correct_BatteryCurrent "VBU0513/VBUSystem/BMS/BCV/BCV/Subsystem/Calculate_BatteryCurrent/Correct_BatteryCurrent"
 /begin REF_CHARACTERISTIC CTS_STATE_CLOSE_MNC_PRECHARGING_MONITORING CTS_STATE_CLOSE_MPC CTS_STATE_NORMAL_OPERATING CTS_STATE_OPEN_MPR_AND_DIAGNOSE_MPC_STUCKOPEN /end REF_CHARACTERISTIC
/end GROUP
/begin GROUP S51_Diagnose_BDM_FastChargeContactorOverCurrentAlarm "VBU0513/VBUSystem/BMS/BCV/BCV/Subsystem/Monitor_BCV_Performance/Diagnose_BDM_FastChargeContactorOverCurrentAlarm" /begin REF_CHARACTERISTIC CcBCV_BDMOutputDelayTime_ms /end REF_CHARACTERISTIC /end GROUP
/begin GROUP S361_Cmd_Close "VBU0513/VBUSystem/BMS/CTC/Subsystem1/Subsystem/DetermineRelayCommandStatus/Cmd_Close" /begin REF_CHARACTERISTIC CTS_MAIN_CONTACTOR_COMMAND_CLOSE /end REF_CHARACTERISTIC /end GROUP
/begin GROUP S361_Cmd_Open "VBU0513/VBUSystem/BMS/CTC/Subsystem1/Subsystem/DetermineRelayCommandStatus/Cmd_Open" /begin REF_CHARACTERISTIC CTS_MAIN_CONTACTOR_COMMAND_OPEN /end REF_CHARACTERISTIC /end GROUP
/begin GROUP S377_Determine_Fail_Lockout "VBU0513/VBUSystem/BMS/CTD/Subsystem/Subsystem4/Lockout_Precharge_Process/Determine_Fail_Lockout" /begin REF_CHARACTERISTIC CTD_PRECHARGE_STATUS_FAIL /end REF_CHARACTERISTIC /end GROUP
/begin GROUP S378_Determine_Diagnostic_Status "VBU0513/VBUSystem/BMS/CTD/Subsystem/Subsystem4/MainFuseDiagnostic/Determine_Diagnostic_Status" /begin REF_CHARACTERISTIC DIAGNOSTIC_COMPLETE DIAGNOSTIC_CONDITION_NOT_MET /end REF_CHARACTERISTIC /end GROUP
/begin GROUP S379_Determine_Diagnostic_Status "VBU0513/VBUSystem/BMS/CTD/Subsystem/Subsystem4/Precharge_Resistance_Diagnostic/Determine_Diagnostic_Status" /begin REF_CHARACTERISTIC DIAGNOSTIC_COMPLETE DIAGNOSTIC_CONDITION_NOT_MET /end REF_CHARACTERISTIC /end GROUP
/begin GROUP S380_Precharge_Timeout_Diagnostic "VBU0513/VBUSystem/BMS/CTD/Subsystem/Subsystem4/PrechrgProcessMonitoring/Precharge_Timeout_Diagnostic" /begin REF_CHARACTERISTIC CTD_PRECHARGE_STATUS_FAIL /end REF_CHARACTERISTIC /end GROUP
/begin GROUP S550_CellThermalRunaway_FaultArrayCheck "VBU0513/VBUSystem/BMS/CTM/CTM/Subsystem/Determine_Thermal_Runaway/CellThermalRunaway_FaultArrayCheck" /begin REF_CHARACTERISTIC SAMPLE_TIME_TASK_D /end REF_CHARACTERISTIC /end GROUP
/begin GROUP S550_DetermineCellTempOver "VBU0513/VBUSystem/BMS/CTM/CTM/Subsystem/Determine_Thermal_Runaway/DetermineCellTempOver" /begin REF_CHARACTERISTIC SAMPLE_TIME_TASK_D /end REF_CHARACTERISTIC /end GROUP
/begin GROUP S550_TriggerCycle "VBU0513/VBUSystem/BMS/CTM/CTM/Subsystem/Determine_Thermal_Runaway/TriggerCycle" /begin REF_CHARACTERISTIC SAMPLE_TIME_TASK_D /end REF_CHARACTERISTIC /end GROUP
/begin GROUP S622_Close_Comamnd "VBU0513/VBUSystem/BMS/CTS/CTS/Subsystem/Determine_Contactor_Request/Close_Comamnd" /begin REF_CHARACTERISTIC CTS_MAIN_CONTACTOR_COMMAND_CLOSE /end REF_CHARACTERISTIC /end GROUP
/begin GROUP S622_Cmd_Close "VBU0513/VBUSystem/BMS/CTS/CTS/Subsystem/Determine_Contactor_Request/Cmd_Close" /begin REF_CHARACTERISTIC CTS_MAIN_CONTACTOR_COMMAND_CLOSE /end REF_CHARACTERISTIC /end GROUP
/begin GROUP S622_Cmd_Open "VBU0513/VBUSystem/BMS/CTS/CTS/Subsystem/Determine_Contactor_Request/Cmd_Open" /begin REF_CHARACTERISTIC CTS_MAIN_CONTACTOR_COMMAND_OPEN /end REF_CHARACTERISTIC /end GROUP
/begin GROUP S622_Open_Comamnd "VBU0513/VBUSystem/BMS/CTS/CTS/Subsystem/Determine_Contactor_Request/Open_Comamnd" /begin REF_CHARACTERISTIC CTS_MAIN_CONTACTOR_COMMAND_OPEN /end REF_CHARACTERISTIC /end GROUP
/begin GROUP S654_Determine_CSCCellVoltage_DeviationDynamicBDM "VBU0513/VBUSystem/BMS/CVT/CVT/Subsystem/Monitor_CVT_DeviationDynamic/Determine_CSCCellVoltage_DeviationDynamicBDM" /begin REF_CHARACTERISTIC SAMPLE_TIME_TASK_D /end REF_CHARACTERISTIC /end GROUP
/begin GROUP S655_Determine_CellVoltage_OverDeviationBDM "VBU0513/VBUSystem/BMS/CVT/CVT/Subsystem/Monitor_CVT_Performance/Determine_CellVoltage_OverDeviationBDM" /begin REF_CHARACTERISTIC SAMPLE_TIME_TASK_D /end REF_CHARACTERISTIC /end GROUP
/begin GROUP S655_Determine_CellVoltage_OverUnderBDM "VBU0513/VBUSystem/BMS/CVT/CVT/Subsystem/Monitor_CVT_Performance/Determine_CellVoltage_OverUnderBDM" /begin REF_CHARACTERISTIC SAMPLE_TIME_TASK_D /end REF_CHARACTERISTIC /end GROUP
/begin GROUP S742_EightyPercentCustomSOC_EnableInvalidChargeTimeFlag "VBU0513/VBUSystem/BMS/FCC /FCC/Subsystem/Calculate_Fastcharge_Time/EightyPercentCustomSOC_EnableInvalidChargeTimeFlag" /begin REF_CHARACTERISTIC CcFCC_EightyCustomSOC_pct SAMPLE_TIME_TASK_D /end REF_CHARACTERISTIC /end GROUP
/begin GROUP S742_EightyPercentCustomSOC_UpdateChargeTimeFlag "VBU0513/VBUSystem/BMS/FCC /FCC/Subsystem/Calculate_Fastcharge_Time/EightyPercentCustomSOC_UpdateChargeTimeFlag" /begin REF_CHARACTERISTIC CcFCC_EightyCustomSOC_pct SAMPLE_TIME_TASK_D /end REF_CHARACTERISTIC /end GROUP
/begin GROUP S742_SendInvalidTime_flg "VBU0513/VBUSystem/BMS/FCC /FCC/Subsystem/Calculate_Fastcharge_Time/SendInvalidTime_flg" /begin REF_CHARACTERISTIC SAMPLE_TIME_TASK_D /end REF_CHARACTERISTIC /end GROUP
/begin GROUP S742_UpdateTimeTrigger "VBU0513/VBUSystem/BMS/FCC /FCC/Subsystem/Calculate_Fastcharge_Time/UpdateTimeTrigger" /begin REF_CHARACTERISTIC SAMPLE_TIME_TASK_D /end REF_CHARACTERISTIC /end GROUP
/begin GROUP S743_Charge_Request_Protection "VBU0513/VBUSystem/BMS/FCC /FCC/Subsystem/Determine_Fastcharge_Request/Charge_Request_Protection" /begin REF_CHARACTERISTIC SAMPLE_TIME_TASK_D /end REF_CHARACTERISTIC /end GROUP
/begin GROUP S743_Determine_Base_ChargeRequest "VBU0513/VBUSystem/BMS/FCC /FCC/Subsystem/Determine_Fastcharge_Request/Determine_Base_ChargeRequest" /begin REF_CHARACTERISTIC FCC_STATE_CHARGING /end REF_CHARACTERISTIC /end GROUP
/begin GROUP S961_Determine_AhIntegral_Capacity "VBU0513/VBUSystem/BMS/SOC/Subsystem5/Subsystem/Determine_AhIntegral_SoC/Determine_AhIntegral_Capacity" /begin REF_CHARACTERISTIC SAMPLE_TIME_TASK_D /end REF_CHARACTERISTIC /end GROUP
/begin GROUP S966_Determine_BatterySOC_ChangeRate "VBU0513/VBUSystem/BMS/SOC/Subsystem5/Subsystem/Determine_Display_SOC/Determine_BatterySOC_ChangeRate" /begin REF_CHARACTERISTIC SAMPLE_TIME_TASK_D /end REF_CHARACTERISTIC /end GROUP
/begin GROUP S966_DisplaySOC_Driving_Calculation "VBU0513/VBUSystem/BMS/SOC/Subsystem5/Subsystem/Determine_Display_SOC/DisplaySOC_Driving_Calculation" /begin REF_CHARACTERISTIC SAMPLE_TIME_TASK_D /end REF_CHARACTERISTIC /end GROUP
/begin GROUP S967_Determine_FastChargeCorrectionEnable "VBU0513/VBUSystem/BMS/SOC/Subsystem5/Subsystem/Determine_FastChargeCorrection_Soc/Determine_FastChargeCorrectionEnable" /begin REF_CHARACTERISTIC SAMPLE_TIME_TASK_D /end REF_CHARACTERISTIC /end GROUP
/begin GROUP S967_FastCharge_PreCorrection "VBU0513/VBUSystem/BMS/SOC/Subsystem5/Subsystem/Determine_FastChargeCorrection_Soc/FastCharge_PreCorrection" /begin REF_CHARACTERISTIC SAMPLE_TIME_TASK_D /end REF_CHARACTERISTIC /end GROUP
/begin GROUP S967_FastCharge_TopofChargeCorrection "VBU0513/VBUSystem/BMS/SOC/Subsystem5/Subsystem/Determine_FastChargeCorrection_Soc/FastCharge_TopofChargeCorrection" /begin REF_CHARACTERISTIC SAMPLE_TIME_TASK_D /end REF_CHARACTERISTIC /end GROUP
/begin GROUP S971_Current_Limit_Condition "VBU0513/VBUSystem/BMS/SOC/Subsystem5/Subsystem/Determine_ShortTimeCorrection_Condition/Current_Limit_Condition" /begin REF_CHARACTERISTIC SAMPLE_TIME_TASK_D /end REF_CHARACTERISTIC /end GROUP
/begin GROUP S974_Data_Storage "VBU0513/VBUSystem/BMS/SOC/Subsystem5/Subsystem/Soc_Data_Storage/Data_Storage" /begin REF_CHARACTERISTIC SAMPLE_TIME_TASK_D /end REF_CHARACTERISTIC /end GROUP
/begin GROUP S1137_Determine_History_Current_Data "VBU0513/VBUSystem/BMS/SOE/Subsystem2/Subsystem/Calculate_History_Average_Current/Determine_History_Current_Data" /begin REF_CHARACTERISTIC SAMPLE_TIME_TASK_D /end REF_CHARACTERISTIC /end GROUP
/begin GROUP S1137_Time_Counter "VBU0513/VBUSystem/BMS/SOE/Subsystem2/Subsystem/Calculate_History_Average_Current/Time_Counter" /begin REF_CHARACTERISTIC SAMPLE_TIME_TASK_D /end REF_CHARACTERISTIC /end GROUP
/begin GROUP S1190_Calculate_Pack_OCV "VBU0513/VBUSystem/BMS/SOF/Subsystem6/Subsystem/Calculate_PowerLimit/Calculate_Pack_OCV" /begin REF_CHARACTERISTIC SAMPLE_TIME_TASK_D /end REF_CHARACTERISTIC /end GROUP
/begin GROUP S1420_Monitor_SOH_Performance "VBU0513/VBUSystem/BMS/SOH/Subsystem4/Subsystem1/SOH_Diagnositic/Monitor_SOH_Performance" /begin REF_CHARACTERISTIC SAMPLE_TIME_TASK_D /end REF_CHARACTERISTIC /end GROUP
/begin GROUP S1634_OBC_ChargeState_Mapping "VBU0513/VBUSystem/BMS/VCT/Subsystem/Subsystem/Determine_BMS_VCU_AD/OBC_ChargeState_Mapping"
 /begin REF_CHARACTERISTIC FCC_STATE_CHARGE_FAULT FCC_STATE_CHARGE_FULL FCC_STATE_CHARGING /end REF_CHARACTERISTIC
/end GROUP
/begin GROUP S3365_ChargeConditon "VBU0513/VBUSystem/VCU /DSPL /DSPL/DriveRange/RemainingRange/ChargeConditon" /begin REF_CHARACTERISTIC DSPL_tiSample_SY /end REF_CHARACTERISTIC /end GROUP
/begin GROUP S3365_DriveTemp "VBU0513/VBUSystem/VCU /DSPL /DSPL/DriveRange/RemainingRange/DriveTemp" /begin REF_CHARACTERISTIC DSPL_tiSample_SY /end REF_CHARACTERISTIC /end GROUP
/begin GROUP S3647_Wakeup "VBU0513/VBUSystem/VCU /PMM/PMM_Ctrl/LvWakeUp_Ctrl/LvWakeUp_State_Calc/Wakeup" /begin REF_CHARACTERISTIC PMM_tiSmplT_SY /end REF_CHARACTERISTIC /end GROUP
/begin GROUP S3696_CtrlSht "VBU0513/VBUSystem/VCU /PMM/PMM_Ctrl/PwrMod_Ctrl/PwrMod_PowerUp/CtrlSht" /begin REF_CHARACTERISTIC PMM_stInitMode_SY PMM_stShutDown_SY /end REF_CHARACTERISTIC /end GROUP
/begin GROUP S3696_EmgcySht "VBU0513/VBUSystem/VCU /PMM/PMM_Ctrl/PwrMod_Ctrl/PwrMod_PowerUp/EmgcySht" /begin REF_CHARACTERISTIC PMM_stInitMode_SY PMM_stShutDown_SY /end REF_CHARACTERISTIC /end GROUP
/begin GROUP S3696_HVClReqSrc "VBU0513/VBUSystem/VCU /PMM/PMM_Ctrl/PwrMod_Ctrl/PwrMod_PowerUp/HVClReqSrc" /begin REF_CHARACTERISTIC PMM_tiSmplT_SY /end REF_CHARACTERISTIC /end GROUP
/begin GROUP S3696_VehStsJudgement "VBU0513/VBUSystem/VCU /PMM/PMM_Ctrl/PwrMod_Ctrl/PwrMod_PowerUp/VehStsJudgement" /begin REF_CHARACTERISTIC PMM_stHVCntctStClosed_SY /end REF_CHARACTERISTIC /end GROUP
/begin GROUP S3696_stateflowcondition "VBU0513/VBUSystem/VCU /PMM/PMM_Ctrl/PwrMod_Ctrl/PwrMod_PowerUp/stateflowcondition" /begin REF_CHARACTERISTIC PMM_tiSmplT_SY /end REF_CHARACTERISTIC /end GROUP
/begin GROUP S3698_PwrUpRoutine "VBU0513/VBUSystem/VCU /PMM/PMM_Ctrl/PwrMod_Ctrl/Routine/PwrUpRoutine" /begin REF_CHARACTERISTIC PMM_stHVRlyConn_SY PMM_tiSmplT_SY /end REF_CHARACTERISTIC /end GROUP
/begin GROUP S3698_Routine_PwrDwn "VBU0513/VBUSystem/VCU /PMM/PMM_Ctrl/PwrMod_Ctrl/Routine/Routine_PwrDwn" /begin REF_CHARACTERISTIC PMM_stInitMode_SY PMM_stShutDown_SY /end REF_CHARACTERISTIC /end GROUP
/begin GROUP S3698_Rouutine_RActiveDis "VBU0513/VBUSystem/VCU /PMM/PMM_Ctrl/PwrMod_Ctrl/Routine/Rouutine_RActiveDis" /begin REF_CHARACTERISTIC PMM_stHVRlyConnReq_SY PMM_stInitMode_SY PMM_stShutDown_SY /end REF_CHARACTERISTIC /end GROUP
/begin GROUP S3752_Normal_VehSpdCal "VBU0513/VBUSystem/VCU /SPD/SPD/SignalProcessing_10ms/VehSpdNorm/Normal_VehSpdCal" /begin REF_CHARACTERISTIC SYS_facGearRatioF_SY /end REF_CHARACTERISTIC /end GROUP
/begin GROUP S3752_nMotr2vVeh "VBU0513/VBUSystem/VCU /SPD/SPD/SignalProcessing_10ms/VehSpdNorm/nMotr2vVeh" /begin REF_CHARACTERISTIC SYS_facGearRatioF_SY /end REF_CHARACTERISTIC /end GROUP
/begin GROUP S4096_Veh_DCPortTempPlausibility "VBU0513/VBUSystem/VCU /VehINP/VehINP_Logic/DCPortTemp/Charge_Port_Temp/Veh_DCPortTempPlausibility" /begin REF_CHARACTERISTIC Veh_tiSampleTime_C /end REF_CHARACTERISTIC /end GROUP
/begin GROUP S54_Calculate_BatteryCurrent_ZeroDrift "VBU0513/VBUSystem/BMS/BCV/BCV/Subsystem/Calculate_BatteryCurrent/Correct_BatteryCurrent/Calculate_BatteryCurrent_ZeroDrift"
 /begin REF_CHARACTERISTIC CTS_STATE_CLOSE_MNC_PRECHARGING_MONITORING CTS_STATE_CLOSE_MPC CTS_STATE_NORMAL_OPERATING CTS_STATE_OPEN_MPR_AND_DIAGNOSE_MPC_STUCKOPEN /end REF_CHARACTERISTIC
/end GROUP
/begin GROUP S107_Equal_FASTCHARGE "VBU0513/VBUSystem/BMS/BCV/BCV/Subsystem/Calculate_Lifetime_Data/Calculate_LifeTimeFastcharge/Equal_FASTCHARGE" /begin REF_CHARACTERISTIC BMM_VEHICLE_WAKEUP_MODE_FAST_CHARGE /end REF_CHARACTERISTIC /end GROUP
/begin GROUP S188_Equal_FASTCHARGE "VBU0513/VBUSystem/BMS/BCV/BCV/Subsystem/Monitor_BCV_Performance/Diagnose_BDM_FastChargeContactorOverCurrentAlarm/Equal_FASTCHARGE" /begin REF_CHARACTERISTIC BMM_VEHICLE_WAKEUP_MODE_FAST_CHARGE /end REF_CHARACTERISTIC /end GROUP
/begin GROUP S387_Determine_Diagnostic_Status "VBU0513/VBUSystem/BMS/CTD/Subsystem/Subsystem4/DiagnoseRelayWeld/MNC_Weld_Check/Determine_Diagnostic_Status" /begin REF_CHARACTERISTIC DIAGNOSTIC_COMPLETE DIAGNOSTIC_CONDITION_NOT_MET /end REF_CHARACTERISTIC /end GROUP
/begin GROUP S388_Determine_Diagnostic_Status "VBU0513/VBUSystem/BMS/CTD/Subsystem/Subsystem4/DiagnoseRelayWeld/MPC_Weld_Check/Determine_Diagnostic_Status" /begin REF_CHARACTERISTIC DIAGNOSTIC_COMPLETE DIAGNOSTIC_CONDITION_NOT_MET /end REF_CHARACTERISTIC /end GROUP
/begin GROUP S428_Determine_LockPoint_AvaliableHeat "VBU0513/VBUSystem/BMS/CTD/Subsystem/Subsystem4/Lockout_Precharge_Process/HeatProtection_Lockout/Determine_LockPoint_AvaliableHeat"
 /begin REF_CHARACTERISTIC CTS_STATE_CLOSE_MC_HSD_DIAGNOSE_LSD_STG CTS_STATE_OPEN_MPR_AND_DIAGNOSE_MPC_STUCKOPEN /end REF_CHARACTERISTIC
/end GROUP
/begin GROUP S456_Status_Fail "VBU0513/VBUSystem/BMS/CTD/Subsystem/Subsystem4/PrechrgProcessMonitoring/Precharging_Process_Monitoring/Status_Fail" /begin REF_CHARACTERISTIC CTD_PRECHARGE_STATUS_FAIL /end REF_CHARACTERISTIC /end GROUP
/begin GROUP S456_Status_Success "VBU0513/VBUSystem/BMS/CTD/Subsystem/Subsystem4/PrechrgProcessMonitoring/Precharging_Process_Monitoring/Status_Success" /begin REF_CHARACTERISTIC CTD_PRECHARGE_STATUS_SUCCESS /end REF_CHARACTERISTIC /end GROUP
/begin GROUP S478_Determine_Diagnostic_Status "VBU0513/VBUSystem/BMS/CTD/Subsystem/Subsystem4/Stuck_Open_Diagnostic/MPR_Stuck_Open/Determine_Diagnostic_Status" /begin REF_CHARACTERISTIC DIAGNOSTIC_COMPLETE DIAGNOSTIC_CONDITION_NOT_MET /end REF_CHARACTERISTIC /end GROUP
/begin GROUP S631_Combine_Precharge_Conditions "VBU0513/VBUSystem/BMS/CTS/CTS/Subsystem/DeterminePrechargeConditions/Precharge_Inhibit_Abort/Combine_Precharge_Conditions" /begin REF_CHARACTERISTIC CTD_PRECHARGE_STATUS_FAIL /end REF_CHARACTERISTIC /end GROUP
/begin GROUP S798_Decrease_ChargeCurrentRequest "VBU0513/VBUSystem/BMS/FCC /FCC/Subsystem/Determine_Fastcharge_Request/Charge_Request_Protection/Decrease_ChargeCurrentRequest"
 /begin REF_CHARACTERISTIC CcFCC_ChargeCurrentOver_A FCC_STATE_CHARGING SAMPLE_TIME_TASK_D /end REF_CHARACTERISTIC
/end GROUP
/begin GROUP S799_Determine_ComputeResistanceCondition "VBU0513/VBUSystem/BMS/FCC /FCC/Subsystem/Determine_Fastcharge_Request/DetermineComputeResistancePulseCurrent/Determine_ComputeResistanceCondition" /begin REF_CHARACTERISTIC FCC_STATE_CHARGING SAMPLE_TIME_TASK_D /end REF_CHARACTERISTIC /end GROUP
/begin GROUP S832_Cell_Temp_Protection "VBU0513/VBUSystem/BMS/FCC /FCC/Subsystem/Fastcharge_Conditions_Check/Condition_Categorize/Cell_Temp_Protection" /begin REF_CHARACTERISTIC SAMPLE_TIME_TASK_D /end REF_CHARACTERISTIC /end GROUP
/begin GROUP S832_Voltage_Protection "VBU0513/VBUSystem/BMS/FCC /FCC/Subsystem/Fastcharge_Conditions_Check/Condition_Categorize/Voltage_Protection" /begin REF_CHARACTERISTIC SAMPLE_TIME_TASK_D /end REF_CHARACTERISTIC /end GROUP
/begin GROUP S986_Determine_Cell_Balanced_Capacity "VBU0513/VBUSystem/BMS/SOC/Subsystem5/Subsystem/Determine_AhIntegral_SoC/Determine_AhIntegral_Capacity/Determine_Cell_Balanced_Capacity" /begin REF_CHARACTERISTIC SAMPLE_TIME_TASK_D /end REF_CHARACTERISTIC /end GROUP
/begin GROUP S1046_Calculate_WindowAverage_BatteryCurrent "VBU0513/VBUSystem/BMS/SOC/Subsystem5/Subsystem/Determine_FastChargeCorrection_Soc/FastCharge_PreCorrection/Calculate_WindowAverage_BatteryCurrent" /begin REF_CHARACTERISTIC SAMPLE_TIME_TASK_D /end REF_CHARACTERISTIC /end GROUP
/begin GROUP S1046_FastCharge_PreCorrectionMain "VBU0513/VBUSystem/BMS/SOC/Subsystem5/Subsystem/Determine_FastChargeCorrection_Soc/FastCharge_PreCorrection/FastCharge_PreCorrectionMain" /begin REF_CHARACTERISTIC SAMPLE_TIME_TASK_D /end REF_CHARACTERISTIC /end GROUP
/begin GROUP S1047_Calculate_WindowAverage_BatteryCurrent "VBU0513/VBUSystem/BMS/SOC/Subsystem5/Subsystem/Determine_FastChargeCorrection_Soc/FastCharge_TopofChargeCorrection/Calculate_WindowAverage_BatteryCurrent" /begin REF_CHARACTERISTIC SAMPLE_TIME_TASK_D /end REF_CHARACTERISTIC /end GROUP
/begin GROUP S1196_Rate_Limiter "VBU0513/VBUSystem/BMS/SOF/Subsystem6/Subsystem/Calculate_PowerLimit/Calculate_Pack_OCV/Rate_Limiter" /begin REF_CHARACTERISTIC SAMPLE_TIME_TASK_D /end REF_CHARACTERISTIC /end GROUP
/begin GROUP S1228_Calculate_CurrentLimit_Base "VBU0513/VBUSystem/BMS/SOF/Subsystem6/Subsystem/Determine_Currentlimit_Target/Calculate_CurrentLimit_Target/Calculate_CurrentLimit_Base" /begin REF_CHARACTERISTIC SAMPLE_TIME_TASK_D /end REF_CHARACTERISTIC /end GROUP
/begin GROUP S1425_Determine_SlowCharge "VBU0513/VBUSystem/BMS/SOH/Subsystem4/Subsystem1/Calculate_Capacity/Determine_CalculateCellCapacity_Condition/Determine_SlowCharge" /begin REF_CHARACTERISTIC SAMPLE_TIME_TASK_D /end REF_CHARACTERISTIC /end GROUP
/begin GROUP S1425_Determine_SlowChargeStart "VBU0513/VBUSystem/BMS/SOH/Subsystem4/Subsystem1/Calculate_Capacity/Determine_CalculateCellCapacity_Condition/Determine_SlowChargeStart" /begin REF_CHARACTERISTIC SAMPLE_TIME_TASK_D /end REF_CHARACTERISTIC /end GROUP
/begin GROUP S3366_DSPL_EnergyComsumptionCal "VBU0513/VBUSystem/VCU /DSPL /DSPL/DriveRange/DSPL_Consumption/DSPL_EnergySelfLearn/DSPL_EnergyComsumptionCal" /begin REF_CHARACTERISTIC DSPL_tiSample_SY /end REF_CHARACTERISTIC /end GROUP
/begin GROUP S3367_Comsumption "VBU0513/VBUSystem/VCU /DSPL /DSPL/DriveRange/DSPL_Consumption/Range10kmConsumption/Comsumption" /begin REF_CHARACTERISTIC DSPL_tiSample_SY /end REF_CHARACTERISTIC /end GROUP
/begin GROUP S3367_DSPLRange10kmCondition "VBU0513/VBUSystem/VCU /DSPL /DSPL/DriveRange/DSPL_Consumption/Range10kmConsumption/DSPLRange10kmCondition" /begin REF_CHARACTERISTIC DSPL_tiSample_SY /end REF_CHARACTERISTIC /end GROUP
/begin GROUP S3368_DSPLRange50kmComsumptionCal "VBU0513/VBUSystem/VCU /DSPL /DSPL/DriveRange/DSPL_Consumption/Range50kmConsumption/DSPLRange50kmComsumptionCal" /begin REF_CHARACTERISTIC DSPL_tiSample_SY /end REF_CHARACTERISTIC /end GROUP
/begin GROUP S3368_DSPLRange50kmCondition "VBU0513/VBUSystem/VCU /DSPL /DSPL/DriveRange/DSPL_Consumption/Range50kmConsumption/DSPLRange50kmCondition" /begin REF_CHARACTERISTIC DSPL_tiSample_SY /end REF_CHARACTERISTIC /end GROUP
/begin GROUP S3419_SOCDeclineFactorCalculation "VBU0513/VBUSystem/VCU /DSPL /DSPL/DriveRange/RemainingRange/FullRangeAndSocDeclineFactor/SOCDeclineFactorCalculation" /begin REF_CHARACTERISTIC DSPL_tiSample_SY /end REF_CHARACTERISTIC /end GROUP
/begin GROUP S3421_Charge "VBU0513/VBUSystem/VCU /DSPL /DSPL/DriveRange/RemainingRange/SelectDisplayRange/Charge" /begin REF_CHARACTERISTIC DSPL_tiSample_SY /end REF_CHARACTERISTIC /end GROUP
/begin GROUP S3421_Drive "VBU0513/VBUSystem/VCU /DSPL /DSPL/DriveRange/RemainingRange/SelectDisplayRange/Drive" /begin REF_CHARACTERISTIC DSPL_tiSample_SY /end REF_CHARACTERISTIC /end GROUP
/begin GROUP S3421_storeRange "VBU0513/VBUSystem/VCU /DSPL /DSPL/DriveRange/RemainingRange/SelectDisplayRange/storeRange" /begin REF_CHARACTERISTIC DSPL_tiSample_SY /end REF_CHARACTERISTIC /end GROUP
/begin GROUP S3650_StopNM "VBU0513/VBUSystem/VCU /PMM/PMM_Ctrl/LvWakeUp_Ctrl/LvWakeUp_State_Calc/LVWSrc/StopNM" /begin REF_CHARACTERISTIC PMM_stInitMode_SY PMM_stShutDown_SY PMM_tiSmplT_SY /end REF_CHARACTERISTIC /end GROUP
/begin GROUP S3650_VCUActSrc "VBU0513/VBUSystem/VCU /PMM/PMM_Ctrl/LvWakeUp_Ctrl/LvWakeUp_State_Calc/LVWSrc/VCUActSrc" /begin REF_CHARACTERISTIC PMM_stInitMode_SY PMM_stShutDown_SY PMM_tiSmplT_SY /end REF_CHARACTERISTIC /end GROUP
/begin GROUP S3650_VCUWakeUp "VBU0513/VBUSystem/VCU /PMM/PMM_Ctrl/LvWakeUp_Ctrl/LvWakeUp_State_Calc/LVWSrc/VCUWakeUp" /begin REF_CHARACTERISTIC PMM_tiSmplT_SY /end REF_CHARACTERISTIC /end GROUP
/begin GROUP S4114_Gear4Reset "VBU0513/VBUSystem/VCU /VehINP/VehINP_Logic/GearShift/Gear1/Gear_Status/Gear4Reset" /begin REF_CHARACTERISTIC Gear_stCurrentGearN_C Gear_stCurrentGearP_C /end REF_CHARACTERISTIC /end GROUP
/begin GROUP S4114_Gear_CurrentValid "VBU0513/VBUSystem/VCU /VehINP/VehINP_Logic/GearShift/Gear1/Gear_Status/Gear_CurrentValid" /begin REF_CHARACTERISTIC Gear_stCurrentGearN_C Gear_stCurrentGearP_C /end REF_CHARACTERISTIC /end GROUP
/begin GROUP S4114_Gear_DefaultGear "VBU0513/VBUSystem/VCU /VehINP/VehINP_Logic/GearShift/Gear1/Gear_Status/Gear_DefaultGear" /begin REF_CHARACTERISTIC Gear_stCurrentGearN_C Gear_stCurrentGearP_C /end REF_CHARACTERISTIC /end GROUP
/begin GROUP S4114_Gear_DriverShiftDReq "VBU0513/VBUSystem/VCU /VehINP/VehINP_Logic/GearShift/Gear1/Gear_Status/Gear_DriverShiftDReq" /begin REF_CHARACTERISTIC Gear_stCurrentGearN_C Gear_stCurrentGearP_C /end REF_CHARACTERISTIC /end GROUP
/begin GROUP S4114_Gear_DriverShiftRReq "VBU0513/VBUSystem/VCU /VehINP/VehINP_Logic/GearShift/Gear1/Gear_Status/Gear_DriverShiftRReq" /begin REF_CHARACTERISTIC Gear_stCurrentGearN_C Gear_stCurrentGearP_C /end REF_CHARACTERISTIC /end GROUP
/begin GROUP S4114_Gear_InitGear "VBU0513/VBUSystem/VCU /VehINP/VehINP_Logic/GearShift/Gear1/Gear_Status/Gear_InitGear" /begin REF_CHARACTERISTIC Gear_stCurrentGearN_C Gear_stCurrentGearP_C /end REF_CHARACTERISTIC /end GROUP
/begin GROUP S4114_Gear_PGear "VBU0513/VBUSystem/VCU /VehINP/VehINP_Logic/GearShift/Gear1/Gear_Status/Gear_PGear" /begin REF_CHARACTERISTIC Gear_stCurrentGearN_C Gear_stCurrentGearP_C /end REF_CHARACTERISTIC /end GROUP
/begin GROUP S4114_Gear_PGear1 "VBU0513/VBUSystem/VCU /VehINP/VehINP_Logic/GearShift/Gear1/Gear_Status/Gear_PGear1" /begin REF_CHARACTERISTIC Gear_stCurrentGearN_C Gear_stCurrentGearP_C /end REF_CHARACTERISTIC /end GROUP
/begin GROUP S4286_Veh_HVILCheck "VBU0513/VBUSystem/VCU /VehINP/VehINP_Logic/Veh_Status/VehHVIL/HVIL/Veh_HVILCheck" /begin REF_CHARACTERISTIC Veh_tiSampleTime_C /end REF_CHARACTERISTIC /end GROUP
/begin GROUP S4286_Veh_VCUHVIL "VBU0513/VBUSystem/VCU /VehINP/VehINP_Logic/Veh_Status/VehHVIL/HVIL/Veh_VCUHVIL" /begin REF_CHARACTERISTIC Veh_tiSampleTime_C /end REF_CHARACTERISTIC /end GROUP
/begin GROUP S324_Determine_VoltageBalanceReq "VBU0513/VBUSystem/BMS/CBL/Subsystem8/Subsystem/Determine_CSCCellBalanceRequest/Determine_CellBalanceRequest/Cell0/Determine_VoltageBalanceReq" /begin REF_CHARACTERISTIC FCC_STATE_CHARGING /end REF_CHARACTERISTIC /end GROUP
/begin GROUP S480_Determine_Diagnostic_Status "VBU0513/VBUSystem/BMS/CTD/Subsystem/Subsystem4/Stuck_Open_Diagnostic/MNC_Stuck_Open/MNC_Stuck_Open_With_VehicleSpeed/Determine_Diagnostic_Status" /begin REF_CHARACTERISTIC DIAGNOSTIC_COMPLETE DIAGNOSTIC_CONDITION_NOT_MET /end REF_CHARACTERISTIC /end GROUP
/begin GROUP S504_Determine_Diagnostic_Status "VBU0513/VBUSystem/BMS/CTD/Subsystem/Subsystem4/Stuck_Open_Diagnostic/MPC_Stuck_Open/MPC_Stuck_Open_Without_VehicleSpeed/Determine_Diagnostic_Status" /begin REF_CHARACTERISTIC DIAGNOSTIC_COMPLETE DIAGNOSTIC_CONDITION_NOT_MET /end REF_CHARACTERISTIC /end GROUP
/begin GROUP S841_FullCharge_criteria1 "VBU0513/VBUSystem/BMS/FCC /FCC/Subsystem/Fastcharge_Conditions_Check/Condition_Categorize/Full_Charge_Determination/FullCharge_criteria1" /begin REF_CHARACTERISTIC SAMPLE_TIME_TASK_D /end REF_CHARACTERISTIC /end GROUP
/begin GROUP S841_FullCharge_criteria2 "VBU0513/VBUSystem/BMS/FCC /FCC/Subsystem/Fastcharge_Conditions_Check/Condition_Categorize/Full_Charge_Determination/FullCharge_criteria2" /begin REF_CHARACTERISTIC SAMPLE_TIME_TASK_D /end REF_CHARACTERISTIC /end GROUP
/begin GROUP S841_FullCharge_criteria4 "VBU0513/VBUSystem/BMS/FCC /FCC/Subsystem/Fastcharge_Conditions_Check/Condition_Categorize/Full_Charge_Determination/FullCharge_criteria4" /begin REF_CHARACTERISTIC SAMPLE_TIME_TASK_D /end REF_CHARACTERISTIC /end GROUP
/begin GROUP S1055_Calculate_WindowAverage_BatteryCurrent "VBU0513/VBUSystem/BMS/SOC/Subsystem5/Subsystem/Determine_FastChargeCorrection_Soc/FastCharge_DynamicCorrection/FastCharge_DynamicCorrection_Enable/Calculate_WindowAverage_BatteryCurrent" /begin REF_CHARACTERISTIC SAMPLE_TIME_TASK_D /end REF_CHARACTERISTIC /end GROUP
/begin GROUP S1055_Determine_CurrentStable_Condition "VBU0513/VBUSystem/BMS/SOC/Subsystem5/Subsystem/Determine_FastChargeCorrection_Soc/FastCharge_DynamicCorrection/FastCharge_DynamicCorrection_Enable/Determine_CurrentStable_Condition" /begin REF_CHARACTERISTIC SAMPLE_TIME_TASK_D /end REF_CHARACTERISTIC /end GROUP
/begin GROUP S1215_Determine_SOCP_Condition "VBU0513/VBUSystem/BMS/SOF/Subsystem6/Subsystem/Calculate_PowerLimit/Determine_SOCP_PowerLimit/Determine_ContinuousDischargePowerLimitTarget/Determine_SOCP_Condition" /begin REF_CHARACTERISTIC SAMPLE_TIME_TASK_D /end REF_CHARACTERISTIC /end GROUP
/begin GROUP S1216_Determine_SOCP_Condition "VBU0513/VBUSystem/BMS/SOF/Subsystem6/Subsystem/Calculate_PowerLimit/Determine_SOCP_PowerLimit/Determine_DischargePowerLimitTarget/Determine_SOCP_Condition" /begin REF_CHARACTERISTIC SAMPLE_TIME_TASK_D /end REF_CHARACTERISTIC /end GROUP
/begin GROUP S1230_Determine_LowVoltageLimitChargeCurrent "VBU0513/VBUSystem/BMS/SOF/Subsystem6/Subsystem/Determine_Currentlimit_Target/Calculate_CurrentLimit_Target/Calculate_CurrentLimit_Base/Determine_LowVoltageLimitChargeCurrent" /begin REF_CHARACTERISTIC SAMPLE_TIME_TASK_D /end REF_CHARACTERISTIC /end GROUP
/begin GROUP S1232_FastChrgOneThirdRateCurrentLimitCheck "VBU0513/VBUSystem/BMS/SOF/Subsystem6/Subsystem/Determine_Currentlimit_Target/Calculate_CurrentLimit_Target/CurrentLimit_FastCharge_Check/FastChrgOneThirdRateCurrentLimitCheck" /begin REF_CHARACTERISTIC SAMPLE_TIME_TASK_D /end REF_CHARACTERISTIC /end GROUP
/begin GROUP S1233_Determine_StopCharge_Condition "VBU0513/VBUSystem/BMS/SOF/Subsystem6/Subsystem/Determine_Currentlimit_Target/Calculate_CurrentLimit_Target/CurrentLimit_Fault_Correct/Determine_StopCharge_Condition" /begin REF_CHARACTERISTIC SAMPLE_TIME_TASK_D /end REF_CHARACTERISTIC /end GROUP
/begin GROUP S1461_Determine_AhIntegral_Q "VBU0513/VBUSystem/BMS/SOH/Subsystem4/Subsystem1/Calculate_Capacity/Calculate_CellCapacity_SlowCharge/Determine_AhIntegral_DeltaQ/Determine_AhIntegral_Q" /begin REF_CHARACTERISTIC SAMPLE_TIME_TASK_D /end REF_CHARACTERISTIC /end GROUP
/begin GROUP S1500_DuringStep_AfterStep_Check "VBU0513/VBUSystem/BMS/SOH/Subsystem4/Subsystem1/Calculate_Resistance/BasicCellResistance_Calculation_Check/BeforStep_DuringStep_AfterStep_Check/DuringStep_AfterStep_Check" /begin REF_CHARACTERISTIC SAMPLE_TIME_TASK_D /end REF_CHARACTERISTIC /end GROUP
/begin GROUP S1516_Determine_FCCPulseCurrent_Condition "VBU0513/VBUSystem/BMS/SOH/Subsystem4/Subsystem1/Calculate_Resistance/Determine_Condition_Calculate_Pulse_Average_CurrentVoltage/Determine_Condition/Determine_FCCPulseCurrent_Condition" /begin REF_CHARACTERISTIC SAMPLE_TIME_TASK_D /end REF_CHARACTERISTIC /end GROUP
/begin GROUP S1516_Determine_OBCPulseCurrent_Condition "VBU0513/VBUSystem/BMS/SOH/Subsystem4/Subsystem1/Calculate_Resistance/Determine_Condition_Calculate_Pulse_Average_CurrentVoltage/Determine_Condition/Determine_OBCPulseCurrent_Condition" /begin REF_CHARACTERISTIC SAMPLE_TIME_TASK_D /end REF_CHARACTERISTIC /end GROUP
/begin GROUP S1281_Calculate_Dynamic_DischargeCurrentLimit "VBU0513/VBUSystem/BMS/SOF/Subsystem6/Subsystem/Determine_Currentlimit_Target/Calculate_CurrentLimit_Target/Calculate_Dynamic_CurrentLimit/Calculate_Dynamic_DischargeCurrentLimit/Calculate_Dynamic_DischargeCurrentLimit" /begin REF_CHARACTERISTIC SAMPLE_TIME_TASK_D /end REF_CHARACTERISTIC /end GROUP
/begin GROUP S1337_Calculate_CurrentLimit "VBU0513/VBUSystem/BMS/SOF/Subsystem6/Subsystem/Determine_Currentlimit_Target/Calculate_CurrentLimit_Target/CurrentLimit_Voltage_Correct/Correct_CurrentLimit/Calculate_CurrentLimit" /begin REF_CHARACTERISTIC SAMPLE_TIME_TASK_D /end REF_CHARACTERISTIC /end GROUP
/begin GROUP S1467_Determine_Cell_Balanced_Capacity "VBU0513/VBUSystem/BMS/SOH/Subsystem4/Subsystem1/Calculate_Capacity/Calculate_CellCapacity_SlowCharge/Determine_AhIntegral_DeltaQ/Determine_AhIntegral_Q/Determine_Cell_Balanced_Capacity" /begin REF_CHARACTERISTIC SAMPLE_TIME_TASK_D /end REF_CHARACTERISTIC /end GROUP
/begin GROUP S1282_Calculate_ChargeCurrentLimitBuffer_Use "VBU0513/VBUSystem/BMS/SOF/Subsystem6/Subsystem/Determine_Currentlimit_Target/Calculate_CurrentLimit_Target/Calculate_Dynamic_CurrentLimit/Calculate_Dynamic_ChargeCurrentLimit/Calculate_ChargeCurrentLimit_Buff/Calculate_ChargeCurrentLimitBuffer_Use" /begin REF_CHARACTERISTIC SAMPLE_TIME_TASK_D /end REF_CHARACTERISTIC /end GROUP
/begin GROUP S1290_Calculate_DischargeCurrentLimitBuffer_Use "VBU0513/VBUSystem/BMS/SOF/Subsystem6/Subsystem/Determine_Currentlimit_Target/Calculate_CurrentLimit_Target/Calculate_Dynamic_CurrentLimit/Calculate_Dynamic_DischargeCurrentLimit/Calculate_DischargeCurrentLimit_Buff/Calculate_DischargeCurrentLimitBuffer_Use" /begin REF_CHARACTERISTIC SAMPLE_TIME_TASK_D /end REF_CHARACTERISTIC /end GROUP
/begin GROUP S1291_Rate_Limiter "VBU0513/VBUSystem/BMS/SOF/Subsystem6/Subsystem/Determine_Currentlimit_Target/Calculate_CurrentLimit_Target/Calculate_Dynamic_CurrentLimit/Calculate_Dynamic_DischargeCurrentLimit/Calculate_Dynamic_DischargeCurrentLimit/Rate_Limiter" /begin REF_CHARACTERISTIC SAMPLE_TIME_TASK_D /end REF_CHARACTERISTIC /end GROUP
/begin GROUP S1339_Rate_Limiter1 "VBU0513/VBUSystem/BMS/SOF/Subsystem6/Subsystem/Determine_Currentlimit_Target/Calculate_CurrentLimit_Target/CurrentLimit_Voltage_Correct/Correct_CurrentLimit/Calculate_CurrentLimit/Rate_Limiter1" /begin REF_CHARACTERISTIC SAMPLE_TIME_TASK_D /end REF_CHARACTERISTIC /end GROUP
/begin GROUP S1340_Set_ChargeVoltageCorrect_level1 "VBU0513/VBUSystem/BMS/SOF/Subsystem6/Subsystem/Determine_Currentlimit_Target/Calculate_CurrentLimit_Target/CurrentLimit_Voltage_Correct/Correct_CurrentLimit/Determine_VoltageCorrect_level/Set_ChargeVoltageCorrect_level1" /begin REF_CHARACTERISTIC SAMPLE_TIME_TASK_D /end REF_CHARACTERISTIC /end GROUP
/begin GROUP S1340_Set_ChargeVoltageCorrect_level2 "VBU0513/VBUSystem/BMS/SOF/Subsystem6/Subsystem/Determine_Currentlimit_Target/Calculate_CurrentLimit_Target/CurrentLimit_Voltage_Correct/Correct_CurrentLimit/Determine_VoltageCorrect_level/Set_ChargeVoltageCorrect_level2" /begin REF_CHARACTERISTIC SAMPLE_TIME_TASK_D /end REF_CHARACTERISTIC /end GROUP
/begin GROUP S1340_Set_ChargeVoltageCorrect_level3 "VBU0513/VBUSystem/BMS/SOF/Subsystem6/Subsystem/Determine_Currentlimit_Target/Calculate_CurrentLimit_Target/CurrentLimit_Voltage_Correct/Correct_CurrentLimit/Determine_VoltageCorrect_level/Set_ChargeVoltageCorrect_level3" /begin REF_CHARACTERISTIC SAMPLE_TIME_TASK_D /end REF_CHARACTERISTIC /end GROUP
/begin GROUP S1340_Set_ChargeVoltageCorrect_level4 "VBU0513/VBUSystem/BMS/SOF/Subsystem6/Subsystem/Determine_Currentlimit_Target/Calculate_CurrentLimit_Target/CurrentLimit_Voltage_Correct/Correct_CurrentLimit/Determine_VoltageCorrect_level/Set_ChargeVoltageCorrect_level4" /begin REF_CHARACTERISTIC SAMPLE_TIME_TASK_D /end REF_CHARACTERISTIC /end GROUP
/begin GROUP S1340_Set_DischargeVoltageCorrect_level1 "VBU0513/VBUSystem/BMS/SOF/Subsystem6/Subsystem/Determine_Currentlimit_Target/Calculate_CurrentLimit_Target/CurrentLimit_Voltage_Correct/Correct_CurrentLimit/Determine_VoltageCorrect_level/Set_DischargeVoltageCorrect_level1" /begin REF_CHARACTERISTIC SAMPLE_TIME_TASK_D /end REF_CHARACTERISTIC /end GROUP
/begin GROUP S1340_Set_DischargeVoltageCorrect_level2 "VBU0513/VBUSystem/BMS/SOF/Subsystem6/Subsystem/Determine_Currentlimit_Target/Calculate_CurrentLimit_Target/CurrentLimit_Voltage_Correct/Correct_CurrentLimit/Determine_VoltageCorrect_level/Set_DischargeVoltageCorrect_level2" /begin REF_CHARACTERISTIC SAMPLE_TIME_TASK_D /end REF_CHARACTERISTIC /end GROUP
/begin GROUP S1340_Set_DischargeVoltageCorrect_level3 "VBU0513/VBUSystem/BMS/SOF/Subsystem6/Subsystem/Determine_Currentlimit_Target/Calculate_CurrentLimit_Target/CurrentLimit_Voltage_Correct/Correct_CurrentLimit/Determine_VoltageCorrect_level/Set_DischargeVoltageCorrect_level3" /begin REF_CHARACTERISTIC SAMPLE_TIME_TASK_D /end REF_CHARACTERISTIC /end GROUP
/begin GROUP S1340_Set_DischargeVoltageCorrect_level4 "VBU0513/VBUSystem/BMS/SOF/Subsystem6/Subsystem/Determine_Currentlimit_Target/Calculate_CurrentLimit_Target/CurrentLimit_Voltage_Correct/Correct_CurrentLimit/Determine_VoltageCorrect_level/Set_DischargeVoltageCorrect_level4" /begin REF_CHARACTERISTIC SAMPLE_TIME_TASK_D /end REF_CHARACTERISTIC /end GROUP
/end MODULE
/end PROJECT
