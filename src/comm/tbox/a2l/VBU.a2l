ASAP2_VERSION 1 31
/begin PROJECT ProjectName "Project Comment Goes Here"
/begin HEADER "Header Comments go here" /end HEADER
/begin MODULE ModuleName "Module Comment Goes Here"
/begin MOD_COMMON "Mod Common Comment Here" BYTE_ORDER MSB_LAST /end MOD_COMMON
/begin RECORD_LAYOUT Scalar_BOOLEAN FNC_VALUES 1 UBYTE COLUMN_DIR DIRECT /end RECORD_LAYOUT
/begin RECORD_LAYOUT Scalar_UBYTE FNC_VALUES 1 UBYTE COLUMN_DIR DIRECT /end RECORD_LAYOUT
/begin RECORD_LAYOUT Scalar_UWORD FNC_VALUES 1 UWORD COLUMN_DIR DIRECT /end RECORD_LAYOUT
/begin RECORD_LAYOUT Scalar_FLOAT32_IEEE FNC_VALUES 1 FLOAT32_IEEE COLUMN_DIR DIRECT /end RECORD_LAYOUT
/begin RECORD_LAYOUT Lookup1D_FLOAT32_IEEE FNC_VALUES 1 FLOAT32_IEEE COLUMN_DIR DIRECT /end RECORD_LAYOUT
/begin RECORD_LAYOUT Lookup1D_X_FLOAT32_IEEE AXIS_PTS_X 1 FLOAT32_IEEE INDEX_INCR DIRECT /end RECORD_LAYOUT
/begin RECORD_LAYOUT Lookup1D_FLOAT64_IEEE FNC_VALUES 1 FLOAT64_IEEE COLUMN_DIR DIRECT /end RECORD_LAYOUT
/begin RECORD_LAYOUT Lookup2D_BOOLEAN FNC_VALUES 1 UBYTE COLUMN_DIR DIRECT /end RECORD_LAYOUT
/begin RECORD_LAYOUT Lookup2D_X_BOOLEAN AXIS_PTS_X 1 UBYTE INDEX_INCR DIRECT /end RECORD_LAYOUT
/begin RECORD_LAYOUT Lookup2D_UBYTE FNC_VALUES 1 UBYTE COLUMN_DIR DIRECT /end RECORD_LAYOUT
/begin RECORD_LAYOUT Lookup2D_X_UBYTE AXIS_PTS_X 1 UBYTE INDEX_INCR DIRECT /end RECORD_LAYOUT
/begin RECORD_LAYOUT Lookup2D_FLOAT32_IEEE FNC_VALUES 1 FLOAT32_IEEE COLUMN_DIR DIRECT /end RECORD_LAYOUT
/begin RECORD_LAYOUT Lookup2D_X_FLOAT32_IEEE AXIS_PTS_X 1 FLOAT32_IEEE INDEX_INCR DIRECT /end RECORD_LAYOUT
/begin CHARACTERISTIC DSPL_numRngCalcAch_CUR_v "" CURVE 0x70011fce Lookup1D_FLOAT32_IEEE 0 VBU0428Test_CM_single_cnt 0.0 1.0E+10
 /begin AXIS_DESCR COM_AXIS NO_INPUT_QUANTITY VBU0428Test_CM_single_A 5 -1000.0 1000.0 AXIS_PTS_REF DSPL_iBattAch_CUR_x /end AXIS_DESCR
/end CHARACTERISTIC
/begin AXIS_PTS DSPL_iBattAch_CUR_x "" 0x70011fa6 NO_INPUT_QUANTITY Lookup1D_X_FLOAT32_IEEE 0 VBU0428Test_CM_single_A 5 -1000.0 1000.0 /end AXIS_PTS
/begin CHARACTERISTIC DSPL_numRngCalcDch_CUR_v "" CURVE 0x70011fe2 Lookup1D_FLOAT32_IEEE 0 VBU0428Test_CM_single_cnt 0.0 1.0E+10
 /begin AXIS_DESCR COM_AXIS NO_INPUT_QUANTITY VBU0428Test_CM_single_A 5 -1000.0 1000.0 AXIS_PTS_REF DSPL_iBattDch_CUR_x /end AXIS_DESCR
/end CHARACTERISTIC
/begin AXIS_PTS DSPL_iBattDch_CUR_x "" 0x70011fba NO_INPUT_QUANTITY Lookup1D_X_FLOAT32_IEEE 0 VBU0428Test_CM_single_A 5 -1000.0 1000.0 /end AXIS_PTS
/begin CHARACTERISTIC EDIS_pwrChrgCurrntOverDelta_CUR_v "" CURVE 0x70011b32 Lookup1D_FLOAT32_IEEE 0 VBU0428Test_CM_single_cnt -3.4028234663852886E+38 3.4028234663852886E+38
 /begin AXIS_DESCR COM_AXIS NO_INPUT_QUANTITY VBU0428Test_CM_single_cnt 2 -3.4028234663852886E+38 3.4028234663852886E+38 AXIS_PTS_REF EDIS_iChrgCurrntOverDelta_CUR_x /end AXIS_DESCR
/end CHARACTERISTIC
/begin AXIS_PTS EDIS_iChrgCurrntOverDelta_CUR_x "" 0x70011b22 NO_INPUT_QUANTITY Lookup1D_X_FLOAT32_IEEE 0 VBU0428Test_CM_single_cnt 2 -3.4028234663852886E+38 3.4028234663852886E+38 /end AXIS_PTS
/begin CHARACTERISTIC EDIS_facChrgCurrLimBaseSoc_CUR_v "" CURVE 0x70011b1a Lookup1D_FLOAT32_IEEE 0 VBU0428Test_CM_single_cnt -3.4028234663852886E+38 3.4028234663852886E+38
 /begin AXIS_DESCR COM_AXIS NO_INPUT_QUANTITY VBU0428Test_CM_single_cnt 2 -3.4028234663852886E+38 3.4028234663852886E+38 AXIS_PTS_REF EDIS_pctBattSocChrgCurrLim_CUR_x /end AXIS_DESCR
/end CHARACTERISTIC
/begin AXIS_PTS EDIS_pctBattSocChrgCurrLim_CUR_x "" 0x70011b2a NO_INPUT_QUANTITY Lookup1D_X_FLOAT32_IEEE 0 VBU0428Test_CM_single_cnt 2 -3.4028234663852886E+38 3.4028234663852886E+38 /end AXIS_PTS
/begin CHARACTERISTIC EDIS_facUpGradPwr_MAP_v "" MAP 0x7001b33c Lookup2D_FLOAT32_IEEE 0 VBU0428Test_CM_single_cnt -3.4028234663852886E+38 3.4028234663852886E+38
 /begin AXIS_DESCR COM_AXIS TQO_trqRMotr VBU0428Test_CM_single_cnt 13 -3.4028234663852886E+38 3.4028234663852886E+38 AXIS_PTS_REF EDIS_facUpGradPwr_MAP_y /end AXIS_DESCR
 /begin AXIS_DESCR COM_AXIS SPD_vVehSpd VBU0428Test_CM_single_cnt 17 -3.4028234663852886E+38 3.4028234663852886E+38 AXIS_PTS_REF EDIS_facUpGradPwr_MAP_x /end AXIS_DESCR
/end CHARACTERISTIC
/begin AXIS_PTS EDIS_facUpGradPwr_MAP_x "" 0x70013d4a SPD_vVehSpd Lookup2D_X_FLOAT32_IEEE 0 VBU0428Test_CM_single_cnt 17 -3.4028234663852886E+38 3.4028234663852886E+38 /end AXIS_PTS
/begin AXIS_PTS EDIS_facUpGradPwr_MAP_y "" 0x700136e2 TQO_trqRMotr Lookup2D_X_FLOAT32_IEEE 0 VBU0428Test_CM_single_cnt 13 -3.4028234663852886E+38 3.4028234663852886E+38 /end AXIS_PTS
/begin CHARACTERISTIC EDIS_facChPwrKd_CUR_v "" CURVE 0x700129e2 Lookup1D_FLOAT32_IEEE 0 VBU0428Test_CM_single_cnt -3.4028234663852886E+38 3.4028234663852886E+38
 /begin AXIS_DESCR COM_AXIS NO_INPUT_QUANTITY VBU0428Test_CM_single_cnt 10 -3.4028234663852886E+38 3.4028234663852886E+38 AXIS_PTS_REF EDIS_facChPwrKd_CUR_x /end AXIS_DESCR
/end CHARACTERISTIC
/begin AXIS_PTS EDIS_facChPwrKd_CUR_x "" 0x70012a0a NO_INPUT_QUANTITY Lookup1D_X_FLOAT32_IEEE 0 VBU0428Test_CM_single_cnt 10 -3.4028234663852886E+38 3.4028234663852886E+38 /end AXIS_PTS
/begin CHARACTERISTIC EDIS_facChPwrBaseDiffKp_CUR_v "" CURVE 0x700144d6 Lookup1D_FLOAT32_IEEE 0 VBU0428Test_CM_single_cnt -3.4028234663852886E+38 3.4028234663852886E+38
 /begin AXIS_DESCR COM_AXIS EDIS_pwrRgnDelta VBU0428Test_CM_single_cnt 21 -3.4028234663852886E+38 3.4028234663852886E+38 AXIS_PTS_REF EDIS_pwrChPwrBaseDiffKp_CUR_x /end AXIS_DESCR
/end CHARACTERISTIC
/begin AXIS_PTS EDIS_pwrChPwrBaseDiffKp_CUR_x "" 0x700145d2 EDIS_pwrRgnDelta Lookup1D_X_FLOAT32_IEEE 0 VBU0428Test_CM_single_cnt 21 -3.4028234663852886E+38 3.4028234663852886E+38 /end AXIS_PTS
/begin CHARACTERISTIC EDIS_facChPwrKi_MAP_v "" MAP 0x70016ae0 Lookup2D_FLOAT32_IEEE 0 VBU0428Test_CM_single_cnt -3.4028234663852886E+38 3.4028234663852886E+38
 /begin AXIS_DESCR COM_AXIS EDIS_pwrChLimDynRaw VBU0428Test_CM_single_cnt 10 -3.4028234663852886E+38 3.4028234663852886E+38 AXIS_PTS_REF EDIS_facChPwrKi_MAP_y /end AXIS_DESCR
 /begin AXIS_DESCR COM_AXIS EDIS_pwrRgnDelta VBU0428Test_CM_single_cnt 11 -3.4028234663852886E+38 3.4028234663852886E+38 AXIS_PTS_REF EDIS_facChPwrKi_MAP_x /end AXIS_DESCR
/end CHARACTERISTIC
/begin AXIS_PTS EDIS_facChPwrKi_MAP_x "" 0x70012d4e EDIS_pwrRgnDelta Lookup2D_X_FLOAT32_IEEE 0 VBU0428Test_CM_single_cnt 11 -3.4028234663852886E+38 3.4028234663852886E+38 /end AXIS_PTS
/begin AXIS_PTS EDIS_facChPwrKi_MAP_y "" 0x70012a32 EDIS_pwrChLimDynRaw Lookup2D_X_FLOAT32_IEEE 0 VBU0428Test_CM_single_cnt 10 -3.4028234663852886E+38 3.4028234663852886E+38 /end AXIS_PTS
/begin CHARACTERISTIC EDIS_facDisChPwrBaseDiffKp_CUR_v "" CURVE 0x7001457e Lookup1D_FLOAT32_IEEE 0 VBU0428Test_CM_single_cnt -3.4028234663852886E+38 3.4028234663852886E+38
 /begin AXIS_DESCR COM_AXIS EDIS_pwrDchaDelta VBU0428Test_CM_single_cnt 21 -3.4028234663852886E+38 3.4028234663852886E+38 AXIS_PTS_REF EDIS_pwrDisChPwrBaseDiffKp_CUR_x /end AXIS_DESCR
/end CHARACTERISTIC
/begin AXIS_PTS EDIS_pwrDisChPwrBaseDiffKp_CUR_x "" 0x7001467a EDIS_pwrDchaDelta Lookup1D_X_FLOAT32_IEEE 0 VBU0428Test_CM_single_cnt 21 -3.4028234663852886E+38 3.4028234663852886E+38 /end AXIS_PTS
/begin CHARACTERISTIC EDIS_facDisChPwrKi_MAP_v "" MAP 0x70016c98 Lookup2D_FLOAT32_IEEE 0 VBU0428Test_CM_single_cnt -3.4028234663852886E+38 3.4028234663852886E+38
 /begin AXIS_DESCR COM_AXIS EDIS_pwrDisChLimDynST VBU0428Test_CM_single_cnt 10 -3.4028234663852886E+38 3.4028234663852886E+38 AXIS_PTS_REF EDIS_facDisChPwrKi_MAP_y /end AXIS_DESCR
 /begin AXIS_DESCR COM_AXIS EDIS_pwrDchaDelta VBU0428Test_CM_single_cnt 11 -3.4028234663852886E+38 3.4028234663852886E+38 AXIS_PTS_REF EDIS_facDisChPwrKi_MAP_x /end AXIS_DESCR
/end CHARACTERISTIC
/begin AXIS_PTS EDIS_facDisChPwrKi_MAP_x "" 0x70012d7a EDIS_pwrDchaDelta Lookup2D_X_FLOAT32_IEEE 0 VBU0428Test_CM_single_cnt 11 -3.4028234663852886E+38 3.4028234663852886E+38 /end AXIS_PTS
/begin AXIS_PTS EDIS_facDisChPwrKi_MAP_y "" 0x70012a5a EDIS_pwrDisChLimDynST Lookup2D_X_FLOAT32_IEEE 0 VBU0428Test_CM_single_cnt 10 -3.4028234663852886E+38 3.4028234663852886E+38 /end AXIS_PTS
/begin CHARACTERISTIC AVAS_flgNumHwVerOvrd_C "" VALUE 0x70010270 Scalar_FLOAT32_IEEE 0 VBU0428Test_CM_single 0.0 1.0 /end CHARACTERISTIC
/begin CHARACTERISTIC AVAS_flgNumSoftwareVerOvrd_C "" VALUE 0x70010274 Scalar_FLOAT32_IEEE 0 VBU0428Test_CM_single 0.0 1.0 /end CHARACTERISTIC
/begin CHARACTERISTIC AVAS_flgStWorkingStatusOvrd_C "" VALUE 0x70010278 Scalar_FLOAT32_IEEE 0 VBU0428Test_CM_single 0.0 1.0 /end CHARACTERISTIC
/begin CHARACTERISTIC AVAS_numHwVerOvrdVal_C "" VALUE 0x7001027c Scalar_FLOAT32_IEEE 0 VBU0428Test_CM_single 0.0 4.294967295E+9 /end CHARACTERISTIC
/begin CHARACTERISTIC AVAS_numSoftwareVerOvrdVal_C "" VALUE 0x70010280 Scalar_FLOAT32_IEEE 0 VBU0428Test_CM_single 0.0 4.294967295E+9 /end CHARACTERISTIC
/begin CHARACTERISTIC AVAS_stWorkingStatusOvrdVal_C "" VALUE 0x70010284 Scalar_FLOAT32_IEEE 0 VBU0428Test_CM_single 0.0 255.0 /end CHARACTERISTIC
/begin CHARACTERISTIC BCM_flgFlgIG1PwrOvrd_C "" VALUE 0x70010288 Scalar_FLOAT32_IEEE 0 VBU0428Test_CM_single 0.0 1.0 /end CHARACTERISTIC
/begin CHARACTERISTIC BCM_flgIG1PwrOvrdVal_C "" VALUE 0x7001028c Scalar_FLOAT32_IEEE 0 VBU0428Test_CM_single 0.0 1.0 /end CHARACTERISTIC
/begin CHARACTERISTIC BCM_flgStAutoHeadlightGearOvrd_C "" VALUE 0x70010290 Scalar_FLOAT32_IEEE 0 VBU0428Test_CM_single 0.0 1.0 /end CHARACTERISTIC
/begin CHARACTERISTIC BCM_flgStAutoWiperGearOvrd_C "" VALUE 0x70010294 Scalar_FLOAT32_IEEE 0 VBU0428Test_CM_single 0.0 1.0 /end CHARACTERISTIC
/begin CHARACTERISTIC BCM_flgStBrkLghtStatusOvrd_C "" VALUE 0x70010298 Scalar_FLOAT32_IEEE 0 VBU0428Test_CM_single 0.0 1.0 /end CHARACTERISTIC
/begin CHARACTERISTIC BCM_flgStDayLghtStatusOvrd_C "" VALUE 0x7001029c Scalar_FLOAT32_IEEE 0 VBU0428Test_CM_single 0.0 1.0 /end CHARACTERISTIC
/begin CHARACTERISTIC BCM_flgStDoorStatusOvrd_C "" VALUE 0x700102a0 Scalar_FLOAT32_IEEE 0 VBU0428Test_CM_single 0.0 1.0 /end CHARACTERISTIC
/begin CHARACTERISTIC BCM_flgStFrntFogLghtOvrd_C "" VALUE 0x700102a4 Scalar_FLOAT32_IEEE 0 VBU0428Test_CM_single 0.0 1.0 /end CHARACTERISTIC
/begin CHARACTERISTIC BCM_flgStHIWiperStatusOvrd_C "" VALUE 0x700102a8 Scalar_FLOAT32_IEEE 0 VBU0428Test_CM_single 0.0 1.0 /end CHARACTERISTIC
/begin CHARACTERISTIC BCM_flgStHiBeamOvrd_C "" VALUE 0x700102ac Scalar_FLOAT32_IEEE 0 VBU0428Test_CM_single 0.0 1.0 /end CHARACTERISTIC
/begin CHARACTERISTIC BCM_flgStHornStatusOvrd_C "" VALUE 0x700102b0 Scalar_FLOAT32_IEEE 0 VBU0428Test_CM_single 0.0 1.0 /end CHARACTERISTIC
/begin CHARACTERISTIC BCM_flgStLeTurnStatusOvrd_C "" VALUE 0x700102b4 Scalar_FLOAT32_IEEE 0 VBU0428Test_CM_single 0.0 1.0 /end CHARACTERISTIC
/begin CHARACTERISTIC BCM_flgStLoWiperStatusOvrd_C "" VALUE 0x700102b8 Scalar_FLOAT32_IEEE 0 VBU0428Test_CM_single 0.0 1.0 /end CHARACTERISTIC
/begin CHARACTERISTIC BCM_flgStLowBeamOvrd_C "" VALUE 0x700102bc Scalar_FLOAT32_IEEE 0 VBU0428Test_CM_single 0.0 1.0 /end CHARACTERISTIC
/begin CHARACTERISTIC BCM_flgStParkLghtStatusOvrd_C "" VALUE 0x700102c0 Scalar_FLOAT32_IEEE 0 VBU0428Test_CM_single 0.0 1.0 /end CHARACTERISTIC
/begin CHARACTERISTIC BCM_flgStParkSwtStatusOvrd_C "" VALUE 0x700102c4 Scalar_FLOAT32_IEEE 0 VBU0428Test_CM_single 0.0 1.0 /end CHARACTERISTIC
/begin CHARACTERISTIC BCM_flgStRealFogLghtOvrd_C "" VALUE 0x700102c8 Scalar_FLOAT32_IEEE 0 VBU0428Test_CM_single 0.0 1.0 /end CHARACTERISTIC
/begin CHARACTERISTIC BCM_flgStReversingSwtStatusOvrd_C "" VALUE 0x700102cc Scalar_FLOAT32_IEEE 0 VBU0428Test_CM_single 0.0 1.0 /end CHARACTERISTIC
/begin CHARACTERISTIC BCM_flgStRiTurnLghtStatusOvrd_C "" VALUE 0x700102d0 Scalar_FLOAT32_IEEE 0 VBU0428Test_CM_single 0.0 1.0 /end CHARACTERISTIC
/begin CHARACTERISTIC BCM_flgStWashMotrStatusOvrd_C "" VALUE 0x700102d4 Scalar_FLOAT32_IEEE 0 VBU0428Test_CM_single 0.0 1.0 /end CHARACTERISTIC
/begin CHARACTERISTIC BCM_stAutoHeadlightGearOvrdVal_C "" VALUE 0x700102d8 Scalar_FLOAT32_IEEE 0 VBU0428Test_CM_single 0.0 255.0 /end CHARACTERISTIC
/begin CHARACTERISTIC BCM_stAutoWiperGearOvrdVal_C "" VALUE 0x700102dc Scalar_FLOAT32_IEEE 0 VBU0428Test_CM_single 0.0 255.0 /end CHARACTERISTIC
/begin CHARACTERISTIC BCM_stBrkLghtStatusOvrdVal_C "" VALUE 0x700102e0 Scalar_FLOAT32_IEEE 0 VBU0428Test_CM_single 0.0 255.0 /end CHARACTERISTIC
/begin CHARACTERISTIC BCM_stDayLghtStatusOvrdVal_C "" VALUE 0x700102e4 Scalar_FLOAT32_IEEE 0 VBU0428Test_CM_single 0.0 255.0 /end CHARACTERISTIC
/begin CHARACTERISTIC BCM_stDoorStatusOvrdVal_C "" VALUE 0x700102e8 Scalar_FLOAT32_IEEE 0 VBU0428Test_CM_single 0.0 255.0 /end CHARACTERISTIC
/begin CHARACTERISTIC BCM_stFrntFogLghtOvrdVal_C "" VALUE 0x700102ec Scalar_FLOAT32_IEEE 0 VBU0428Test_CM_single 0.0 255.0 /end CHARACTERISTIC
/begin CHARACTERISTIC BCM_stHIWiperStatusOvrdVal_C "" VALUE 0x700102f0 Scalar_FLOAT32_IEEE 0 VBU0428Test_CM_single 0.0 255.0 /end CHARACTERISTIC
/begin CHARACTERISTIC BCM_stHiBeamOvrdVal_C "" VALUE 0x700102f4 Scalar_FLOAT32_IEEE 0 VBU0428Test_CM_single 0.0 255.0 /end CHARACTERISTIC
/begin CHARACTERISTIC BCM_stHornStatusOvrdVal_C "" VALUE 0x700102f8 Scalar_FLOAT32_IEEE 0 VBU0428Test_CM_single 0.0 255.0 /end CHARACTERISTIC
/begin CHARACTERISTIC BCM_stLeTurnStatusOvrdVal_C "" VALUE 0x700102fc Scalar_FLOAT32_IEEE 0 VBU0428Test_CM_single 0.0 255.0 /end CHARACTERISTIC
/begin CHARACTERISTIC BCM_stLoWiperStatusOvrdVal_C "" VALUE 0x70010300 Scalar_FLOAT32_IEEE 0 VBU0428Test_CM_single 0.0 255.0 /end CHARACTERISTIC
/begin CHARACTERISTIC BCM_stLowBeamOvrdVal_C "" VALUE 0x70010304 Scalar_FLOAT32_IEEE 0 VBU0428Test_CM_single 0.0 255.0 /end CHARACTERISTIC
/begin CHARACTERISTIC BCM_stParkLghtStatusOvrdVal_C "" VALUE 0x70010308 Scalar_FLOAT32_IEEE 0 VBU0428Test_CM_single 0.0 255.0 /end CHARACTERISTIC
/begin CHARACTERISTIC BCM_stParkSwtStatusOvrdVal_C "" VALUE 0x7001030c Scalar_FLOAT32_IEEE 0 VBU0428Test_CM_single 0.0 255.0 /end CHARACTERISTIC
/begin CHARACTERISTIC BCM_stRealFogLghtOvrdVal_C "" VALUE 0x70010310 Scalar_FLOAT32_IEEE 0 VBU0428Test_CM_single 0.0 255.0 /end CHARACTERISTIC
/begin CHARACTERISTIC BCM_stReversingSwtStatusOvrdVal_C "" VALUE 0x70010314 Scalar_FLOAT32_IEEE 0 VBU0428Test_CM_single 0.0 255.0 /end CHARACTERISTIC
/begin CHARACTERISTIC BCM_stRiTurnLghtStatusOvrdVal_C "" VALUE 0x70010318 Scalar_FLOAT32_IEEE 0 VBU0428Test_CM_single 0.0 255.0 /end CHARACTERISTIC
/begin CHARACTERISTIC BCM_stWashMotrStatusOvrdVal_C "" VALUE 0x7001031c Scalar_FLOAT32_IEEE 0 VBU0428Test_CM_single 0.0 255.0 /end CHARACTERISTIC
/begin CHARACTERISTIC CCU_flgFlgOverCurrFreqRdcOvrd_C "" VALUE 0x70010400 Scalar_FLOAT32_IEEE 0 VBU0428Test_CM_single 0.0 1.0 /end CHARACTERISTIC
/begin CHARACTERISTIC CCU_flgFlgOvrCurrOvrd_C "" VALUE 0x70010404 Scalar_FLOAT32_IEEE 0 VBU0428Test_CM_single 0.0 1.0 /end CHARACTERISTIC
/begin CHARACTERISTIC CCU_flgFlgOvrVltgOvrd_C "" VALUE 0x70010408 Scalar_FLOAT32_IEEE 0 VBU0428Test_CM_single 0.0 1.0 /end CHARACTERISTIC
/begin CHARACTERISTIC CCU_flgFlgStdbyOvrVltgOvrd_C "" VALUE 0x7001040c Scalar_FLOAT32_IEEE 0 VBU0428Test_CM_single 0.0 1.0 /end CHARACTERISTIC
/begin CHARACTERISTIC CCU_flgFlgStdbyUndrVltgOvrd_C "" VALUE 0x70010410 Scalar_FLOAT32_IEEE 0 VBU0428Test_CM_single 0.0 1.0 /end CHARACTERISTIC
/begin CHARACTERISTIC CCU_flgFlgUndrVltgOvrd_C "" VALUE 0x70010414 Scalar_FLOAT32_IEEE 0 VBU0428Test_CM_single 0.0 1.0 /end CHARACTERISTIC
/begin CHARACTERISTIC CCU_flgICompCurrOvrd_C "" VALUE 0x70010418 Scalar_FLOAT32_IEEE 0 VBU0428Test_CM_single 0.0 1.0 /end CHARACTERISTIC
/begin CHARACTERISTIC CCU_flgNCompActSpdOvrd_C "" VALUE 0x7001041c Scalar_FLOAT32_IEEE 0 VBU0428Test_CM_single 0.0 1.0 /end CHARACTERISTIC
/begin CHARACTERISTIC CCU_flgOverCurrFreqRdcOvrdVal_C "" VALUE 0x70010420 Scalar_FLOAT32_IEEE 0 VBU0428Test_CM_single 0.0 1.0 /end CHARACTERISTIC
/begin CHARACTERISTIC CCU_flgOvrCurrOvrdVal_C "" VALUE 0x70010424 Scalar_FLOAT32_IEEE 0 VBU0428Test_CM_single 0.0 1.0 /end CHARACTERISTIC
/begin CHARACTERISTIC CCU_flgOvrVltgOvrdVal_C "" VALUE 0x70010428 Scalar_FLOAT32_IEEE 0 VBU0428Test_CM_single 0.0 1.0 /end CHARACTERISTIC
/begin CHARACTERISTIC CCU_flgStCompFaultOvrd_C "" VALUE 0x7001042c Scalar_FLOAT32_IEEE 0 VBU0428Test_CM_single 0.0 1.0 /end CHARACTERISTIC
/begin CHARACTERISTIC CCU_flgStCpmpStatusOvrd_C "" VALUE 0x70010430 Scalar_FLOAT32_IEEE 0 VBU0428Test_CM_single 0.0 1.0 /end CHARACTERISTIC
/begin CHARACTERISTIC CCU_flgStSpdFaultOvrd_C "" VALUE 0x70010434 Scalar_FLOAT32_IEEE 0 VBU0428Test_CM_single 0.0 1.0 /end CHARACTERISTIC
/begin CHARACTERISTIC CCU_flgStdbyOvrVltgOvrdVal_C "" VALUE 0x70010438 Scalar_FLOAT32_IEEE 0 VBU0428Test_CM_single 0.0 1.0 /end CHARACTERISTIC
/begin CHARACTERISTIC CCU_flgStdbyUndrVltgOvrdVal_C "" VALUE 0x7001043c Scalar_FLOAT32_IEEE 0 VBU0428Test_CM_single 0.0 1.0 /end CHARACTERISTIC
/begin CHARACTERISTIC CCU_flgUCompVltgOvrd_C "" VALUE 0x70010440 Scalar_FLOAT32_IEEE 0 VBU0428Test_CM_single 0.0 1.0 /end CHARACTERISTIC
/begin CHARACTERISTIC CCU_flgUndrVltgOvrdVal_C "" VALUE 0x70010444 Scalar_FLOAT32_IEEE 0 VBU0428Test_CM_single 0.0 1.0 /end CHARACTERISTIC
/begin CHARACTERISTIC CCU_iCompCurrOvrdVal_C "" VALUE 0x70010448 Scalar_FLOAT32_IEEE 0 VBU0428Test_CM_single -3.40282346638528E+38 3.40282346638528E+38 /end CHARACTERISTIC
/begin CHARACTERISTIC CCU_nCompActSpdOvrdVal_C "" VALUE 0x7001044c Scalar_FLOAT32_IEEE 0 VBU0428Test_CM_single -3.40282346638528E+38 3.40282346638528E+38 /end CHARACTERISTIC
/begin CHARACTERISTIC CCU_stCompFaultOvrdVal_C "" VALUE 0x70010450 Scalar_FLOAT32_IEEE 0 VBU0428Test_CM_single 0.0 255.0 /end CHARACTERISTIC
/begin CHARACTERISTIC CCU_stCpmpStatusOvrdVal_C "" VALUE 0x70010454 Scalar_FLOAT32_IEEE 0 VBU0428Test_CM_single 0.0 255.0 /end CHARACTERISTIC
/begin CHARACTERISTIC CCU_stSpdFaultOvrdVal_C "" VALUE 0x70010458 Scalar_FLOAT32_IEEE 0 VBU0428Test_CM_single 0.0 255.0 /end CHARACTERISTIC
/begin CHARACTERISTIC CCU_uCompVltgOvrdVal_C "" VALUE 0x7001045c Scalar_FLOAT32_IEEE 0 VBU0428Test_CM_single -3.40282346638528E+38 3.40282346638528E+38 /end CHARACTERISTIC
/begin CHARACTERISTIC CDC_flgCreepOnOffOvrdVal_C "" VALUE 0x70010460 Scalar_FLOAT32_IEEE 0 VBU0428Test_CM_single 0.0 1.0 /end CHARACTERISTIC
/begin CHARACTERISTIC CDC_flgFlgCreepOnOffOvrd_C "" VALUE 0x70010464 Scalar_FLOAT32_IEEE 0 VBU0428Test_CM_single 0.0 1.0 /end CHARACTERISTIC
/begin CHARACTERISTIC CDC_flgFlgGoNotifierOnOffOvrd_C "" VALUE 0x70010468 Scalar_FLOAT32_IEEE 0 VBU0428Test_CM_single 0.0 1.0 /end CHARACTERISTIC
/begin CHARACTERISTIC CDC_flgGoNotifierOnOffOvrdVal_C "" VALUE 0x7001046c Scalar_FLOAT32_IEEE 0 VBU0428Test_CM_single 0.0 1.0 /end CHARACTERISTIC
/begin CHARACTERISTIC CDC_flgStDrvModeOvrd_C "" VALUE 0x70010470 Scalar_FLOAT32_IEEE 0 VBU0428Test_CM_single 0.0 1.0 /end CHARACTERISTIC
/begin CHARACTERISTIC CDC_flgStRgnModeOvrd_C "" VALUE 0x70010474 Scalar_FLOAT32_IEEE 0 VBU0428Test_CM_single 0.0 1.0 /end CHARACTERISTIC
/begin CHARACTERISTIC CDC_flgStTowModeOvrd_C "" VALUE 0x70010478 Scalar_FLOAT32_IEEE 0 VBU0428Test_CM_single 0.0 1.0 /end CHARACTERISTIC
/begin CHARACTERISTIC CDC_stDrvModeOvrdVal_C "" VALUE 0x7001047c Scalar_FLOAT32_IEEE 0 VBU0428Test_CM_single 0.0 255.0 /end CHARACTERISTIC
/begin CHARACTERISTIC CDC_stRgnModeOvrdVal_C "" VALUE 0x70010480 Scalar_FLOAT32_IEEE 0 VBU0428Test_CM_single 0.0 255.0 /end CHARACTERISTIC
/begin CHARACTERISTIC CDC_stTowModeOvrdVal_C "" VALUE 0x70010484 Scalar_FLOAT32_IEEE 0 VBU0428Test_CM_single 0.0 255.0 /end CHARACTERISTIC
/begin CHARACTERISTIC DCDC_flgDeritingOvrdVal_C "" VALUE 0x70010bf4 Scalar_FLOAT32_IEEE 0 VBU0428Test_CM_single 0.0 1.0 /end CHARACTERISTIC
/begin CHARACTERISTIC DCDC_flgEnaFdbkOvrdVal_C "" VALUE 0x70010bf8 Scalar_FLOAT32_IEEE 0 VBU0428Test_CM_single 0.0 1.0 /end CHARACTERISTIC
/begin CHARACTERISTIC DCDC_flgFlgDeritingOvrd_C "" VALUE 0x70010bfc Scalar_FLOAT32_IEEE 0 VBU0428Test_CM_single 0.0 1.0 /end CHARACTERISTIC
/begin CHARACTERISTIC DCDC_flgFlgEnaFdbkOvrd_C "" VALUE 0x70010c00 Scalar_FLOAT32_IEEE 0 VBU0428Test_CM_single 0.0 1.0 /end CHARACTERISTIC
/begin CHARACTERISTIC DCDC_flgFlgOvrHeatOvrd_C "" VALUE 0x70010c04 Scalar_FLOAT32_IEEE 0 VBU0428Test_CM_single 0.0 1.0 /end CHARACTERISTIC
/begin CHARACTERISTIC DCDC_flgFlgOvrInCurrOvrd_C "" VALUE 0x70010c08 Scalar_FLOAT32_IEEE 0 VBU0428Test_CM_single 0.0 1.0 /end CHARACTERISTIC
/begin CHARACTERISTIC DCDC_flgFlgOvrInVltgOvrd_C "" VALUE 0x70010c0c Scalar_FLOAT32_IEEE 0 VBU0428Test_CM_single 0.0 1.0 /end CHARACTERISTIC
/begin CHARACTERISTIC DCDC_flgFlgOvrOutCurrOvrd_C "" VALUE 0x70010c10 Scalar_FLOAT32_IEEE 0 VBU0428Test_CM_single 0.0 1.0 /end CHARACTERISTIC
/begin CHARACTERISTIC DCDC_flgFlgOvrOutVltgOvrd_C "" VALUE 0x70010c14 Scalar_FLOAT32_IEEE 0 VBU0428Test_CM_single 0.0 1.0 /end CHARACTERISTIC
/begin CHARACTERISTIC DCDC_flgFlgUndrInVltgOvrd_C "" VALUE 0x70010c18 Scalar_FLOAT32_IEEE 0 VBU0428Test_CM_single 0.0 1.0 /end CHARACTERISTIC
/begin CHARACTERISTIC DCDC_flgFlgUndrOutVltgOvrd_C "" VALUE 0x70010c1c Scalar_FLOAT32_IEEE 0 VBU0428Test_CM_single 0.0 1.0 /end CHARACTERISTIC
/begin CHARACTERISTIC DCDC_flgIInputCurrOvrd_C "" VALUE 0x70010c20 Scalar_FLOAT32_IEEE 0 VBU0428Test_CM_single 0.0 1.0 /end CHARACTERISTIC
/begin CHARACTERISTIC DCDC_flgIOutputCurrOvrd_C "" VALUE 0x70010c24 Scalar_FLOAT32_IEEE 0 VBU0428Test_CM_single 0.0 1.0 /end CHARACTERISTIC
/begin CHARACTERISTIC DCDC_flgOvrHeatOvrdVal_C "" VALUE 0x70010c28 Scalar_FLOAT32_IEEE 0 VBU0428Test_CM_single 0.0 1.0 /end CHARACTERISTIC
/begin CHARACTERISTIC DCDC_flgOvrInCurrOvrdVal_C "" VALUE 0x70010c2c Scalar_FLOAT32_IEEE 0 VBU0428Test_CM_single 0.0 1.0 /end CHARACTERISTIC
/begin CHARACTERISTIC DCDC_flgOvrInVltgOvrdVal_C "" VALUE 0x70010c30 Scalar_FLOAT32_IEEE 0 VBU0428Test_CM_single 0.0 1.0 /end CHARACTERISTIC
/begin CHARACTERISTIC DCDC_flgOvrOutCurrOvrdVal_C "" VALUE 0x70010c34 Scalar_FLOAT32_IEEE 0 VBU0428Test_CM_single 0.0 1.0 /end CHARACTERISTIC
/begin CHARACTERISTIC DCDC_flgOvrOutVltgOvrdVal_C "" VALUE 0x70010c38 Scalar_FLOAT32_IEEE 0 VBU0428Test_CM_single 0.0 1.0 /end CHARACTERISTIC
/begin CHARACTERISTIC DCDC_flgStStatusOvrd_C "" VALUE 0x70010c3c Scalar_FLOAT32_IEEE 0 VBU0428Test_CM_single 0.0 1.0 /end CHARACTERISTIC
/begin CHARACTERISTIC DCDC_flgTTempOvrd_C "" VALUE 0x70010c40 Scalar_FLOAT32_IEEE 0 VBU0428Test_CM_single 0.0 1.0 /end CHARACTERISTIC
/begin CHARACTERISTIC DCDC_flgUInputVltgOvrd_C "" VALUE 0x70010c44 Scalar_FLOAT32_IEEE 0 VBU0428Test_CM_single 0.0 1.0 /end CHARACTERISTIC
/begin CHARACTERISTIC DCDC_flgUOutputVltgOvrd_C "" VALUE 0x70010c48 Scalar_FLOAT32_IEEE 0 VBU0428Test_CM_single 0.0 1.0 /end CHARACTERISTIC
/begin CHARACTERISTIC DCDC_flgUndrInVltgOvrdVal_C "" VALUE 0x70010c4c Scalar_FLOAT32_IEEE 0 VBU0428Test_CM_single 0.0 1.0 /end CHARACTERISTIC
/begin CHARACTERISTIC DCDC_flgUndrOutVltgOvrdVal_C "" VALUE 0x70010c50 Scalar_FLOAT32_IEEE 0 VBU0428Test_CM_single 0.0 1.0 /end CHARACTERISTIC
/begin CHARACTERISTIC DCDC_iInputCurrOvrdVal_C "" VALUE 0x70010c54 Scalar_FLOAT32_IEEE 0 VBU0428Test_CM_single -3.40282346638528E+38 3.40282346638528E+38 /end CHARACTERISTIC
/begin CHARACTERISTIC DCDC_iOutputCurrOvrdVal_C "" VALUE 0x70010c58 Scalar_FLOAT32_IEEE 0 VBU0428Test_CM_single -3.40282346638528E+38 3.40282346638528E+38 /end CHARACTERISTIC
/begin CHARACTERISTIC DCDC_stStatusOvrdVal_C "" VALUE 0x70010c5c Scalar_FLOAT32_IEEE 0 VBU0428Test_CM_single 0.0 255.0 /end CHARACTERISTIC
/begin CHARACTERISTIC DCDC_tTempOvrdVal_C "" VALUE 0x70010c60 Scalar_FLOAT32_IEEE 0 VBU0428Test_CM_single -3.40282346638528E+38 3.40282346638528E+38 /end CHARACTERISTIC
/begin CHARACTERISTIC DCDC_uInputVltgOvrdVal_C "" VALUE 0x70010c64 Scalar_FLOAT32_IEEE 0 VBU0428Test_CM_single -3.40282346638528E+38 3.40282346638528E+38 /end CHARACTERISTIC
/begin CHARACTERISTIC DCDC_uOutputVltgOvrdVal_C "" VALUE 0x70010c68 Scalar_FLOAT32_IEEE 0 VBU0428Test_CM_single -3.40282346638528E+38 3.40282346638528E+38 /end CHARACTERISTIC
/begin CHARACTERISTIC DCH_iDiaDCChOvrCrntDiff_C "" VALUE 0x70010cb0 Scalar_FLOAT32_IEEE 0 VBU0428Test_CM_single_cnt -3.4028234663852886E+38 3.4028234663852886E+38 /end CHARACTERISTIC
/begin CHARACTERISTIC DCH_numPDUNonRlySticky_C "" VALUE 0x70010d20 Scalar_FLOAT32_IEEE 0 VBU0428Test_CM_single_cnt -3.4028234663852886E+38 3.4028234663852886E+38 /end CHARACTERISTIC
/begin CHARACTERISTIC DCH_numPDUPosRlySticky_C "" VALUE 0x70010d24 Scalar_FLOAT32_IEEE 0 VBU0428Test_CM_single_cnt -3.4028234663852886E+38 3.4028234663852886E+38 /end CHARACTERISTIC
/begin CHARACTERISTIC DCH_numPDUStickyTolerance_C "" VALUE 0x70010d28 Scalar_FLOAT32_IEEE 0 VBU0428Test_CM_single_cnt -3.4028234663852886E+38 3.4028234663852886E+38 /end CHARACTERISTIC
/begin CHARACTERISTIC DCH_tDCChPortTempLowLim_C "" VALUE 0x70010d58 Scalar_FLOAT32_IEEE 0 VBU0428Test_CM_single_cnt -3.4028234663852886E+38 3.4028234663852886E+38 /end CHARACTERISTIC
/begin CHARACTERISTIC DCH_tReStartDCChPortTemp_C "" VALUE 0x70010d74 Scalar_FLOAT32_IEEE 0 VBU0428Test_CM_single_cnt -3.4028234663852886E+38 3.4028234663852886E+38 /end CHARACTERISTIC
/begin CHARACTERISTIC DCH_tStopForDCChPortTemp_C "" VALUE 0x70010d78 Scalar_FLOAT32_IEEE 0 VBU0428Test_CM_single_cnt -3.4028234663852886E+38 3.4028234663852886E+38 /end CHARACTERISTIC
/begin CHARACTERISTIC DCH_tiDCChRlyOpClsdDly_C "" VALUE 0x70010dd0 Scalar_FLOAT32_IEEE 0 VBU0428Test_CM_single_cnt -3.4028234663852886E+38 3.4028234663852886E+38 /end CHARACTERISTIC
/begin CHARACTERISTIC DCH_tiDiagRlyCmd_C "" VALUE 0x70010de0 Scalar_FLOAT32_IEEE 0 VBU0428Test_CM_single_cnt -3.4028234663852886E+38 3.4028234663852886E+38 /end CHARACTERISTIC
/begin CHARACTERISTIC DCH_uDiaDCChOvrVltgDiff_C "" VALUE 0x70010e30 Scalar_FLOAT32_IEEE 0 VBU0428Test_CM_single_cnt -3.4028234663852886E+38 3.4028234663852886E+38 /end CHARACTERISTIC
/begin CHARACTERISTIC DSPL_facChargeTemp1_C "" VALUE 0x70010e5c Scalar_FLOAT32_IEEE 0 VBU0428Test_CM_single_fac 0.0 1.0 /end CHARACTERISTIC
/begin CHARACTERISTIC DSPL_facChargeTemp2_C "" VALUE 0x70010e60 Scalar_FLOAT32_IEEE 0 VBU0428Test_CM_single_fac 0.0 1.0 /end CHARACTERISTIC
/begin CHARACTERISTIC DSPL_facChargeTemp3_C "" VALUE 0x70010e64 Scalar_FLOAT32_IEEE 0 VBU0428Test_CM_single_fac 0.0 1.0 /end CHARACTERISTIC
/begin CHARACTERISTIC DSPL_facChargeTemp4_C "" VALUE 0x70010e68 Scalar_FLOAT32_IEEE 0 VBU0428Test_CM_single_fac 0.0 1.0 /end CHARACTERISTIC
/begin CHARACTERISTIC DSPL_facChargeTemp5_C "" VALUE 0x70010e6c Scalar_FLOAT32_IEEE 0 VBU0428Test_CM_single_fac 0.0 1.0 /end CHARACTERISTIC
/begin CHARACTERISTIC DSPL_iRngCalcAch_C "" VALUE 0x70010f80 Scalar_FLOAT32_IEEE 0 VBU0428Test_CM_single_A -1000.0 1000.0 /end CHARACTERISTIC
/begin CHARACTERISTIC DSPL_iRngCalcDch_C "" VALUE 0x70010f84 Scalar_FLOAT32_IEEE 0 VBU0428Test_CM_single_A -1000.0 1000.0 /end CHARACTERISTIC
/begin CHARACTERISTIC DSPL_kmDriveTempSpeedEnThreshold_C "" VALUE 0x70010f90 Scalar_FLOAT32_IEEE 0 VBU0428Test_CM_single_km 0.0 1.0E+11 /end CHARACTERISTIC
/begin CHARACTERISTIC DSPL_tDriveTempDefault_C "" VALUE 0x7001102c Scalar_FLOAT32_IEEE 0 VBU0428Test_CM_single_cnt 0.0 1.0E+17 /end CHARACTERISTIC
/begin CHARACTERISTIC DSPL_tRangeTempDefault_C "" VALUE 0x70011030 Scalar_FLOAT32_IEEE 0 VBU0428Test_CM_single_cnt -40.0 120.0 /end CHARACTERISTIC
/begin CHARACTERISTIC DSPL_tiDelayTimeDriveCnt_C "" VALUE 0x70011048 Scalar_FLOAT32_IEEE 0 VBU0428Test_CM_single_s 0.0 1.0E+23 /end CHARACTERISTIC
/begin CHARACTERISTIC DSPL_tiDriveTempMoveTime_C "" VALUE 0x70011050 Scalar_FLOAT32_IEEE 0 VBU0428Test_CM_single_s 0.0 1.0E+23 /end CHARACTERISTIC
/begin CHARACTERISTIC DSPL_tiDriveTempSpeedEnThreshold_C "" VALUE 0x70011054 Scalar_FLOAT32_IEEE 0 VBU0428Test_CM_single_s 0.0 1.0E+23 /end CHARACTERISTIC
/begin CHARACTERISTIC DSPL_tiDriveTempSpeedReset_C "" VALUE 0x70011058 Scalar_FLOAT32_IEEE 0 VBU0428Test_CM_single_s 0.0 1.0E+23 /end CHARACTERISTIC
/begin CHARACTERISTIC DSPL_tiRemChrgLineDelay_C "" VALUE 0x70011070 Scalar_FLOAT32_IEEE 0 VBU0428Test_CM_single_s 0.0 1.0E+23 /end CHARACTERISTIC
/begin CHARACTERISTIC DSPL_vDriveTempResetThreshold_C "" VALUE 0x70011094 Scalar_FLOAT32_IEEE 0 VBU0428Test_CM_single_cnt 0.0 1000.0 /end CHARACTERISTIC
/begin CHARACTERISTIC DSPL_vDriveTempSpeedEnLe_C "" VALUE 0x70011098 Scalar_FLOAT32_IEEE 0 VBU0428Test_CM_single_cnt 0.0 1000.0 /end CHARACTERISTIC
/begin CHARACTERISTIC DSPL_vDriveTempSpeedEnRi_C "" VALUE 0x7001109c Scalar_FLOAT32_IEEE 0 VBU0428Test_CM_single_cnt 0.0 10000.0 /end CHARACTERISTIC
/begin CHARACTERISTIC EDIS_facStermDisChgRaw_C "" VALUE 0x700110ac Scalar_FLOAT32_IEEE 0 VBU0428Test_CM_single_cnt -3.4028234663852886E+38 3.4028234663852886E+38 /end CHARACTERISTIC
/begin CHARACTERISTIC EDIS_kmVehOdometer_C "" VALUE 0x700110b4 Scalar_FLOAT32_IEEE 0 VBU0428Test_CM_single_cnt -3.4028234663852886E+38 3.4028234663852886E+38 /end CHARACTERISTIC
/begin CHARACTERISTIC EDIS_pctBmsSocOverrideHi1_C "" VALUE 0x700110d8 Scalar_FLOAT32_IEEE 0 VBU0428Test_CM_single_cnt -3.4028234663852886E+38 3.4028234663852886E+38 /end CHARACTERISTIC
/begin CHARACTERISTIC EDIS_pctBmsSocOverrideHi_C "" VALUE 0x700110dc Scalar_FLOAT32_IEEE 0 VBU0428Test_CM_single_cnt -3.4028234663852886E+38 3.4028234663852886E+38 /end CHARACTERISTIC
/begin CHARACTERISTIC EDIS_pctBmsSocOverrideLo1_C "" VALUE 0x700110e0 Scalar_FLOAT32_IEEE 0 VBU0428Test_CM_single_cnt -3.4028234663852886E+38 3.4028234663852886E+38 /end CHARACTERISTIC
/begin CHARACTERISTIC EDIS_pctBmsSocOverrideLo_C "" VALUE 0x700110e4 Scalar_FLOAT32_IEEE 0 VBU0428Test_CM_single_cnt -3.4028234663852886E+38 3.4028234663852886E+38 /end CHARACTERISTIC
/begin CHARACTERISTIC EDIS_pwrACPowOverride_C "" VALUE 0x700110f0 Scalar_FLOAT32_IEEE 0 VBU0428Test_CM_single_cnt -3.4028234663852886E+38 3.4028234663852886E+38 /end CHARACTERISTIC
/begin CHARACTERISTIC EDIS_pwrACRated_C "" VALUE 0x700110f4 Scalar_FLOAT32_IEEE 0 VBU0428Test_CM_single_kW 0.0 1000.0 /end CHARACTERISTIC
/begin CHARACTERISTIC EDIS_pwrBattMaxPwrForInvaild_C "" VALUE 0x700110f8 Scalar_FLOAT32_IEEE 0 VBU0428Test_CM_single_cnt -3.4028234663852886E+38 3.4028234663852886E+38 /end CHARACTERISTIC
/begin CHARACTERISTIC EDIS_pwrBattMinPwrForInvaild_C "" VALUE 0x700110fc Scalar_FLOAT32_IEEE 0 VBU0428Test_CM_single_cnt -3.4028234663852886E+38 3.4028234663852886E+38 /end CHARACTERISTIC
/begin CHARACTERISTIC EDIS_pwrDCDCPowOverride_C "" VALUE 0x70011110 Scalar_FLOAT32_IEEE 0 VBU0428Test_CM_single_cnt -3.4028234663852886E+38 3.4028234663852886E+38 /end CHARACTERISTIC
/begin CHARACTERISTIC EDIS_pwrDcdcRated_C "" VALUE 0x70011118 Scalar_FLOAT32_IEEE 0 VBU0428Test_CM_single_cnt 0.0 1000.0 /end CHARACTERISTIC
/begin CHARACTERISTIC EDIS_pwrDchaDeltaMin_C "" VALUE 0x7001111c Scalar_FLOAT32_IEEE 0 VBU0428Test_CM_single_kW -1000.0 1000.0 /end CHARACTERISTIC
/begin CHARACTERISTIC EDIS_pwrDchaItermMin_C "" VALUE 0x70011120 Scalar_FLOAT32_IEEE 0 VBU0428Test_CM_single_cnt -3.4028234663852886E+38 3.4028234663852886E+38 /end CHARACTERISTIC
/begin CHARACTERISTIC EDIS_pwrDchaPIDPowrLim_C "" VALUE 0x70011124 Scalar_FLOAT32_IEEE 0 VBU0428Test_CM_single_cnt -3.4028234663852886E+38 3.4028234663852886E+38 /end CHARACTERISTIC
/begin CHARACTERISTIC EDIS_pwrDecGradBmsSocLo_C "" VALUE 0x70011128 Scalar_FLOAT32_IEEE 0 VBU0428Test_CM_single_cnt -3.4028234663852886E+38 3.4028234663852886E+38 /end CHARACTERISTIC
/begin CHARACTERISTIC EDIS_pwrDrvPowLackHi_C "" VALUE 0x70011140 Scalar_FLOAT32_IEEE 0 VBU0428Test_CM_single_cnt -3.4028234663852886E+38 3.4028234663852886E+38 /end CHARACTERISTIC
/begin CHARACTERISTIC EDIS_pwrDrvPowLackLo_C "" VALUE 0x70011144 Scalar_FLOAT32_IEEE 0 VBU0428Test_CM_single_cnt -3.4028234663852886E+38 3.4028234663852886E+38 /end CHARACTERISTIC
/begin CHARACTERISTIC EDIS_pwrHVHPowOverride_C "" VALUE 0x7001114c Scalar_FLOAT32_IEEE 0 VBU0428Test_CM_single_cnt -3.4028234663852886E+38 3.4028234663852886E+38 /end CHARACTERISTIC
/begin CHARACTERISTIC EDIS_pwrHVHRated_C "" VALUE 0x70011150 Scalar_FLOAT32_IEEE 0 VBU0428Test_CM_single_cnt 0.0 1000.0 /end CHARACTERISTIC
/begin CHARACTERISTIC EDIS_pwrPTCPowOverride_C "" VALUE 0x70011178 Scalar_FLOAT32_IEEE 0 VBU0428Test_CM_single_cnt -3.4028234663852886E+38 3.4028234663852886E+38 /end CHARACTERISTIC
/begin CHARACTERISTIC EDIS_pwrPTCRated_C "" VALUE 0x7001117c Scalar_FLOAT32_IEEE 0 VBU0428Test_CM_single_kW 0.0 1000.0 /end CHARACTERISTIC
/begin CHARACTERISTIC EDIS_tiBattPowLackDelay_C "" VALUE 0x70011194 Scalar_FLOAT32_IEEE 0 VBU0428Test_CM_single_cnt -3.4028234663852886E+38 3.4028234663852886E+38 /end CHARACTERISTIC
/begin CHARACTERISTIC EDIS_tiDrvPwrFilter_C "" VALUE 0x70011198 Scalar_FLOAT32_IEEE 0 VBU0428Test_CM_single_cnt -3.4028234663852886E+38 3.4028234663852886E+38 /end CHARACTERISTIC
/begin CHARACTERISTIC EDIS_tiRgnPwrFilter_C "" VALUE 0x700111a0 Scalar_FLOAT32_IEEE 0 VBU0428Test_CM_single_cnt -3.4028234663852886E+38 3.4028234663852886E+38 /end CHARACTERISTIC
/begin CHARACTERISTIC EDIS_tiSmplT_SY "" VALUE 0x700111a4 Scalar_FLOAT32_IEEE 0 VBU0428Test_CM_single_s -3.4028234663852886E+38 3.4028234663852886E+38 /end CHARACTERISTIC
/begin CHARACTERISTIC EPS_cntECUMsgCntOvrdVal_C "" VALUE 0x70011200 Scalar_FLOAT32_IEEE 0 VBU0428Test_CM_single 0.0 4.294967295E+9 /end CHARACTERISTIC
/begin CHARACTERISTIC EPS_flgCntECUMsgCntOvrd_C "" VALUE 0x70011208 Scalar_FLOAT32_IEEE 0 VBU0428Test_CM_single 0.0 1.0 /end CHARACTERISTIC
/begin CHARACTERISTIC EPS_flgPhiStrngAgOvrd_C "" VALUE 0x70011210 Scalar_FLOAT32_IEEE 0 VBU0428Test_CM_single 0.0 1.0 /end CHARACTERISTIC
/begin CHARACTERISTIC EPS_phiStrngAgOvrdVal_C "" VALUE 0x70011220 Scalar_FLOAT32_IEEE 0 VBU0428Test_CM_single -3.40282346638528E+38 3.40282346638528E+38 /end CHARACTERISTIC
/begin CHARACTERISTIC IC_flgBrkDisWarnOvrdVal_C "" VALUE 0x700112b8 Scalar_FLOAT32_IEEE 0 VBU0428Test_CM_single 0.0 1.0 /end CHARACTERISTIC
/begin CHARACTERISTIC IC_flgBrkFluidWarnOvrdVal_C "" VALUE 0x700112bc Scalar_FLOAT32_IEEE 0 VBU0428Test_CM_single 0.0 1.0 /end CHARACTERISTIC
/begin CHARACTERISTIC IC_flgFlgBrkDisWarnOvrd_C "" VALUE 0x700112c0 Scalar_FLOAT32_IEEE 0 VBU0428Test_CM_single 0.0 1.0 /end CHARACTERISTIC
/begin CHARACTERISTIC IC_flgFlgBrkFluidWarnOvrd_C "" VALUE 0x700112c4 Scalar_FLOAT32_IEEE 0 VBU0428Test_CM_single 0.0 1.0 /end CHARACTERISTIC
/begin CHARACTERISTIC IC_flgFlgSeatbeltUnlockOvrd_C "" VALUE 0x700112c8 Scalar_FLOAT32_IEEE 0 VBU0428Test_CM_single 0.0 1.0 /end CHARACTERISTIC
/begin CHARACTERISTIC IC_flgKmVehOdmeterOvrd_C "" VALUE 0x700112cc Scalar_FLOAT32_IEEE 0 VBU0428Test_CM_single 0.0 1.0 /end CHARACTERISTIC
/begin CHARACTERISTIC IC_flgSeatbeltUnlockOvrdVal_C "" VALUE 0x700112d0 Scalar_FLOAT32_IEEE 0 VBU0428Test_CM_single 0.0 1.0 /end CHARACTERISTIC
/begin CHARACTERISTIC IC_kmVehOdmeterOvrdVal_C "" VALUE 0x700112d4 Scalar_FLOAT32_IEEE 0 VBU0428Test_CM_single -3.40282346638528E+38 3.40282346638528E+38 /end CHARACTERISTIC
/begin CHARACTERISTIC LVC_uDCDCReq_C "" VALUE 0x700113b0 Scalar_FLOAT32_IEEE 0 VBU0428Test_CM_single_cnt -3.4028234663852886E+38 3.4028234663852886E+38 /end CHARACTERISTIC
/begin CHARACTERISTIC LVC_uDcdcHvMax_C "" VALUE 0x700113b4 Scalar_FLOAT32_IEEE 0 VBU0428Test_CM_single_cnt -3.4028234663852886E+38 3.4028234663852886E+38 /end CHARACTERISTIC
/begin CHARACTERISTIC LVC_uDcdcHvMin_C "" VALUE 0x700113b8 Scalar_FLOAT32_IEEE 0 VBU0428Test_CM_single_cnt -3.4028234663852886E+38 3.4028234663852886E+38 /end CHARACTERISTIC
/begin CHARACTERISTIC PEUR_flgBusOvrVltgOvrdVal_C "" VALUE 0x700113f8 Scalar_FLOAT32_IEEE 0 VBU0428Test_CM_single 0.0 1.0 /end CHARACTERISTIC
/begin CHARACTERISTIC PEUR_flgBusUndrVltgOvrdVal_C "" VALUE 0x700113fc Scalar_FLOAT32_IEEE 0 VBU0428Test_CM_single 0.0 1.0 /end CHARACTERISTIC
/begin CHARACTERISTIC PEUR_flgCANFaultOvrdVal_C "" VALUE 0x70011400 Scalar_FLOAT32_IEEE 0 VBU0428Test_CM_single 0.0 1.0 /end CHARACTERISTIC
/begin CHARACTERISTIC PEUR_flgDrvDownarmFailOvrdVal_C "" VALUE 0x70011404 Scalar_FLOAT32_IEEE 0 VBU0428Test_CM_single 0.0 1.0 /end CHARACTERISTIC
/begin CHARACTERISTIC PEUR_flgDrvUparmFailOvrdVal_C "" VALUE 0x70011408 Scalar_FLOAT32_IEEE 0 VBU0428Test_CM_single 0.0 1.0 /end CHARACTERISTIC
/begin CHARACTERISTIC PEUR_flgFlgBusOvrVltgOvrd_C "" VALUE 0x7001140c Scalar_FLOAT32_IEEE 0 VBU0428Test_CM_single 0.0 1.0 /end CHARACTERISTIC
/begin CHARACTERISTIC PEUR_flgFlgBusUndrVltgOvrd_C "" VALUE 0x70011410 Scalar_FLOAT32_IEEE 0 VBU0428Test_CM_single 0.0 1.0 /end CHARACTERISTIC
/begin CHARACTERISTIC PEUR_flgFlgCANFaultOvrd_C "" VALUE 0x70011414 Scalar_FLOAT32_IEEE 0 VBU0428Test_CM_single 0.0 1.0 /end CHARACTERISTIC
/begin CHARACTERISTIC PEUR_flgFlgDrvDownarmFailOvrd_C "" VALUE 0x70011418 Scalar_FLOAT32_IEEE 0 VBU0428Test_CM_single 0.0 1.0 /end CHARACTERISTIC
/begin CHARACTERISTIC PEUR_flgFlgDrvUparmFailOvrd_C "" VALUE 0x7001141c Scalar_FLOAT32_IEEE 0 VBU0428Test_CM_single 0.0 1.0 /end CHARACTERISTIC
/begin CHARACTERISTIC PEUR_flgFlgHWUnderVoltOvrd_C "" VALUE 0x70011420 Scalar_FLOAT32_IEEE 0 VBU0428Test_CM_single 0.0 1.0 /end CHARACTERISTIC
/begin CHARACTERISTIC PEUR_flgFlgHallFaultOvrd_C "" VALUE 0x70011424 Scalar_FLOAT32_IEEE 0 VBU0428Test_CM_single 0.0 1.0 /end CHARACTERISTIC
/begin CHARACTERISTIC PEUR_flgFlgHwOvrVloltOvrd_C "" VALUE 0x70011428 Scalar_FLOAT32_IEEE 0 VBU0428Test_CM_single 0.0 1.0 /end CHARACTERISTIC
/begin CHARACTERISTIC PEUR_flgFlgIGBTFaultOvrd_C "" VALUE 0x7001142c Scalar_FLOAT32_IEEE 0 VBU0428Test_CM_single 0.0 1.0 /end CHARACTERISTIC
/begin CHARACTERISTIC PEUR_flgFlgIGBTJunctionOvrTempLimOvrd_C "" VALUE 0x70011430 Scalar_FLOAT32_IEEE 0 VBU0428Test_CM_single 0.0 1.0 /end CHARACTERISTIC
/begin CHARACTERISTIC PEUR_flgFlgIGBTNTCOvrTempLimOvrd_C "" VALUE 0x70011434 Scalar_FLOAT32_IEEE 0 VBU0428Test_CM_single 0.0 1.0 /end CHARACTERISTIC
/begin CHARACTERISTIC PEUR_flgFlgIGBTOvrHeatOvrd_C "" VALUE 0x70011438 Scalar_FLOAT32_IEEE 0 VBU0428Test_CM_single 0.0 1.0 /end CHARACTERISTIC
/begin CHARACTERISTIC PEUR_flgFlgMotrHillHldOvrd_C "" VALUE 0x7001143c Scalar_FLOAT32_IEEE 0 VBU0428Test_CM_single 0.0 1.0 /end CHARACTERISTIC
/begin CHARACTERISTIC PEUR_flgFlgMotrOvrHeatOvrd_C "" VALUE 0x70011440 Scalar_FLOAT32_IEEE 0 VBU0428Test_CM_single 0.0 1.0 /end CHARACTERISTIC
/begin CHARACTERISTIC PEUR_flgFlgMotrOvrTempLimOvrd_C "" VALUE 0x70011444 Scalar_FLOAT32_IEEE 0 VBU0428Test_CM_single 0.0 1.0 /end CHARACTERISTIC
/begin CHARACTERISTIC PEUR_flgFlgMotrSpdVldOvrd_C "" VALUE 0x70011448 Scalar_FLOAT32_IEEE 0 VBU0428Test_CM_single 0.0 1.0 /end CHARACTERISTIC
/begin CHARACTERISTIC PEUR_flgFlgOutputPhaseFaultOvrd_C "" VALUE 0x7001144c Scalar_FLOAT32_IEEE 0 VBU0428Test_CM_single 0.0 1.0 /end CHARACTERISTIC
/begin CHARACTERISTIC PEUR_flgFlgOvrCurrOvrd_C "" VALUE 0x70011450 Scalar_FLOAT32_IEEE 0 VBU0428Test_CM_single 0.0 1.0 /end CHARACTERISTIC
/begin CHARACTERISTIC PEUR_flgFlgOvrSpdOvrd_C "" VALUE 0x70011454 Scalar_FLOAT32_IEEE 0 VBU0428Test_CM_single 0.0 1.0 /end CHARACTERISTIC
/begin CHARACTERISTIC PEUR_flgFlgRadiatorOvrTempLimOvrd_C "" VALUE 0x70011458 Scalar_FLOAT32_IEEE 0 VBU0428Test_CM_single 0.0 1.0 /end CHARACTERISTIC
/begin CHARACTERISTIC PEUR_flgFlgResolverFaultOvrd_C "" VALUE 0x7001145c Scalar_FLOAT32_IEEE 0 VBU0428Test_CM_single 0.0 1.0 /end CHARACTERISTIC
/begin CHARACTERISTIC PEUR_flgHWUnderVoltOvrdVal_C "" VALUE 0x70011460 Scalar_FLOAT32_IEEE 0 VBU0428Test_CM_single 0.0 1.0 /end CHARACTERISTIC
/begin CHARACTERISTIC PEUR_flgHallFaultOvrdVal_C "" VALUE 0x70011464 Scalar_FLOAT32_IEEE 0 VBU0428Test_CM_single 0.0 1.0 /end CHARACTERISTIC
/begin CHARACTERISTIC PEUR_flgHwOvrVloltOvrdVal_C "" VALUE 0x70011468 Scalar_FLOAT32_IEEE 0 VBU0428Test_CM_single 0.0 1.0 /end CHARACTERISTIC
/begin CHARACTERISTIC PEUR_flgICalcDCOvrd_C "" VALUE 0x7001146c Scalar_FLOAT32_IEEE 0 VBU0428Test_CM_single 0.0 1.0 /end CHARACTERISTIC
/begin CHARACTERISTIC PEUR_flgIGBTFaultOvrdVal_C "" VALUE 0x70011470 Scalar_FLOAT32_IEEE 0 VBU0428Test_CM_single 0.0 1.0 /end CHARACTERISTIC
/begin CHARACTERISTIC PEUR_flgIGBTJunctionOvrTempLimOvrdVal_C "" VALUE 0x70011474 Scalar_FLOAT32_IEEE 0 VBU0428Test_CM_single 0.0 1.0 /end CHARACTERISTIC
/begin CHARACTERISTIC PEUR_flgIGBTNTCOvrTempLimOvrdVal_C "" VALUE 0x70011478 Scalar_FLOAT32_IEEE 0 VBU0428Test_CM_single 0.0 1.0 /end CHARACTERISTIC
/begin CHARACTERISTIC PEUR_flgIGBTOvrHeatOvrdVal_C "" VALUE 0x7001147c Scalar_FLOAT32_IEEE 0 VBU0428Test_CM_single 0.0 1.0 /end CHARACTERISTIC
/begin CHARACTERISTIC PEUR_flgIUVWMaxCurrOvrd_C "" VALUE 0x70011480 Scalar_FLOAT32_IEEE 0 VBU0428Test_CM_single 0.0 1.0 /end CHARACTERISTIC
/begin CHARACTERISTIC PEUR_flgMotrHillHldOvrdVal_C "" VALUE 0x70011484 Scalar_FLOAT32_IEEE 0 VBU0428Test_CM_single 0.0 1.0 /end CHARACTERISTIC
/begin CHARACTERISTIC PEUR_flgMotrOvrHeatOvrdVal_C "" VALUE 0x70011488 Scalar_FLOAT32_IEEE 0 VBU0428Test_CM_single 0.0 1.0 /end CHARACTERISTIC
/begin CHARACTERISTIC PEUR_flgMotrOvrTempLimOvrdVal_C "" VALUE 0x7001148c Scalar_FLOAT32_IEEE 0 VBU0428Test_CM_single 0.0 1.0 /end CHARACTERISTIC
/begin CHARACTERISTIC PEUR_flgMotrSpdVldOvrdVal_C "" VALUE 0x70011490 Scalar_FLOAT32_IEEE 0 VBU0428Test_CM_single 0.0 1.0 /end CHARACTERISTIC
/begin CHARACTERISTIC PEUR_flgNMotrOvrd_C "" VALUE 0x70011494 Scalar_FLOAT32_IEEE 0 VBU0428Test_CM_single 0.0 1.0 /end CHARACTERISTIC
/begin CHARACTERISTIC PEUR_flgOutputPhaseFaultOvrdVal_C "" VALUE 0x70011498 Scalar_FLOAT32_IEEE 0 VBU0428Test_CM_single 0.0 1.0 /end CHARACTERISTIC
/begin CHARACTERISTIC PEUR_flgOvrCurrOvrdVal_C "" VALUE 0x7001149c Scalar_FLOAT32_IEEE 0 VBU0428Test_CM_single 0.0 1.0 /end CHARACTERISTIC
/begin CHARACTERISTIC PEUR_flgOvrSpdOvrdVal_C "" VALUE 0x700114a0 Scalar_FLOAT32_IEEE 0 VBU0428Test_CM_single 0.0 1.0 /end CHARACTERISTIC
/begin CHARACTERISTIC PEUR_flgRadiatorOvrTempLimOvrdVal_C "" VALUE 0x700114a4 Scalar_FLOAT32_IEEE 0 VBU0428Test_CM_single 0.0 1.0 /end CHARACTERISTIC
/begin CHARACTERISTIC PEUR_flgResolverFaultOvrdVal_C "" VALUE 0x700114a8 Scalar_FLOAT32_IEEE 0 VBU0428Test_CM_single 0.0 1.0 /end CHARACTERISTIC
/begin CHARACTERISTIC PEUR_flgStActvDisChOvrd_C "" VALUE 0x700114ac Scalar_FLOAT32_IEEE 0 VBU0428Test_CM_single 0.0 1.0 /end CHARACTERISTIC
/begin CHARACTERISTIC PEUR_flgStFaultOvrd_C "" VALUE 0x700114b0 Scalar_FLOAT32_IEEE 0 VBU0428Test_CM_single 0.0 1.0 /end CHARACTERISTIC
/begin CHARACTERISTIC PEUR_flgStInvrOvrd_C "" VALUE 0x700114b4 Scalar_FLOAT32_IEEE 0 VBU0428Test_CM_single 0.0 1.0 /end CHARACTERISTIC
/begin CHARACTERISTIC PEUR_flgTIPMTempOvrd_C "" VALUE 0x700114b8 Scalar_FLOAT32_IEEE 0 VBU0428Test_CM_single 0.0 1.0 /end CHARACTERISTIC
/begin CHARACTERISTIC PEUR_flgTMeasMaxPhUVWOvrd_C "" VALUE 0x700114bc Scalar_FLOAT32_IEEE 0 VBU0428Test_CM_single 0.0 1.0 /end CHARACTERISTIC
/begin CHARACTERISTIC PEUR_flgTMeasMaxStrOvrd_C "" VALUE 0x700114c0 Scalar_FLOAT32_IEEE 0 VBU0428Test_CM_single 0.0 1.0 /end CHARACTERISTIC
/begin CHARACTERISTIC PEUR_flgTrqActOvrd_C "" VALUE 0x700114c4 Scalar_FLOAT32_IEEE 0 VBU0428Test_CM_single 0.0 1.0 /end CHARACTERISTIC
/begin CHARACTERISTIC PEUR_flgTrqMaxLimitOvrd_C "" VALUE 0x700114c8 Scalar_FLOAT32_IEEE 0 VBU0428Test_CM_single 0.0 1.0 /end CHARACTERISTIC
/begin CHARACTERISTIC PEUR_flgUDCRlyOutsideVltgOvrd_C "" VALUE 0x700114cc Scalar_FLOAT32_IEEE 0 VBU0428Test_CM_single 0.0 1.0 /end CHARACTERISTIC
/begin CHARACTERISTIC PEUR_flgUMeasDCOvrd_C "" VALUE 0x700114d0 Scalar_FLOAT32_IEEE 0 VBU0428Test_CM_single 0.0 1.0 /end CHARACTERISTIC
/begin CHARACTERISTIC PEUR_iCalcDCOvrdVal_C "" VALUE 0x700114d4 Scalar_FLOAT32_IEEE 0 VBU0428Test_CM_single -3.40282346638528E+38 3.40282346638528E+38 /end CHARACTERISTIC
/begin CHARACTERISTIC PEUR_iUVWMaxCurrOvrdVal_C "" VALUE 0x700114d8 Scalar_FLOAT32_IEEE 0 VBU0428Test_CM_single -3.40282346638528E+38 3.40282346638528E+38 /end CHARACTERISTIC
/begin CHARACTERISTIC PEUR_nMotrOvrdVal_C "" VALUE 0x700114dc Scalar_FLOAT32_IEEE 0 VBU0428Test_CM_single -3.40282346638528E+38 3.40282346638528E+38 /end CHARACTERISTIC
/begin CHARACTERISTIC PEUR_stActvDisChOvrdVal_C "" VALUE 0x700114e0 Scalar_FLOAT32_IEEE 0 VBU0428Test_CM_single 0.0 255.0 /end CHARACTERISTIC
/begin CHARACTERISTIC PEUR_stFaultOvrdVal_C "" VALUE 0x700114e4 Scalar_FLOAT32_IEEE 0 VBU0428Test_CM_single 0.0 255.0 /end CHARACTERISTIC
/begin CHARACTERISTIC PEUR_stInvrOvrdVal_C "" VALUE 0x700114e8 Scalar_FLOAT32_IEEE 0 VBU0428Test_CM_single 0.0 255.0 /end CHARACTERISTIC
/begin CHARACTERISTIC PEUR_tIPMTempOvrdVal_C "" VALUE 0x700114ec Scalar_FLOAT32_IEEE 0 VBU0428Test_CM_single -3.40282346638528E+38 3.40282346638528E+38 /end CHARACTERISTIC
/begin CHARACTERISTIC PEUR_tMeasMaxPhUVWOvrdVal_C "" VALUE 0x700114f0 Scalar_FLOAT32_IEEE 0 VBU0428Test_CM_single -3.40282346638528E+38 3.40282346638528E+38 /end CHARACTERISTIC
/begin CHARACTERISTIC PEUR_tMeasMaxStrOvrdVal_C "" VALUE 0x700114f4 Scalar_FLOAT32_IEEE 0 VBU0428Test_CM_single -3.40282346638528E+38 3.40282346638528E+38 /end CHARACTERISTIC
/begin CHARACTERISTIC PEUR_trqActOvrdVal_C "" VALUE 0x700114f8 Scalar_FLOAT32_IEEE 0 VBU0428Test_CM_single -3.40282346638528E+38 3.40282346638528E+38 /end CHARACTERISTIC
/begin CHARACTERISTIC PEUR_trqMaxLimitOvrdVal_C "" VALUE 0x700114fc Scalar_FLOAT32_IEEE 0 VBU0428Test_CM_single -3.40282346638528E+38 3.40282346638528E+38 /end CHARACTERISTIC
/begin CHARACTERISTIC PEUR_uDCRlyOutsideVltgOvrdVal_C "" VALUE 0x70011500 Scalar_FLOAT32_IEEE 0 VBU0428Test_CM_single -3.40282346638528E+38 3.40282346638528E+38 /end CHARACTERISTIC
/begin CHARACTERISTIC PEUR_uMeasDCOvrdVal_C "" VALUE 0x70011504 Scalar_FLOAT32_IEEE 0 VBU0428Test_CM_single -3.40282346638528E+38 3.40282346638528E+38 /end CHARACTERISTIC
/begin CHARACTERISTIC PMM_iCtlShtDwnOffLoad_C "" VALUE 0x70011508 Scalar_FLOAT32_IEEE 0 VBU0428Test_CM_single_cnt -400.0 400.0 /end CHARACTERISTIC
/begin CHARACTERISTIC PMM_iEmgShtDwnOffLoad_C "" VALUE 0x7001150c Scalar_FLOAT32_IEEE 0 VBU0428Test_CM_single_cnt -400.0 400.0 /end CHARACTERISTIC
/begin CHARACTERISTIC PMM_iNrmlShtDwnOffLoad_C "" VALUE 0x70011510 Scalar_FLOAT32_IEEE 0 VBU0428Test_CM_single_cnt -400.0 400.0 /end CHARACTERISTIC
/begin CHARACTERISTIC PMM_pctBrkPos4HV_C "" VALUE 0x70011514 Scalar_FLOAT32_IEEE 0 VBU0428Test_CM_single_cnt 0.0 100.0 /end CHARACTERISTIC
/begin CHARACTERISTIC PMM_tiCtlShtDwnOffLoad_C "" VALUE 0x70011520 Scalar_FLOAT32_IEEE 0 VBU0428Test_CM_single_cnt 0.0 100.0 /end CHARACTERISTIC
/begin CHARACTERISTIC PMM_tiDCHShtDwnOffLoad_C "" VALUE 0x70011528 Scalar_FLOAT32_IEEE 0 VBU0428Test_CM_single_cnt 0.0 100.0 /end CHARACTERISTIC
/begin CHARACTERISTIC PMM_tiDlyHVClReqSrcOff_C "" VALUE 0x70011548 Scalar_FLOAT32_IEEE 0 VBU0428Test_CM_single_cnt -3.4028234663852886E+38 3.4028234663852886E+38 /end CHARACTERISTIC
/begin CHARACTERISTIC PMM_tiDlyHVRlyReqCC2_C "" VALUE 0x7001154c Scalar_FLOAT32_IEEE 0 VBU0428Test_CM_single_cnt -3.4028234663852886E+38 3.4028234663852886E+38 /end CHARACTERISTIC
/begin CHARACTERISTIC PMM_tiDlyIgnOnHVReq_C "" VALUE 0x70011554 Scalar_FLOAT32_IEEE 0 VBU0428Test_CM_single_cnt 0.0 10.0 /end CHARACTERISTIC
/begin CHARACTERISTIC PMM_tiDlyOffLoadCnfrm_C "" VALUE 0x70011560 Scalar_FLOAT32_IEEE 0 VBU0428Test_CM_single_cnt -3.4028234663852886E+38 3.4028234663852886E+38 /end CHARACTERISTIC
/begin CHARACTERISTIC PMM_tiDlyPwrUpNokResp_C "" VALUE 0x70011570 Scalar_FLOAT32_IEEE 0 VBU0428Test_CM_single_cnt -3.4028234663852886E+38 3.4028234663852886E+38 /end CHARACTERISTIC
/begin CHARACTERISTIC PMM_tiDlyVCUSwtOff_C "" VALUE 0x70011584 Scalar_FLOAT32_IEEE 0 VBU0428Test_CM_single_cnt -3.4028234663852886E+38 3.4028234663852886E+38 /end CHARACTERISTIC
/begin CHARACTERISTIC PMM_tiDlyWkup1Cmd_SY "" VALUE 0x7001158c Scalar_FLOAT32_IEEE 0 VBU0428Test_CM_single -3.4E+38 3.4E+38 /end CHARACTERISTIC
/begin CHARACTERISTIC PMM_tiEmgShtDwnOffLoad_C "" VALUE 0x70011590 Scalar_FLOAT32_IEEE 0 VBU0428Test_CM_single_cnt 0.0 100.0 /end CHARACTERISTIC
/begin CHARACTERISTIC PMM_tiInitToHVRlyClReq_C "" VALUE 0x7001159c Scalar_FLOAT32_IEEE 0 VBU0428Test_CM_single_cnt -3.4028234663852886E+38 3.4028234663852886E+38 /end CHARACTERISTIC
/begin CHARACTERISTIC PMM_tiNrmlShtDwnOffLoad_C "" VALUE 0x700115a4 Scalar_FLOAT32_IEEE 0 VBU0428Test_CM_single_cnt 0.0 100.0 /end CHARACTERISTIC
/begin CHARACTERISTIC PMM_uActvDisChVltg_C "" VALUE 0x700115b0 Scalar_FLOAT32_IEEE 0 VBU0428Test_CM_single_cnt 0.0 1000.0 /end CHARACTERISTIC
/begin CHARACTERISTIC PMM_vMaxSpdShtDwn_C "" VALUE 0x700115b8 Scalar_FLOAT32_IEEE 0 VBU0428Test_CM_single_cnt 0.0 255.0 /end CHARACTERISTIC
/begin CHARACTERISTIC PMM_vMinSpdShtDwn_C "" VALUE 0x700115bc Scalar_FLOAT32_IEEE 0 VBU0428Test_CM_single_cnt 0.0 255.0 /end CHARACTERISTIC
/begin CHARACTERISTIC PUER_flgCPLDStatusOvrdVal_C "" VALUE 0x700115c4 Scalar_FLOAT32_IEEE 0 VBU0428Test_CM_single 0.0 1.0 /end CHARACTERISTIC
/begin CHARACTERISTIC PUER_flgFlgCPLDStatusOvrd_C "" VALUE 0x700115c8 Scalar_FLOAT32_IEEE 0 VBU0428Test_CM_single 0.0 1.0 /end CHARACTERISTIC
/begin CHARACTERISTIC SPD_aBenchReset_C "" VALUE 0x700115d4 Scalar_FLOAT32_IEEE 0 VBU0428Test_CM_single_cnt -3.4028234663852886E+38 3.4028234663852886E+38 /end CHARACTERISTIC
/begin CHARACTERISTIC SPD_aBenchSetHi_C "" VALUE 0x700115d8 Scalar_FLOAT32_IEEE 0 VBU0428Test_CM_single_cnt -3.4028234663852886E+38 3.4028234663852886E+38 /end CHARACTERISTIC
/begin CHARACTERISTIC SPD_aBenchSetLow_C "" VALUE 0x700115dc Scalar_FLOAT32_IEEE 0 VBU0428Test_CM_single_cnt -3.4028234663852886E+38 3.4028234663852886E+38 /end CHARACTERISTIC
/begin CHARACTERISTIC SPD_cntBenchThd_C "" VALUE 0x700115e0 Scalar_FLOAT32_IEEE 0 VBU0428Test_CM_single_cnt -3.4028234663852886E+38 3.4028234663852886E+38 /end CHARACTERISTIC
/begin CHARACTERISTIC SPD_facAXFilter_C "" VALUE 0x700115e4 Scalar_FLOAT32_IEEE 0 VBU0428Test_CM_single_cnt -3.4028234663852886E+38 3.4028234663852886E+38 /end CHARACTERISTIC
/begin CHARACTERISTIC DSPL_numRngCalcAch_C "" VALUE 0x70010122 Scalar_UWORD 0 VBU0428Test_CM_uint16_cnt 0.0 65535.0 /end CHARACTERISTIC
/begin CHARACTERISTIC DCH_flgDCChDiagCmdOvrdVal_C "" VALUE 0x70022257 Scalar_BOOLEAN 0 VBU0428Test_CM_boolean_cnt 0.0 1.0 /end CHARACTERISTIC
/begin CHARACTERISTIC DCH_flgDCChDiagCmdOvrd_C "" VALUE 0x70022258 Scalar_BOOLEAN 0 VBU0428Test_CM_boolean_cnt 0.0 1.0 /end CHARACTERISTIC
/begin CHARACTERISTIC DCH_flgPosDCRlyReqOvrdVal_C "" VALUE 0x7002226e Scalar_BOOLEAN 0 VBU0428Test_CM_boolean_cnt 0.0 1.0 /end CHARACTERISTIC
/begin CHARACTERISTIC DCH_flgPosDCRlyReqOvrd_C "" VALUE 0x7002226f Scalar_BOOLEAN 0 VBU0428Test_CM_boolean_cnt 0.0 1.0 /end CHARACTERISTIC
/begin CHARACTERISTIC DSPL_flgSwapModeEn_C "" VALUE 0x700222ef Scalar_BOOLEAN 0 VBU0428Test_CM_boolean_flg 0.0 1.0 /end CHARACTERISTIC
/begin CHARACTERISTIC EDIS_flgACPowOverride_C "" VALUE 0x700222fd Scalar_BOOLEAN 0 VBU0428Test_CM_boolean_cnt 0.0 1.0 /end CHARACTERISTIC
/begin CHARACTERISTIC EDIS_flgDCDCPowOverride_C "" VALUE 0x700222ff Scalar_BOOLEAN 0 VBU0428Test_CM_boolean_cnt 0.0 1.0 /end CHARACTERISTIC
/begin CHARACTERISTIC EDIS_flgHVHPowOverride_C "" VALUE 0x70022302 Scalar_BOOLEAN 0 VBU0428Test_CM_boolean_cnt 0.0 1.0 /end CHARACTERISTIC
/begin CHARACTERISTIC EDIS_flgNoUsePowLackUpGrad_C "" VALUE 0x70022303 Scalar_BOOLEAN 0 VBU0428Test_CM_boolean_cnt 0.0 1.0 /end CHARACTERISTIC
/begin CHARACTERISTIC EDIS_flgPTCPowOverride_C "" VALUE 0x70022305 Scalar_BOOLEAN 0 VBU0428Test_CM_boolean_cnt 0.0 1.0 /end CHARACTERISTIC
/begin CHARACTERISTIC EDIS_flgUseAcsPwrReq_C "" VALUE 0x70022306 Scalar_BOOLEAN 0 VBU0428Test_CM_boolean_cnt 0.0 1.0 /end CHARACTERISTIC
/begin CHARACTERISTIC EDIS_flgUseDynChPwrComfort_C "" VALUE 0x70022307 Scalar_BOOLEAN 0 VBU0428Test_CM_boolean_cnt 0.0 1.0 /end CHARACTERISTIC
/begin CHARACTERISTIC PMM_flgOffLoadTOutToHVOpReqSwt_C "" VALUE 0x700223d0 Scalar_BOOLEAN 0 VBU0428Test_CM_boolean_cnt 0.0 1.0 /end CHARACTERISTIC
/begin CHARACTERISTIC PMM_flgVCUShtDwnOvrdSwt_C "" VALUE 0x700223db Scalar_BOOLEAN 0 VBU0428Test_CM_boolean_cnt 0.0 1.0 /end CHARACTERISTIC
/begin CHARACTERISTIC PMM_flgVCUShtDwnOvrdVal_C "" VALUE 0x700223dc Scalar_BOOLEAN 0 VBU0428Test_CM_boolean_cnt 0.0 1.0 /end CHARACTERISTIC
/begin CHARACTERISTIC PMM_flgWkup1CmdOvrdSwt_C "" VALUE 0x700223e2 Scalar_BOOLEAN 0 VBU0428Test_CM_boolean_cnt 0.0 1.0 /end CHARACTERISTIC
/begin CHARACTERISTIC PMM_flgWkup1CmdOvrdVal_C "" VALUE 0x700223e3 Scalar_BOOLEAN 0 VBU0428Test_CM_boolean_cnt 0.0 1.0 /end CHARACTERISTIC
/begin CHARACTERISTIC DCH_stBMSChrging_SY "" VALUE 0x70022297 Scalar_UBYTE 0 VBU0428Test_CM_uint8_cnt 0.0 255.0 /end CHARACTERISTIC
/begin CHARACTERISTIC DCH_stHVCntctClosed_SY "" VALUE 0x700222ae Scalar_UBYTE 0 VBU0428Test_CM_uint8_cnt 0.0 255.0 /end CHARACTERISTIC
/begin CHARACTERISTIC DIAGS_stPsvRespAlreadyOk_SY "" VALUE 0x700222e8 Scalar_UBYTE 0 VBU0428Test_CM_uint8_cnt 0.0 255.0 /end CHARACTERISTIC
/begin CHARACTERISTIC DSPL_cntDriveTempReset_C "" VALUE 0x700222ec Scalar_UBYTE 0 VBU0428Test_CM_uint8_cnt 0.0 255.0 /end CHARACTERISTIC
/begin CHARACTERISTIC DSPL_stDCPortTempNoErr_C "" VALUE 0x700222f5 Scalar_UBYTE 0 VBU0428Test_CM_uint8_cnt 0.0 255.0 /end CHARACTERISTIC
/begin CHARACTERISTIC PMM_stACChMode_SY "" VALUE 0x700223e5 Scalar_UBYTE 0 VBU0428Test_CM_uint8_cnt 0.0 255.0 /end CHARACTERISTIC
/begin CHARACTERISTIC PMM_stDCDCWrking_SY "" VALUE 0x700223eb Scalar_UBYTE 0 VBU0428Test_CM_uint8_cnt 0.0 255.0 /end CHARACTERISTIC
/begin CHARACTERISTIC PMM_stDCHInitSts_SY "" VALUE 0x700223ec Scalar_UBYTE 0 VBU0428Test_CM_uint8_cnt 0.0 255.0 /end CHARACTERISTIC
/begin CHARACTERISTIC PMM_stDCHShtDwnSts_SY "" VALUE 0x700223ed Scalar_UBYTE 0 VBU0428Test_CM_uint8_cnt 0.0 255.0 /end CHARACTERISTIC
/begin CHARACTERISTIC SYS_stShftPosNeutr_SY "" VALUE 0x7002242c Scalar_UBYTE 0 VBU0428Test_CM_uint8_cnt 0.0 255.0 /end CHARACTERISTIC
/begin CHARACTERISTIC SYS_stShftPosPark_SY "" VALUE 0x7002242d Scalar_UBYTE 0 VBU0428Test_CM_uint8_cnt 0.0 255.0 /end CHARACTERISTIC
/begin MEASUREMENT LEM_BatteryCurrent "" ULONG VBU0428Test_CM_ufix32_Bn2147483648 0 0 -2.147483648E+9 2.147483647E+9 ECU_ADDRESS 0x6003bf96 /end MEASUREMENT
/begin MEASUREMENT LEM_SensorName "" ULONG VBU0428Test_CM_ufix24 0 0 0 1.6777215E+7 ECU_ADDRESS 0x6003bf9a /end MEASUREMENT
/begin MEASUREMENT EDIS_pwrDisChBattPwr "" FLOAT32_IEEE VBU0428Test_CM_single 0 0 -3.4E+38 3.4E+38 ECU_ADDRESS 0x9000010c /end MEASUREMENT
/begin MEASUREMENT EDIS_pwrDchaDelta "" FLOAT32_IEEE VBU0428Test_CM_single 0 0 -1000.0 1000.0 ECU_ADDRESS 0x6003bdea /end MEASUREMENT
/begin MEASUREMENT EDIS_pwrPIDDisChgFnl "" FLOAT32_IEEE VBU0428Test_CM_single 0 0 -3.4E+38 3.4E+38 ECU_ADDRESS 0x6003be12 /end MEASUREMENT
/begin MEASUREMENT EDIS_pwrBattMaxPwr "" FLOAT32_IEEE VBU0428Test_CM_single 0 0 0.0 1000.0 ECU_ADDRESS 0x6003bdd6 /end MEASUREMENT
/begin MEASUREMENT EDIS_pwrBattMaxPwrFnl "" FLOAT32_IEEE VBU0428Test_CM_single 0 0 0.0 1000.0 ECU_ADDRESS 0x6003bdda /end MEASUREMENT
/begin MEASUREMENT EDIS_pwrAcsPwrReq "" FLOAT32_IEEE VBU0428Test_CM_single 0 0 -3.4E+38 3.4E+38 ECU_ADDRESS 0x6003bb42 /end MEASUREMENT
/begin MEASUREMENT EDIS_pwrDrvPwrLim "" FLOAT32_IEEE VBU0428Test_CM_single 0 0 -3.4E+38 3.4E+38 ECU_ADDRESS 0x6003bb5e /end MEASUREMENT
/begin MEASUREMENT EDIS_pwrRgnLim "" FLOAT32_IEEE VBU0428Test_CM_single 0 0 -3.4E+38 3.4E+38 ECU_ADDRESS 0x6003be26 /end MEASUREMENT
/begin MEASUREMENT EDIS_pwrRgnDelta "" FLOAT32_IEEE VBU0428Test_CM_single 0 0 -3.4E+38 3.4E+38 ECU_ADDRESS 0x6003be1a /end MEASUREMENT
/begin MEASUREMENT EDIS_pwrRgnPterm "" FLOAT32_IEEE VBU0428Test_CM_single 0 0 -3.4E+38 3.4E+38 ECU_ADDRESS 0x6003be2a /end MEASUREMENT
/begin MEASUREMENT EDIS_pwrRgnIterm "" FLOAT32_IEEE VBU0428Test_CM_single 0 0 -3.4E+38 3.4E+38 ECU_ADDRESS 0x6003be22 /end MEASUREMENT
/begin MEASUREMENT EDIS_pwrRgnDterm "" FLOAT32_IEEE VBU0428Test_CM_single 0 0 -3.4E+38 3.4E+38 ECU_ADDRESS 0x6003be1e /end MEASUREMENT
/begin MEASUREMENT EDIS_pwrRgn "" FLOAT32_IEEE VBU0428Test_CM_single 0 0 -3.4E+38 3.4E+38 ECU_ADDRESS 0x6003be16 /end MEASUREMENT
/begin MEASUREMENT EDIS_pwrBattMinPwrFnl "" FLOAT32_IEEE VBU0428Test_CM_single 0 0 0.0 1000.0 ECU_ADDRESS 0x6003bdde /end MEASUREMENT
/begin MEASUREMENT HV5_MP_Pcharge_Relay__AD "" UWORD VBU0428Test_CM_uint16 0 0 0 65535 ECU_ADDRESS 0x90001650 /end MEASUREMENT
/begin MEASUREMENT Hall1_AD "" UWORD VBU0428Test_CM_uint16 0 0 0 65535 ECU_ADDRESS 0x90001652 /end MEASUREMENT
/begin MEASUREMENT Hall2_AD "" UWORD VBU0428Test_CM_uint16 0 0 0 65535 ECU_ADDRESS 0x90001654 /end MEASUREMENT
/begin MEASUREMENT HV4_Heat_Fuse__AD "" UWORD VBU0428Test_CM_uint16 0 0 0 65535 ECU_ADDRESS 0x9000164e /end MEASUREMENT
/begin MEASUREMENT LINK_Relay_MN_AD "" UWORD VBU0428Test_CM_uint16 0 0 0 65535 ECU_ADDRESS 0x90001670 /end MEASUREMENT
/begin MEASUREMENT Total_Volt_B "" UWORD VBU0428Test_CM_uint16 0 0 0 65535 ECU_ADDRESS 0x900016a6 /end MEASUREMENT
/begin MEASUREMENT CellVolt33 "" UWORD VBU0428Test_CM_uint16 0 0 0 65535 ECU_ADDRESS 0x900015aa /end MEASUREMENT
/begin MEASUREMENT CellVolt34 "" UWORD VBU0428Test_CM_uint16 0 0 0 65535 ECU_ADDRESS 0x900015ac /end MEASUREMENT
/begin MEASUREMENT CellVolt35 "" UWORD VBU0428Test_CM_uint16 0 0 0 65535 ECU_ADDRESS 0x900015ae /end MEASUREMENT
/begin MEASUREMENT CellVolt36 "" UWORD VBU0428Test_CM_uint16 0 0 0 65535 ECU_ADDRESS 0x900015b0 /end MEASUREMENT
/begin MEASUREMENT CellVolt29 "" UWORD VBU0428Test_CM_uint16 0 0 0 65535 ECU_ADDRESS 0x900015a0 /end MEASUREMENT
/begin MEASUREMENT CellVolt30 "" UWORD VBU0428Test_CM_uint16 0 0 0 65535 ECU_ADDRESS 0x900015a4 /end MEASUREMENT
/begin MEASUREMENT CellVolt31 "" UWORD VBU0428Test_CM_uint16 0 0 0 65535 ECU_ADDRESS 0x900015a6 /end MEASUREMENT
/begin MEASUREMENT CellVolt32 "" UWORD VBU0428Test_CM_uint16 0 0 0 65535 ECU_ADDRESS 0x900015a8 /end MEASUREMENT
/begin MEASUREMENT CellVolt25 "" UWORD VBU0428Test_CM_uint16 0 0 0 65535 ECU_ADDRESS 0x90001598 /end MEASUREMENT
/begin MEASUREMENT CellVolt26 "" UWORD VBU0428Test_CM_uint16 0 0 0 65535 ECU_ADDRESS 0x9000159a /end MEASUREMENT
/begin MEASUREMENT CellVolt27 "" UWORD VBU0428Test_CM_uint16 0 0 0 65535 ECU_ADDRESS 0x9000159c /end MEASUREMENT
/begin MEASUREMENT CellVolt28 "" UWORD VBU0428Test_CM_uint16 0 0 0 65535 ECU_ADDRESS 0x9000159e /end MEASUREMENT
/begin MEASUREMENT CellVolt21 "" UWORD VBU0428Test_CM_uint16 0 0 0 65535 ECU_ADDRESS 0x90001590 /end MEASUREMENT
/begin MEASUREMENT CellVolt22 "" UWORD VBU0428Test_CM_uint16 0 0 0 65535 ECU_ADDRESS 0x90001592 /end MEASUREMENT
/begin MEASUREMENT CellVolt23 "" UWORD VBU0428Test_CM_uint16 0 0 0 65535 ECU_ADDRESS 0x90001594 /end MEASUREMENT
/begin MEASUREMENT CellVolt24 "" UWORD VBU0428Test_CM_uint16 0 0 0 65535 ECU_ADDRESS 0x90001596 /end MEASUREMENT
/begin MEASUREMENT CellVolt197 "" UWORD VBU0428Test_CM_uint16 0 0 0 65535 ECU_ADDRESS 0x90001584 /end MEASUREMENT
/begin MEASUREMENT CellVolt198 "" UWORD VBU0428Test_CM_uint16 0 0 0 65535 ECU_ADDRESS 0x90001586 /end MEASUREMENT
/begin MEASUREMENT CellVolt199 "" UWORD VBU0428Test_CM_uint16 0 0 0 65535 ECU_ADDRESS 0x90001588 /end MEASUREMENT
/begin MEASUREMENT CellVolt200 "" UWORD VBU0428Test_CM_uint16 0 0 0 65535 ECU_ADDRESS 0x9000158e /end MEASUREMENT
/begin MEASUREMENT CellVolt17 "" UWORD VBU0428Test_CM_uint16 0 0 0 65535 ECU_ADDRESS 0x90001548 /end MEASUREMENT
/begin MEASUREMENT CellVolt18 "" UWORD VBU0428Test_CM_uint16 0 0 0 65535 ECU_ADDRESS 0x9000155e /end MEASUREMENT
/begin MEASUREMENT CellVolt19 "" UWORD VBU0428Test_CM_uint16 0 0 0 65535 ECU_ADDRESS 0x90001574 /end MEASUREMENT
/begin MEASUREMENT CellVolt20 "" UWORD VBU0428Test_CM_uint16 0 0 0 65535 ECU_ADDRESS 0x9000158c /end MEASUREMENT
/begin MEASUREMENT CellVolt193 "" UWORD VBU0428Test_CM_uint16 0 0 0 65535 ECU_ADDRESS 0x9000157c /end MEASUREMENT
/begin MEASUREMENT CellVolt194 "" UWORD VBU0428Test_CM_uint16 0 0 0 65535 ECU_ADDRESS 0x9000157e /end MEASUREMENT
/begin MEASUREMENT CellVolt195 "" UWORD VBU0428Test_CM_uint16 0 0 0 65535 ECU_ADDRESS 0x90001580 /end MEASUREMENT
/begin MEASUREMENT CellVolt196 "" UWORD VBU0428Test_CM_uint16 0 0 0 65535 ECU_ADDRESS 0x90001582 /end MEASUREMENT
/begin MEASUREMENT CellVolt189 "" UWORD VBU0428Test_CM_uint16 0 0 0 65535 ECU_ADDRESS 0x90001572 /end MEASUREMENT
/begin MEASUREMENT CellVolt190 "" UWORD VBU0428Test_CM_uint16 0 0 0 65535 ECU_ADDRESS 0x90001576 /end MEASUREMENT
/begin MEASUREMENT CellVolt191 "" UWORD VBU0428Test_CM_uint16 0 0 0 65535 ECU_ADDRESS 0x90001578 /end MEASUREMENT
/begin MEASUREMENT CellVolt192 "" UWORD VBU0428Test_CM_uint16 0 0 0 65535 ECU_ADDRESS 0x9000157a /end MEASUREMENT
/begin MEASUREMENT CellVolt185 "" UWORD VBU0428Test_CM_uint16 0 0 0 65535 ECU_ADDRESS 0x9000156a /end MEASUREMENT
/begin MEASUREMENT CellVolt186 "" UWORD VBU0428Test_CM_uint16 0 0 0 65535 ECU_ADDRESS 0x9000156c /end MEASUREMENT
/begin MEASUREMENT CellVolt187 "" UWORD VBU0428Test_CM_uint16 0 0 0 65535 ECU_ADDRESS 0x9000156e /end MEASUREMENT
/begin MEASUREMENT CellVolt188 "" UWORD VBU0428Test_CM_uint16 0 0 0 65535 ECU_ADDRESS 0x90001570 /end MEASUREMENT
/begin MEASUREMENT HV1_AD "" UWORD VBU0428Test_CM_uint16 0 0 0 65535 ECU_ADDRESS 0x90001648 /end MEASUREMENT
/begin MEASUREMENT HV2_Heating_Relay__AD "" UWORD VBU0428Test_CM_uint16 0 0 0 65535 ECU_ADDRESS 0x9000164a /end MEASUREMENT
/begin MEASUREMENT HV3_Main_Fuse__AD "" UWORD VBU0428Test_CM_uint16 0 0 0 65535 ECU_ADDRESS 0x9000164c /end MEASUREMENT
/begin MEASUREMENT CellVolt181 "" UWORD VBU0428Test_CM_uint16 0 0 0 65535 ECU_ADDRESS 0x90001562 /end MEASUREMENT
/begin MEASUREMENT CellVolt182 "" UWORD VBU0428Test_CM_uint16 0 0 0 65535 ECU_ADDRESS 0x90001564 /end MEASUREMENT
/begin MEASUREMENT CellVolt183 "" UWORD VBU0428Test_CM_uint16 0 0 0 65535 ECU_ADDRESS 0x90001566 /end MEASUREMENT
/begin MEASUREMENT CellVolt184 "" UWORD VBU0428Test_CM_uint16 0 0 0 65535 ECU_ADDRESS 0x90001568 /end MEASUREMENT
/begin MEASUREMENT CellVolt177 "" UWORD VBU0428Test_CM_uint16 0 0 0 65535 ECU_ADDRESS 0x90001558 /end MEASUREMENT
/begin MEASUREMENT CellVolt178 "" UWORD VBU0428Test_CM_uint16 0 0 0 65535 ECU_ADDRESS 0x9000155a /end MEASUREMENT
/begin MEASUREMENT CellVolt179 "" UWORD VBU0428Test_CM_uint16 0 0 0 65535 ECU_ADDRESS 0x9000155c /end MEASUREMENT
/begin MEASUREMENT CellVolt180 "" UWORD VBU0428Test_CM_uint16 0 0 0 65535 ECU_ADDRESS 0x90001560 /end MEASUREMENT
/begin MEASUREMENT CellVolt173 "" UWORD VBU0428Test_CM_uint16 0 0 0 65535 ECU_ADDRESS 0x90001550 /end MEASUREMENT
/begin MEASUREMENT CellVolt174 "" UWORD VBU0428Test_CM_uint16 0 0 0 65535 ECU_ADDRESS 0x90001552 /end MEASUREMENT
/begin MEASUREMENT CellVolt175 "" UWORD VBU0428Test_CM_uint16 0 0 0 65535 ECU_ADDRESS 0x90001554 /end MEASUREMENT
/begin MEASUREMENT CellVolt176 "" UWORD VBU0428Test_CM_uint16 0 0 0 65535 ECU_ADDRESS 0x90001556 /end MEASUREMENT
/begin MEASUREMENT CellVolt169 "" UWORD VBU0428Test_CM_uint16 0 0 0 65535 ECU_ADDRESS 0x90001546 /end MEASUREMENT
/begin MEASUREMENT CellVolt170 "" UWORD VBU0428Test_CM_uint16 0 0 0 65535 ECU_ADDRESS 0x9000154a /end MEASUREMENT
/begin MEASUREMENT CellVolt171 "" UWORD VBU0428Test_CM_uint16 0 0 0 65535 ECU_ADDRESS 0x9000154c /end MEASUREMENT
/begin MEASUREMENT CellVolt172 "" UWORD VBU0428Test_CM_uint16 0 0 0 65535 ECU_ADDRESS 0x9000154e /end MEASUREMENT
/begin MEASUREMENT CellVolt165 "" UWORD VBU0428Test_CM_uint16 0 0 0 65535 ECU_ADDRESS 0x9000153e /end MEASUREMENT
/begin MEASUREMENT CellVolt166 "" UWORD VBU0428Test_CM_uint16 0 0 0 65535 ECU_ADDRESS 0x90001540 /end MEASUREMENT
/begin MEASUREMENT CellVolt167 "" UWORD VBU0428Test_CM_uint16 0 0 0 65535 ECU_ADDRESS 0x90001542 /end MEASUREMENT
/begin MEASUREMENT CellVolt168 "" UWORD VBU0428Test_CM_uint16 0 0 0 65535 ECU_ADDRESS 0x90001544 /end MEASUREMENT
/begin MEASUREMENT CellVolt161 "" UWORD VBU0428Test_CM_uint16 0 0 0 65535 ECU_ADDRESS 0x90001536 /end MEASUREMENT
/begin MEASUREMENT CellVolt162 "" UWORD VBU0428Test_CM_uint16 0 0 0 65535 ECU_ADDRESS 0x90001538 /end MEASUREMENT
/begin MEASUREMENT CellVolt163 "" UWORD VBU0428Test_CM_uint16 0 0 0 65535 ECU_ADDRESS 0x9000153a /end MEASUREMENT
/begin MEASUREMENT CellVolt164 "" UWORD VBU0428Test_CM_uint16 0 0 0 65535 ECU_ADDRESS 0x9000153c /end MEASUREMENT
/begin MEASUREMENT CellVolt157 "" UWORD VBU0428Test_CM_uint16 0 0 0 65535 ECU_ADDRESS 0x9000152c /end MEASUREMENT
/begin MEASUREMENT CellVolt158 "" UWORD VBU0428Test_CM_uint16 0 0 0 65535 ECU_ADDRESS 0x9000152e /end MEASUREMENT
/begin MEASUREMENT CellVolt159 "" UWORD VBU0428Test_CM_uint16 0 0 0 65535 ECU_ADDRESS 0x90001530 /end MEASUREMENT
/begin MEASUREMENT CellVolt160 "" UWORD VBU0428Test_CM_uint16 0 0 0 65535 ECU_ADDRESS 0x90001534 /end MEASUREMENT
/begin MEASUREMENT CellVolt13 "" UWORD VBU0428Test_CM_uint16 0 0 0 65535 ECU_ADDRESS 0x900014f0 /end MEASUREMENT
/begin MEASUREMENT CellVolt14 "" UWORD VBU0428Test_CM_uint16 0 0 0 65535 ECU_ADDRESS 0x90001506 /end MEASUREMENT
/begin MEASUREMENT CellVolt15 "" UWORD VBU0428Test_CM_uint16 0 0 0 65535 ECU_ADDRESS 0x9000151c /end MEASUREMENT
/begin MEASUREMENT CellVolt16 "" UWORD VBU0428Test_CM_uint16 0 0 0 65535 ECU_ADDRESS 0x90001532 /end MEASUREMENT
/begin MEASUREMENT CellVolt153 "" UWORD VBU0428Test_CM_uint16 0 0 0 65535 ECU_ADDRESS 0x90001524 /end MEASUREMENT
/begin MEASUREMENT CellVolt154 "" UWORD VBU0428Test_CM_uint16 0 0 0 65535 ECU_ADDRESS 0x90001526 /end MEASUREMENT
/begin MEASUREMENT CellVolt155 "" UWORD VBU0428Test_CM_uint16 0 0 0 65535 ECU_ADDRESS 0x90001528 /end MEASUREMENT
/begin MEASUREMENT CellVolt156 "" UWORD VBU0428Test_CM_uint16 0 0 0 65535 ECU_ADDRESS 0x9000152a /end MEASUREMENT
/begin MEASUREMENT CellVolt149 "" UWORD VBU0428Test_CM_uint16 0 0 0 65535 ECU_ADDRESS 0x9000151a /end MEASUREMENT
/begin MEASUREMENT CellVolt150 "" UWORD VBU0428Test_CM_uint16 0 0 0 65535 ECU_ADDRESS 0x9000151e /end MEASUREMENT
/begin MEASUREMENT CellVolt151 "" UWORD VBU0428Test_CM_uint16 0 0 0 65535 ECU_ADDRESS 0x90001520 /end MEASUREMENT
/begin MEASUREMENT CellVolt152 "" UWORD VBU0428Test_CM_uint16 0 0 0 65535 ECU_ADDRESS 0x90001522 /end MEASUREMENT
/begin MEASUREMENT CellVolt145 "" UWORD VBU0428Test_CM_uint16 0 0 0 65535 ECU_ADDRESS 0x90001512 /end MEASUREMENT
/begin MEASUREMENT CellVolt146 "" UWORD VBU0428Test_CM_uint16 0 0 0 65535 ECU_ADDRESS 0x90001514 /end MEASUREMENT
/begin MEASUREMENT CellVolt147 "" UWORD VBU0428Test_CM_uint16 0 0 0 65535 ECU_ADDRESS 0x90001516 /end MEASUREMENT
/begin MEASUREMENT CellVolt148 "" UWORD VBU0428Test_CM_uint16 0 0 0 65535 ECU_ADDRESS 0x90001518 /end MEASUREMENT
/begin MEASUREMENT CellVolt141 "" UWORD VBU0428Test_CM_uint16 0 0 0 65535 ECU_ADDRESS 0x9000150a /end MEASUREMENT
/begin MEASUREMENT CellVolt142 "" UWORD VBU0428Test_CM_uint16 0 0 0 65535 ECU_ADDRESS 0x9000150c /end MEASUREMENT
/begin MEASUREMENT CellVolt143 "" UWORD VBU0428Test_CM_uint16 0 0 0 65535 ECU_ADDRESS 0x9000150e /end MEASUREMENT
/begin MEASUREMENT CellVolt144 "" UWORD VBU0428Test_CM_uint16 0 0 0 65535 ECU_ADDRESS 0x90001510 /end MEASUREMENT
/begin MEASUREMENT CellVolt137 "" UWORD VBU0428Test_CM_uint16 0 0 0 65535 ECU_ADDRESS 0x90001500 /end MEASUREMENT
/begin MEASUREMENT CellVolt138 "" UWORD VBU0428Test_CM_uint16 0 0 0 65535 ECU_ADDRESS 0x90001502 /end MEASUREMENT
/begin MEASUREMENT CellVolt139 "" UWORD VBU0428Test_CM_uint16 0 0 0 65535 ECU_ADDRESS 0x90001504 /end MEASUREMENT
/begin MEASUREMENT CellVolt140 "" UWORD VBU0428Test_CM_uint16 0 0 0 65535 ECU_ADDRESS 0x90001508 /end MEASUREMENT
/begin MEASUREMENT CellVolt133 "" UWORD VBU0428Test_CM_uint16 0 0 0 65535 ECU_ADDRESS 0x900014f8 /end MEASUREMENT
/begin MEASUREMENT CellVolt134 "" UWORD VBU0428Test_CM_uint16 0 0 0 65535 ECU_ADDRESS 0x900014fa /end MEASUREMENT
/begin MEASUREMENT CellVolt135 "" UWORD VBU0428Test_CM_uint16 0 0 0 65535 ECU_ADDRESS 0x900014fc /end MEASUREMENT
/begin MEASUREMENT CellVolt136 "" UWORD VBU0428Test_CM_uint16 0 0 0 65535 ECU_ADDRESS 0x900014fe /end MEASUREMENT
/begin MEASUREMENT CellVolt129 "" UWORD VBU0428Test_CM_uint16 0 0 0 65535 ECU_ADDRESS 0x900014ee /end MEASUREMENT
/begin MEASUREMENT CellVolt130 "" UWORD VBU0428Test_CM_uint16 0 0 0 65535 ECU_ADDRESS 0x900014f2 /end MEASUREMENT
/begin MEASUREMENT CellVolt131 "" UWORD VBU0428Test_CM_uint16 0 0 0 65535 ECU_ADDRESS 0x900014f4 /end MEASUREMENT
/begin MEASUREMENT CellVolt132 "" UWORD VBU0428Test_CM_uint16 0 0 0 65535 ECU_ADDRESS 0x900014f6 /end MEASUREMENT
/begin MEASUREMENT CellVolt125 "" UWORD VBU0428Test_CM_uint16 0 0 0 65535 ECU_ADDRESS 0x900014e6 /end MEASUREMENT
/begin MEASUREMENT CellVolt126 "" UWORD VBU0428Test_CM_uint16 0 0 0 65535 ECU_ADDRESS 0x900014e8 /end MEASUREMENT
/begin MEASUREMENT CellVolt127 "" UWORD VBU0428Test_CM_uint16 0 0 0 65535 ECU_ADDRESS 0x900014ea /end MEASUREMENT
/begin MEASUREMENT CellVolt128 "" UWORD VBU0428Test_CM_uint16 0 0 0 65535 ECU_ADDRESS 0x900014ec /end MEASUREMENT
/begin MEASUREMENT CellVolt121 "" UWORD VBU0428Test_CM_uint16 0 0 0 65535 ECU_ADDRESS 0x900014de /end MEASUREMENT
/begin MEASUREMENT CellVolt122 "" UWORD VBU0428Test_CM_uint16 0 0 0 65535 ECU_ADDRESS 0x900014e0 /end MEASUREMENT
/begin MEASUREMENT CellVolt123 "" UWORD VBU0428Test_CM_uint16 0 0 0 65535 ECU_ADDRESS 0x900014e2 /end MEASUREMENT
/begin MEASUREMENT CellVolt124 "" UWORD VBU0428Test_CM_uint16 0 0 0 65535 ECU_ADDRESS 0x900014e4 /end MEASUREMENT
/begin MEASUREMENT CellVolt117 "" UWORD VBU0428Test_CM_uint16 0 0 0 65535 ECU_ADDRESS 0x900014d4 /end MEASUREMENT
/begin MEASUREMENT CellVolt118 "" UWORD VBU0428Test_CM_uint16 0 0 0 65535 ECU_ADDRESS 0x900014d6 /end MEASUREMENT
/begin MEASUREMENT CellVolt119 "" UWORD VBU0428Test_CM_uint16 0 0 0 65535 ECU_ADDRESS 0x900014d8 /end MEASUREMENT
/begin MEASUREMENT CellVolt120 "" UWORD VBU0428Test_CM_uint16 0 0 0 65535 ECU_ADDRESS 0x900014dc /end MEASUREMENT
/begin MEASUREMENT CellVolt10 "" UWORD VBU0428Test_CM_uint16 0 0 0 65535 ECU_ADDRESS 0x900014ae /end MEASUREMENT
/begin MEASUREMENT CellVolt11 "" UWORD VBU0428Test_CM_uint16 0 0 0 65535 ECU_ADDRESS 0x900014c4 /end MEASUREMENT
/begin MEASUREMENT CellVolt12 "" UWORD VBU0428Test_CM_uint16 0 0 0 65535 ECU_ADDRESS 0x900014da /end MEASUREMENT
/begin MEASUREMENT CellVolt9 "" UWORD VBU0428Test_CM_uint16 0 0 0 65535 ECU_ADDRESS 0x90001626 /end MEASUREMENT
/begin MEASUREMENT CellVolt113 "" UWORD VBU0428Test_CM_uint16 0 0 0 65535 ECU_ADDRESS 0x900014cc /end MEASUREMENT
/begin MEASUREMENT CellVolt114 "" UWORD VBU0428Test_CM_uint16 0 0 0 65535 ECU_ADDRESS 0x900014ce /end MEASUREMENT
/begin MEASUREMENT CellVolt115 "" UWORD VBU0428Test_CM_uint16 0 0 0 65535 ECU_ADDRESS 0x900014d0 /end MEASUREMENT
/begin MEASUREMENT CellVolt116 "" UWORD VBU0428Test_CM_uint16 0 0 0 65535 ECU_ADDRESS 0x900014d2 /end MEASUREMENT
/begin MEASUREMENT CellVolt109 "" UWORD VBU0428Test_CM_uint16 0 0 0 65535 ECU_ADDRESS 0x900014c2 /end MEASUREMENT
/begin MEASUREMENT CellVolt110 "" UWORD VBU0428Test_CM_uint16 0 0 0 65535 ECU_ADDRESS 0x900014c6 /end MEASUREMENT
/begin MEASUREMENT CellVolt111 "" UWORD VBU0428Test_CM_uint16 0 0 0 65535 ECU_ADDRESS 0x900014c8 /end MEASUREMENT
/begin MEASUREMENT CellVolt112 "" UWORD VBU0428Test_CM_uint16 0 0 0 65535 ECU_ADDRESS 0x900014ca /end MEASUREMENT
/begin MEASUREMENT CellVolt105 "" UWORD VBU0428Test_CM_uint16 0 0 0 65535 ECU_ADDRESS 0x900014ba /end MEASUREMENT
/begin MEASUREMENT CellVolt106 "" UWORD VBU0428Test_CM_uint16 0 0 0 65535 ECU_ADDRESS 0x900014bc /end MEASUREMENT
/begin MEASUREMENT CellVolt107 "" UWORD VBU0428Test_CM_uint16 0 0 0 65535 ECU_ADDRESS 0x900014be /end MEASUREMENT
/begin MEASUREMENT CellVolt108 "" UWORD VBU0428Test_CM_uint16 0 0 0 65535 ECU_ADDRESS 0x900014c0 /end MEASUREMENT
/begin MEASUREMENT CellVolt101 "" UWORD VBU0428Test_CM_uint16 0 0 0 65535 ECU_ADDRESS 0x900014b2 /end MEASUREMENT
/begin MEASUREMENT CellVolt102 "" UWORD VBU0428Test_CM_uint16 0 0 0 65535 ECU_ADDRESS 0x900014b4 /end MEASUREMENT
/begin MEASUREMENT CellVolt103 "" UWORD VBU0428Test_CM_uint16 0 0 0 65535 ECU_ADDRESS 0x900014b6 /end MEASUREMENT
/begin MEASUREMENT CellVolt104 "" UWORD VBU0428Test_CM_uint16 0 0 0 65535 ECU_ADDRESS 0x900014b8 /end MEASUREMENT
/begin MEASUREMENT CellVolt100 "" UWORD VBU0428Test_CM_uint16 0 0 0 65535 ECU_ADDRESS 0x900014b0 /end MEASUREMENT
/begin MEASUREMENT CellVolt97 "" UWORD VBU0428Test_CM_uint16 0 0 0 65535 ECU_ADDRESS 0x90001636 /end MEASUREMENT
/begin MEASUREMENT CellVolt98 "" UWORD VBU0428Test_CM_uint16 0 0 0 65535 ECU_ADDRESS 0x90001638 /end MEASUREMENT
/begin MEASUREMENT CellVolt99 "" UWORD VBU0428Test_CM_uint16 0 0 0 65535 ECU_ADDRESS 0x9000163a /end MEASUREMENT
/begin MEASUREMENT CellVolt93 "" UWORD VBU0428Test_CM_uint16 0 0 0 65535 ECU_ADDRESS 0x9000162e /end MEASUREMENT
/begin MEASUREMENT CellVolt94 "" UWORD VBU0428Test_CM_uint16 0 0 0 65535 ECU_ADDRESS 0x90001630 /end MEASUREMENT
/begin MEASUREMENT CellVolt95 "" UWORD VBU0428Test_CM_uint16 0 0 0 65535 ECU_ADDRESS 0x90001632 /end MEASUREMENT
/begin MEASUREMENT CellVolt96 "" UWORD VBU0428Test_CM_uint16 0 0 0 65535 ECU_ADDRESS 0x90001634 /end MEASUREMENT
/begin MEASUREMENT CellVolt89 "" UWORD VBU0428Test_CM_uint16 0 0 0 65535 ECU_ADDRESS 0x90001624 /end MEASUREMENT
/begin MEASUREMENT CellVolt90 "" UWORD VBU0428Test_CM_uint16 0 0 0 65535 ECU_ADDRESS 0x90001628 /end MEASUREMENT
/begin MEASUREMENT CellVolt91 "" UWORD VBU0428Test_CM_uint16 0 0 0 65535 ECU_ADDRESS 0x9000162a /end MEASUREMENT
/begin MEASUREMENT CellVolt92 "" UWORD VBU0428Test_CM_uint16 0 0 0 65535 ECU_ADDRESS 0x9000162c /end MEASUREMENT
/begin MEASUREMENT CellVolt85 "" UWORD VBU0428Test_CM_uint16 0 0 0 65535 ECU_ADDRESS 0x9000161c /end MEASUREMENT
/begin MEASUREMENT CellVolt86 "" UWORD VBU0428Test_CM_uint16 0 0 0 65535 ECU_ADDRESS 0x9000161e /end MEASUREMENT
/begin MEASUREMENT CellVolt87 "" UWORD VBU0428Test_CM_uint16 0 0 0 65535 ECU_ADDRESS 0x90001620 /end MEASUREMENT
/begin MEASUREMENT CellVolt88 "" UWORD VBU0428Test_CM_uint16 0 0 0 65535 ECU_ADDRESS 0x90001622 /end MEASUREMENT
/begin MEASUREMENT CellVolt81 "" UWORD VBU0428Test_CM_uint16 0 0 0 65535 ECU_ADDRESS 0x90001614 /end MEASUREMENT
/begin MEASUREMENT CellVolt82 "" UWORD VBU0428Test_CM_uint16 0 0 0 65535 ECU_ADDRESS 0x90001616 /end MEASUREMENT
/begin MEASUREMENT CellVolt83 "" UWORD VBU0428Test_CM_uint16 0 0 0 65535 ECU_ADDRESS 0x90001618 /end MEASUREMENT
/begin MEASUREMENT CellVolt84 "" UWORD VBU0428Test_CM_uint16 0 0 0 65535 ECU_ADDRESS 0x9000161a /end MEASUREMENT
/begin MEASUREMENT CellVolt77 "" UWORD VBU0428Test_CM_uint16 0 0 0 65535 ECU_ADDRESS 0x9000160a /end MEASUREMENT
/begin MEASUREMENT CellVolt78 "" UWORD VBU0428Test_CM_uint16 0 0 0 65535 ECU_ADDRESS 0x9000160c /end MEASUREMENT
/begin MEASUREMENT CellVolt79 "" UWORD VBU0428Test_CM_uint16 0 0 0 65535 ECU_ADDRESS 0x9000160e /end MEASUREMENT
/begin MEASUREMENT CellVolt80 "" UWORD VBU0428Test_CM_uint16 0 0 0 65535 ECU_ADDRESS 0x90001612 /end MEASUREMENT
/begin MEASUREMENT CellVolt5 "" UWORD VBU0428Test_CM_uint16 0 0 0 65535 ECU_ADDRESS 0x900015ce /end MEASUREMENT
/begin MEASUREMENT CellVolt6 "" UWORD VBU0428Test_CM_uint16 0 0 0 65535 ECU_ADDRESS 0x900015e4 /end MEASUREMENT
/begin MEASUREMENT CellVolt7 "" UWORD VBU0428Test_CM_uint16 0 0 0 65535 ECU_ADDRESS 0x900015fa /end MEASUREMENT
/begin MEASUREMENT CellVolt8 "" UWORD VBU0428Test_CM_uint16 0 0 0 65535 ECU_ADDRESS 0x90001610 /end MEASUREMENT
/begin MEASUREMENT CellVolt73 "" UWORD VBU0428Test_CM_uint16 0 0 0 65535 ECU_ADDRESS 0x90001602 /end MEASUREMENT
/begin MEASUREMENT CellVolt74 "" UWORD VBU0428Test_CM_uint16 0 0 0 65535 ECU_ADDRESS 0x90001604 /end MEASUREMENT
/begin MEASUREMENT CellVolt75 "" UWORD VBU0428Test_CM_uint16 0 0 0 65535 ECU_ADDRESS 0x90001606 /end MEASUREMENT
/begin MEASUREMENT CellVolt76 "" UWORD VBU0428Test_CM_uint16 0 0 0 65535 ECU_ADDRESS 0x90001608 /end MEASUREMENT
/begin MEASUREMENT CellVolt69 "" UWORD VBU0428Test_CM_uint16 0 0 0 65535 ECU_ADDRESS 0x900015f8 /end MEASUREMENT
/begin MEASUREMENT CellVolt70 "" UWORD VBU0428Test_CM_uint16 0 0 0 65535 ECU_ADDRESS 0x900015fc /end MEASUREMENT
/begin MEASUREMENT CellVolt71 "" UWORD VBU0428Test_CM_uint16 0 0 0 65535 ECU_ADDRESS 0x900015fe /end MEASUREMENT
/begin MEASUREMENT CellVolt72 "" UWORD VBU0428Test_CM_uint16 0 0 0 65535 ECU_ADDRESS 0x90001600 /end MEASUREMENT
/begin MEASUREMENT CellVolt65 "" UWORD VBU0428Test_CM_uint16 0 0 0 65535 ECU_ADDRESS 0x900015f0 /end MEASUREMENT
/begin MEASUREMENT CellVolt66 "" UWORD VBU0428Test_CM_uint16 0 0 0 65535 ECU_ADDRESS 0x900015f2 /end MEASUREMENT
/begin MEASUREMENT CellVolt67 "" UWORD VBU0428Test_CM_uint16 0 0 0 65535 ECU_ADDRESS 0x900015f4 /end MEASUREMENT
/begin MEASUREMENT CellVolt68 "" UWORD VBU0428Test_CM_uint16 0 0 0 65535 ECU_ADDRESS 0x900015f6 /end MEASUREMENT
/begin MEASUREMENT CellVolt61 "" UWORD VBU0428Test_CM_uint16 0 0 0 65535 ECU_ADDRESS 0x900015e8 /end MEASUREMENT
/begin MEASUREMENT CellVolt62 "" UWORD VBU0428Test_CM_uint16 0 0 0 65535 ECU_ADDRESS 0x900015ea /end MEASUREMENT
/begin MEASUREMENT CellVolt63 "" UWORD VBU0428Test_CM_uint16 0 0 0 65535 ECU_ADDRESS 0x900015ec /end MEASUREMENT
/begin MEASUREMENT CellVolt64 "" UWORD VBU0428Test_CM_uint16 0 0 0 65535 ECU_ADDRESS 0x900015ee /end MEASUREMENT
/begin MEASUREMENT CellVolt57 "" UWORD VBU0428Test_CM_uint16 0 0 0 65535 ECU_ADDRESS 0x900015de /end MEASUREMENT
/begin MEASUREMENT CellVolt58 "" UWORD VBU0428Test_CM_uint16 0 0 0 65535 ECU_ADDRESS 0x900015e0 /end MEASUREMENT
/begin MEASUREMENT CellVolt59 "" UWORD VBU0428Test_CM_uint16 0 0 0 65535 ECU_ADDRESS 0x900015e2 /end MEASUREMENT
/begin MEASUREMENT CellVolt60 "" UWORD VBU0428Test_CM_uint16 0 0 0 65535 ECU_ADDRESS 0x900015e6 /end MEASUREMENT
/begin MEASUREMENT CellVolt53 "" UWORD VBU0428Test_CM_uint16 0 0 0 65535 ECU_ADDRESS 0x900015d6 /end MEASUREMENT
/begin MEASUREMENT CellVolt54 "" UWORD VBU0428Test_CM_uint16 0 0 0 65535 ECU_ADDRESS 0x900015d8 /end MEASUREMENT
/begin MEASUREMENT CellVolt55 "" UWORD VBU0428Test_CM_uint16 0 0 0 65535 ECU_ADDRESS 0x900015da /end MEASUREMENT
/begin MEASUREMENT CellVolt56 "" UWORD VBU0428Test_CM_uint16 0 0 0 65535 ECU_ADDRESS 0x900015dc /end MEASUREMENT
/begin MEASUREMENT CellVolt49 "" UWORD VBU0428Test_CM_uint16 0 0 0 65535 ECU_ADDRESS 0x900015cc /end MEASUREMENT
/begin MEASUREMENT CellVolt50 "" UWORD VBU0428Test_CM_uint16 0 0 0 65535 ECU_ADDRESS 0x900015d0 /end MEASUREMENT
/begin MEASUREMENT CellVolt51 "" UWORD VBU0428Test_CM_uint16 0 0 0 65535 ECU_ADDRESS 0x900015d2 /end MEASUREMENT
/begin MEASUREMENT CellVolt52 "" UWORD VBU0428Test_CM_uint16 0 0 0 65535 ECU_ADDRESS 0x900015d4 /end MEASUREMENT
/begin MEASUREMENT CellVolt45 "" UWORD VBU0428Test_CM_uint16 0 0 0 65535 ECU_ADDRESS 0x900015c4 /end MEASUREMENT
/begin MEASUREMENT CellVolt46 "" UWORD VBU0428Test_CM_uint16 0 0 0 65535 ECU_ADDRESS 0x900015c6 /end MEASUREMENT
/begin MEASUREMENT CellVolt47 "" UWORD VBU0428Test_CM_uint16 0 0 0 65535 ECU_ADDRESS 0x900015c8 /end MEASUREMENT
/begin MEASUREMENT CellVolt48 "" UWORD VBU0428Test_CM_uint16 0 0 0 65535 ECU_ADDRESS 0x900015ca /end MEASUREMENT
/begin MEASUREMENT CellVolt41 "" UWORD VBU0428Test_CM_uint16 0 0 0 65535 ECU_ADDRESS 0x900015bc /end MEASUREMENT
/begin MEASUREMENT CellVolt42 "" UWORD VBU0428Test_CM_uint16 0 0 0 65535 ECU_ADDRESS 0x900015be /end MEASUREMENT
/begin MEASUREMENT CellVolt43 "" UWORD VBU0428Test_CM_uint16 0 0 0 65535 ECU_ADDRESS 0x900015c0 /end MEASUREMENT
/begin MEASUREMENT CellVolt44 "" UWORD VBU0428Test_CM_uint16 0 0 0 65535 ECU_ADDRESS 0x900015c2 /end MEASUREMENT
/begin MEASUREMENT CellVolt37 "" UWORD VBU0428Test_CM_uint16 0 0 0 65535 ECU_ADDRESS 0x900015b2 /end MEASUREMENT
/begin MEASUREMENT CellVolt38 "" UWORD VBU0428Test_CM_uint16 0 0 0 65535 ECU_ADDRESS 0x900015b4 /end MEASUREMENT
/begin MEASUREMENT CellVolt39 "" UWORD VBU0428Test_CM_uint16 0 0 0 65535 ECU_ADDRESS 0x900015b6 /end MEASUREMENT
/begin MEASUREMENT CellVolt40 "" UWORD VBU0428Test_CM_uint16 0 0 0 65535 ECU_ADDRESS 0x900015ba /end MEASUREMENT
/begin MEASUREMENT CellVolt1 "" UWORD VBU0428Test_CM_uint16 0 0 0 65535 ECU_ADDRESS 0x900014ac /end MEASUREMENT
/begin MEASUREMENT CellVolt2 "" UWORD VBU0428Test_CM_uint16 0 0 0 65535 ECU_ADDRESS 0x9000158a /end MEASUREMENT
/begin MEASUREMENT CellVolt3 "" UWORD VBU0428Test_CM_uint16 0 0 0 65535 ECU_ADDRESS 0x900015a2 /end MEASUREMENT
/begin MEASUREMENT CellVolt4 "" UWORD VBU0428Test_CM_uint16 0 0 0 65535 ECU_ADDRESS 0x900015b8 /end MEASUREMENT
/begin MEASUREMENT Low_Cell_Volt_4 "" UWORD VBU0428Test_CM_uint16 0 0 0 65535 ECU_ADDRESS 0x90001682 /end MEASUREMENT
/begin MEASUREMENT Low_Cell_Volt_5 "" UWORD VBU0428Test_CM_uint16 0 0 0 65535 ECU_ADDRESS 0x90001684 /end MEASUREMENT
/begin MEASUREMENT Low_Cell_Volt_2 "" UWORD VBU0428Test_CM_uint16 0 0 0 65535 ECU_ADDRESS 0x9000167e /end MEASUREMENT
/begin MEASUREMENT Low_Cell_Volt_3 "" UWORD VBU0428Test_CM_uint16 0 0 0 65535 ECU_ADDRESS 0x90001680 /end MEASUREMENT
/begin MEASUREMENT High_Cell_Volt_5 "" UWORD VBU0428Test_CM_uint16 0 0 0 65535 ECU_ADDRESS 0x90001668 /end MEASUREMENT
/begin MEASUREMENT Low_Cell_Volt_1 "" UWORD VBU0428Test_CM_uint16 0 0 0 65535 ECU_ADDRESS 0x9000167c /end MEASUREMENT
/begin MEASUREMENT High_Cell_Volt_3 "" UWORD VBU0428Test_CM_uint16 0 0 0 65535 ECU_ADDRESS 0x90001664 /end MEASUREMENT
/begin MEASUREMENT High_Cell_Volt_4 "" UWORD VBU0428Test_CM_uint16 0 0 0 65535 ECU_ADDRESS 0x90001666 /end MEASUREMENT
/begin MEASUREMENT High_Cell_Volt_1 "" UWORD VBU0428Test_CM_uint16 0 0 0 65535 ECU_ADDRESS 0x90001660 /end MEASUREMENT
/begin MEASUREMENT High_Cell_Volt_2 "" UWORD VBU0428Test_CM_uint16 0 0 0 65535 ECU_ADDRESS 0x90001662 /end MEASUREMENT
/begin MEASUREMENT Min_Volt "" UWORD VBU0428Test_CM_uint16 0 0 0 65535 ECU_ADDRESS 0x90001698 /end MEASUREMENT
/begin MEASUREMENT Max_Volt "" UWORD VBU0428Test_CM_uint16 0 0 0 65535 ECU_ADDRESS 0x90001694 /end MEASUREMENT
/begin MEASUREMENT Insulation_R_Minus "" UWORD VBU0428Test_CM_uint16 0 0 0 65535 ECU_ADDRESS 0x9000166a /end MEASUREMENT
/begin MEASUREMENT Insulation_R_Plus "" UWORD VBU0428Test_CM_uint16 0 0 0 65535 ECU_ADDRESS 0x9000166c /end MEASUREMENT
/begin MEASUREMENT Ave_Volt "" UWORD VBU0428Test_CM_uint16 0 0 0 65535 ECU_ADDRESS 0x900014a0 /end MEASUREMENT
/begin MEASUREMENT Insulation_Resistance "" UWORD VBU0428Test_CM_uint16 0 0 0 65535 ECU_ADDRESS 0x9000166e /end MEASUREMENT
/begin MEASUREMENT High_Cell_Temp_1 "" UWORD VBU0428Test_CM_ufix16_Sp1_Bn40 0 0 -40.0 6513.5 ECU_ADDRESS 0x90001656 /end MEASUREMENT
/begin MEASUREMENT High_Cell_Temp_2 "" UWORD VBU0428Test_CM_ufix16_Sp1_Bn40 0 0 -40.0 6513.5 ECU_ADDRESS 0x90001658 /end MEASUREMENT
/begin MEASUREMENT Low_Cell_Temp_4 "" UWORD VBU0428Test_CM_ufix16_Sp1_Bn40 0 0 -40.0 6513.5 ECU_ADDRESS 0x90001678 /end MEASUREMENT
/begin MEASUREMENT Low_Cell_Temp_5 "" UWORD VBU0428Test_CM_ufix16_Sp1_Bn40 0 0 -40.0 6513.5 ECU_ADDRESS 0x9000167a /end MEASUREMENT
/begin MEASUREMENT Low_Cell_Temp_2 "" UWORD VBU0428Test_CM_ufix16_Sp1_Bn40 0 0 -40.0 6513.5 ECU_ADDRESS 0x90001674 /end MEASUREMENT
/begin MEASUREMENT Low_Cell_Temp_3 "" UWORD VBU0428Test_CM_ufix16_Sp1_Bn40 0 0 -40.0 6513.5 ECU_ADDRESS 0x90001676 /end MEASUREMENT
/begin MEASUREMENT High_Cell_Temp_5 "" UWORD VBU0428Test_CM_ufix16_Sp1_Bn40 0 0 -40.0 6513.5 ECU_ADDRESS 0x9000165e /end MEASUREMENT
/begin MEASUREMENT Low_Cell_Temp_1 "" UWORD VBU0428Test_CM_ufix16_Sp1_Bn40 0 0 -40.0 6513.5 ECU_ADDRESS 0x90001672 /end MEASUREMENT
/begin MEASUREMENT High_Cell_Temp_3 "" UWORD VBU0428Test_CM_ufix16_Sp1_Bn40 0 0 -40.0 6513.5 ECU_ADDRESS 0x9000165a /end MEASUREMENT
/begin MEASUREMENT High_Cell_Temp_4 "" UWORD VBU0428Test_CM_ufix16_Sp1_Bn40 0 0 -40.0 6513.5 ECU_ADDRESS 0x9000165c /end MEASUREMENT
/begin MEASUREMENT Max_Temp "" UWORD VBU0428Test_CM_ufix16_Sp1_Bn40 0 0 -40.0 6513.5 ECU_ADDRESS 0x90001692 /end MEASUREMENT
/begin MEASUREMENT Min_Temp "" UWORD VBU0428Test_CM_ufix16_Sp1_Bn40 0 0 -40.0 6513.5 ECU_ADDRESS 0x90001696 /end MEASUREMENT
/begin MEASUREMENT Total_Volt "" UWORD VBU0428Test_CM_ufix16_Sp1 0 0 0 6553.5 ECU_ADDRESS 0x900016a4 /end MEASUREMENT
/begin MEASUREMENT HCU_Message_3_AD3_Heart "" UBYTE VBU0428Test_CM_uint8 0 0 0 255 ECU_ADDRESS 0x90001e1f /end MEASUREMENT
/begin MEASUREMENT HCU_Message_3_AD2_Heart "" UBYTE VBU0428Test_CM_uint8 0 0 0 255 ECU_ADDRESS 0x90001e1e /end MEASUREMENT
/begin MEASUREMENT HCU_Message_2_AD1_Heart "" UBYTE VBU0428Test_CM_uint8 0 0 0 255 ECU_ADDRESS 0x90001e1d /end MEASUREMENT
/begin MEASUREMENT HCU_Message_1_RelayStatus_Heart "" UBYTE VBU0428Test_CM_uint8 0 0 0 255 ECU_ADDRESS 0x90001e1c /end MEASUREMENT
/begin MEASUREMENT HCU_State "" UBYTE VBU0428Test_CM_uint8 0 0 0 255 ECU_ADDRESS 0x90001e22 /end MEASUREMENT
/begin MEASUREMENT Total_Temp_Num "" UBYTE VBU0428Test_CM_uint8 0 0 0 255 ECU_ADDRESS 0x90001eda /end MEASUREMENT
/begin MEASUREMENT Total_Volt_Cell_Num "" UBYTE VBU0428Test_CM_uint8 0 0 0 255 ECU_ADDRESS 0x90001edb /end MEASUREMENT
/begin MEASUREMENT High_Cell_Temp_1_BMU_ID "" UBYTE VBU0428Test_CM_uint8 0 0 0 255 ECU_ADDRESS 0x90001e26 /end MEASUREMENT
/begin MEASUREMENT High_Cell_Temp_1_BMU_Index "" UBYTE VBU0428Test_CM_uint8 0 0 0 255 ECU_ADDRESS 0x90001e27 /end MEASUREMENT
/begin MEASUREMENT High_Cell_Temp_2_BMU_ID "" UBYTE VBU0428Test_CM_uint8 0 0 0 255 ECU_ADDRESS 0x90001e28 /end MEASUREMENT
/begin MEASUREMENT High_Cell_Temp_2_BMU_Index "" UBYTE VBU0428Test_CM_uint8 0 0 0 255 ECU_ADDRESS 0x90001e29 /end MEASUREMENT
/begin MEASUREMENT Low_Cell_Volt_4_BMU_ID "" UBYTE VBU0428Test_CM_uint8 0 0 0 255 ECU_ADDRESS 0x90001e57 /end MEASUREMENT
/begin MEASUREMENT Low_Cell_Volt_4_BMU_Index "" UBYTE VBU0428Test_CM_uint8 0 0 0 255 ECU_ADDRESS 0x90001e58 /end MEASUREMENT
/begin MEASUREMENT Low_Cell_Volt_5_BMU_ID "" UBYTE VBU0428Test_CM_uint8 0 0 0 255 ECU_ADDRESS 0x90001e59 /end MEASUREMENT
/begin MEASUREMENT Low_Cell_Volt_5_BMU_Index "" UBYTE VBU0428Test_CM_uint8 0 0 0 255 ECU_ADDRESS 0x90001e5a /end MEASUREMENT
/begin MEASUREMENT Low_Cell_Volt_2_BMU_ID "" UBYTE VBU0428Test_CM_uint8 0 0 0 255 ECU_ADDRESS 0x90001e53 /end MEASUREMENT
/begin MEASUREMENT Low_Cell_Volt_2_BMU_Index "" UBYTE VBU0428Test_CM_uint8 0 0 0 255 ECU_ADDRESS 0x90001e54 /end MEASUREMENT
/begin MEASUREMENT Low_Cell_Volt_3_BMU_ID "" UBYTE VBU0428Test_CM_uint8 0 0 0 255 ECU_ADDRESS 0x90001e55 /end MEASUREMENT
/begin MEASUREMENT Low_Cell_Volt_3_BMU_Index "" UBYTE VBU0428Test_CM_uint8 0 0 0 255 ECU_ADDRESS 0x90001e56 /end MEASUREMENT
/begin MEASUREMENT High_Cell_Volt_5_BMU_ID "" UBYTE VBU0428Test_CM_uint8 0 0 0 255 ECU_ADDRESS 0x90001e38 /end MEASUREMENT
/begin MEASUREMENT High_Cell_Volt_5_BMU_Index "" UBYTE VBU0428Test_CM_uint8 0 0 0 255 ECU_ADDRESS 0x90001e39 /end MEASUREMENT
/begin MEASUREMENT Low_Cell_Volt_1_BMU_ID "" UBYTE VBU0428Test_CM_uint8 0 0 0 255 ECU_ADDRESS 0x90001e51 /end MEASUREMENT
/begin MEASUREMENT Low_Cell_Volt_1_BMU_Index "" UBYTE VBU0428Test_CM_uint8 0 0 0 255 ECU_ADDRESS 0x90001e52 /end MEASUREMENT
/begin MEASUREMENT High_Cell_Volt_3_BMU_ID "" UBYTE VBU0428Test_CM_uint8 0 0 0 255 ECU_ADDRESS 0x90001e34 /end MEASUREMENT
/begin MEASUREMENT High_Cell_Volt_3_BMU_Index "" UBYTE VBU0428Test_CM_uint8 0 0 0 255 ECU_ADDRESS 0x90001e35 /end MEASUREMENT
/begin MEASUREMENT High_Cell_Volt_4_BMU_ID "" UBYTE VBU0428Test_CM_uint8 0 0 0 255 ECU_ADDRESS 0x90001e36 /end MEASUREMENT
/begin MEASUREMENT High_Cell_Volt_4_BMU_Index "" UBYTE VBU0428Test_CM_uint8 0 0 0 255 ECU_ADDRESS 0x90001e37 /end MEASUREMENT
/begin MEASUREMENT High_Cell_Volt_1_BMU_ID "" UBYTE VBU0428Test_CM_uint8 0 0 0 255 ECU_ADDRESS 0x90001e30 /end MEASUREMENT
/begin MEASUREMENT High_Cell_Volt_1_BMU_Index "" UBYTE VBU0428Test_CM_uint8 0 0 0 255 ECU_ADDRESS 0x90001e31 /end MEASUREMENT
/begin MEASUREMENT High_Cell_Volt_2_BMU_ID "" UBYTE VBU0428Test_CM_uint8 0 0 0 255 ECU_ADDRESS 0x90001e32 /end MEASUREMENT
/begin MEASUREMENT High_Cell_Volt_2_BMU_Index "" UBYTE VBU0428Test_CM_uint8 0 0 0 255 ECU_ADDRESS 0x90001e33 /end MEASUREMENT
/begin MEASUREMENT HCU_Statistics_State3_Heart "" UBYTE VBU0428Test_CM_uint8 0 0 0 255 ECU_ADDRESS 0x90001e25 /end MEASUREMENT
/begin MEASUREMENT Max_Volt_BMU_index "" UBYTE VBU0428Test_CM_uint8 0 0 0 255 ECU_ADDRESS 0x90001e7e /end MEASUREMENT
/begin MEASUREMENT Min_Volt_BMU_ID "" UBYTE VBU0428Test_CM_uint8 0 0 0 255 ECU_ADDRESS 0x90001e83 /end MEASUREMENT
/begin MEASUREMENT Min_Volt_BMU_index "" UBYTE VBU0428Test_CM_uint8 0 0 0 255 ECU_ADDRESS 0x90001e84 /end MEASUREMENT
/begin MEASUREMENT Min_Volt_Index "" UBYTE VBU0428Test_CM_uint8 0 0 0 255 ECU_ADDRESS 0x90001e85 /end MEASUREMENT
/begin MEASUREMENT HCU_Statistics_State2_Heart "" UBYTE VBU0428Test_CM_uint8 0 0 0 255 ECU_ADDRESS 0x90001e24 /end MEASUREMENT
/begin MEASUREMENT Max_Volt_BMU_ID "" UBYTE VBU0428Test_CM_uint8 0 0 0 255 ECU_ADDRESS 0x90001e7d /end MEASUREMENT
/begin MEASUREMENT Max_Volt_Index "" UBYTE VBU0428Test_CM_uint8 0 0 0 255 ECU_ADDRESS 0x90001e7f /end MEASUREMENT
/begin MEASUREMENT Min_Temp_BMU_ID "" UBYTE VBU0428Test_CM_uint8 0 0 0 255 ECU_ADDRESS 0x90001e80 /end MEASUREMENT
/begin MEASUREMENT Min_Temp_BMU_index "" UBYTE VBU0428Test_CM_uint8 0 0 0 255 ECU_ADDRESS 0x90001e81 /end MEASUREMENT
/begin MEASUREMENT Min_Temp_index "" UBYTE VBU0428Test_CM_uint8 0 0 0 255 ECU_ADDRESS 0x90001e82 /end MEASUREMENT
/begin MEASUREMENT Low_Cell_Temp_4_BMU_ID "" UBYTE VBU0428Test_CM_uint8 0 0 0 255 ECU_ADDRESS 0x90001e4d /end MEASUREMENT
/begin MEASUREMENT Low_Cell_Temp_4_BMU_Index "" UBYTE VBU0428Test_CM_uint8 0 0 0 255 ECU_ADDRESS 0x90001e4e /end MEASUREMENT
/begin MEASUREMENT Low_Cell_Temp_5_BMU_ID "" UBYTE VBU0428Test_CM_uint8 0 0 0 255 ECU_ADDRESS 0x90001e4f /end MEASUREMENT
/begin MEASUREMENT Low_Cell_Temp_5_BMU_Index "" UBYTE VBU0428Test_CM_uint8 0 0 0 255 ECU_ADDRESS 0x90001e50 /end MEASUREMENT
/begin MEASUREMENT Low_Cell_Temp_2_BMU_ID "" UBYTE VBU0428Test_CM_uint8 0 0 0 255 ECU_ADDRESS 0x90001e49 /end MEASUREMENT
/begin MEASUREMENT Low_Cell_Temp_2_BMU_Index "" UBYTE VBU0428Test_CM_uint8 0 0 0 255 ECU_ADDRESS 0x90001e4a /end MEASUREMENT
/begin MEASUREMENT Low_Cell_Temp_3_BMU_ID "" UBYTE VBU0428Test_CM_uint8 0 0 0 255 ECU_ADDRESS 0x90001e4b /end MEASUREMENT
/begin MEASUREMENT Low_Cell_Temp_3_BMU_Index "" UBYTE VBU0428Test_CM_uint8 0 0 0 255 ECU_ADDRESS 0x90001e4c /end MEASUREMENT
/begin MEASUREMENT High_Cell_Temp_5_BMU_ID "" UBYTE VBU0428Test_CM_uint8 0 0 0 255 ECU_ADDRESS 0x90001e2e /end MEASUREMENT
/begin MEASUREMENT High_Cell_Temp_5_BMU_Index "" UBYTE VBU0428Test_CM_uint8 0 0 0 255 ECU_ADDRESS 0x90001e2f /end MEASUREMENT
/begin MEASUREMENT Low_Cell_Temp_1_BMU_ID "" UBYTE VBU0428Test_CM_uint8 0 0 0 255 ECU_ADDRESS 0x90001e47 /end MEASUREMENT
/begin MEASUREMENT Low_Cell_Temp_1_BMU_Index "" UBYTE VBU0428Test_CM_uint8 0 0 0 255 ECU_ADDRESS 0x90001e48 /end MEASUREMENT
/begin MEASUREMENT High_Cell_Temp_3_BMU_ID "" UBYTE VBU0428Test_CM_uint8 0 0 0 255 ECU_ADDRESS 0x90001e2a /end MEASUREMENT
/begin MEASUREMENT High_Cell_Temp_3_BMU_Index "" UBYTE VBU0428Test_CM_uint8 0 0 0 255 ECU_ADDRESS 0x90001e2b /end MEASUREMENT
/begin MEASUREMENT High_Cell_Temp_4_BMU_ID "" UBYTE VBU0428Test_CM_uint8 0 0 0 255 ECU_ADDRESS 0x90001e2c /end MEASUREMENT
/begin MEASUREMENT High_Cell_Temp_4_BMU_Index "" UBYTE VBU0428Test_CM_uint8 0 0 0 255 ECU_ADDRESS 0x90001e2d /end MEASUREMENT
/begin MEASUREMENT HCU_Statistics_State1_Heart "" UBYTE VBU0428Test_CM_uint8 0 0 0 255 ECU_ADDRESS 0x90001e23 /end MEASUREMENT
/begin MEASUREMENT MaxTempBMU_ID "" UBYTE VBU0428Test_CM_uint8 0 0 0 255 ECU_ADDRESS 0x90001e7a /end MEASUREMENT
/begin MEASUREMENT Max_Temp_BMU_index "" UBYTE VBU0428Test_CM_uint8 0 0 0 255 ECU_ADDRESS 0x90001e7b /end MEASUREMENT
/begin MEASUREMENT Max_Temp_index "" UBYTE VBU0428Test_CM_uint8 0 0 0 255 ECU_ADDRESS 0x90001e7c /end MEASUREMENT
/begin MEASUREMENT PWM_IN1_Duty "" UBYTE VBU0428Test_CM_uint8 0 0 0 255 ECU_ADDRESS 0x90001e88 /end MEASUREMENT
/begin MEASUREMENT PWM_IN2_Duty "" UBYTE VBU0428Test_CM_uint8 0 0 0 255 ECU_ADDRESS 0x90001e8a /end MEASUREMENT
/begin MEASUREMENT HCU_Message_6_Heart "" UBYTE VBU0428Test_CM_uint8 0 0 0 255 ECU_ADDRESS 0x90001e21 /end MEASUREMENT
/begin MEASUREMENT HCU_Message_5_Heart "" UBYTE VBU0428Test_CM_uint8 0 0 0 255 ECU_ADDRESS 0x90001e20 /end MEASUREMENT
/begin MEASUREMENT Insulation_State "" UBYTE VBU0428Test_CM_uint8 0 0 0 255 ECU_ADDRESS 0x90001e3e /end MEASUREMENT
/begin MEASUREMENT Self_Lock_State "" UBYTE VBU0428Test_CM_uint8 0 0 0 255 ECU_ADDRESS 0x90001e9d /end MEASUREMENT
/begin MEASUREMENT PWM_IN1_Freq "" UBYTE VBU0428Test_CM_ufix8_S10 0 0 0 2550.0 ECU_ADDRESS 0x90001e89 /end MEASUREMENT
/begin MEASUREMENT PWM_IN2_Freq "" UBYTE VBU0428Test_CM_ufix8_S10 0 0 0 2550.0 ECU_ADDRESS 0x90001e8b /end MEASUREMENT
/begin MEASUREMENT Temperature_33 "" UBYTE VBU0428Test_CM_ufix8_Bn40 0 0 -40.0 215.0 ECU_ADDRESS 0x90001ecc /end MEASUREMENT
/begin MEASUREMENT Temperature_34 "" UBYTE VBU0428Test_CM_ufix8_Bn40 0 0 -40.0 215.0 ECU_ADDRESS 0x90001ecd /end MEASUREMENT
/begin MEASUREMENT Temperature_35 "" UBYTE VBU0428Test_CM_ufix8_Bn40 0 0 -40.0 215.0 ECU_ADDRESS 0x90001ece /end MEASUREMENT
/begin MEASUREMENT Temperature_36 "" UBYTE VBU0428Test_CM_ufix8_Bn40 0 0 -40.0 215.0 ECU_ADDRESS 0x90001ecf /end MEASUREMENT
/begin MEASUREMENT Temperature_37 "" UBYTE VBU0428Test_CM_ufix8_Bn40 0 0 -40.0 215.0 ECU_ADDRESS 0x90001ed0 /end MEASUREMENT
/begin MEASUREMENT Temperature_38 "" UBYTE VBU0428Test_CM_ufix8_Bn40 0 0 -40.0 215.0 ECU_ADDRESS 0x90001ed1 /end MEASUREMENT
/begin MEASUREMENT Temperature_39 "" UBYTE VBU0428Test_CM_ufix8_Bn40 0 0 -40.0 215.0 ECU_ADDRESS 0x90001ed2 /end MEASUREMENT
/begin MEASUREMENT Temperature_40 "" UBYTE VBU0428Test_CM_ufix8_Bn40 0 0 -40.0 215.0 ECU_ADDRESS 0x90001ed4 /end MEASUREMENT
/begin MEASUREMENT Temperature_25 "" UBYTE VBU0428Test_CM_ufix8_Bn40 0 0 -40.0 215.0 ECU_ADDRESS 0x90001ec3 /end MEASUREMENT
/begin MEASUREMENT Temperature_26 "" UBYTE VBU0428Test_CM_ufix8_Bn40 0 0 -40.0 215.0 ECU_ADDRESS 0x90001ec4 /end MEASUREMENT
/begin MEASUREMENT Temperature_27 "" UBYTE VBU0428Test_CM_ufix8_Bn40 0 0 -40.0 215.0 ECU_ADDRESS 0x90001ec5 /end MEASUREMENT
/begin MEASUREMENT Temperature_28 "" UBYTE VBU0428Test_CM_ufix8_Bn40 0 0 -40.0 215.0 ECU_ADDRESS 0x90001ec6 /end MEASUREMENT
/begin MEASUREMENT Temperature_29 "" UBYTE VBU0428Test_CM_ufix8_Bn40 0 0 -40.0 215.0 ECU_ADDRESS 0x90001ec7 /end MEASUREMENT
/begin MEASUREMENT Temperature_30 "" UBYTE VBU0428Test_CM_ufix8_Bn40 0 0 -40.0 215.0 ECU_ADDRESS 0x90001ec9 /end MEASUREMENT
/begin MEASUREMENT Temperature_31 "" UBYTE VBU0428Test_CM_ufix8_Bn40 0 0 -40.0 215.0 ECU_ADDRESS 0x90001eca /end MEASUREMENT
/begin MEASUREMENT Temperature_32 "" UBYTE VBU0428Test_CM_ufix8_Bn40 0 0 -40.0 215.0 ECU_ADDRESS 0x90001ecb /end MEASUREMENT
/begin MEASUREMENT Temperature_17 "" UBYTE VBU0428Test_CM_ufix8_Bn40 0 0 -40.0 215.0 ECU_ADDRESS 0x90001eba /end MEASUREMENT
/begin MEASUREMENT Temperature_18 "" UBYTE VBU0428Test_CM_ufix8_Bn40 0 0 -40.0 215.0 ECU_ADDRESS 0x90001ebb /end MEASUREMENT
/begin MEASUREMENT Temperature_19 "" UBYTE VBU0428Test_CM_ufix8_Bn40 0 0 -40.0 215.0 ECU_ADDRESS 0x90001ebc /end MEASUREMENT
/begin MEASUREMENT Temperature_20 "" UBYTE VBU0428Test_CM_ufix8_Bn40 0 0 -40.0 215.0 ECU_ADDRESS 0x90001ebe /end MEASUREMENT
/begin MEASUREMENT Temperature_21 "" UBYTE VBU0428Test_CM_ufix8_Bn40 0 0 -40.0 215.0 ECU_ADDRESS 0x90001ebf /end MEASUREMENT
/begin MEASUREMENT Temperature_22 "" UBYTE VBU0428Test_CM_ufix8_Bn40 0 0 -40.0 215.0 ECU_ADDRESS 0x90001ec0 /end MEASUREMENT
/begin MEASUREMENT Temperature_23 "" UBYTE VBU0428Test_CM_ufix8_Bn40 0 0 -40.0 215.0 ECU_ADDRESS 0x90001ec1 /end MEASUREMENT
/begin MEASUREMENT Temperature_24 "" UBYTE VBU0428Test_CM_ufix8_Bn40 0 0 -40.0 215.0 ECU_ADDRESS 0x90001ec2 /end MEASUREMENT
/begin MEASUREMENT Temp_HCU_3 "" UBYTE VBU0428Test_CM_ufix8_Bn40 0 0 -40.0 215.0 ECU_ADDRESS 0x90001ea9 /end MEASUREMENT
/begin MEASUREMENT Temp_HCU_4 "" UBYTE VBU0428Test_CM_ufix8_Bn40 0 0 -40.0 215.0 ECU_ADDRESS 0x90001eaa /end MEASUREMENT
/begin MEASUREMENT Temp_HCU_5 "" UBYTE VBU0428Test_CM_ufix8_Bn40 0 0 -40.0 215.0 ECU_ADDRESS 0x90001eab /end MEASUREMENT
/begin MEASUREMENT Temp_HCU_6 "" UBYTE VBU0428Test_CM_ufix8_Bn40 0 0 -40.0 215.0 ECU_ADDRESS 0x90001eac /end MEASUREMENT
/begin MEASUREMENT Temp_HCU_7 "" UBYTE VBU0428Test_CM_ufix8_Bn40 0 0 -40.0 215.0 ECU_ADDRESS 0x90001ead /end MEASUREMENT
/begin MEASUREMENT Temp_HCU_8 "" UBYTE VBU0428Test_CM_ufix8_Bn40 0 0 -40.0 215.0 ECU_ADDRESS 0x90001eae /end MEASUREMENT
/begin MEASUREMENT Temp_HCU_Water_Inlet "" UBYTE VBU0428Test_CM_ufix8_Bn40 0 0 -40.0 215.0 ECU_ADDRESS 0x90001eaf /end MEASUREMENT
/begin MEASUREMENT Temp_HCU_Water_Outlet "" UBYTE VBU0428Test_CM_ufix8_Bn40 0 0 -40.0 215.0 ECU_ADDRESS 0x90001eb0 /end MEASUREMENT
/begin MEASUREMENT Temperature_10 "" UBYTE VBU0428Test_CM_ufix8_Bn40 0 0 -40.0 215.0 ECU_ADDRESS 0x90001eb3 /end MEASUREMENT
/begin MEASUREMENT Temperature_11 "" UBYTE VBU0428Test_CM_ufix8_Bn40 0 0 -40.0 215.0 ECU_ADDRESS 0x90001eb4 /end MEASUREMENT
/begin MEASUREMENT Temperature_12 "" UBYTE VBU0428Test_CM_ufix8_Bn40 0 0 -40.0 215.0 ECU_ADDRESS 0x90001eb5 /end MEASUREMENT
/begin MEASUREMENT Temperature_13 "" UBYTE VBU0428Test_CM_ufix8_Bn40 0 0 -40.0 215.0 ECU_ADDRESS 0x90001eb6 /end MEASUREMENT
/begin MEASUREMENT Temperature_14 "" UBYTE VBU0428Test_CM_ufix8_Bn40 0 0 -40.0 215.0 ECU_ADDRESS 0x90001eb7 /end MEASUREMENT
/begin MEASUREMENT Temperature_15 "" UBYTE VBU0428Test_CM_ufix8_Bn40 0 0 -40.0 215.0 ECU_ADDRESS 0x90001eb8 /end MEASUREMENT
/begin MEASUREMENT Temperature_16 "" UBYTE VBU0428Test_CM_ufix8_Bn40 0 0 -40.0 215.0 ECU_ADDRESS 0x90001eb9 /end MEASUREMENT
/begin MEASUREMENT Temperature_9 "" UBYTE VBU0428Test_CM_ufix8_Bn40 0 0 -40.0 215.0 ECU_ADDRESS 0x90001ed9 /end MEASUREMENT
/begin MEASUREMENT Ave_Temp "" UBYTE VBU0428Test_CM_ufix8_Bn40 0 0 -40.0 215.0 ECU_ADDRESS 0x90001da4 /end MEASUREMENT
/begin MEASUREMENT Board_Temp "" UBYTE VBU0428Test_CM_ufix8_Bn40 0 0 -40.0 215.0 ECU_ADDRESS 0x90001dc7 /end MEASUREMENT
/begin MEASUREMENT Temperature_1 "" UBYTE VBU0428Test_CM_ufix8_Bn40 0 0 -40.0 215.0 ECU_ADDRESS 0x90001eb2 /end MEASUREMENT
/begin MEASUREMENT Temperature_2 "" UBYTE VBU0428Test_CM_ufix8_Bn40 0 0 -40.0 215.0 ECU_ADDRESS 0x90001ebd /end MEASUREMENT
/begin MEASUREMENT Temperature_3 "" UBYTE VBU0428Test_CM_ufix8_Bn40 0 0 -40.0 215.0 ECU_ADDRESS 0x90001ec8 /end MEASUREMENT
/begin MEASUREMENT Temperature_4 "" UBYTE VBU0428Test_CM_ufix8_Bn40 0 0 -40.0 215.0 ECU_ADDRESS 0x90001ed3 /end MEASUREMENT
/begin MEASUREMENT Temperature_5 "" UBYTE VBU0428Test_CM_ufix8_Bn40 0 0 -40.0 215.0 ECU_ADDRESS 0x90001ed5 /end MEASUREMENT
/begin MEASUREMENT Temperature_6 "" UBYTE VBU0428Test_CM_ufix8_Bn40 0 0 -40.0 215.0 ECU_ADDRESS 0x90001ed6 /end MEASUREMENT
/begin MEASUREMENT Temperature_7 "" UBYTE VBU0428Test_CM_ufix8_Bn40 0 0 -40.0 215.0 ECU_ADDRESS 0x90001ed7 /end MEASUREMENT
/begin MEASUREMENT Temperature_8 "" UBYTE VBU0428Test_CM_ufix8_Bn40 0 0 -40.0 215.0 ECU_ADDRESS 0x90001ed8 /end MEASUREMENT
/begin MEASUREMENT LEM_stFaultInfor "" UBYTE VBU0428Test_CM_ufix7 0 0 0 127.0 ECU_ADDRESS 0x90001e40 /end MEASUREMENT
/begin MEASUREMENT Relay5_Error_State "" UBYTE VBU0428Test_CM_ufix4 0 0 0 15.0 ECU_ADDRESS 0x90001e90 /end MEASUREMENT
/begin MEASUREMENT Relay6_Error_State "" UBYTE VBU0428Test_CM_ufix4 0 0 0 15.0 ECU_ADDRESS 0x90001e91 /end MEASUREMENT
/begin MEASUREMENT Relay_Heat_Error_State "" UBYTE VBU0428Test_CM_ufix4 0 0 0 15.0 ECU_ADDRESS 0x90001e95 /end MEASUREMENT
/begin MEASUREMENT Relay_MainNegative_Error_State "" UBYTE VBU0428Test_CM_ufix4 0 0 0 15.0 ECU_ADDRESS 0x90001e97 /end MEASUREMENT
/begin MEASUREMENT Relay_MainPositive_Error_State "" UBYTE VBU0428Test_CM_ufix4 0 0 0 15.0 ECU_ADDRESS 0x90001e99 /end MEASUREMENT
/begin MEASUREMENT Relay_Precharge_Error_State "" UBYTE VBU0428Test_CM_ufix4 0 0 0 15.0 ECU_ADDRESS 0x90001e9b /end MEASUREMENT
/begin MEASUREMENT Power_Supply_Error_lev "" UBYTE VBU0428Test_CM_ufix2 0 0 0 3.0 ECU_ADDRESS 0x90001e8f /end MEASUREMENT
/begin MEASUREMENT Relay_5 "" UBYTE VBU0428Test_CM_ufix1 0 0 0 1.0 ECU_ADDRESS 0x90001e92 /end MEASUREMENT
/begin MEASUREMENT Relay_6 "" UBYTE VBU0428Test_CM_ufix1 0 0 0 1.0 ECU_ADDRESS 0x90001e93 /end MEASUREMENT
/begin MEASUREMENT Relay_Heat "" UBYTE VBU0428Test_CM_ufix1 0 0 0 1.0 ECU_ADDRESS 0x90001e94 /end MEASUREMENT
/begin MEASUREMENT Relay_MainNegative "" UBYTE VBU0428Test_CM_ufix1 0 0 0 1.0 ECU_ADDRESS 0x90001e96 /end MEASUREMENT
/begin MEASUREMENT Relay_MainPositive "" UBYTE VBU0428Test_CM_ufix1 0 0 0 1.0 ECU_ADDRESS 0x90001e98 /end MEASUREMENT
/begin MEASUREMENT Relay_Precharge "" UBYTE VBU0428Test_CM_ufix1 0 0 0 1.0 ECU_ADDRESS 0x90001e9a /end MEASUREMENT
/begin MEASUREMENT LEM_CurrentSensorInvalid "" UBYTE VBU0428Test_CM_ufix1 0 0 0 1.0 ECU_ADDRESS 0x90001e3f /end MEASUREMENT
/begin MEASUREMENT ADS_Error_1 "" UBYTE VBU0428Test_CM_ufix1 0 0 0 1.0 ECU_ADDRESS 0x90001da1 /end MEASUREMENT
/begin MEASUREMENT ADS_Error_2 "" UBYTE VBU0428Test_CM_ufix1 0 0 0 1.0 ECU_ADDRESS 0x90001da2 /end MEASUREMENT
/begin MEASUREMENT Comm_Error "" UBYTE VBU0428Test_CM_ufix1 0 0 0 1.0 ECU_ADDRESS 0x90001de9 /end MEASUREMENT
/begin MEASUREMENT Power_5V_High_Error "" UBYTE VBU0428Test_CM_ufix1 0 0 0 1.0 ECU_ADDRESS 0x90001e8d /end MEASUREMENT
/begin MEASUREMENT Power_5V_Low_Error "" UBYTE VBU0428Test_CM_ufix1 0 0 0 1.0 ECU_ADDRESS 0x90001e8e /end MEASUREMENT
/begin MEASUREMENT Self_Test "" UBYTE VBU0428Test_CM_ufix1 0 0 0 1.0 ECU_ADDRESS 0x90001e9e /end MEASUREMENT
/begin MEASUREMENT Temp_Line_Error "" UBYTE VBU0428Test_CM_ufix1 0 0 0 1.0 ECU_ADDRESS 0x90001eb1 /end MEASUREMENT
/begin MEASUREMENT Volt_Line_Error "" UBYTE VBU0428Test_CM_ufix1 0 0 0 1.0 ECU_ADDRESS 0x90001f27 /end MEASUREMENT
/begin MEASUREMENT DCH_flgStationCrrntLimd "" UBYTE VBU0428Test_CM_boolean 0 0 0.0 1.0 ECU_ADDRESS 0x90001cee /end MEASUREMENT
/begin MEASUREMENT DCH_flgChargingPortTempHigh "" UBYTE VBU0428Test_CM_boolean 0 0 0.0 1.0 ECU_ADDRESS 0x90001cd2 /end MEASUREMENT
/begin MEASUREMENT PMM_flgHVClReqSrcRising "" UBYTE VBU0428Test_CM_boolean 0 0 0 1 ECU_ADDRESS 0x90001d79 /end MEASUREMENT
/begin MEASUREMENT PMM_flgCtlSht "" UBYTE VBU0428Test_CM_boolean 0 0 0 1 ECU_ADDRESS 0x90001f41 /end MEASUREMENT
/begin MEASUREMENT PMM_flgRutnOffReq "" UBYTE VBU0428Test_CM_boolean 0 0 0 1 ECU_ADDRESS 0x90001d83 /end MEASUREMENT
/begin MEASUREMENT PMM_flgVehAllwOp "" UBYTE VBU0428Test_CM_boolean 0 0 0 1 ECU_ADDRESS 0x90001d84 /end MEASUREMENT
/begin MEASUREMENT PMM_flgHVRly "" UBYTE VBU0428Test_CM_boolean 0 0 0 1 ECU_ADDRESS 0x90001d7a /end MEASUREMENT
/begin MEASUREMENT PMM_flgInhinPwrUp "" UBYTE VBU0428Test_CM_boolean 0 0 0 1 ECU_ADDRESS 0x90001d80 /end MEASUREMENT
/begin MEASUREMENT PMM_flgHVRlyOpReqToHVRlyClReq "" UBYTE VBU0428Test_CM_boolean 0 0 0 1 ECU_ADDRESS 0x90001d7f /end MEASUREMENT
/begin MEASUREMENT PMM_flgHVClReqOn "" UBYTE VBU0428Test_CM_boolean 0 0 0 1 ECU_ADDRESS 0x90001d78 /end MEASUREMENT
/begin MEASUREMENT PMM_flgDCDCDisblToHVRlyOpReq "" UBYTE VBU0428Test_CM_boolean 0 0 0 1 ECU_ADDRESS 0x90001d77 /end MEASUREMENT
/begin MEASUREMENT PMM_flgOffLoadToHVRlyCld "" UBYTE VBU0428Test_CM_boolean 0 0 0 1 ECU_ADDRESS 0x90001f4a /end MEASUREMENT
/begin MEASUREMENT PMM_flgHVRlyOpReqToActvDisCh "" UBYTE VBU0428Test_CM_boolean 0 0 0 1 ECU_ADDRESS 0x90001d7e /end MEASUREMENT
/begin MEASUREMENT PMM_flgACTstToHVRlyOpReq "" UBYTE VBU0428Test_CM_boolean 0 0 0 1 ECU_ADDRESS 0x90001d74 /end MEASUREMENT
/begin MEASUREMENT PMM_flgHVRlyClReqToActvDisCh "" UBYTE VBU0428Test_CM_boolean 0 0 0 1 ECU_ADDRESS 0x90001d7b /end MEASUREMENT
/begin MEASUREMENT PMM_flgHVRlyCldToOffLoad "" UBYTE VBU0428Test_CM_boolean 0 0 0 1 ECU_ADDRESS 0x90001d7d /end MEASUREMENT
/begin MEASUREMENT PMM_flgHVRlyClReqToHVRlyCld "" UBYTE VBU0428Test_CM_boolean 0 0 0 1 ECU_ADDRESS 0x90001d7c /end MEASUREMENT
/begin MEASUREMENT PMM_flgActvDisChToHVRlyClReq "" UBYTE VBU0428Test_CM_boolean 0 0 0 1 ECU_ADDRESS 0x90001d75 /end MEASUREMENT
/begin MEASUREMENT PMM_flgShtDwnToInit "" UBYTE VBU0428Test_CM_boolean 0 0 0 1 ECU_ADDRESS 0x90001f51 /end MEASUREMENT
/begin MEASUREMENT PMM_flgACTstToHVRlyCld "" UBYTE VBU0428Test_CM_boolean 0 0 0 1 ECU_ADDRESS 0x90001f3e /end MEASUREMENT
/begin MEASUREMENT PMM_flgActvDisChToShtDwn "" UBYTE VBU0428Test_CM_boolean 0 0 0 1 ECU_ADDRESS 0x90001d76 /end MEASUREMENT
/begin MEASUREMENT PMM_flgWkup1Cmd "" UBYTE VBU0428Test_CM_boolean 0 0 0 1 ECU_ADDRESS 0x90001f54 /end MEASUREMENT
/begin MEASUREMENT PMM_flgVCUShtDwn "" UBYTE VBU0428Test_CM_boolean 0 0 0 1 ECU_ADDRESS 0x90001f52 /end MEASUREMENT
/begin MEASUREMENT PMM_flgACTstReq "" UBYTE VBU0428Test_CM_boolean 0 0 0 1 ECU_ADDRESS 0x90001f3c /end MEASUREMENT
/begin MEASUREMENT DCH_flgDCChDiagCmd "" UBYTE VBU0428Test_CM_boolean 0 0 0.0 1.0 ECU_ADDRESS 0x90001cd4 /end MEASUREMENT
/begin MEASUREMENT DCH_flgMonDCChOvrCrnt "" UBYTE VBU0428Test_CM_boolean 0 0 0.0 1.0 ECU_ADDRESS 0x90001ce0 /end MEASUREMENT
/begin MEASUREMENT DCH_flgDftDCChOvrCrnt "" UBYTE VBU0428Test_CM_boolean 0 0 0.0 1.0 ECU_ADDRESS 0x90001cda /end MEASUREMENT
/begin MEASUREMENT DCH_flgDftDCChOvrVltg "" UBYTE VBU0428Test_CM_boolean 0 0 0.0 1.0 ECU_ADDRESS 0x90001cdb /end MEASUREMENT
/begin MEASUREMENT DCH_flgDftDCPortOvrTemp "" UBYTE VBU0428Test_CM_boolean 0 0 0.0 1.0 ECU_ADDRESS 0x90001cdd /end MEASUREMENT
/begin MEASUREMENT DCH_flgMonDCPortOvrTemp "" UBYTE VBU0428Test_CM_boolean 0 0 0.0 1.0 ECU_ADDRESS 0x90001ce1 /end MEASUREMENT
/begin MEASUREMENT DCH_flgDCChPortTempLimEna "" UBYTE VBU0428Test_CM_boolean 0 0 0.0 1.0 ECU_ADDRESS 0x90001cd5 /end MEASUREMENT
/begin COMPU_METHOD VBU0428Test_CM_single_cnt "Q = V" RAT_FUNC "%8.6" "cnt" COEFFS 0 1 0 0 0 1 /end COMPU_METHOD
/begin COMPU_METHOD VBU0428Test_CM_uint16_cnt "Q = V" RAT_FUNC "%5.0" "cnt" COEFFS 0 1 0 0 0 1 /end COMPU_METHOD
/begin COMPU_METHOD VBU0428Test_CM_single_A "Q = V" RAT_FUNC "%8.6" "A" COEFFS 0 1 0 0 0 1 /end COMPU_METHOD
/begin COMPU_METHOD VBU0428Test_CM_single_fac "Q = V" RAT_FUNC "%8.6" "fac" COEFFS 0 1 0 0 0 1 /end COMPU_METHOD
/begin COMPU_METHOD VBU0428Test_CM_uint8 "Q = V" RAT_FUNC "%3.0" "" COEFFS 0 1 0 0 0 1 /end COMPU_METHOD
/begin COMPU_METHOD VBU0428Test_CM_single_km "Q = V" RAT_FUNC "%8.6" "km" COEFFS 0 1 0 0 0 1 /end COMPU_METHOD
/begin COMPU_METHOD VBU0428Test_CM_uint16 "Q = V" RAT_FUNC "%5.0" "" COEFFS 0 1 0 0 0 1 /end COMPU_METHOD
/begin COMPU_METHOD VBU0428Test_CM_single "Q = V" RAT_FUNC "%8.6" "" COEFFS 0 1 0 0 0 1 /end COMPU_METHOD
/begin COMPU_METHOD VBU0428Test_CM_single_s "Q = V" RAT_FUNC "%8.6" "s" COEFFS 0 1 0 0 0 1 /end COMPU_METHOD
/begin COMPU_METHOD VBU0428Test_CM_single_kW "Q = V" RAT_FUNC "%8.6" "kW" COEFFS 0 1 0 0 0 1 /end COMPU_METHOD
/begin COMPU_METHOD VBU0428Test_CM_boolean_flg "Q = V" RAT_FUNC "%1.0" "flg" COEFFS 0 1 0 0 0 1 /end COMPU_METHOD
/begin COMPU_METHOD VBU0428Test_CM_boolean_cnt "Q = V" RAT_FUNC "%1.0" "cnt" COEFFS 0 1 0 0 0 1 /end COMPU_METHOD
/begin COMPU_METHOD VBU0428Test_CM_boolean "Q = V" RAT_FUNC "%1.0" "" COEFFS 0 1 0 0 0 1 /end COMPU_METHOD
/begin COMPU_METHOD VBU0428Test_CM_uint8_cnt "Q = V" RAT_FUNC "%3.0" "cnt" COEFFS 0 1 0 0 0 1 /end COMPU_METHOD
/begin COMPU_METHOD VBU0428Test_CM_ufix32_Bn2147483648 "Q = (V+2147483648.000000)/1.000000" RAT_FUNC "%0.6" "" COEFFS 0 1.000000 2147483648.000000 0 0 1.000000 /end COMPU_METHOD
/begin COMPU_METHOD VBU0428Test_CM_ufix24 "Q = V/1.000000" RAT_FUNC "%10.0" "" COEFFS 0 1.000000 0.000000 0 0 1.000000 /end COMPU_METHOD
/begin COMPU_METHOD VBU0428Test_CM_ufix16_Sp1_Bn40 "Q = (V+40.000000)*10.000000" RAT_FUNC "%0.6" "" COEFFS 0 10.000000 400.000000 0 0 1.000000 /end COMPU_METHOD
/begin COMPU_METHOD VBU0428Test_CM_ufix16_Sp1 "Q = V*10.000000" RAT_FUNC "%0.6" "" COEFFS 0 10.000000 0.000000 0 0 1.000000 /end COMPU_METHOD
/begin COMPU_METHOD VBU0428Test_CM_ufix8_S10 "Q = V/10.000000" RAT_FUNC "%0.6" "" COEFFS 0 1.000000 0.000000 0 0 10.000000 /end COMPU_METHOD
/begin COMPU_METHOD VBU0428Test_CM_ufix8_Bn40 "Q = (V+40.000000)/1.000000" RAT_FUNC "%0.6" "" COEFFS 0 1.000000 40.000000 0 0 1.000000 /end COMPU_METHOD
/begin COMPU_METHOD VBU0428Test_CM_ufix7 "Q = V/1.000000" RAT_FUNC "%3.0" "" COEFFS 0 1.000000 0.000000 0 0 1.000000 /end COMPU_METHOD
/begin COMPU_METHOD VBU0428Test_CM_ufix4 "Q = V/1.000000" RAT_FUNC "%3.0" "" COEFFS 0 1.000000 0.000000 0 0 1.000000 /end COMPU_METHOD
/begin COMPU_METHOD VBU0428Test_CM_ufix2 "Q = V/1.000000" RAT_FUNC "%3.0" "" COEFFS 0 1.000000 0.000000 0 0 1.000000 /end COMPU_METHOD
/begin COMPU_METHOD VBU0428Test_CM_ufix1 "Q = V/1.000000" RAT_FUNC "%3.0" "" COEFFS 0 1.000000 0.000000 0 0 1.000000 /end COMPU_METHOD
/begin GROUP S2007_Input_CAN_Signal_No_Range_Check5 "VBU0428Test/VBUSystem/HALIn/PTCAN/Subsystem/20ms/EPS_0x70/Input_CAN_Signal_No_Range_Check5" /begin REF_CHARACTERISTIC EPS_flgPhiStrngAgOvrd_C EPS_phiStrngAgOvrdVal_C /end REF_CHARACTERISTIC /end GROUP
/begin GROUP S2007_Input_CAN_Signal_No_Range_Check6 "VBU0428Test/VBUSystem/HALIn/PTCAN/Subsystem/20ms/EPS_0x70/Input_CAN_Signal_No_Range_Check6" /begin REF_CHARACTERISTIC EPS_cntECUMsgCntOvrdVal_C EPS_flgCntECUMsgCntOvrd_C /end REF_CHARACTERISTIC /end GROUP
/begin GROUP S2008_Input_CAN_Signal_No_Range_Check1 "VBU0428Test/VBUSystem/HALIn/PTCAN/Subsystem/20ms/MCU_205/Input_CAN_Signal_No_Range_Check1" /begin SUB_GROUP S2169_override_signal /end SUB_GROUP /begin REF_CHARACTERISTIC PEUR_flgTrqActOvrd_C PEUR_trqActOvrdVal_C /end REF_CHARACTERISTIC /end GROUP
/begin GROUP S2008_Input_CAN_Signal_No_Range_Check2 "VBU0428Test/VBUSystem/HALIn/PTCAN/Subsystem/20ms/MCU_205/Input_CAN_Signal_No_Range_Check2" /begin REF_CHARACTERISTIC PEUR_flgStInvrOvrd_C PEUR_stInvrOvrdVal_C /end REF_CHARACTERISTIC /end GROUP
/begin GROUP S2008_Input_CAN_Signal_No_Range_Check3 "VBU0428Test/VBUSystem/HALIn/PTCAN/Subsystem/20ms/MCU_205/Input_CAN_Signal_No_Range_Check3" /begin SUB_GROUP S2171_override_signal /end SUB_GROUP /begin REF_CHARACTERISTIC PEUR_flgFlgMotrHillHldOvrd_C PEUR_flgMotrHillHldOvrdVal_C /end REF_CHARACTERISTIC /end GROUP
/begin GROUP S2008_Input_CAN_Signal_No_Range_Check4 "VBU0428Test/VBUSystem/HALIn/PTCAN/Subsystem/20ms/MCU_205/Input_CAN_Signal_No_Range_Check4" /begin SUB_GROUP S2172_override_signal /end SUB_GROUP /begin REF_CHARACTERISTIC PEUR_flgStActvDisChOvrd_C PEUR_stActvDisChOvrdVal_C /end REF_CHARACTERISTIC /end GROUP
/begin GROUP S2008_Input_CAN_Signal_No_Range_Check5 "VBU0428Test/VBUSystem/HALIn/PTCAN/Subsystem/20ms/MCU_205/Input_CAN_Signal_No_Range_Check5" /begin SUB_GROUP S2173_override_signal /end SUB_GROUP /begin REF_CHARACTERISTIC PEUR_flgNMotrOvrd_C PEUR_nMotrOvrdVal_C /end REF_CHARACTERISTIC /end GROUP
/begin GROUP S2008_Input_CAN_Signal_No_Range_Check6 "VBU0428Test/VBUSystem/HALIn/PTCAN/Subsystem/20ms/MCU_205/Input_CAN_Signal_No_Range_Check6" /begin REF_CHARACTERISTIC PEUR_flgFlgMotrSpdVldOvrd_C PEUR_flgMotrSpdVldOvrdVal_C /end REF_CHARACTERISTIC /end GROUP
/begin GROUP S2008_Input_CAN_Signal_No_Range_Check7 "VBU0428Test/VBUSystem/HALIn/PTCAN/Subsystem/20ms/MCU_205/Input_CAN_Signal_No_Range_Check7" /begin SUB_GROUP S2175_override_signal /end SUB_GROUP /begin REF_CHARACTERISTIC PEUR_flgICalcDCOvrd_C PEUR_iCalcDCOvrdVal_C /end REF_CHARACTERISTIC /end GROUP
/begin GROUP S2196_Input_CAN_Signal_No_Range_Check "VBU0428Test/VBUSystem/HALIn/PTCAN/Subsystem/50ms/BCM_0x18FE0121/Input_CAN_Signal_No_Range_Check" /begin REF_CHARACTERISTIC BCM_flgStRealFogLghtOvrd_C BCM_stRealFogLghtOvrdVal_C /end REF_CHARACTERISTIC /end GROUP
/begin GROUP S2196_Input_CAN_Signal_No_Range_Check1 "VBU0428Test/VBUSystem/HALIn/PTCAN/Subsystem/50ms/BCM_0x18FE0121/Input_CAN_Signal_No_Range_Check1" /begin REF_CHARACTERISTIC BCM_flgStDayLghtStatusOvrd_C BCM_stDayLghtStatusOvrdVal_C /end REF_CHARACTERISTIC /end GROUP
/begin GROUP S2196_Input_CAN_Signal_No_Range_Check10 "VBU0428Test/VBUSystem/HALIn/PTCAN/Subsystem/50ms/BCM_0x18FE0121/Input_CAN_Signal_No_Range_Check10" /begin REF_CHARACTERISTIC BCM_flgStParkSwtStatusOvrd_C BCM_stParkSwtStatusOvrdVal_C /end REF_CHARACTERISTIC /end GROUP
/begin GROUP S2196_Input_CAN_Signal_No_Range_Check11 "VBU0428Test/VBUSystem/HALIn/PTCAN/Subsystem/50ms/BCM_0x18FE0121/Input_CAN_Signal_No_Range_Check11" /begin REF_CHARACTERISTIC BCM_flgStBrkLghtStatusOvrd_C BCM_stBrkLghtStatusOvrdVal_C /end REF_CHARACTERISTIC /end GROUP
/begin GROUP S2196_Input_CAN_Signal_No_Range_Check12 "VBU0428Test/VBUSystem/HALIn/PTCAN/Subsystem/50ms/BCM_0x18FE0121/Input_CAN_Signal_No_Range_Check12" /begin REF_CHARACTERISTIC BCM_flgStDoorStatusOvrd_C BCM_stDoorStatusOvrdVal_C /end REF_CHARACTERISTIC /end GROUP
/begin GROUP S2196_Input_CAN_Signal_No_Range_Check13 "VBU0428Test/VBUSystem/HALIn/PTCAN/Subsystem/50ms/BCM_0x18FE0121/Input_CAN_Signal_No_Range_Check13" /begin REF_CHARACTERISTIC BCM_flgFlgIG1PwrOvrd_C BCM_flgIG1PwrOvrdVal_C /end REF_CHARACTERISTIC /end GROUP
/begin GROUP S2196_Input_CAN_Signal_No_Range_Check14 "VBU0428Test/VBUSystem/HALIn/PTCAN/Subsystem/50ms/BCM_0x18FE0121/Input_CAN_Signal_No_Range_Check14"
 /begin REF_CHARACTERISTIC BCM_flgStWashMotrStatusOvrd_C BCM_stWashMotrStatusOvrdVal_C /end REF_CHARACTERISTIC
/end GROUP
/begin GROUP S2196_Input_CAN_Signal_No_Range_Check15 "VBU0428Test/VBUSystem/HALIn/PTCAN/Subsystem/50ms/BCM_0x18FE0121/Input_CAN_Signal_No_Range_Check15" /begin REF_CHARACTERISTIC BCM_flgStLoWiperStatusOvrd_C BCM_stLoWiperStatusOvrdVal_C /end REF_CHARACTERISTIC /end GROUP
/begin GROUP S2196_Input_CAN_Signal_No_Range_Check16 "VBU0428Test/VBUSystem/HALIn/PTCAN/Subsystem/50ms/BCM_0x18FE0121/Input_CAN_Signal_No_Range_Check16" /begin REF_CHARACTERISTIC BCM_flgStHIWiperStatusOvrd_C BCM_stHIWiperStatusOvrdVal_C /end REF_CHARACTERISTIC /end GROUP
/begin GROUP S2196_Input_CAN_Signal_No_Range_Check17 "VBU0428Test/VBUSystem/HALIn/PTCAN/Subsystem/50ms/BCM_0x18FE0121/Input_CAN_Signal_No_Range_Check17" /begin REF_CHARACTERISTIC BCM_flgStAutoWiperGearOvrd_C BCM_stAutoWiperGearOvrdVal_C /end REF_CHARACTERISTIC /end GROUP
/begin GROUP S2196_Input_CAN_Signal_No_Range_Check18 "VBU0428Test/VBUSystem/HALIn/PTCAN/Subsystem/50ms/BCM_0x18FE0121/Input_CAN_Signal_No_Range_Check18"
 /begin REF_CHARACTERISTIC BCM_flgStAutoHeadlightGearOvrd_C BCM_stAutoHeadlightGearOvrdVal_C /end REF_CHARACTERISTIC
/end GROUP
/begin GROUP S2196_Input_CAN_Signal_No_Range_Check2 "VBU0428Test/VBUSystem/HALIn/PTCAN/Subsystem/50ms/BCM_0x18FE0121/Input_CAN_Signal_No_Range_Check2"
 /begin REF_CHARACTERISTIC BCM_flgStParkLghtStatusOvrd_C BCM_stParkLghtStatusOvrdVal_C /end REF_CHARACTERISTIC
/end GROUP
/begin GROUP S2196_Input_CAN_Signal_No_Range_Check3 "VBU0428Test/VBUSystem/HALIn/PTCAN/Subsystem/50ms/BCM_0x18FE0121/Input_CAN_Signal_No_Range_Check3" /begin REF_CHARACTERISTIC BCM_flgStFrntFogLghtOvrd_C BCM_stFrntFogLghtOvrdVal_C /end REF_CHARACTERISTIC /end GROUP
/begin GROUP S2196_Input_CAN_Signal_No_Range_Check4 "VBU0428Test/VBUSystem/HALIn/PTCAN/Subsystem/50ms/BCM_0x18FE0121/Input_CAN_Signal_No_Range_Check4"
 /begin REF_CHARACTERISTIC BCM_flgStRiTurnLghtStatusOvrd_C BCM_stRiTurnLghtStatusOvrdVal_C /end REF_CHARACTERISTIC
/end GROUP
/begin GROUP S2196_Input_CAN_Signal_No_Range_Check5 "VBU0428Test/VBUSystem/HALIn/PTCAN/Subsystem/50ms/BCM_0x18FE0121/Input_CAN_Signal_No_Range_Check5" /begin REF_CHARACTERISTIC BCM_flgStLeTurnStatusOvrd_C BCM_stLeTurnStatusOvrdVal_C /end REF_CHARACTERISTIC /end GROUP
/begin GROUP S2196_Input_CAN_Signal_No_Range_Check6 "VBU0428Test/VBUSystem/HALIn/PTCAN/Subsystem/50ms/BCM_0x18FE0121/Input_CAN_Signal_No_Range_Check6" /begin REF_CHARACTERISTIC BCM_flgStLowBeamOvrd_C BCM_stLowBeamOvrdVal_C /end REF_CHARACTERISTIC /end GROUP
/begin GROUP S2196_Input_CAN_Signal_No_Range_Check7 "VBU0428Test/VBUSystem/HALIn/PTCAN/Subsystem/50ms/BCM_0x18FE0121/Input_CAN_Signal_No_Range_Check7" /begin REF_CHARACTERISTIC BCM_flgStHiBeamOvrd_C BCM_stHiBeamOvrdVal_C /end REF_CHARACTERISTIC /end GROUP
/begin GROUP S2196_Input_CAN_Signal_No_Range_Check8 "VBU0428Test/VBUSystem/HALIn/PTCAN/Subsystem/50ms/BCM_0x18FE0121/Input_CAN_Signal_No_Range_Check8"
 /begin REF_CHARACTERISTIC BCM_flgStReversingSwtStatusOvrd_C BCM_stReversingSwtStatusOvrdVal_C /end REF_CHARACTERISTIC
/end GROUP
/begin GROUP S2196_Input_CAN_Signal_No_Range_Check9 "VBU0428Test/VBUSystem/HALIn/PTCAN/Subsystem/50ms/BCM_0x18FE0121/Input_CAN_Signal_No_Range_Check9" /begin REF_CHARACTERISTIC BCM_flgStHornStatusOvrd_C BCM_stHornStatusOvrdVal_C /end REF_CHARACTERISTIC /end GROUP
/begin GROUP S2197_Input_CAN_Signal_No_Range_Check "VBU0428Test/VBUSystem/HALIn/PTCAN/Subsystem/50ms/MCU_305/Input_CAN_Signal_No_Range_Check" /begin SUB_GROUP S2263_override_signal /end SUB_GROUP
 /begin REF_CHARACTERISTIC PEUR_flgUDCRlyOutsideVltgOvrd_C PEUR_uDCRlyOutsideVltgOvrdVal_C /end REF_CHARACTERISTIC
/end GROUP
/begin GROUP S2197_Input_CAN_Signal_No_Range_Check1 "VBU0428Test/VBUSystem/HALIn/PTCAN/Subsystem/50ms/MCU_305/Input_CAN_Signal_No_Range_Check1" /begin REF_CHARACTERISTIC PEUR_flgTrqMaxLimitOvrd_C PEUR_trqMaxLimitOvrdVal_C /end REF_CHARACTERISTIC /end GROUP
/begin GROUP S2197_Input_CAN_Signal_No_Range_Check2 "VBU0428Test/VBUSystem/HALIn/PTCAN/Subsystem/50ms/MCU_305/Input_CAN_Signal_No_Range_Check2" /begin REF_CHARACTERISTIC PEUR_flgUMeasDCOvrd_C PEUR_uMeasDCOvrdVal_C /end REF_CHARACTERISTIC /end GROUP
/begin GROUP S2380_CanRxData_Unpack "VBU0428Test/VBUSystem/HALIn/PTCAN/Subsystem/CanMsgUnpack/MsgRxData_Unpack1/CanRxData_Unpack" /begin SUB_GROUP S2400_ABS_VehicleSpeedAndStatus /end SUB_GROUP /end GROUP
/begin GROUP S2381_CanRxData_Unpack "VBU0428Test/VBUSystem/HALIn/PTCAN/Subsystem/CanMsgUnpack/MsgRxData_Unpack10/CanRxData_Unpack" /begin SUB_GROUP S2402_DCDC_VCU_509 /end SUB_GROUP /end GROUP
/begin GROUP S2382_CanRxData_Unpack "VBU0428Test/VBUSystem/HALIn/PTCAN/Subsystem/CanMsgUnpack/MsgRxData_Unpack11/CanRxData_Unpack" /begin SUB_GROUP S2404_EPB_State /end SUB_GROUP /end GROUP
/begin GROUP S2383_CanRxData_Unpack "VBU0428Test/VBUSystem/HALIn/PTCAN/Subsystem/CanMsgUnpack/MsgRxData_Unpack12/CanRxData_Unpack" /begin SUB_GROUP S2406_EPS_DM1 /end SUB_GROUP /end GROUP
/begin GROUP S2384_CanRxData_Unpack "VBU0428Test/VBUSystem/HALIn/PTCAN/Subsystem/CanMsgUnpack/MsgRxData_Unpack13/CanRxData_Unpack" /begin SUB_GROUP S2408_EPS_FEEDBACK_STA /end SUB_GROUP /end GROUP
/begin GROUP S2385_CanRxData_Unpack "VBU0428Test/VBUSystem/HALIn/PTCAN/Subsystem/CanMsgUnpack/MsgRxData_Unpack14/CanRxData_Unpack" /begin SUB_GROUP S2410_IC_401 /end SUB_GROUP /end GROUP
/begin GROUP S2386_CanRxData_Unpack "VBU0428Test/VBUSystem/HALIn/PTCAN/Subsystem/CanMsgUnpack/MsgRxData_Unpack15/CanRxData_Unpack" /begin SUB_GROUP S2412_MCU_205 /end SUB_GROUP /end GROUP
/begin GROUP S2387_CanRxData_Unpack "VBU0428Test/VBUSystem/HALIn/PTCAN/Subsystem/CanMsgUnpack/MsgRxData_Unpack16/CanRxData_Unpack" /begin SUB_GROUP S2414_MCU_305 /end SUB_GROUP /end GROUP
/begin GROUP S2388_CanRxData_Unpack "VBU0428Test/VBUSystem/HALIn/PTCAN/Subsystem/CanMsgUnpack/MsgRxData_Unpack17/CanRxData_Unpack" /begin SUB_GROUP S2416_MCU_405 /end SUB_GROUP /end GROUP
/begin GROUP S2389_CanRxData_Unpack "VBU0428Test/VBUSystem/HALIn/PTCAN/Subsystem/CanMsgUnpack/MsgRxData_Unpack18/CanRxData_Unpack" /begin SUB_GROUP S2418_MCU_505 /end SUB_GROUP /end GROUP
/begin GROUP S2390_CanRxData_Unpack "VBU0428Test/VBUSystem/HALIn/PTCAN/Subsystem/CanMsgUnpack/MsgRxData_Unpack19/CanRxData_Unpack" /begin SUB_GROUP S2420_T_BOX_510 /end SUB_GROUP /end GROUP
/begin GROUP S2391_CanRxData_Unpack "VBU0428Test/VBUSystem/HALIn/PTCAN/Subsystem/CanMsgUnpack/MsgRxData_Unpack2/CanRxData_Unpack" /begin SUB_GROUP S2422_ABS_WheelSpeed_Front_Whl /end SUB_GROUP /end GROUP
/begin GROUP S2392_CanRxData_Unpack "VBU0428Test/VBUSystem/HALIn/PTCAN/Subsystem/CanMsgUnpack/MsgRxData_Unpack20/CanRxData_Unpack" /begin SUB_GROUP S2424_T_BOX_511 /end SUB_GROUP /end GROUP
/begin GROUP S2393_CanRxData_Unpack "VBU0428Test/VBUSystem/HALIn/PTCAN/Subsystem/CanMsgUnpack/MsgRxData_Unpack3/CanRxData_Unpack" /begin SUB_GROUP S2426_ABS_WheelSpeed_PulseCounter /end SUB_GROUP /end GROUP
/begin GROUP S2394_CanRxData_Unpack "VBU0428Test/VBUSystem/HALIn/PTCAN/Subsystem/CanMsgUnpack/MsgRxData_Unpack4/CanRxData_Unpack" /begin SUB_GROUP S2428_ABS_WheelSpeed_Rear_Whl /end SUB_GROUP /end GROUP
/begin GROUP S2395_CanRxData_Unpack "VBU0428Test/VBUSystem/HALIn/PTCAN/Subsystem/CanMsgUnpack/MsgRxData_Unpack5/CanRxData_Unpack" /begin SUB_GROUP S2430_AC_VCU /end SUB_GROUP /end GROUP
/begin GROUP S2396_CanRxData_Unpack "VBU0428Test/VBUSystem/HALIn/PTCAN/Subsystem/CanMsgUnpack/MsgRxData_Unpack6/CanRxData_Unpack" /begin SUB_GROUP S2432_AVAS /end SUB_GROUP /end GROUP
/begin GROUP S2397_CanRxData_Unpack "VBU0428Test/VBUSystem/HALIn/PTCAN/Subsystem/CanMsgUnpack/MsgRxData_Unpack7/CanRxData_Unpack" /begin SUB_GROUP S2434_BCM_VCU /end SUB_GROUP /end GROUP
/begin GROUP S2398_CanRxData_Unpack "VBU0428Test/VBUSystem/HALIn/PTCAN/Subsystem/CanMsgUnpack/MsgRxData_Unpack8/CanRxData_Unpack" /begin SUB_GROUP S2436_CDC_VCU /end SUB_GROUP /end GROUP
/begin GROUP S2399_CanRxData_Unpack "VBU0428Test/VBUSystem/HALIn/PTCAN/Subsystem/CanMsgUnpack/MsgRxData_Unpack9/CanRxData_Unpack" /begin SUB_GROUP S2438_DCDC_VCU_303 /end SUB_GROUP /end GROUP
/begin GROUP S2440_Input_CAN_Signal_No_Range_Check "VBU0428Test/VBUSystem/HALIn/PTCAN/Subsystem/Subsystem2/AVAS_1801D0D3/Input_CAN_Signal_No_Range_Check"
 /begin REF_CHARACTERISTIC AVAS_flgStWorkingStatusOvrd_C AVAS_stWorkingStatusOvrdVal_C /end REF_CHARACTERISTIC
/end GROUP
/begin GROUP S2440_Input_CAN_Signal_No_Range_Check1 "VBU0428Test/VBUSystem/HALIn/PTCAN/Subsystem/Subsystem2/AVAS_1801D0D3/Input_CAN_Signal_No_Range_Check1" /begin REF_CHARACTERISTIC AVAS_flgNumHwVerOvrd_C AVAS_numHwVerOvrdVal_C /end REF_CHARACTERISTIC /end GROUP
/begin GROUP S2440_Input_CAN_Signal_No_Range_Check2 "VBU0428Test/VBUSystem/HALIn/PTCAN/Subsystem/Subsystem2/AVAS_1801D0D3/Input_CAN_Signal_No_Range_Check2" /begin REF_CHARACTERISTIC AVAS_flgNumSoftwareVerOvrd_C AVAS_numSoftwareVerOvrdVal_C /end REF_CHARACTERISTIC /end GROUP
/begin GROUP S2441_Input_CAN_Signal_No_Range_Check "VBU0428Test/VBUSystem/HALIn/PTCAN/Subsystem/Subsystem2/IC_401/Input_CAN_Signal_No_Range_Check" /begin REF_CHARACTERISTIC IC_flgBrkDisWarnOvrdVal_C IC_flgFlgBrkDisWarnOvrd_C /end REF_CHARACTERISTIC /end GROUP
/begin GROUP S2441_Input_CAN_Signal_No_Range_Check1 "VBU0428Test/VBUSystem/HALIn/PTCAN/Subsystem/Subsystem2/IC_401/Input_CAN_Signal_No_Range_Check1"
 /begin REF_CHARACTERISTIC IC_flgFlgSeatbeltUnlockOvrd_C IC_flgSeatbeltUnlockOvrdVal_C /end REF_CHARACTERISTIC
/end GROUP
/begin GROUP S2441_Input_CAN_Signal_No_Range_Check2 "VBU0428Test/VBUSystem/HALIn/PTCAN/Subsystem/Subsystem2/IC_401/Input_CAN_Signal_No_Range_Check2" /begin REF_CHARACTERISTIC IC_flgKmVehOdmeterOvrd_C IC_kmVehOdmeterOvrdVal_C /end REF_CHARACTERISTIC /end GROUP
/begin GROUP S2441_Input_CAN_Signal_No_Range_Check3 "VBU0428Test/VBUSystem/HALIn/PTCAN/Subsystem/Subsystem2/IC_401/Input_CAN_Signal_No_Range_Check3" /begin REF_CHARACTERISTIC IC_flgBrkFluidWarnOvrdVal_C IC_flgFlgBrkFluidWarnOvrd_C /end REF_CHARACTERISTIC /end GROUP
/begin GROUP S2442_Input_CAN_Signal_No_Range_Check "VBU0428Test/VBUSystem/HALIn/PTCAN/Subsystem/Subsystem2/MCU_505/Input_CAN_Signal_No_Range_Check" /begin REF_CHARACTERISTIC PEUR_flgFlgMotrOvrHeatOvrd_C PEUR_flgMotrOvrHeatOvrdVal_C /end REF_CHARACTERISTIC /end GROUP
/begin GROUP S2442_Input_CAN_Signal_No_Range_Check1 "VBU0428Test/VBUSystem/HALIn/PTCAN/Subsystem/Subsystem2/MCU_505/Input_CAN_Signal_No_Range_Check1" /begin REF_CHARACTERISTIC PEUR_flgFlgIGBTOvrHeatOvrd_C PEUR_flgIGBTOvrHeatOvrdVal_C /end REF_CHARACTERISTIC /end GROUP
/begin GROUP S2442_Input_CAN_Signal_No_Range_Check10 "VBU0428Test/VBUSystem/HALIn/PTCAN/Subsystem/Subsystem2/MCU_505/Input_CAN_Signal_No_Range_Check10"
 /begin REF_CHARACTERISTIC PEUR_flgDrvUparmFailOvrdVal_C PEUR_flgFlgDrvUparmFailOvrd_C /end REF_CHARACTERISTIC
/end GROUP
/begin GROUP S2442_Input_CAN_Signal_No_Range_Check11 "VBU0428Test/VBUSystem/HALIn/PTCAN/Subsystem/Subsystem2/MCU_505/Input_CAN_Signal_No_Range_Check11" /begin REF_CHARACTERISTIC PEUR_flgFlgHWUnderVoltOvrd_C PEUR_flgHWUnderVoltOvrdVal_C /end REF_CHARACTERISTIC /end GROUP
/begin GROUP S2442_Input_CAN_Signal_No_Range_Check12 "VBU0428Test/VBUSystem/HALIn/PTCAN/Subsystem/Subsystem2/MCU_505/Input_CAN_Signal_No_Range_Check12" /begin REF_CHARACTERISTIC PEUR_flgFlgHwOvrVloltOvrd_C PEUR_flgHwOvrVloltOvrdVal_C /end REF_CHARACTERISTIC /end GROUP
/begin GROUP S2442_Input_CAN_Signal_No_Range_Check13 "VBU0428Test/VBUSystem/HALIn/PTCAN/Subsystem/Subsystem2/MCU_505/Input_CAN_Signal_No_Range_Check13" /begin REF_CHARACTERISTIC PEUR_flgBusUndrVltgOvrdVal_C PEUR_flgFlgBusUndrVltgOvrd_C /end REF_CHARACTERISTIC /end GROUP
/begin GROUP S2442_Input_CAN_Signal_No_Range_Check14 "VBU0428Test/VBUSystem/HALIn/PTCAN/Subsystem/Subsystem2/MCU_505/Input_CAN_Signal_No_Range_Check14" /begin REF_CHARACTERISTIC PEUR_flgBusOvrVltgOvrdVal_C PEUR_flgFlgBusOvrVltgOvrd_C /end REF_CHARACTERISTIC /end GROUP
/begin GROUP S2442_Input_CAN_Signal_No_Range_Check15 "VBU0428Test/VBUSystem/HALIn/PTCAN/Subsystem/Subsystem2/MCU_505/Input_CAN_Signal_No_Range_Check15" /begin REF_CHARACTERISTIC PEUR_flgCANFaultOvrdVal_C PEUR_flgFlgCANFaultOvrd_C /end REF_CHARACTERISTIC /end GROUP
/begin GROUP S2442_Input_CAN_Signal_No_Range_Check16 "VBU0428Test/VBUSystem/HALIn/PTCAN/Subsystem/Subsystem2/MCU_505/Input_CAN_Signal_No_Range_Check16"
 /begin REF_CHARACTERISTIC PEUR_flgFlgRadiatorOvrTempLimOvrd_C PEUR_flgRadiatorOvrTempLimOvrdVal_C /end REF_CHARACTERISTIC
/end GROUP
/begin GROUP S2442_Input_CAN_Signal_No_Range_Check17 "VBU0428Test/VBUSystem/HALIn/PTCAN/Subsystem/Subsystem2/MCU_505/Input_CAN_Signal_No_Range_Check17"
 /begin REF_CHARACTERISTIC PEUR_flgFlgIGBTJunctionOvrTempLimOvrd_C PEUR_flgIGBTJunctionOvrTempLimOvrdVal_C /end REF_CHARACTERISTIC
/end GROUP
/begin GROUP S2442_Input_CAN_Signal_No_Range_Check18 "VBU0428Test/VBUSystem/HALIn/PTCAN/Subsystem/Subsystem2/MCU_505/Input_CAN_Signal_No_Range_Check18"
 /begin REF_CHARACTERISTIC PEUR_flgFlgIGBTNTCOvrTempLimOvrd_C PEUR_flgIGBTNTCOvrTempLimOvrdVal_C /end REF_CHARACTERISTIC
/end GROUP
/begin GROUP S2442_Input_CAN_Signal_No_Range_Check19 "VBU0428Test/VBUSystem/HALIn/PTCAN/Subsystem/Subsystem2/MCU_505/Input_CAN_Signal_No_Range_Check19"
 /begin REF_CHARACTERISTIC PEUR_flgFlgMotrOvrTempLimOvrd_C PEUR_flgMotrOvrTempLimOvrdVal_C /end REF_CHARACTERISTIC
/end GROUP
/begin GROUP S2442_Input_CAN_Signal_No_Range_Check2 "VBU0428Test/VBUSystem/HALIn/PTCAN/Subsystem/Subsystem2/MCU_505/Input_CAN_Signal_No_Range_Check2"
 /begin REF_CHARACTERISTIC PEUR_flgFlgResolverFaultOvrd_C PEUR_flgResolverFaultOvrdVal_C /end REF_CHARACTERISTIC
/end GROUP
/begin GROUP S2442_Input_CAN_Signal_No_Range_Check20 "VBU0428Test/VBUSystem/HALIn/PTCAN/Subsystem/Subsystem2/MCU_505/Input_CAN_Signal_No_Range_Check20" /begin REF_CHARACTERISTIC PEUR_flgStFaultOvrd_C PEUR_stFaultOvrdVal_C /end REF_CHARACTERISTIC /end GROUP
/begin GROUP S2442_Input_CAN_Signal_No_Range_Check3 "VBU0428Test/VBUSystem/HALIn/PTCAN/Subsystem/Subsystem2/MCU_505/Input_CAN_Signal_No_Range_Check3" /begin REF_CHARACTERISTIC PEUR_flgFlgHallFaultOvrd_C PEUR_flgHallFaultOvrdVal_C /end REF_CHARACTERISTIC /end GROUP
/begin GROUP S2442_Input_CAN_Signal_No_Range_Check4 "VBU0428Test/VBUSystem/HALIn/PTCAN/Subsystem/Subsystem2/MCU_505/Input_CAN_Signal_No_Range_Check4" /begin REF_CHARACTERISTIC PEUR_flgFlgOvrSpdOvrd_C PEUR_flgOvrSpdOvrdVal_C /end REF_CHARACTERISTIC /end GROUP
/begin GROUP S2442_Input_CAN_Signal_No_Range_Check5 "VBU0428Test/VBUSystem/HALIn/PTCAN/Subsystem/Subsystem2/MCU_505/Input_CAN_Signal_No_Range_Check5"
 /begin REF_CHARACTERISTIC PEUR_flgFlgOutputPhaseFaultOvrd_C PEUR_flgOutputPhaseFaultOvrdVal_C /end REF_CHARACTERISTIC
/end GROUP
/begin GROUP S2442_Input_CAN_Signal_No_Range_Check6 "VBU0428Test/VBUSystem/HALIn/PTCAN/Subsystem/Subsystem2/MCU_505/Input_CAN_Signal_No_Range_Check6" /begin REF_CHARACTERISTIC PEUR_flgFlgIGBTFaultOvrd_C PEUR_flgIGBTFaultOvrdVal_C /end REF_CHARACTERISTIC /end GROUP
/begin GROUP S2442_Input_CAN_Signal_No_Range_Check7 "VBU0428Test/VBUSystem/HALIn/PTCAN/Subsystem/Subsystem2/MCU_505/Input_CAN_Signal_No_Range_Check7" /begin REF_CHARACTERISTIC PEUR_flgFlgOvrCurrOvrd_C PEUR_flgOvrCurrOvrdVal_C /end REF_CHARACTERISTIC /end GROUP
/begin GROUP S2442_Input_CAN_Signal_No_Range_Check8 "VBU0428Test/VBUSystem/HALIn/PTCAN/Subsystem/Subsystem2/MCU_505/Input_CAN_Signal_No_Range_Check8" /begin REF_CHARACTERISTIC PUER_flgCPLDStatusOvrdVal_C PUER_flgFlgCPLDStatusOvrd_C /end REF_CHARACTERISTIC /end GROUP
/begin GROUP S2442_Input_CAN_Signal_No_Range_Check9 "VBU0428Test/VBUSystem/HALIn/PTCAN/Subsystem/Subsystem2/MCU_505/Input_CAN_Signal_No_Range_Check9"
 /begin REF_CHARACTERISTIC PEUR_flgDrvDownarmFailOvrdVal_C PEUR_flgFlgDrvDownarmFailOvrd_C /end REF_CHARACTERISTIC
/end GROUP
/begin GROUP S2548_Input_CAN_Signal_No_Range_Check "VBU0428Test/VBUSystem/HALIn/PTCAN/Subsystem/Subsystem3/DCDC_509/Input_CAN_Signal_No_Range_Check" /begin REF_CHARACTERISTIC DCDC_flgTTempOvrd_C DCDC_tTempOvrdVal_C /end REF_CHARACTERISTIC /end GROUP
/begin GROUP S2548_Input_CAN_Signal_No_Range_Check1 "VBU0428Test/VBUSystem/HALIn/PTCAN/Subsystem/Subsystem3/DCDC_509/Input_CAN_Signal_No_Range_Check1" /begin REF_CHARACTERISTIC DCDC_flgFlgUndrOutVltgOvrd_C DCDC_flgUndrOutVltgOvrdVal_C /end REF_CHARACTERISTIC /end GROUP
/begin GROUP S2548_Input_CAN_Signal_No_Range_Check2 "VBU0428Test/VBUSystem/HALIn/PTCAN/Subsystem/Subsystem3/DCDC_509/Input_CAN_Signal_No_Range_Check2" /begin REF_CHARACTERISTIC DCDC_flgFlgOvrOutVltgOvrd_C DCDC_flgOvrOutVltgOvrdVal_C /end REF_CHARACTERISTIC /end GROUP
/begin GROUP S2548_Input_CAN_Signal_No_Range_Check3 "VBU0428Test/VBUSystem/HALIn/PTCAN/Subsystem/Subsystem3/DCDC_509/Input_CAN_Signal_No_Range_Check3" /begin REF_CHARACTERISTIC DCDC_flgFlgUndrInVltgOvrd_C DCDC_flgUndrInVltgOvrdVal_C /end REF_CHARACTERISTIC /end GROUP
/begin GROUP S2548_Input_CAN_Signal_No_Range_Check4 "VBU0428Test/VBUSystem/HALIn/PTCAN/Subsystem/Subsystem3/DCDC_509/Input_CAN_Signal_No_Range_Check4" /begin REF_CHARACTERISTIC DCDC_flgFlgOvrInVltgOvrd_C DCDC_flgOvrInVltgOvrdVal_C /end REF_CHARACTERISTIC /end GROUP
/begin GROUP S2548_Input_CAN_Signal_No_Range_Check5 "VBU0428Test/VBUSystem/HALIn/PTCAN/Subsystem/Subsystem3/DCDC_509/Input_CAN_Signal_No_Range_Check5" /begin REF_CHARACTERISTIC DCDC_flgFlgOvrOutCurrOvrd_C DCDC_flgOvrOutCurrOvrdVal_C /end REF_CHARACTERISTIC /end GROUP
/begin GROUP S2548_Input_CAN_Signal_No_Range_Check6 "VBU0428Test/VBUSystem/HALIn/PTCAN/Subsystem/Subsystem3/DCDC_509/Input_CAN_Signal_No_Range_Check6" /begin REF_CHARACTERISTIC DCDC_flgFlgOvrInCurrOvrd_C DCDC_flgOvrInCurrOvrdVal_C /end REF_CHARACTERISTIC /end GROUP
/begin GROUP S2548_Input_CAN_Signal_No_Range_Check7 "VBU0428Test/VBUSystem/HALIn/PTCAN/Subsystem/Subsystem3/DCDC_509/Input_CAN_Signal_No_Range_Check7" /begin REF_CHARACTERISTIC DCDC_flgFlgOvrHeatOvrd_C DCDC_flgOvrHeatOvrdVal_C /end REF_CHARACTERISTIC /end GROUP
/begin GROUP S2548_Input_CAN_Signal_No_Range_Check8 "VBU0428Test/VBUSystem/HALIn/PTCAN/Subsystem/Subsystem3/DCDC_509/Input_CAN_Signal_No_Range_Check8" /begin REF_CHARACTERISTIC DCDC_flgDeritingOvrdVal_C DCDC_flgFlgDeritingOvrd_C /end REF_CHARACTERISTIC /end GROUP
/begin GROUP S2583_Input_CAN_Signal_No_Range_Check "VBU0428Test/VBUSystem/HALIn/PTCAN/Subsystem/Subsystem4/AC_248/Input_CAN_Signal_No_Range_Check" /begin REF_CHARACTERISTIC CCU_flgNCompActSpdOvrd_C CCU_nCompActSpdOvrdVal_C /end REF_CHARACTERISTIC /end GROUP
/begin GROUP S2583_Input_CAN_Signal_No_Range_Check1 "VBU0428Test/VBUSystem/HALIn/PTCAN/Subsystem/Subsystem4/AC_248/Input_CAN_Signal_No_Range_Check1" /begin REF_CHARACTERISTIC CCU_flgStCpmpStatusOvrd_C CCU_stCpmpStatusOvrdVal_C /end REF_CHARACTERISTIC /end GROUP
/begin GROUP S2583_Input_CAN_Signal_No_Range_Check10 "VBU0428Test/VBUSystem/HALIn/PTCAN/Subsystem/Subsystem4/AC_248/Input_CAN_Signal_No_Range_Check10" /begin REF_CHARACTERISTIC CCU_flgICompCurrOvrd_C CCU_iCompCurrOvrdVal_C /end REF_CHARACTERISTIC /end GROUP
/begin GROUP S2583_Input_CAN_Signal_No_Range_Check11 "VBU0428Test/VBUSystem/HALIn/PTCAN/Subsystem/Subsystem4/AC_248/Input_CAN_Signal_No_Range_Check11" /begin REF_CHARACTERISTIC CCU_flgUCompVltgOvrd_C CCU_uCompVltgOvrdVal_C /end REF_CHARACTERISTIC /end GROUP
/begin GROUP S2583_Input_CAN_Signal_No_Range_Check2 "VBU0428Test/VBUSystem/HALIn/PTCAN/Subsystem/Subsystem4/AC_248/Input_CAN_Signal_No_Range_Check2" /begin REF_CHARACTERISTIC CCU_flgStSpdFaultOvrd_C CCU_stSpdFaultOvrdVal_C /end REF_CHARACTERISTIC /end GROUP
/begin GROUP S2583_Input_CAN_Signal_No_Range_Check3 "VBU0428Test/VBUSystem/HALIn/PTCAN/Subsystem/Subsystem4/AC_248/Input_CAN_Signal_No_Range_Check3"
 /begin REF_CHARACTERISTIC CCU_flgFlgOverCurrFreqRdcOvrd_C CCU_flgOverCurrFreqRdcOvrdVal_C /end REF_CHARACTERISTIC
/end GROUP
/begin GROUP S2583_Input_CAN_Signal_No_Range_Check4 "VBU0428Test/VBUSystem/HALIn/PTCAN/Subsystem/Subsystem4/AC_248/Input_CAN_Signal_No_Range_Check4" /begin REF_CHARACTERISTIC CCU_flgStCompFaultOvrd_C CCU_stCompFaultOvrdVal_C /end REF_CHARACTERISTIC /end GROUP
/begin GROUP S2583_Input_CAN_Signal_No_Range_Check5 "VBU0428Test/VBUSystem/HALIn/PTCAN/Subsystem/Subsystem4/AC_248/Input_CAN_Signal_No_Range_Check5"
 /begin REF_CHARACTERISTIC CCU_flgFlgStdbyUndrVltgOvrd_C CCU_flgStdbyUndrVltgOvrdVal_C /end REF_CHARACTERISTIC
/end GROUP
/begin GROUP S2583_Input_CAN_Signal_No_Range_Check6 "VBU0428Test/VBUSystem/HALIn/PTCAN/Subsystem/Subsystem4/AC_248/Input_CAN_Signal_No_Range_Check6" /begin REF_CHARACTERISTIC CCU_flgFlgStdbyOvrVltgOvrd_C CCU_flgStdbyOvrVltgOvrdVal_C /end REF_CHARACTERISTIC /end GROUP
/begin GROUP S2583_Input_CAN_Signal_No_Range_Check7 "VBU0428Test/VBUSystem/HALIn/PTCAN/Subsystem/Subsystem4/AC_248/Input_CAN_Signal_No_Range_Check7" /begin REF_CHARACTERISTIC CCU_flgFlgUndrVltgOvrd_C CCU_flgUndrVltgOvrdVal_C /end REF_CHARACTERISTIC /end GROUP
/begin GROUP S2583_Input_CAN_Signal_No_Range_Check8 "VBU0428Test/VBUSystem/HALIn/PTCAN/Subsystem/Subsystem4/AC_248/Input_CAN_Signal_No_Range_Check8" /begin REF_CHARACTERISTIC CCU_flgFlgOvrVltgOvrd_C CCU_flgOvrVltgOvrdVal_C /end REF_CHARACTERISTIC /end GROUP
/begin GROUP S2583_Input_CAN_Signal_No_Range_Check9 "VBU0428Test/VBUSystem/HALIn/PTCAN/Subsystem/Subsystem4/AC_248/Input_CAN_Signal_No_Range_Check9" /begin REF_CHARACTERISTIC CCU_flgFlgOvrCurrOvrd_C CCU_flgOvrCurrOvrdVal_C /end REF_CHARACTERISTIC /end GROUP
/begin GROUP S2584_Input_CAN_Signal_No_Range_Check "VBU0428Test/VBUSystem/HALIn/PTCAN/Subsystem/Subsystem4/CDC_220/Input_CAN_Signal_No_Range_Check" /begin REF_CHARACTERISTIC CDC_flgCreepOnOffOvrdVal_C CDC_flgFlgCreepOnOffOvrd_C /end REF_CHARACTERISTIC /end GROUP
/begin GROUP S2584_Input_CAN_Signal_No_Range_Check1 "VBU0428Test/VBUSystem/HALIn/PTCAN/Subsystem/Subsystem4/CDC_220/Input_CAN_Signal_No_Range_Check1" /begin REF_CHARACTERISTIC CDC_flgStTowModeOvrd_C CDC_stTowModeOvrdVal_C /end REF_CHARACTERISTIC /end GROUP
/begin GROUP S2584_Input_CAN_Signal_No_Range_Check2 "VBU0428Test/VBUSystem/HALIn/PTCAN/Subsystem/Subsystem4/CDC_220/Input_CAN_Signal_No_Range_Check2"
 /begin REF_CHARACTERISTIC CDC_flgFlgGoNotifierOnOffOvrd_C CDC_flgGoNotifierOnOffOvrdVal_C /end REF_CHARACTERISTIC
/end GROUP
/begin GROUP S2584_Input_CAN_Signal_No_Range_Check3 "VBU0428Test/VBUSystem/HALIn/PTCAN/Subsystem/Subsystem4/CDC_220/Input_CAN_Signal_No_Range_Check3" /begin SUB_GROUP S2634_override_signal /end SUB_GROUP /begin REF_CHARACTERISTIC CDC_flgStRgnModeOvrd_C CDC_stRgnModeOvrdVal_C /end REF_CHARACTERISTIC /end GROUP
/begin GROUP S2584_Input_CAN_Signal_No_Range_Check4 "VBU0428Test/VBUSystem/HALIn/PTCAN/Subsystem/Subsystem4/CDC_220/Input_CAN_Signal_No_Range_Check4" /begin SUB_GROUP S2635_override_signal /end SUB_GROUP /begin REF_CHARACTERISTIC CDC_flgStDrvModeOvrd_C CDC_stDrvModeOvrdVal_C /end REF_CHARACTERISTIC /end GROUP
/begin GROUP S2585_Input_CAN_Signal_No_Range_Check "VBU0428Test/VBUSystem/HALIn/PTCAN/Subsystem/Subsystem4/DCDC_303/Input_CAN_Signal_No_Range_Check" /begin REF_CHARACTERISTIC DCDC_flgUInputVltgOvrd_C DCDC_uInputVltgOvrdVal_C /end REF_CHARACTERISTIC /end GROUP
/begin GROUP S2585_Input_CAN_Signal_No_Range_Check1 "VBU0428Test/VBUSystem/HALIn/PTCAN/Subsystem/Subsystem4/DCDC_303/Input_CAN_Signal_No_Range_Check1" /begin REF_CHARACTERISTIC DCDC_flgUOutputVltgOvrd_C DCDC_uOutputVltgOvrdVal_C /end REF_CHARACTERISTIC /end GROUP
/begin GROUP S2585_Input_CAN_Signal_No_Range_Check2 "VBU0428Test/VBUSystem/HALIn/PTCAN/Subsystem/Subsystem4/DCDC_303/Input_CAN_Signal_No_Range_Check2" /begin REF_CHARACTERISTIC DCDC_flgIInputCurrOvrd_C DCDC_iInputCurrOvrdVal_C /end REF_CHARACTERISTIC /end GROUP
/begin GROUP S2585_Input_CAN_Signal_No_Range_Check3 "VBU0428Test/VBUSystem/HALIn/PTCAN/Subsystem/Subsystem4/DCDC_303/Input_CAN_Signal_No_Range_Check3" /begin REF_CHARACTERISTIC DCDC_flgIOutputCurrOvrd_C DCDC_iOutputCurrOvrdVal_C /end REF_CHARACTERISTIC /end GROUP
/begin GROUP S2585_Input_CAN_Signal_No_Range_Check4 "VBU0428Test/VBUSystem/HALIn/PTCAN/Subsystem/Subsystem4/DCDC_303/Input_CAN_Signal_No_Range_Check4" /begin REF_CHARACTERISTIC DCDC_flgStStatusOvrd_C DCDC_stStatusOvrdVal_C /end REF_CHARACTERISTIC /end GROUP
/begin GROUP S2585_Input_CAN_Signal_No_Range_Check5 "VBU0428Test/VBUSystem/HALIn/PTCAN/Subsystem/Subsystem4/DCDC_303/Input_CAN_Signal_No_Range_Check5" /begin REF_CHARACTERISTIC DCDC_flgEnaFdbkOvrdVal_C DCDC_flgFlgEnaFdbkOvrd_C /end REF_CHARACTERISTIC /end GROUP
/begin GROUP S2586_Input_CAN_Signal_No_Range_Check "VBU0428Test/VBUSystem/HALIn/PTCAN/Subsystem/Subsystem4/MCU_405/Input_CAN_Signal_No_Range_Check" /begin REF_CHARACTERISTIC PEUR_flgTMeasMaxPhUVWOvrd_C PEUR_tMeasMaxPhUVWOvrdVal_C /end REF_CHARACTERISTIC /end GROUP
/begin GROUP S2586_Input_CAN_Signal_No_Range_Check1 "VBU0428Test/VBUSystem/HALIn/PTCAN/Subsystem/Subsystem4/MCU_405/Input_CAN_Signal_No_Range_Check1" /begin REF_CHARACTERISTIC PEUR_flgTMeasMaxStrOvrd_C PEUR_tMeasMaxStrOvrdVal_C /end REF_CHARACTERISTIC /end GROUP
/begin GROUP S2586_Input_CAN_Signal_No_Range_Check2 "VBU0428Test/VBUSystem/HALIn/PTCAN/Subsystem/Subsystem4/MCU_405/Input_CAN_Signal_No_Range_Check2" /begin REF_CHARACTERISTIC PEUR_flgTIPMTempOvrd_C PEUR_tIPMTempOvrdVal_C /end REF_CHARACTERISTIC /end GROUP
/begin GROUP S2586_Input_CAN_Signal_No_Range_Check3 "VBU0428Test/VBUSystem/HALIn/PTCAN/Subsystem/Subsystem4/MCU_405/Input_CAN_Signal_No_Range_Check3" /begin REF_CHARACTERISTIC PEUR_flgIUVWMaxCurrOvrd_C PEUR_iUVWMaxCurrOvrdVal_C /end REF_CHARACTERISTIC /end GROUP
/begin GROUP S2776_HCUCellTemp_1 "VBU0428Test/VBUSystem/HALIn/PrivateCAN/CanMsgUnpack1/MsgRxData_Unpack1/CanRxData_Unpack/HCUCellTemp_1"
 /begin REF_MEASUREMENT Temperature_1 Temperature_2 Temperature_3 Temperature_4 Temperature_5 Temperature_6 Temperature_7 Temperature_8 /end REF_MEASUREMENT
/end GROUP
/begin GROUP S2778_HCU_Message_5 "VBU0428Test/VBUSystem/HALIn/PrivateCAN/CanMsgUnpack1/MsgRxData_Unpack10/CanRxData_Unpack/HCU_Message_5"
 /begin REF_MEASUREMENT ADS_Error_1 ADS_Error_2 Comm_Error HCU_Message_5_Heart Insulation_Resistance Insulation_State Power_5V_High_Error Power_5V_Low_Error Power_Supply_Error_lev Self_Lock_State Self_Test Temp_Line_Error Volt_Line_Error /end REF_MEASUREMENT
/end GROUP
/begin GROUP S2780_HCU_Message_6 "VBU0428Test/VBUSystem/HALIn/PrivateCAN/CanMsgUnpack1/MsgRxData_Unpack11/CanRxData_Unpack/HCU_Message_6"
 /begin REF_MEASUREMENT Ave_Temp Ave_Volt Board_Temp HCU_Message_6_Heart Total_Volt /end REF_MEASUREMENT
/end GROUP
/begin GROUP S2782_HCU_Message_7_PWM "VBU0428Test/VBUSystem/HALIn/PrivateCAN/CanMsgUnpack1/MsgRxData_Unpack12/CanRxData_Unpack/HCU_Message_7_PWM"
 /begin REF_MEASUREMENT Insulation_R_Minus Insulation_R_Plus PWM_IN1_Duty PWM_IN1_Freq PWM_IN2_Duty PWM_IN2_Freq /end REF_MEASUREMENT
/end GROUP
/begin GROUP S2784_HCU_Statistics_State1 "VBU0428Test/VBUSystem/HALIn/PrivateCAN/CanMsgUnpack1/MsgRxData_Unpack13/CanRxData_Unpack/HCU_Statistics_State1"
 /begin REF_MEASUREMENT HCU_Statistics_State1_Heart MaxTempBMU_ID Max_Temp Max_Temp_BMU_index Max_Temp_index Min_Temp /end REF_MEASUREMENT
/end GROUP
/begin GROUP S2786_HCU_Statistics_State10 "VBU0428Test/VBUSystem/HALIn/PrivateCAN/CanMsgUnpack1/MsgRxData_Unpack14/CanRxData_Unpack/HCU_Statistics_State10"
 /begin REF_MEASUREMENT High_Cell_Temp_3 High_Cell_Temp_3_BMU_ID High_Cell_Temp_3_BMU_Index High_Cell_Temp_4 High_Cell_Temp_4_BMU_ID High_Cell_Temp_4_BMU_Index /end REF_MEASUREMENT
/end GROUP
/begin GROUP S2788_HCU_Statistics_State11 "VBU0428Test/VBUSystem/HALIn/PrivateCAN/CanMsgUnpack1/MsgRxData_Unpack15/CanRxData_Unpack/HCU_Statistics_State11"
 /begin REF_MEASUREMENT High_Cell_Temp_5 High_Cell_Temp_5_BMU_ID High_Cell_Temp_5_BMU_Index Low_Cell_Temp_1 Low_Cell_Temp_1_BMU_ID Low_Cell_Temp_1_BMU_Index /end REF_MEASUREMENT
/end GROUP
/begin GROUP S2790_HCU_Statistics_State12 "VBU0428Test/VBUSystem/HALIn/PrivateCAN/CanMsgUnpack1/MsgRxData_Unpack16/CanRxData_Unpack/HCU_Statistics_State12"
 /begin REF_MEASUREMENT Low_Cell_Temp_2 Low_Cell_Temp_2_BMU_ID Low_Cell_Temp_2_BMU_Index Low_Cell_Temp_3 Low_Cell_Temp_3_BMU_ID Low_Cell_Temp_3_BMU_Index /end REF_MEASUREMENT
/end GROUP
/begin GROUP S2792_HCU_Statistics_State13 "VBU0428Test/VBUSystem/HALIn/PrivateCAN/CanMsgUnpack1/MsgRxData_Unpack17/CanRxData_Unpack/HCU_Statistics_State13"
 /begin REF_MEASUREMENT Low_Cell_Temp_4 Low_Cell_Temp_4_BMU_ID Low_Cell_Temp_4_BMU_Index Low_Cell_Temp_5 Low_Cell_Temp_5_BMU_ID Low_Cell_Temp_5_BMU_Index /end REF_MEASUREMENT
/end GROUP
/begin GROUP S2794_HCU_Statistics_State2 "VBU0428Test/VBUSystem/HALIn/PrivateCAN/CanMsgUnpack1/MsgRxData_Unpack18/CanRxData_Unpack/HCU_Statistics_State2"
 /begin REF_MEASUREMENT HCU_Statistics_State2_Heart Max_Volt Max_Volt_BMU_ID Max_Volt_Index Min_Temp_BMU_ID Min_Temp_BMU_index Min_Temp_index /end REF_MEASUREMENT
/end GROUP
/begin GROUP S2796_HCU_Statistics_State3 "VBU0428Test/VBUSystem/HALIn/PrivateCAN/CanMsgUnpack1/MsgRxData_Unpack19/CanRxData_Unpack/HCU_Statistics_State3"
 /begin REF_MEASUREMENT HCU_Statistics_State3_Heart Max_Volt_BMU_index Min_Volt Min_Volt_BMU_ID Min_Volt_BMU_index Min_Volt_Index /end REF_MEASUREMENT
/end GROUP
/begin GROUP S2798_HCUCellTemp_2 "VBU0428Test/VBUSystem/HALIn/PrivateCAN/CanMsgUnpack1/MsgRxData_Unpack2/CanRxData_Unpack/HCUCellTemp_2"
 /begin REF_MEASUREMENT Temperature_10 Temperature_11 Temperature_12 Temperature_13 Temperature_14 Temperature_15 Temperature_16 Temperature_9 /end REF_MEASUREMENT
/end GROUP
/begin GROUP S2800_HCU_Statistics_State4 "VBU0428Test/VBUSystem/HALIn/PrivateCAN/CanMsgUnpack1/MsgRxData_Unpack20/CanRxData_Unpack/HCU_Statistics_State4"
 /begin REF_MEASUREMENT High_Cell_Volt_1 High_Cell_Volt_1_BMU_ID High_Cell_Volt_1_BMU_Index High_Cell_Volt_2 High_Cell_Volt_2_BMU_ID High_Cell_Volt_2_BMU_Index /end REF_MEASUREMENT
/end GROUP
/begin GROUP S2802_HCU_Statistics_State5 "VBU0428Test/VBUSystem/HALIn/PrivateCAN/CanMsgUnpack1/MsgRxData_Unpack21/CanRxData_Unpack/HCU_Statistics_State5"
 /begin REF_MEASUREMENT High_Cell_Volt_3 High_Cell_Volt_3_BMU_ID High_Cell_Volt_3_BMU_Index High_Cell_Volt_4 High_Cell_Volt_4_BMU_ID High_Cell_Volt_4_BMU_Index /end REF_MEASUREMENT
/end GROUP
/begin GROUP S2804_HCU_Statistics_State6 "VBU0428Test/VBUSystem/HALIn/PrivateCAN/CanMsgUnpack1/MsgRxData_Unpack22/CanRxData_Unpack/HCU_Statistics_State6"
 /begin REF_MEASUREMENT High_Cell_Volt_5 High_Cell_Volt_5_BMU_ID High_Cell_Volt_5_BMU_Index Low_Cell_Volt_1 Low_Cell_Volt_1_BMU_ID Low_Cell_Volt_1_BMU_Index /end REF_MEASUREMENT
/end GROUP
/begin GROUP S2806_HCU_Statistics_State7 "VBU0428Test/VBUSystem/HALIn/PrivateCAN/CanMsgUnpack1/MsgRxData_Unpack23/CanRxData_Unpack/HCU_Statistics_State7"
 /begin REF_MEASUREMENT Low_Cell_Volt_2 Low_Cell_Volt_2_BMU_ID Low_Cell_Volt_2_BMU_Index Low_Cell_Volt_3 Low_Cell_Volt_3_BMU_ID Low_Cell_Volt_3_BMU_Index /end REF_MEASUREMENT
/end GROUP
/begin GROUP S2808_HCU_Statistics_State8 "VBU0428Test/VBUSystem/HALIn/PrivateCAN/CanMsgUnpack1/MsgRxData_Unpack24/CanRxData_Unpack/HCU_Statistics_State8"
 /begin REF_MEASUREMENT Low_Cell_Volt_4 Low_Cell_Volt_4_BMU_ID Low_Cell_Volt_4_BMU_Index Low_Cell_Volt_5 Low_Cell_Volt_5_BMU_ID Low_Cell_Volt_5_BMU_Index /end REF_MEASUREMENT
/end GROUP
/begin GROUP S2810_HCU_Statistics_State9 "VBU0428Test/VBUSystem/HALIn/PrivateCAN/CanMsgUnpack1/MsgRxData_Unpack25/CanRxData_Unpack/HCU_Statistics_State9"
 /begin REF_MEASUREMENT High_Cell_Temp_1 High_Cell_Temp_1_BMU_ID High_Cell_Temp_1_BMU_Index High_Cell_Temp_2 High_Cell_Temp_2_BMU_ID High_Cell_Temp_2_BMU_Index /end REF_MEASUREMENT
/end GROUP
/begin GROUP S2812_HCU_Temp "VBU0428Test/VBUSystem/HALIn/PrivateCAN/CanMsgUnpack1/MsgRxData_Unpack26/CanRxData_Unpack/HCU_Temp"
 /begin REF_MEASUREMENT Temp_HCU_3 Temp_HCU_4 Temp_HCU_5 Temp_HCU_6 Temp_HCU_7 Temp_HCU_8 Temp_HCU_Water_Inlet Temp_HCU_Water_Outlet /end REF_MEASUREMENT
/end GROUP
/begin GROUP S2814_HCU_Total_Cell_Num "VBU0428Test/VBUSystem/HALIn/PrivateCAN/CanMsgUnpack1/MsgRxData_Unpack27/CanRxData_Unpack/HCU_Total_Cell_Num" /begin REF_MEASUREMENT Total_Temp_Num Total_Volt_Cell_Num /end REF_MEASUREMENT /end GROUP
/begin GROUP S2816_LEM_CurrentSensor_3C2 "VBU0428Test/VBUSystem/HALIn/PrivateCAN/CanMsgUnpack1/MsgRxData_Unpack28/CanRxData_Unpack/LEM_CurrentSensor_3C2"
 /begin REF_MEASUREMENT LEM_BatteryCurrent LEM_CurrentSensorInvalid LEM_SensorName LEM_stFaultInfor /end REF_MEASUREMENT
/end GROUP
/begin GROUP S2818_HCUCellVolt1 "VBU0428Test/VBUSystem/HALIn/PrivateCAN/CanMsgUnpack1/MsgRxData_Unpack29/CanRxData_Unpack/HCUCellVolt1" /begin REF_MEASUREMENT CellVolt1 CellVolt2 CellVolt3 CellVolt4 /end REF_MEASUREMENT /end GROUP
/begin GROUP S2820_HCUCellTemp_3 "VBU0428Test/VBUSystem/HALIn/PrivateCAN/CanMsgUnpack1/MsgRxData_Unpack3/CanRxData_Unpack/HCUCellTemp_3"
 /begin REF_MEASUREMENT Temperature_17 Temperature_18 Temperature_19 Temperature_20 Temperature_21 Temperature_22 Temperature_23 Temperature_24 /end REF_MEASUREMENT
/end GROUP
/begin GROUP S2822_HCUCellVolt10 "VBU0428Test/VBUSystem/HALIn/PrivateCAN/CanMsgUnpack1/MsgRxData_Unpack30/CanRxData_Unpack/HCUCellVolt10" /begin REF_MEASUREMENT CellVolt37 CellVolt38 CellVolt39 CellVolt40 /end REF_MEASUREMENT /end GROUP
/begin GROUP S2824_HCUCellVolt11 "VBU0428Test/VBUSystem/HALIn/PrivateCAN/CanMsgUnpack1/MsgRxData_Unpack31/CanRxData_Unpack/HCUCellVolt11" /begin REF_MEASUREMENT CellVolt41 CellVolt42 CellVolt43 CellVolt44 /end REF_MEASUREMENT /end GROUP
/begin GROUP S2826_HCUCellVolt12 "VBU0428Test/VBUSystem/HALIn/PrivateCAN/CanMsgUnpack1/MsgRxData_Unpack32/CanRxData_Unpack/HCUCellVolt12" /begin REF_MEASUREMENT CellVolt45 CellVolt46 CellVolt47 CellVolt48 /end REF_MEASUREMENT /end GROUP
/begin GROUP S2828_HCUCellVolt13 "VBU0428Test/VBUSystem/HALIn/PrivateCAN/CanMsgUnpack1/MsgRxData_Unpack33/CanRxData_Unpack/HCUCellVolt13" /begin REF_MEASUREMENT CellVolt49 CellVolt50 CellVolt51 CellVolt52 /end REF_MEASUREMENT /end GROUP
/begin GROUP S2830_HCUCellVolt14 "VBU0428Test/VBUSystem/HALIn/PrivateCAN/CanMsgUnpack1/MsgRxData_Unpack34/CanRxData_Unpack/HCUCellVolt14" /begin REF_MEASUREMENT CellVolt53 CellVolt54 CellVolt55 CellVolt56 /end REF_MEASUREMENT /end GROUP
/begin GROUP S2832_HCUCellVolt15 "VBU0428Test/VBUSystem/HALIn/PrivateCAN/CanMsgUnpack1/MsgRxData_Unpack35/CanRxData_Unpack/HCUCellVolt15" /begin REF_MEASUREMENT CellVolt57 CellVolt58 CellVolt59 CellVolt60 /end REF_MEASUREMENT /end GROUP
/begin GROUP S2834_HCUCellVolt16 "VBU0428Test/VBUSystem/HALIn/PrivateCAN/CanMsgUnpack1/MsgRxData_Unpack36/CanRxData_Unpack/HCUCellVolt16" /begin REF_MEASUREMENT CellVolt61 CellVolt62 CellVolt63 CellVolt64 /end REF_MEASUREMENT /end GROUP
/begin GROUP S2836_HCUCellVolt17 "VBU0428Test/VBUSystem/HALIn/PrivateCAN/CanMsgUnpack1/MsgRxData_Unpack37/CanRxData_Unpack/HCUCellVolt17" /begin REF_MEASUREMENT CellVolt65 CellVolt66 CellVolt67 CellVolt68 /end REF_MEASUREMENT /end GROUP
/begin GROUP S2838_HCUCellVolt18 "VBU0428Test/VBUSystem/HALIn/PrivateCAN/CanMsgUnpack1/MsgRxData_Unpack38/CanRxData_Unpack/HCUCellVolt18" /begin REF_MEASUREMENT CellVolt69 CellVolt70 CellVolt71 CellVolt72 /end REF_MEASUREMENT /end GROUP
/begin GROUP S2840_HCUCellVolt19 "VBU0428Test/VBUSystem/HALIn/PrivateCAN/CanMsgUnpack1/MsgRxData_Unpack39/CanRxData_Unpack/HCUCellVolt19" /begin REF_MEASUREMENT CellVolt73 CellVolt74 CellVolt75 CellVolt76 /end REF_MEASUREMENT /end GROUP
/begin GROUP S2842_HCUCellTemp_4 "VBU0428Test/VBUSystem/HALIn/PrivateCAN/CanMsgUnpack1/MsgRxData_Unpack4/CanRxData_Unpack/HCUCellTemp_4"
 /begin REF_MEASUREMENT Temperature_25 Temperature_26 Temperature_27 Temperature_28 Temperature_29 Temperature_30 Temperature_31 Temperature_32 /end REF_MEASUREMENT
/end GROUP
/begin GROUP S2844_HCUCellVolt2 "VBU0428Test/VBUSystem/HALIn/PrivateCAN/CanMsgUnpack1/MsgRxData_Unpack40/CanRxData_Unpack/HCUCellVolt2" /begin REF_MEASUREMENT CellVolt5 CellVolt6 CellVolt7 CellVolt8 /end REF_MEASUREMENT /end GROUP
/begin GROUP S2846_HCUCellVolt20 "VBU0428Test/VBUSystem/HALIn/PrivateCAN/CanMsgUnpack1/MsgRxData_Unpack41/CanRxData_Unpack/HCUCellVolt20" /begin REF_MEASUREMENT CellVolt77 CellVolt78 CellVolt79 CellVolt80 /end REF_MEASUREMENT /end GROUP
/begin GROUP S2848_HCUCellVolt21 "VBU0428Test/VBUSystem/HALIn/PrivateCAN/CanMsgUnpack1/MsgRxData_Unpack42/CanRxData_Unpack/HCUCellVolt21" /begin REF_MEASUREMENT CellVolt81 CellVolt82 CellVolt83 CellVolt84 /end REF_MEASUREMENT /end GROUP
/begin GROUP S2850_HCUCellVolt22 "VBU0428Test/VBUSystem/HALIn/PrivateCAN/CanMsgUnpack1/MsgRxData_Unpack43/CanRxData_Unpack/HCUCellVolt22" /begin REF_MEASUREMENT CellVolt85 CellVolt86 CellVolt87 CellVolt88 /end REF_MEASUREMENT /end GROUP
/begin GROUP S2852_HCUCellVolt23 "VBU0428Test/VBUSystem/HALIn/PrivateCAN/CanMsgUnpack1/MsgRxData_Unpack44/CanRxData_Unpack/HCUCellVolt23" /begin REF_MEASUREMENT CellVolt89 CellVolt90 CellVolt91 CellVolt92 /end REF_MEASUREMENT /end GROUP
/begin GROUP S2854_HCUCellVolt24 "VBU0428Test/VBUSystem/HALIn/PrivateCAN/CanMsgUnpack1/MsgRxData_Unpack45/CanRxData_Unpack/HCUCellVolt24" /begin REF_MEASUREMENT CellVolt93 CellVolt94 CellVolt95 CellVolt96 /end REF_MEASUREMENT /end GROUP
/begin GROUP S2856_HCUCellVolt25 "VBU0428Test/VBUSystem/HALIn/PrivateCAN/CanMsgUnpack1/MsgRxData_Unpack46/CanRxData_Unpack/HCUCellVolt25" /begin REF_MEASUREMENT CellVolt100 CellVolt97 CellVolt98 CellVolt99 /end REF_MEASUREMENT /end GROUP
/begin GROUP S2858_HCUCellVolt26 "VBU0428Test/VBUSystem/HALIn/PrivateCAN/CanMsgUnpack1/MsgRxData_Unpack47/CanRxData_Unpack/HCUCellVolt26" /begin REF_MEASUREMENT CellVolt101 CellVolt102 CellVolt103 CellVolt104 /end REF_MEASUREMENT /end GROUP
/begin GROUP S2860_HCUCellVolt27 "VBU0428Test/VBUSystem/HALIn/PrivateCAN/CanMsgUnpack1/MsgRxData_Unpack48/CanRxData_Unpack/HCUCellVolt27" /begin REF_MEASUREMENT CellVolt105 CellVolt106 CellVolt107 CellVolt108 /end REF_MEASUREMENT /end GROUP
/begin GROUP S2862_HCUCellVolt28 "VBU0428Test/VBUSystem/HALIn/PrivateCAN/CanMsgUnpack1/MsgRxData_Unpack49/CanRxData_Unpack/HCUCellVolt28" /begin REF_MEASUREMENT CellVolt109 CellVolt110 CellVolt111 CellVolt112 /end REF_MEASUREMENT /end GROUP
/begin GROUP S2864_HCUCellTemp_5 "VBU0428Test/VBUSystem/HALIn/PrivateCAN/CanMsgUnpack1/MsgRxData_Unpack5/CanRxData_Unpack/HCUCellTemp_5"
 /begin REF_MEASUREMENT Temperature_33 Temperature_34 Temperature_35 Temperature_36 Temperature_37 Temperature_38 Temperature_39 Temperature_40 /end REF_MEASUREMENT
/end GROUP
/begin GROUP S2866_HCUCellVolt29 "VBU0428Test/VBUSystem/HALIn/PrivateCAN/CanMsgUnpack1/MsgRxData_Unpack50/CanRxData_Unpack/HCUCellVolt29" /begin REF_MEASUREMENT CellVolt113 CellVolt114 CellVolt115 CellVolt116 /end REF_MEASUREMENT /end GROUP
/begin GROUP S2868_HCUCellVolt3 "VBU0428Test/VBUSystem/HALIn/PrivateCAN/CanMsgUnpack1/MsgRxData_Unpack51/CanRxData_Unpack/HCUCellVolt3" /begin REF_MEASUREMENT CellVolt10 CellVolt11 CellVolt12 CellVolt9 /end REF_MEASUREMENT /end GROUP
/begin GROUP S2870_HCUCellVolt30 "VBU0428Test/VBUSystem/HALIn/PrivateCAN/CanMsgUnpack1/MsgRxData_Unpack52/CanRxData_Unpack/HCUCellVolt30" /begin REF_MEASUREMENT CellVolt117 CellVolt118 CellVolt119 CellVolt120 /end REF_MEASUREMENT /end GROUP
/begin GROUP S2872_HCUCellVolt31 "VBU0428Test/VBUSystem/HALIn/PrivateCAN/CanMsgUnpack1/MsgRxData_Unpack53/CanRxData_Unpack/HCUCellVolt31" /begin REF_MEASUREMENT CellVolt121 CellVolt122 CellVolt123 CellVolt124 /end REF_MEASUREMENT /end GROUP
/begin GROUP S2874_HCUCellVolt32 "VBU0428Test/VBUSystem/HALIn/PrivateCAN/CanMsgUnpack1/MsgRxData_Unpack54/CanRxData_Unpack/HCUCellVolt32" /begin REF_MEASUREMENT CellVolt125 CellVolt126 CellVolt127 CellVolt128 /end REF_MEASUREMENT /end GROUP
/begin GROUP S2876_HCUCellVolt33 "VBU0428Test/VBUSystem/HALIn/PrivateCAN/CanMsgUnpack1/MsgRxData_Unpack55/CanRxData_Unpack/HCUCellVolt33" /begin REF_MEASUREMENT CellVolt129 CellVolt130 CellVolt131 CellVolt132 /end REF_MEASUREMENT /end GROUP
/begin GROUP S2878_HCUCellVolt34 "VBU0428Test/VBUSystem/HALIn/PrivateCAN/CanMsgUnpack1/MsgRxData_Unpack56/CanRxData_Unpack/HCUCellVolt34" /begin REF_MEASUREMENT CellVolt133 CellVolt134 CellVolt135 CellVolt136 /end REF_MEASUREMENT /end GROUP
/begin GROUP S2880_HCUCellVolt35 "VBU0428Test/VBUSystem/HALIn/PrivateCAN/CanMsgUnpack1/MsgRxData_Unpack57/CanRxData_Unpack/HCUCellVolt35" /begin REF_MEASUREMENT CellVolt137 CellVolt138 CellVolt139 CellVolt140 /end REF_MEASUREMENT /end GROUP
/begin GROUP S2882_HCUCellVolt36 "VBU0428Test/VBUSystem/HALIn/PrivateCAN/CanMsgUnpack1/MsgRxData_Unpack58/CanRxData_Unpack/HCUCellVolt36" /begin REF_MEASUREMENT CellVolt141 CellVolt142 CellVolt143 CellVolt144 /end REF_MEASUREMENT /end GROUP
/begin GROUP S2884_HCUCellVolt37 "VBU0428Test/VBUSystem/HALIn/PrivateCAN/CanMsgUnpack1/MsgRxData_Unpack59/CanRxData_Unpack/HCUCellVolt37" /begin REF_MEASUREMENT CellVolt145 CellVolt146 CellVolt147 CellVolt148 /end REF_MEASUREMENT /end GROUP
/begin GROUP S2886_HCU_Message_1_RelayStatus "VBU0428Test/VBUSystem/HALIn/PrivateCAN/CanMsgUnpack1/MsgRxData_Unpack6/CanRxData_Unpack/HCU_Message_1_RelayStatus"
 /begin REF_MEASUREMENT HCU_Message_1_RelayStatus_Heart HCU_State Relay5_Error_State Relay6_Error_State Relay_5 Relay_6 Relay_Heat Relay_Heat_Error_State Relay_MainNegative Relay_MainNegative_Error_State Relay_MainPositive Relay_MainPositive_Error_State Relay_Precharge Relay_Precharge_Error_State /end REF_MEASUREMENT
/end GROUP
/begin GROUP S2888_HCUCellVolt38 "VBU0428Test/VBUSystem/HALIn/PrivateCAN/CanMsgUnpack1/MsgRxData_Unpack60/CanRxData_Unpack/HCUCellVolt38" /begin REF_MEASUREMENT CellVolt149 CellVolt150 CellVolt151 CellVolt152 /end REF_MEASUREMENT /end GROUP
/begin GROUP S2890_HCUCellVolt39 "VBU0428Test/VBUSystem/HALIn/PrivateCAN/CanMsgUnpack1/MsgRxData_Unpack61/CanRxData_Unpack/HCUCellVolt39" /begin REF_MEASUREMENT CellVolt153 CellVolt154 CellVolt155 CellVolt156 /end REF_MEASUREMENT /end GROUP
/begin GROUP S2892_HCUCellVolt4 "VBU0428Test/VBUSystem/HALIn/PrivateCAN/CanMsgUnpack1/MsgRxData_Unpack62/CanRxData_Unpack/HCUCellVolt4" /begin REF_MEASUREMENT CellVolt13 CellVolt14 CellVolt15 CellVolt16 /end REF_MEASUREMENT /end GROUP
/begin GROUP S2894_HCUCellVolt40 "VBU0428Test/VBUSystem/HALIn/PrivateCAN/CanMsgUnpack1/MsgRxData_Unpack63/CanRxData_Unpack/HCUCellVolt40" /begin REF_MEASUREMENT CellVolt157 CellVolt158 CellVolt159 CellVolt160 /end REF_MEASUREMENT /end GROUP
/begin GROUP S2896_HCUCellVolt41 "VBU0428Test/VBUSystem/HALIn/PrivateCAN/CanMsgUnpack1/MsgRxData_Unpack64/CanRxData_Unpack/HCUCellVolt41" /begin REF_MEASUREMENT CellVolt161 CellVolt162 CellVolt163 CellVolt164 /end REF_MEASUREMENT /end GROUP
/begin GROUP S2898_HCUCellVolt42 "VBU0428Test/VBUSystem/HALIn/PrivateCAN/CanMsgUnpack1/MsgRxData_Unpack65/CanRxData_Unpack/HCUCellVolt42" /begin REF_MEASUREMENT CellVolt165 CellVolt166 CellVolt167 CellVolt168 /end REF_MEASUREMENT /end GROUP
/begin GROUP S2900_HCUCellVolt43 "VBU0428Test/VBUSystem/HALIn/PrivateCAN/CanMsgUnpack1/MsgRxData_Unpack66/CanRxData_Unpack/HCUCellVolt43" /begin REF_MEASUREMENT CellVolt169 CellVolt170 CellVolt171 CellVolt172 /end REF_MEASUREMENT /end GROUP
/begin GROUP S2902_HCUCellVolt44 "VBU0428Test/VBUSystem/HALIn/PrivateCAN/CanMsgUnpack1/MsgRxData_Unpack67/CanRxData_Unpack/HCUCellVolt44" /begin REF_MEASUREMENT CellVolt173 CellVolt174 CellVolt175 CellVolt176 /end REF_MEASUREMENT /end GROUP
/begin GROUP S2904_HCUCellVolt45 "VBU0428Test/VBUSystem/HALIn/PrivateCAN/CanMsgUnpack1/MsgRxData_Unpack68/CanRxData_Unpack/HCUCellVolt45" /begin REF_MEASUREMENT CellVolt177 CellVolt178 CellVolt179 CellVolt180 /end REF_MEASUREMENT /end GROUP
/begin GROUP S2906_HCUCellVolt46 "VBU0428Test/VBUSystem/HALIn/PrivateCAN/CanMsgUnpack1/MsgRxData_Unpack69/CanRxData_Unpack/HCUCellVolt46" /begin REF_MEASUREMENT CellVolt181 CellVolt182 CellVolt183 CellVolt184 /end REF_MEASUREMENT /end GROUP
/begin GROUP S2908_HCU_Message_2_AD1 "VBU0428Test/VBUSystem/HALIn/PrivateCAN/CanMsgUnpack1/MsgRxData_Unpack7/CanRxData_Unpack/HCU_Message_2_AD1"
 /begin REF_MEASUREMENT HCU_Message_2_AD1_Heart HV1_AD HV2_Heating_Relay__AD HV3_Main_Fuse__AD /end REF_MEASUREMENT
/end GROUP
/begin GROUP S2910_HCUCellVolt47 "VBU0428Test/VBUSystem/HALIn/PrivateCAN/CanMsgUnpack1/MsgRxData_Unpack70/CanRxData_Unpack/HCUCellVolt47" /begin REF_MEASUREMENT CellVolt185 CellVolt186 CellVolt187 CellVolt188 /end REF_MEASUREMENT /end GROUP
/begin GROUP S2912_HCUCellVolt48 "VBU0428Test/VBUSystem/HALIn/PrivateCAN/CanMsgUnpack1/MsgRxData_Unpack71/CanRxData_Unpack/HCUCellVolt48" /begin REF_MEASUREMENT CellVolt189 CellVolt190 CellVolt191 CellVolt192 /end REF_MEASUREMENT /end GROUP
/begin GROUP S2914_HCUCellVolt49 "VBU0428Test/VBUSystem/HALIn/PrivateCAN/CanMsgUnpack1/MsgRxData_Unpack72/CanRxData_Unpack/HCUCellVolt49" /begin REF_MEASUREMENT CellVolt193 CellVolt194 CellVolt195 CellVolt196 /end REF_MEASUREMENT /end GROUP
/begin GROUP S2916_HCUCellVolt5 "VBU0428Test/VBUSystem/HALIn/PrivateCAN/CanMsgUnpack1/MsgRxData_Unpack73/CanRxData_Unpack/HCUCellVolt5" /begin REF_MEASUREMENT CellVolt17 CellVolt18 CellVolt19 CellVolt20 /end REF_MEASUREMENT /end GROUP
/begin GROUP S2918_HCUCellVolt50 "VBU0428Test/VBUSystem/HALIn/PrivateCAN/CanMsgUnpack1/MsgRxData_Unpack74/CanRxData_Unpack/HCUCellVolt50" /begin REF_MEASUREMENT CellVolt197 CellVolt198 CellVolt199 CellVolt200 /end REF_MEASUREMENT /end GROUP
/begin GROUP S2920_HCUCellVolt6 "VBU0428Test/VBUSystem/HALIn/PrivateCAN/CanMsgUnpack1/MsgRxData_Unpack75/CanRxData_Unpack/HCUCellVolt6" /begin REF_MEASUREMENT CellVolt21 CellVolt22 CellVolt23 CellVolt24 /end REF_MEASUREMENT /end GROUP
/begin GROUP S2922_HCUCellVolt7 "VBU0428Test/VBUSystem/HALIn/PrivateCAN/CanMsgUnpack1/MsgRxData_Unpack76/CanRxData_Unpack/HCUCellVolt7" /begin REF_MEASUREMENT CellVolt25 CellVolt26 CellVolt27 CellVolt28 /end REF_MEASUREMENT /end GROUP
/begin GROUP S2924_HCUCellVolt8 "VBU0428Test/VBUSystem/HALIn/PrivateCAN/CanMsgUnpack1/MsgRxData_Unpack77/CanRxData_Unpack/HCUCellVolt8" /begin REF_MEASUREMENT CellVolt29 CellVolt30 CellVolt31 CellVolt32 /end REF_MEASUREMENT /end GROUP
/begin GROUP S2926_HCUCellVolt9 "VBU0428Test/VBUSystem/HALIn/PrivateCAN/CanMsgUnpack1/MsgRxData_Unpack78/CanRxData_Unpack/HCUCellVolt9" /begin REF_MEASUREMENT CellVolt33 CellVolt34 CellVolt35 CellVolt36 /end REF_MEASUREMENT /end GROUP
/begin GROUP S2928_HCU_Message_3_AD2 "VBU0428Test/VBUSystem/HALIn/PrivateCAN/CanMsgUnpack1/MsgRxData_Unpack8/CanRxData_Unpack/HCU_Message_3_AD2"
 /begin REF_MEASUREMENT HCU_Message_3_AD2_Heart HV4_Heat_Fuse__AD LINK_Relay_MN_AD Total_Volt_B /end REF_MEASUREMENT
/end GROUP
/begin GROUP S2930_HCU_Message_4_AD3 "VBU0428Test/VBUSystem/HALIn/PrivateCAN/CanMsgUnpack1/MsgRxData_Unpack9/CanRxData_Unpack/HCU_Message_4_AD3"
 /begin REF_MEASUREMENT HCU_Message_3_AD3_Heart HV5_MP_Pcharge_Relay__AD Hall1_AD Hall2_AD /end REF_MEASUREMENT
/end GROUP
/begin GROUP S3213_Turn_On_Delay_Time "VBU0428Test/VBUSystem/VCU /DCH/DCH_Overall/DCH_DCChargeCtrlOverall/DCH_BMSChgrReq/Turn_On_Delay_Time" /begin REF_MEASUREMENT DCH_flgStationCrrntLimd /end REF_MEASUREMENT /end GROUP
/begin GROUP S3213_Turn_On_Delay_Time1 "VBU0428Test/VBUSystem/VCU /DCH/DCH_Overall/DCH_DCChargeCtrlOverall/DCH_BMSChgrReq/Turn_On_Delay_Time1" /begin REF_MEASUREMENT DCH_flgChargingPortTempHigh /end REF_MEASUREMENT /end GROUP
/begin GROUP S3214_DCH_CtrlStateflowPostProcess "VBU0428Test/VBUSystem/VCU /DCH/DCH_Overall/DCH_DCChargeCtrlOverall/DCH_DCChargeCtrlStateflow/DCH_CtrlStateflowPostProcess"
 /begin REF_CHARACTERISTIC DCH_flgPosDCRlyReqOvrdVal_C DCH_flgPosDCRlyReqOvrd_C DCH_tiDCChRlyOpClsdDly_C /end REF_CHARACTERISTIC
/end GROUP
/begin GROUP S3214_DCH_InputSignalPreProcess "VBU0428Test/VBUSystem/VCU /DCH/DCH_Overall/DCH_DCChargeCtrlOverall/DCH_DCChargeCtrlStateflow/DCH_InputSignalPreProcess"
 /begin SUB_GROUP S3229_DCH_BMSChAvlDebounce S3229_DCH_DCRelayCloseDiagnose S3229_DCH_VehStateAnalyze /end SUB_GROUP
/end GROUP
/begin GROUP S3214_DCH_SignalPreProcessForStateflow "VBU0428Test/VBUSystem/VCU /DCH/DCH_Overall/DCH_DCChargeCtrlOverall/DCH_DCChargeCtrlStateflow/DCH_SignalPreProcessForStateflow"
 /begin SUB_GROUP S3230_DCH_BMSErrorDetect S3230_DCH_ChargeStopCalc S3230_DCH_ChgerZeroCurrentDiagnose S3230_DCH_ChgrAvlDiagnose S3230_DCH_OpenPDURelayValid /end SUB_GROUP
/end GROUP
/begin GROUP S3215_DCH_BmsVoltagCurrentDiagnose "VBU0428Test/VBUSystem/VCU /DCH/DCH_Overall/DCH_DCChargeCtrlOverall/DCH_Diagnose/DCH_BmsVoltagCurrentDiagnose"
 /begin REF_CHARACTERISTIC DCH_iDiaDCChOvrCrntDiff_C DCH_stBMSChrging_SY DCH_uDiaDCChOvrVltgDiff_C /end REF_CHARACTERISTIC
 /begin REF_MEASUREMENT DCH_flgDftDCChOvrCrnt DCH_flgDftDCChOvrVltg /end REF_MEASUREMENT
/end GROUP
/begin GROUP S3215_DCH_ChargeErrDetect "VBU0428Test/VBUSystem/VCU /DCH/DCH_Overall/DCH_DCChargeCtrlOverall/DCH_Diagnose/DCH_ChargeErrDetect"
 /begin REF_CHARACTERISTIC DCH_flgDCChDiagCmdOvrdVal_C DCH_flgDCChDiagCmdOvrd_C DCH_stHVCntctClosed_SY DCH_tiDiagRlyCmd_C /end REF_CHARACTERISTIC
 /begin REF_MEASUREMENT DCH_flgDCChDiagCmd DCH_flgMonDCChOvrCrnt /end REF_MEASUREMENT
/end GROUP
/begin GROUP S3215_DCH_DCRelayDiag "VBU0428Test/VBUSystem/VCU /DCH/DCH_Overall/DCH_DCChargeCtrlOverall/DCH_Diagnose/DCH_DCRelayDiag"
 /begin REF_CHARACTERISTIC DCH_numPDUNonRlySticky_C DCH_numPDUPosRlySticky_C DCH_numPDUStickyTolerance_C /end REF_CHARACTERISTIC
/end GROUP
/begin GROUP S3215_DCH_VehErrDetect "VBU0428Test/VBUSystem/VCU /DCH/DCH_Overall/DCH_DCChargeCtrlOverall/DCH_Diagnose/DCH_VehErrDetect"
 /begin REF_CHARACTERISTIC DCH_tDCChPortTempLowLim_C DCH_tReStartDCChPortTemp_C DCH_tStopForDCChPortTemp_C /end REF_CHARACTERISTIC
 /begin REF_MEASUREMENT DCH_flgDCChPortTempLimEna DCH_flgDftDCPortOvrTemp DCH_flgMonDCPortOvrTemp /end REF_MEASUREMENT
/end GROUP
/begin GROUP S3216_DCH_ChargeStopErrDiagnose "VBU0428Test/VBUSystem/VCU /DCH/DCH_Overall/DCH_DCChargeCtrlOverall/DCH_EepromStore/DCH_ChargeStopErrDiagnose" /begin SUB_GROUP S3273_DCH_BSTOrCSTTrigger /end SUB_GROUP /end GROUP
/begin GROUP S3216_DCH_ChargeTimeOutDiagnose "VBU0428Test/VBUSystem/VCU /DCH/DCH_Overall/DCH_DCChargeCtrlOverall/DCH_EepromStore/DCH_ChargeTimeOutDiagnose" /begin SUB_GROUP S3274_BEM_EEPROM /end SUB_GROUP /end GROUP
/begin GROUP S3216_DataConvertandCSTEEPROM "VBU0428Test/VBUSystem/VCU /DCH/DCH_Overall/DCH_DCChargeCtrlOverall/DCH_EepromStore/DataConvertandCSTEEPROM" /begin SUB_GROUP S3275_CSTTrigDly S3275_CST_EEPROM /end SUB_GROUP /end GROUP
/begin GROUP S3337_DSPL_EnergySelfLearn "VBU0428Test/VBUSystem/VCU /DSPL /DSPL/DriveRange/DSPL_Consumption/DSPL_EnergySelfLearn"
 /begin SUB_GROUP S3339_DSPL_EnergyComsumptionCal S3339_DSPL_EnergyFactorCal S3339_DSPL_EnergyRemainingCal /end SUB_GROUP
/end GROUP
/begin GROUP S3337_Range10kmConsumption "VBU0428Test/VBUSystem/VCU /DSPL /DSPL/DriveRange/DSPL_Consumption/Range10kmConsumption" /begin SUB_GROUP S3340_Comsumption S3340_DSPLRange10kmCondition /end SUB_GROUP /end GROUP
/begin GROUP S3337_Range50kmConsumption "VBU0428Test/VBUSystem/VCU /DSPL /DSPL/DriveRange/DSPL_Consumption/Range50kmConsumption"
 /begin SUB_GROUP S3341_DSPLRange50kmComsumptionCal S3341_DSPLRange50kmCondition /end SUB_GROUP
/end GROUP
/begin GROUP S3338_ChargeConditon "VBU0428Test/VBUSystem/VCU /DSPL /DSPL/DriveRange/RemainingRange/ChargeConditon"
 /begin REF_CHARACTERISTIC DSPL_iRngCalcAch_C DSPL_iRngCalcDch_C DSPL_numRngCalcAch_C DSPL_numRngCalcAch_CUR_v DSPL_numRngCalcDch_CUR_v DSPL_tiRemChrgLineDelay_C PMM_stACChMode_SY /end REF_CHARACTERISTIC
/end GROUP
/begin GROUP S3338_ChargeTemp "VBU0428Test/VBUSystem/VCU /DSPL /DSPL/DriveRange/RemainingRange/ChargeTemp"
 /begin REF_CHARACTERISTIC DSPL_facChargeTemp1_C DSPL_facChargeTemp2_C DSPL_facChargeTemp3_C DSPL_facChargeTemp4_C DSPL_facChargeTemp5_C /end REF_CHARACTERISTIC
/end GROUP
/begin GROUP S3338_DriveTemp "VBU0428Test/VBUSystem/VCU /DSPL /DSPL/DriveRange/RemainingRange/DriveTemp"
 /begin REF_CHARACTERISTIC DSPL_cntDriveTempReset_C DSPL_flgSwapModeEn_C DSPL_kmDriveTempSpeedEnThreshold_C DSPL_tDriveTempDefault_C DSPL_tiDelayTimeDriveCnt_C DSPL_tiDriveTempMoveTime_C DSPL_tiDriveTempSpeedEnThreshold_C DSPL_tiDriveTempSpeedReset_C DSPL_vDriveTempResetThreshold_C DSPL_vDriveTempSpeedEnLe_C DSPL_vDriveTempSpeedEnRi_C /end REF_CHARACTERISTIC
/end GROUP
/begin GROUP S3338_FullRangeAndSocDeclineFactor "VBU0428Test/VBUSystem/VCU /DSPL /DSPL/DriveRange/RemainingRange/FullRangeAndSocDeclineFactor"
 /begin SUB_GROUP S3392_FullRangeCalculation S3392_SOCDecRate S3392_SOCDeclineFactorCalculation /end SUB_GROUP
/end GROUP
/begin GROUP S3338_RangeTempSelect "VBU0428Test/VBUSystem/VCU /DSPL /DSPL/DriveRange/RemainingRange/RangeTempSelect" /begin REF_CHARACTERISTIC DSPL_stDCPortTempNoErr_C DSPL_tRangeTempDefault_C /end REF_CHARACTERISTIC /end GROUP
/begin GROUP S3338_SelectDisplayRange "VBU0428Test/VBUSystem/VCU /DSPL /DSPL/DriveRange/RemainingRange/SelectDisplayRange" /begin SUB_GROUP S3394_Charge S3394_Drive S3394_storeRange /end SUB_GROUP /end GROUP
/begin GROUP S3481_accessory_power_limit_Calculate "VBU0428Test/VBUSystem/VCU /EDIS/EDIS_Ctrl/BatDis_Power_Lim_Calc/Power_Arbitration/accessory_power_limit_Calculate"
 /begin REF_CHARACTERISTIC EDIS_facChrgCurrLimBaseSoc_CUR_v EDIS_flgACPowOverride_C EDIS_flgDCDCPowOverride_C EDIS_flgHVHPowOverride_C EDIS_flgPTCPowOverride_C EDIS_flgUseAcsPwrReq_C EDIS_pwrACPowOverride_C EDIS_pwrACRated_C EDIS_pwrChrgCurrntOverDelta_CUR_v EDIS_pwrDCDCPowOverride_C EDIS_pwrDcdcRated_C EDIS_pwrHVHPowOverride_C EDIS_pwrHVHRated_C EDIS_pwrPTCPowOverride_C EDIS_pwrPTCRated_C /end REF_CHARACTERISTIC
 /begin REF_MEASUREMENT EDIS_pwrAcsPwrReq /end REF_MEASUREMENT
/end GROUP
/begin GROUP S3481_drive_power_limit_calculate "VBU0428Test/VBUSystem/VCU /EDIS/EDIS_Ctrl/BatDis_Power_Lim_Calc/Power_Arbitration/drive_power_limit_calculate" /begin SUB_GROUP S3484_LowpassT /end SUB_GROUP
 /begin REF_CHARACTERISTIC EDIS_facUpGradPwr_MAP_v EDIS_flgNoUsePowLackUpGrad_C EDIS_kmVehOdometer_C EDIS_pctBmsSocOverrideHi1_C EDIS_pctBmsSocOverrideHi_C EDIS_pctBmsSocOverrideLo1_C EDIS_pctBmsSocOverrideLo_C EDIS_pwrDecGradBmsSocLo_C EDIS_pwrDrvPowLackHi_C EDIS_pwrDrvPowLackLo_C EDIS_tiBattPowLackDelay_C EDIS_tiDrvPwrFilter_C EDIS_tiRgnPwrFilter_C EDIS_tiSmplT_SY SYS_stShftPosNeutr_SY SYS_stShftPosPark_SY /end REF_CHARACTERISTIC
 /begin REF_MEASUREMENT EDIS_pwrDrvPwrLim /end REF_MEASUREMENT
/end GROUP
/begin GROUP S3500_BatDis_Regen_Power_PI_Filter "VBU0428Test/VBUSystem/VCU /EDIS/EDIS_Ctrl/battery_power_calculate/charge_power_calculate/BatDis_Regen_Power_PI_Filter"
 /begin REF_CHARACTERISTIC EDIS_facChPwrBaseDiffKp_CUR_v EDIS_facChPwrKd_CUR_v EDIS_facChPwrKi_MAP_v EDIS_flgUseDynChPwrComfort_C EDIS_pwrBattMinPwrForInvaild_C EDIS_pwrDchaDeltaMin_C EDIS_pwrDchaPIDPowrLim_C /end REF_CHARACTERISTIC
 /begin REF_MEASUREMENT EDIS_pwrBattMinPwrFnl EDIS_pwrRgn EDIS_pwrRgnDelta EDIS_pwrRgnDterm EDIS_pwrRgnIterm EDIS_pwrRgnLim EDIS_pwrRgnPterm /end REF_MEASUREMENT
/end GROUP
/begin GROUP S3500_ChPowSetPoint "VBU0428Test/VBUSystem/VCU /EDIS/EDIS_Ctrl/battery_power_calculate/charge_power_calculate/ChPowSetPoint" /begin SUB_GROUP S3503_fid_action S3503_setpiont /end SUB_GROUP /end GROUP
/begin GROUP S3501_DchPowSetpiont "VBU0428Test/VBUSystem/VCU /EDIS/EDIS_Ctrl/battery_power_calculate/discharge_power_calculate/DchPowSetpiont"
 /begin SUB_GROUP S3518_fid_action S3518_setpoint S3518_temperature_correction /end SUB_GROUP
/end GROUP
/begin GROUP S3501_discharge_pid "VBU0428Test/VBUSystem/VCU /EDIS/EDIS_Ctrl/battery_power_calculate/discharge_power_calculate/discharge_pid"
 /begin REF_CHARACTERISTIC EDIS_facDisChPwrBaseDiffKp_CUR_v EDIS_facDisChPwrKi_MAP_v EDIS_facStermDisChgRaw_C EDIS_pwrBattMaxPwrForInvaild_C EDIS_pwrDchaDeltaMin_C EDIS_pwrDchaItermMin_C EDIS_pwrDchaPIDPowrLim_C /end REF_CHARACTERISTIC
 /begin REF_MEASUREMENT EDIS_pwrBattMaxPwr EDIS_pwrBattMaxPwrFnl EDIS_pwrDchaDelta EDIS_pwrDisChBattPwr EDIS_pwrPIDDisChgFnl /end REF_MEASUREMENT
/end GROUP
/begin GROUP S3583_DCDC_Enable "VBU0428Test/VBUSystem/VCU /LVC/LVC/LowVoltageBalanceControl/LVC_DcdcStCtl/DCDC_Enable" /begin REF_CHARACTERISTIC LVC_uDCDCReq_C LVC_uDcdcHvMax_C LVC_uDcdcHvMin_C /end REF_CHARACTERISTIC /end GROUP
/begin GROUP S3583_RoutineControl "VBU0428Test/VBUSystem/VCU /LVC/LVC/LowVoltageBalanceControl/LVC_DcdcStCtl/RoutineControl" /begin SUB_GROUP S3593_Disenable S3593_Enable /end SUB_GROUP /end GROUP
/begin GROUP S3609_Turn_On_Delay_Time2 "VBU0428Test/VBUSystem/VCU /PMM/PMM_Ctrl/DrvMod_Ctrl/DVM_PEUShtDwn/Turn_On_Delay_Time2" /begin REF_MEASUREMENT PMM_flgACTstReq /end REF_MEASUREMENT /end GROUP
/begin GROUP S3620_LVWSrc "VBU0428Test/VBUSystem/VCU /PMM/PMM_Ctrl/LvWakeUp_Ctrl/LvWakeUp_State_Calc/LVWSrc" /begin SUB_GROUP S3623_StopNM S3623_VCUActSrc S3623_VCUWakeUp /end SUB_GROUP /end GROUP
/begin GROUP S3620_Wakeup "VBU0428Test/VBUSystem/VCU /PMM/PMM_Ctrl/LvWakeUp_Ctrl/LvWakeUp_State_Calc/Wakeup"
 /begin REF_CHARACTERISTIC PMM_flgVCUShtDwnOvrdSwt_C PMM_flgVCUShtDwnOvrdVal_C PMM_flgWkup1CmdOvrdSwt_C PMM_flgWkup1CmdOvrdVal_C PMM_tiDlyVCUSwtOff_C PMM_tiDlyWkup1Cmd_SY /end REF_CHARACTERISTIC
 /begin REF_MEASUREMENT PMM_flgVCUShtDwn PMM_flgWkup1Cmd /end REF_MEASUREMENT
/end GROUP
/begin GROUP S3669_CtrlSht "VBU0428Test/VBUSystem/VCU /PMM/PMM_Ctrl/PwrMod_Ctrl/PwrMod_PowerUp/CtrlSht" /begin REF_MEASUREMENT PMM_flgCtlSht /end REF_MEASUREMENT /end GROUP
/begin GROUP S3669_HVClReqSrc "VBU0428Test/VBUSystem/VCU /PMM/PMM_Ctrl/PwrMod_Ctrl/PwrMod_PowerUp/HVClReqSrc"
 /begin REF_CHARACTERISTIC PMM_pctBrkPos4HV_C PMM_stDCHInitSts_SY PMM_stDCHShtDwnSts_SY PMM_tiDlyHVRlyReqCC2_C PMM_tiDlyIgnOnHVReq_C /end REF_CHARACTERISTIC
 /begin REF_MEASUREMENT PMM_flgHVClReqSrcRising /end REF_MEASUREMENT
/end GROUP
/begin GROUP S3669_OllLoad "VBU0428Test/VBUSystem/VCU /PMM/PMM_Ctrl/PwrMod_Ctrl/PwrMod_PowerUp/OllLoad"
 /begin REF_CHARACTERISTIC PMM_iCtlShtDwnOffLoad_C PMM_iEmgShtDwnOffLoad_C PMM_iNrmlShtDwnOffLoad_C PMM_tiCtlShtDwnOffLoad_C PMM_tiDCHShtDwnOffLoad_C PMM_tiEmgShtDwnOffLoad_C PMM_tiNrmlShtDwnOffLoad_C /end REF_CHARACTERISTIC
/end GROUP
/begin GROUP S3669_VehStsJudgement "VBU0428Test/VBUSystem/VCU /PMM/PMM_Ctrl/PwrMod_Ctrl/PwrMod_PowerUp/VehStsJudgement"
 /begin REF_CHARACTERISTIC PMM_vMaxSpdShtDwn_C PMM_vMinSpdShtDwn_C SYS_stShftPosNeutr_SY SYS_stShftPosPark_SY /end REF_CHARACTERISTIC
 /begin REF_MEASUREMENT PMM_flgHVRly PMM_flgInhinPwrUp PMM_flgRutnOffReq PMM_flgVehAllwOp /end REF_MEASUREMENT
/end GROUP
/begin GROUP S3669_stateflowcondition "VBU0428Test/VBUSystem/VCU /PMM/PMM_Ctrl/PwrMod_Ctrl/PwrMod_PowerUp/stateflowcondition" /begin SUB_GROUP S3681_Turn_On_Delay_Time S3681_Turn_On_Delay_Time1 /end SUB_GROUP
 /begin REF_CHARACTERISTIC PMM_flgOffLoadTOutToHVOpReqSwt_C PMM_stDCDCWrking_SY PMM_tiDlyHVClReqSrcOff_C PMM_tiDlyOffLoadCnfrm_C PMM_tiInitToHVRlyClReq_C PMM_uActvDisChVltg_C /end REF_CHARACTERISTIC
 /begin REF_MEASUREMENT PMM_flgACTstToHVRlyCld PMM_flgACTstToHVRlyOpReq PMM_flgActvDisChToHVRlyClReq PMM_flgActvDisChToShtDwn PMM_flgDCDCDisblToHVRlyOpReq PMM_flgHVClReqOn PMM_flgHVRlyClReqToActvDisCh PMM_flgHVRlyClReqToHVRlyCld PMM_flgHVRlyCldToOffLoad PMM_flgHVRlyOpReqToActvDisCh PMM_flgHVRlyOpReqToHVRlyClReq PMM_flgOffLoadToHVRlyCld PMM_flgShtDwnToInit /end REF_MEASUREMENT
/end GROUP
/begin GROUP S3671_PwrUpRoutine "VBU0428Test/VBUSystem/VCU /PMM/PMM_Ctrl/PwrMod_Ctrl/Routine/PwrUpRoutine" /begin REF_CHARACTERISTIC DIAGS_stPsvRespAlreadyOk_SY PMM_tiDlyPwrUpNokResp_C /end REF_CHARACTERISTIC /end GROUP
/begin GROUP S3671_Routine_PwrDwn "VBU0428Test/VBUSystem/VCU /PMM/PMM_Ctrl/PwrMod_Ctrl/Routine/Routine_PwrDwn" /begin REF_CHARACTERISTIC DIAGS_stPsvRespAlreadyOk_SY PMM_uActvDisChVltg_C /end REF_CHARACTERISTIC /end GROUP
/begin GROUP S3671_Rouutine_RActiveDis "VBU0428Test/VBUSystem/VCU /PMM/PMM_Ctrl/PwrMod_Ctrl/Routine/Rouutine_RActiveDis" /begin REF_CHARACTERISTIC PMM_uActvDisChVltg_C /end REF_CHARACTERISTIC /end GROUP
/begin GROUP S3721_BenchArb "VBU0428Test/VBUSystem/VCU /SPD/SPD/SignalProcessing_10ms/Bench/BenchArb"
 /begin REF_CHARACTERISTIC SPD_aBenchReset_C SPD_aBenchSetHi_C SPD_aBenchSetLow_C SPD_cntBenchThd_C SPD_facAXFilter_C /end REF_CHARACTERISTIC
/end GROUP
/begin GROUP S3229_DCH_VehStateAnalyze "VBU0428Test/VBUSystem/VCU /DCH/DCH_Overall/DCH_DCChargeCtrlOverall/DCH_DCChargeCtrlStateflow/DCH_InputSignalPreProcess/DCH_VehStateAnalyze" /begin REF_CHARACTERISTIC DCH_stHVCntctClosed_SY /end REF_CHARACTERISTIC /end GROUP
/begin GROUP S3503_setpiont "VBU0428Test/VBUSystem/VCU /EDIS/EDIS_Ctrl/battery_power_calculate/charge_power_calculate/ChPowSetPoint/setpiont" /begin REF_CHARACTERISTIC EDIS_tiSmplT_SY /end REF_CHARACTERISTIC /end GROUP
/begin GROUP S3593_Disenable "VBU0428Test/VBUSystem/VCU /LVC/LVC/LowVoltageBalanceControl/LVC_DcdcStCtl/RoutineControl/Disenable" /begin REF_CHARACTERISTIC DIAGS_stPsvRespAlreadyOk_SY /end REF_CHARACTERISTIC /end GROUP
/begin GROUP S3593_Enable "VBU0428Test/VBUSystem/VCU /LVC/LVC/LowVoltageBalanceControl/LVC_DcdcStCtl/RoutineControl/Enable" /begin REF_CHARACTERISTIC DIAGS_stPsvRespAlreadyOk_SY /end REF_CHARACTERISTIC /end GROUP
/begin GROUP S3623_VCUActSrc "VBU0428Test/VBUSystem/VCU /PMM/PMM_Ctrl/LvWakeUp_Ctrl/LvWakeUp_State_Calc/LVWSrc/VCUActSrc"
 /begin REF_CHARACTERISTIC PMM_stDCHInitSts_SY PMM_stDCHShtDwnSts_SY PMM_tiDlyHVRlyReqCC2_C PMM_uActvDisChVltg_C /end REF_CHARACTERISTIC
/end GROUP
/begin GROUP S4003_ShftChange "VBU0428Test/VBUSystem/VCU /TQO/TQOAll/TQO/TQO/MotorTorque/ShftChange" /begin REF_CHARACTERISTIC SYS_stShftPosNeutr_SY SYS_stShftPosPark_SY /end REF_CHARACTERISTIC /end GROUP
/begin GROUP S3521_batt_stpower_overrite "VBU0428Test/VBUSystem/VCU /EDIS/EDIS_Ctrl/battery_power_calculate/discharge_power_calculate/DchPowSetpiont/setpoint/batt_stpower_overrite" /begin REF_CHARACTERISTIC EDIS_tiSmplT_SY /end REF_CHARACTERISTIC /end GROUP
/begin GROUP S3521_discharge_setpoint "VBU0428Test/VBUSystem/VCU /EDIS/EDIS_Ctrl/battery_power_calculate/discharge_power_calculate/DchPowSetpiont/setpoint/discharge_setpoint" /begin REF_CHARACTERISTIC EDIS_tiSmplT_SY /end REF_CHARACTERISTIC /end GROUP
/begin GROUP S3986_AccPdlIdl "VBU0428Test/VBUSystem/VCU /TQO/TQOAll/TQDIS/TQDIS/TrqFilter/DrvLim/AccPdlIdl" /begin REF_CHARACTERISTIC SYS_stShftPosNeutr_SY SYS_stShftPosPark_SY /end REF_CHARACTERISTIC /end GROUP
/begin GROUP S3986_Creep "VBU0428Test/VBUSystem/VCU /TQO/TQOAll/TQDIS/TQDIS/TrqFilter/DrvLim/Creep" /begin REF_CHARACTERISTIC SYS_stShftPosNeutr_SY SYS_stShftPosPark_SY /end REF_CHARACTERISTIC /end GROUP
/end MODULE
/end PROJECT
