ASAP2_VERSION 1 31
/begin PROJECT ProjectName "Project Comment Goes Here"
/begin HEADER "Header Comments go here" /end HEADER
/begin MODULE ModuleName "Module Comment Goes Here"
/begin MOD_COMMON "Mod Common Comment Here" BYTE_ORDER MSB_LAST /end MOD_COMMON
/begin RECORD_LAYOUT Scalar_BOOLEAN FNC_VALUES 1 UBYTE COLUMN_DIR DIRECT /end RECORD_LAYOUT
/begin RECORD_LAYOUT Scalar_UBYTE FNC_VALUES 1 UBYTE COLUMN_DIR DIRECT /end RECORD_LAYOUT
/begin RECORD_LAYOUT Scalar_UWORD FNC_VALUES 1 UWORD COLUMN_DIR DIRECT /end RECORD_LAYOUT
/begin RECORD_LAYOUT Scalar_SWORD FNC_VALUES 1 SWORD COLUMN_DIR DIRECT /end RECORD_LAYOUT
/begin RECORD_LAYOUT Scalar_ULONG FNC_VALUES 1 ULONG COLUMN_DIR DIRECT /end RECORD_LAYOUT
/begin RECORD_LAYOUT Scalar_FLOAT32_IEEE FNC_VALUES 1 FLOAT32_IEEE COLUMN_DIR DIRECT /end RECORD_LAYOUT
/begin RECORD_LAYOUT Lookup1D_FLOAT32_IEEE FNC_VALUES 1 FLOAT32_IEEE COLUMN_DIR DIRECT /end RECORD_LAYOUT
/begin RECORD_LAYOUT Lookup1D_X_FLOAT32_IEEE AXIS_PTS_X 1 FLOAT32_IEEE INDEX_INCR DIRECT /end RECORD_LAYOUT
/begin RECORD_LAYOUT Lookup2D_UWORD FNC_VALUES 1 UWORD COLUMN_DIR DIRECT /end RECORD_LAYOUT
/begin RECORD_LAYOUT Lookup2D_X_UWORD AXIS_PTS_X 1 UWORD INDEX_INCR DIRECT /end RECORD_LAYOUT
/begin RECORD_LAYOUT Lookup2D_WORD FNC_VALUES 1 SWORD COLUMN_DIR DIRECT /end RECORD_LAYOUT
/begin RECORD_LAYOUT Lookup2D_X_WORD AXIS_PTS_X 1 SWORD INDEX_INCR DIRECT /end RECORD_LAYOUT
/begin RECORD_LAYOUT Lookup2D_ULONG FNC_VALUES 1 ULONG COLUMN_DIR DIRECT /end RECORD_LAYOUT
/begin RECORD_LAYOUT Lookup2D_X_ULONG AXIS_PTS_X 1 ULONG INDEX_INCR DIRECT /end RECORD_LAYOUT
/begin RECORD_LAYOUT Lookup2D_FLOAT32_IEEE FNC_VALUES 1 FLOAT32_IEEE COLUMN_DIR DIRECT /end RECORD_LAYOUT
/begin RECORD_LAYOUT Lookup2D_X_FLOAT32_IEEE AXIS_PTS_X 1 FLOAT32_IEEE INDEX_INCR DIRECT /end RECORD_LAYOUT
/begin AXIS_PTS CaTHM_PackSohMapX_pct "" 0x70011eee NO_INPUT_QUANTITY Lookup1D_X_FLOAT32_IEEE 0 VBU0513_CM_single_cnt 5 0.0 100.0 /end AXIS_PTS
/begin AXIS_PTS CaTHM_CellTempMaxMapX_C "" 0x700121ca CTM_tCellTempMax Lookup2D_X_FLOAT32_IEEE 0 VBU0513_CM_single_cnt 6 -40.0 80.0 /end AXIS_PTS
/begin AXIS_PTS CaTHM_CellSocMaxMapY_pct "" 0x70011e9e SOC_pctCellSocMax Lookup2D_X_FLOAT32_IEEE 0 VBU0513_CM_single_cnt 5 0.0 100.0 /end AXIS_PTS
/begin CHARACTERISTIC CaFCC_VCRVCUAuxPowerFactorVoltageTempMapZ_nbr "" MAP 0x700131ae Lookup2D_FLOAT32_IEEE 0 VBU0513_CM_single_cnt -3.4028234663852886E+38 3.4028234663852886E+38
 /begin AXIS_DESCR COM_AXIS CVT_mvCellVoltageMin VBU0513_CM_uint16_cnt 3 0.0 65535.0 AXIS_PTS_REF CaFCC_VCRVCUAuxPowerFactorVoltageTempMapY_mV /end AXIS_DESCR
 /begin AXIS_DESCR COM_AXIS CTM_tCellTempMin VBU0513_CM_single_cnt 4 -3.4028234663852886E+38 3.4028234663852886E+38 AXIS_PTS_REF CaFCC_VCRVCUAuxPowerFactorVoltageTempMapX_C /end AXIS_DESCR
/end CHARACTERISTIC
/begin AXIS_PTS CaFCC_VCRVCUAuxPowerFactorVoltageTempMapX_C "" 0x70011c2a CTM_tCellTempMin Lookup2D_X_FLOAT32_IEEE 0 VBU0513_CM_single_cnt 4 -3.4028234663852886E+38 3.4028234663852886E+38 /end AXIS_PTS
/begin AXIS_PTS CaFCC_VCRVCUAuxPowerFactorVoltageTempMapY_mV "" 0x70011a0c CVT_mvCellVoltageMin Lookup2D_X_UWORD 0 VBU0513_CM_uint16_cnt 3 0.0 65535.0 /end AXIS_PTS
/begin CHARACTERISTIC CaSOC_BatteryDisplaySocDischargeDecRateY_n "" CURVE 0x70011dc2 Lookup1D_FLOAT32_IEEE 0 VBU0513_CM_single_cnt -3.4028234663852886E+38 3.4028234663852886E+38
 /begin AXIS_DESCR COM_AXIS SOC_pctBatterySoc VBU0513_CM_single_cnt 5 -3.4028234663852886E+38 3.4028234663852886E+38 AXIS_PTS_REF CaSOC_BatteryDisplaySocDischargeDecRateX_pct /end AXIS_DESCR
/end CHARACTERISTIC
/begin AXIS_PTS CaSOC_BatteryDisplaySocDischargeDecRateX_pct "" 0x70011dae SOC_pctBatterySoc Lookup1D_X_FLOAT32_IEEE 0 VBU0513_CM_single_cnt 5 -3.4028234663852886E+38 3.4028234663852886E+38 /end AXIS_PTS
/begin CHARACTERISTIC CaSOC_BatteryDisplaySocDischargeIncRateY_n "" CURVE 0x70011dea Lookup1D_FLOAT32_IEEE 0 VBU0513_CM_single_cnt -3.4028234663852886E+38 3.4028234663852886E+38
 /begin AXIS_DESCR COM_AXIS SOC_pctBatterySoc VBU0513_CM_single_cnt 5 -3.4028234663852886E+38 3.4028234663852886E+38 AXIS_PTS_REF CaSOC_BatteryDisplaySocDischargeIncRateX_pct /end AXIS_DESCR
/end CHARACTERISTIC
/begin AXIS_PTS CaSOC_BatteryDisplaySocDischargeIncRateX_pct "" 0x70011dd6 SOC_pctBatterySoc Lookup1D_X_FLOAT32_IEEE 0 VBU0513_CM_single_cnt 5 -3.4028234663852886E+38 3.4028234663852886E+38 /end AXIS_PTS
/begin CHARACTERISTIC CaSOC_SOCDisChargeIncOffsetY_n "" CURVE 0x7001219a Lookup1D_FLOAT32_IEEE 0 VBU0513_CM_single_cnt -3.4028234663852886E+38 3.4028234663852886E+38
 /begin AXIS_DESCR COM_AXIS SOC_pctBatterySoc VBU0513_CM_single_cnt 6 -3.4028234663852886E+38 3.4028234663852886E+38 AXIS_PTS_REF CaSOC_SOCDisChargeIncOffsetX_pct /end AXIS_DESCR
/end CHARACTERISTIC
/begin AXIS_PTS CaSOC_SOCDisChargeIncOffsetX_pct "" 0x70012182 SOC_pctBatterySoc Lookup1D_X_FLOAT32_IEEE 0 VBU0513_CM_single_cnt 6 -3.4028234663852886E+38 3.4028234663852886E+38 /end AXIS_PTS
/begin CHARACTERISTIC CaSOC_SOCDisChargeDecOffsetY_n "" CURVE 0x7001216a Lookup1D_FLOAT32_IEEE 0 VBU0513_CM_single_cnt -3.4028234663852886E+38 3.4028234663852886E+38
 /begin AXIS_DESCR COM_AXIS SOC_pctBatterySoc VBU0513_CM_single_cnt 6 -3.4028234663852886E+38 3.4028234663852886E+38 AXIS_PTS_REF CaSOC_SOCDisChargeDecOffsetX_pct /end AXIS_DESCR
/end CHARACTERISTIC
/begin AXIS_PTS CaSOC_SOCDisChargeDecOffsetX_pct "" 0x70012152 SOC_pctBatterySoc Lookup1D_X_FLOAT32_IEEE 0 VBU0513_CM_single_cnt 6 -3.4028234663852886E+38 3.4028234663852886E+38 /end AXIS_PTS
/begin CHARACTERISTIC CaSOC_FastChargeCCCorrectionBOLVoltThd1Z_mV "" MAP 0x0000 Lookup2D_UWORD 0 VBU0513_CM_uint16_cnt 0.0 65535.0
 /begin AXIS_DESCR COM_AXIS NO_INPUT_QUANTITY VBU0513_CM_single_cnt 11 -3.4028234663852886E+38 3.4028234663852886E+38 AXIS_PTS_REF CaSOC_FastChargeCCRateY_n /end AXIS_DESCR
 /begin AXIS_DESCR COM_AXIS NO_INPUT_QUANTITY VBU0513_CM_single_cnt 9 -3.4028234663852886E+38 3.4028234663852886E+38 AXIS_PTS_REF CaSOC_FastChargeCCTempX_C /end AXIS_DESCR
/end CHARACTERISTIC
/begin AXIS_PTS CaSOC_FastChargeCCTempX_C "" 0x0000 NO_INPUT_QUANTITY Lookup2D_X_FLOAT32_IEEE 0 VBU0513_CM_single_cnt 9 -3.4028234663852886E+38 3.4028234663852886E+38 /end AXIS_PTS
/begin AXIS_PTS CaSOC_FastChargeCCRateY_n "" 0x0000 NO_INPUT_QUANTITY Lookup2D_X_FLOAT32_IEEE 0 VBU0513_CM_single_cnt 11 -3.4028234663852886E+38 3.4028234663852886E+38 /end AXIS_PTS
/begin CHARACTERISTIC CaSOC_FastChargeCCCorrectionSoc1Z_pct "" MAP 0x0000 Lookup2D_FLOAT32_IEEE 0 VBU0513_CM_single_cnt -3.4028234663852886E+38 3.4028234663852886E+38
 /begin AXIS_DESCR COM_AXIS NO_INPUT_QUANTITY VBU0513_CM_single_cnt 11 -3.4028234663852886E+38 3.4028234663852886E+38 AXIS_PTS_REF CaSOC_FastChargeCCRateY_n /end AXIS_DESCR
 /begin AXIS_DESCR COM_AXIS NO_INPUT_QUANTITY VBU0513_CM_single_cnt 9 -3.4028234663852886E+38 3.4028234663852886E+38 AXIS_PTS_REF CaSOC_FastChargeCCTempX_C /end AXIS_DESCR
/end CHARACTERISTIC
/begin CHARACTERISTIC CaSOC_FastChargeCCCorrectionVoltThd2Z_mV "" MAP 0x0000 Lookup2D_UWORD 0 VBU0513_CM_uint16_cnt 0.0 65535.0
 /begin AXIS_DESCR COM_AXIS NO_INPUT_QUANTITY VBU0513_CM_single_cnt 11 -3.4028234663852886E+38 3.4028234663852886E+38 AXIS_PTS_REF CaSOC_FastChargeCCRateY_n /end AXIS_DESCR
 /begin AXIS_DESCR COM_AXIS NO_INPUT_QUANTITY VBU0513_CM_single_cnt 9 -3.4028234663852886E+38 3.4028234663852886E+38 AXIS_PTS_REF CaSOC_FastChargeCCTempX_C /end AXIS_DESCR
/end CHARACTERISTIC
/begin CHARACTERISTIC CaSOC_FastChargeCCCorrectionSoc2Z_pct "" MAP 0x0000 Lookup2D_FLOAT32_IEEE 0 VBU0513_CM_single_cnt -3.4028234663852886E+38 3.4028234663852886E+38
 /begin AXIS_DESCR COM_AXIS NO_INPUT_QUANTITY VBU0513_CM_single_cnt 11 -3.4028234663852886E+38 3.4028234663852886E+38 AXIS_PTS_REF CaSOC_FastChargeCCRateY_n /end AXIS_DESCR
 /begin AXIS_DESCR COM_AXIS NO_INPUT_QUANTITY VBU0513_CM_single_cnt 9 -3.4028234663852886E+38 3.4028234663852886E+38 AXIS_PTS_REF CaSOC_FastChargeCCTempX_C /end AXIS_DESCR
/end CHARACTERISTIC
/begin CHARACTERISTIC CaSOC_FastChargeCCCorrectionEOLVoltThd1Z_mV "" MAP 0x0000 Lookup2D_UWORD 0 VBU0513_CM_uint16_cnt 0.0 65535.0
 /begin AXIS_DESCR COM_AXIS NO_INPUT_QUANTITY VBU0513_CM_single_cnt 11 -3.4028234663852886E+38 3.4028234663852886E+38 AXIS_PTS_REF CaSOC_FastChargeCCRateY_n /end AXIS_DESCR
 /begin AXIS_DESCR COM_AXIS NO_INPUT_QUANTITY VBU0513_CM_single_cnt 9 -3.4028234663852886E+38 3.4028234663852886E+38 AXIS_PTS_REF CaSOC_FastChargeCCTempX_C /end AXIS_DESCR
/end CHARACTERISTIC
/begin CHARACTERISTIC CaSOE_SocOcvMapZ_mV "" MAP 0x7001584a Lookup2D_FLOAT32_IEEE 0 VBU0513_CM_single_cnt 2500.0 3800.0
 /begin AXIS_DESCR COM_AXIS NO_INPUT_QUANTITY VBU0513_CM_single_cnt 11 0.0 100.0 AXIS_PTS_REF CaSOE_SocOcvMapY_pct /end AXIS_DESCR
 /begin AXIS_DESCR COM_AXIS CTM_tCellTempAve VBU0513_CM_single_cnt 9 -40.0 80.0 AXIS_PTS_REF CaSOE_SocOcvMapX_C /end AXIS_DESCR
/end CHARACTERISTIC
/begin AXIS_PTS CaSOE_SocOcvMapX_C "" 0x700127da CTM_tCellTempAve Lookup2D_X_FLOAT32_IEEE 0 VBU0513_CM_single_cnt 9 -40.0 80.0 /end AXIS_PTS
/begin AXIS_PTS CaSOE_SocOcvMapY_pct "" 0x70012d5e NO_INPUT_QUANTITY Lookup2D_X_FLOAT32_IEEE 0 VBU0513_CM_single_cnt 11 0.0 100.0 /end AXIS_PTS
/begin CHARACTERISTIC CaSOE_SocResistanceLongMapZ_mohm "" MAP 0x700159d6 Lookup2D_FLOAT32_IEEE 0 VBU0513_CM_single_cnt -3.4028234663852886E+38 3.4028234663852886E+38
 /begin AXIS_DESCR COM_AXIS NO_INPUT_QUANTITY VBU0513_CM_single_cnt 11 -3.4028234663852886E+38 3.4028234663852886E+38 AXIS_PTS_REF CaSOE_SocResistanceLongMapY_pct /end AXIS_DESCR
 /begin AXIS_DESCR COM_AXIS CTM_tCellTempAve VBU0513_CM_single_cnt 9 -3.4028234663852886E+38 3.4028234663852886E+38 AXIS_PTS_REF CaSOE_SocResistanceLongMapX_C /end AXIS_DESCR
/end CHARACTERISTIC
/begin AXIS_PTS CaSOE_SocResistanceLongMapX_C "" 0x700127fe CTM_tCellTempAve Lookup2D_X_FLOAT32_IEEE 0 VBU0513_CM_single_cnt 9 -3.4028234663852886E+38 3.4028234663852886E+38 /end AXIS_PTS
/begin AXIS_PTS CaSOE_SocResistanceLongMapY_pct "" 0x70012d8a NO_INPUT_QUANTITY Lookup2D_X_FLOAT32_IEEE 0 VBU0513_CM_single_cnt 11 -3.4028234663852886E+38 3.4028234663852886E+38 /end AXIS_PTS
/begin CHARACTERISTIC CaSOH_CellCapacity_Ah "" CURVE 0x7001375e Lookup1D_FLOAT32_IEEE 0 VBU0513_CM_single_cnt -3.4028234663852886E+38 3.4028234663852886E+38
 /begin AXIS_DESCR COM_AXIS NO_INPUT_QUANTITY VBU0513_CM_single_cnt 13 -3.4028234663852886E+38 3.4028234663852886E+38 AXIS_PTS_REF CaSOH_LifeTimeDischarge_Ah /end AXIS_DESCR
/end CHARACTERISTIC
/begin AXIS_PTS CaSOH_LifeTimeDischarge_Ah "" 0x700137c6 NO_INPUT_QUANTITY Lookup1D_X_FLOAT32_IEEE 0 VBU0513_CM_single_cnt 13 -3.4028234663852886E+38 3.4028234663852886E+38 /end AXIS_PTS
/begin CHARACTERISTIC CaSOH_LifeTimeDischargeLookUp_Ah "" CURVE 0x70013792 Lookup1D_FLOAT32_IEEE 0 VBU0513_CM_single_cnt -3.4028234663852886E+38 3.4028234663852886E+38
 /begin AXIS_DESCR COM_AXIS NO_INPUT_QUANTITY VBU0513_CM_single_cnt 13 -3.4028234663852886E+38 3.4028234663852886E+38 AXIS_PTS_REF CaSOH_CellCapacityLookUp_Ah /end AXIS_DESCR
/end CHARACTERISTIC
/begin AXIS_PTS CaSOH_CellCapacityLookUp_Ah "" 0x7001372a NO_INPUT_QUANTITY Lookup1D_X_FLOAT32_IEEE 0 VBU0513_CM_single_cnt 13 -3.4028234663852886E+38 3.4028234663852886E+38 /end AXIS_PTS
/begin CHARACTERISTIC CaTHM_ObcSohFactorMapY_n "" CURVE 0x70011eda Lookup1D_FLOAT32_IEEE 0 VBU0513_CM_single_cnt 0.0 1.0
 /begin AXIS_DESCR COM_AXIS NO_INPUT_QUANTITY VBU0513_CM_single_cnt 5 0.0 100.0 AXIS_PTS_REF CaTHM_PackSohMapX_pct /end AXIS_DESCR
/end CHARACTERISTIC
/begin CHARACTERISTIC CaTHM_ObcHighSocRequestTempMapZ_C "" MAP 0x70014ef6 Lookup2D_FLOAT32_IEEE 0 VBU0513_CM_single_cnt -40.0 80.0
 /begin AXIS_DESCR COM_AXIS SOC_pctCellSocMax VBU0513_CM_single_cnt 5 0.0 100.0 AXIS_PTS_REF CaTHM_CellSocMaxMapY_pct /end AXIS_DESCR
 /begin AXIS_DESCR COM_AXIS CTM_tCellTempMax VBU0513_CM_single_cnt 6 -40.0 80.0 AXIS_PTS_REF CaTHM_CellTempMaxMapX_C /end AXIS_DESCR
/end CHARACTERISTIC
/begin CHARACTERISTIC DSPL_facEnergyFactorDeviation_CUR_v "" CURVE 0x70011f02 Lookup1D_FLOAT32_IEEE 0 VBU0513_CM_single_fac 0.0 1.0
 /begin AXIS_DESCR COM_AXIS NO_INPUT_QUANTITY VBU0513_CM_single_fac 5 0.0 1.0 AXIS_PTS_REF DSPL_facEnergyFactorDeviation_CUR_x /end AXIS_DESCR
/end CHARACTERISTIC
/begin AXIS_PTS DSPL_facEnergyFactorDeviation_CUR_x "" 0x70011f16 NO_INPUT_QUANTITY Lookup1D_X_FLOAT32_IEEE 0 VBU0513_CM_single_fac 5 0.0 1.0 /end AXIS_PTS
/begin CHARACTERISTIC DSPL_facRngAmbTempCorr_CUR_v_Md_Default "" CURVE 0x70011f52 Lookup1D_FLOAT32_IEEE 0 VBU0513_CM_single_fac 0.0 1.0
 /begin AXIS_DESCR COM_AXIS NO_INPUT_QUANTITY VBU0513_CM_single_C 5 -40.0 120.0 AXIS_PTS_REF DSPL_tAmbTempChrg_CUR_x /end AXIS_DESCR
/end CHARACTERISTIC
/begin AXIS_PTS DSPL_tAmbTempChrg_CUR_x "" 0x70011fb6 NO_INPUT_QUANTITY Lookup1D_X_FLOAT32_IEEE 0 VBU0513_CM_single_C 5 -40.0 120.0 /end AXIS_PTS
/begin CHARACTERISTIC DSPL_kmRngNEDCMAP_CUR_y_Md_Default "" CURVE 0x70011cca Lookup1D_FLOAT32_IEEE 0 VBU0513_CM_single_km 0.0 1.0E+10
 /begin AXIS_DESCR COM_AXIS NO_INPUT_QUANTITY VBU0513_CM_single_pct 4 0.0 1.0E+23 AXIS_PTS_REF DSPL_pctSOCNEDCMAP_CUR_x /end AXIS_DESCR
/end CHARACTERISTIC
/begin AXIS_PTS DSPL_pctSOCNEDCMAP_CUR_x "" 0x70011cda NO_INPUT_QUANTITY Lookup1D_X_FLOAT32_IEEE 0 VBU0513_CM_single_pct 4 0.0 1.0E+23 /end AXIS_PTS
/begin CHARACTERISTIC EDIS_facMaxBMSCh_CUR_v "" CURVE 0x70012b76 Lookup1D_FLOAT32_IEEE 0 VBU0513_CM_single_cnt -3.4028234663852886E+38 3.4028234663852886E+38
 /begin AXIS_DESCR COM_AXIS NO_INPUT_QUANTITY VBU0513_CM_single_cnt 10 -3.4028234663852886E+38 3.4028234663852886E+38 AXIS_PTS_REF EDIS_tMaxBMSCh_CUR_x /end AXIS_DESCR
/end CHARACTERISTIC
/begin AXIS_PTS EDIS_tMaxBMSCh_CUR_x "" 0x70012c16 NO_INPUT_QUANTITY Lookup1D_X_FLOAT32_IEEE 0 VBU0513_CM_single_cnt 10 -3.4028234663852886E+38 3.4028234663852886E+38 /end AXIS_PTS
/begin CHARACTERISTIC EDIS_facMinBMSCh_CUR_v "" CURVE 0x70012bc6 Lookup1D_FLOAT32_IEEE 0 VBU0513_CM_single_cnt -3.4028234663852886E+38 3.4028234663852886E+38
 /begin AXIS_DESCR COM_AXIS NO_INPUT_QUANTITY VBU0513_CM_single_cnt 10 -3.4028234663852886E+38 3.4028234663852886E+38 AXIS_PTS_REF EDIS_tMinBMSCh_CUR_x /end AXIS_DESCR
/end CHARACTERISTIC
/begin AXIS_PTS EDIS_tMinBMSCh_CUR_x "" 0x70012c66 NO_INPUT_QUANTITY Lookup1D_X_FLOAT32_IEEE 0 VBU0513_CM_single_cnt 10 -3.4028234663852886E+38 3.4028234663852886E+38 /end AXIS_PTS
/begin CHARACTERISTIC EDIS_facRgnReqCapDelta_CUR_v "" CURVE 0x70012ebe Lookup1D_FLOAT32_IEEE 0 VBU0513_CM_single_cnt -3.4028234663852886E+38 3.4028234663852886E+38
 /begin AXIS_DESCR COM_AXIS NO_INPUT_QUANTITY VBU0513_CM_single_cnt 11 -3.4028234663852886E+38 3.4028234663852886E+38 AXIS_PTS_REF EDIS_facRgnReqCapDelta_CUR_x /end AXIS_DESCR
/end CHARACTERISTIC
/begin AXIS_PTS EDIS_facRgnReqCapDelta_CUR_x "" 0x70012eea NO_INPUT_QUANTITY Lookup1D_X_FLOAT32_IEEE 0 VBU0513_CM_single_cnt 11 -3.4028234663852886E+38 3.4028234663852886E+38 /end AXIS_PTS
/begin CHARACTERISTIC EDIS_facBMSSOCCh_CUR_v "" CURVE 0x70014232 Lookup1D_FLOAT32_IEEE 0 VBU0513_CM_single_cnt -3.4028234663852886E+38 3.4028234663852886E+38
 /begin AXIS_DESCR COM_AXIS NO_INPUT_QUANTITY VBU0513_CM_single_cnt 19 -3.4028234663852886E+38 3.4028234663852886E+38 AXIS_PTS_REF EDIS_pctBMSSOCCh_CUR_x /end AXIS_DESCR
/end CHARACTERISTIC
/begin AXIS_PTS EDIS_pctBMSSOCCh_CUR_x "" 0x700142ca NO_INPUT_QUANTITY Lookup1D_X_FLOAT32_IEEE 0 VBU0513_CM_single_cnt 19 -3.4028234663852886E+38 3.4028234663852886E+38 /end AXIS_PTS
/begin CHARACTERISTIC EDIS_pwrSpBaseChDyn_CUR_v "" CURVE 0x70011cea Lookup1D_FLOAT32_IEEE 0 VBU0513_CM_single_cnt -3.4028234663852886E+38 3.4028234663852886E+38
 /begin AXIS_DESCR COM_AXIS EDIS_pwrChLimDynRaw VBU0513_CM_single_cnt 4 -3.4028234663852886E+38 3.4028234663852886E+38 AXIS_PTS_REF EDIS_pwrSpBaseChDyn_CUR_x /end AXIS_DESCR
/end CHARACTERISTIC
/begin AXIS_PTS EDIS_pwrSpBaseChDyn_CUR_x "" 0x70011cfa EDIS_pwrChLimDynRaw Lookup1D_X_FLOAT32_IEEE 0 VBU0513_CM_single_cnt 4 -3.4028234663852886E+38 3.4028234663852886E+38 /end AXIS_PTS
/begin CHARACTERISTIC EDIS_facChPwrDeltaBaseDiff_CUR_v "" CURVE 0x70014642 Lookup1D_FLOAT32_IEEE 0 VBU0513_CM_single_cnt -3.4028234663852886E+38 3.4028234663852886E+38
 /begin AXIS_DESCR COM_AXIS NO_INPUT_QUANTITY VBU0513_CM_single_cnt 21 -3.4028234663852886E+38 3.4028234663852886E+38 AXIS_PTS_REF EDIS_pwrChPwrDeltaBaseDiff_CUR_x /end AXIS_DESCR
/end CHARACTERISTIC
/begin AXIS_PTS EDIS_pwrChPwrDeltaBaseDiff_CUR_x "" 0x7001473e NO_INPUT_QUANTITY Lookup1D_X_FLOAT32_IEEE 0 VBU0513_CM_single_cnt 21 -3.4028234663852886E+38 3.4028234663852886E+38 /end AXIS_PTS
/begin CHARACTERISTIC TQCMP_trqPulse_CUR_v "" CURVE 0x700123da Lookup1D_FLOAT32_IEEE 0 VBU0513_CM_single_cnt -3.4028234663852886E+38 3.4028234663852886E+38
 /begin AXIS_DESCR COM_AXIS NO_INPUT_QUANTITY VBU0513_CM_single_cnt 6 -3.4028234663852886E+38 3.4028234663852886E+38 AXIS_PTS_REF TQCMP_tiPulse_CUR_x /end AXIS_DESCR
/end CHARACTERISTIC
/begin AXIS_PTS TQCMP_tiPulse_CUR_x "" 0x700123c2 NO_INPUT_QUANTITY Lookup1D_X_FLOAT32_IEEE 0 VBU0513_CM_single_cnt 6 -3.4028234663852886E+38 3.4028234663852886E+38 /end AXIS_PTS
/begin CHARACTERISTIC TQCMP_stPulseRAEna_CUR_v "" CURVE 0x70011b70 Lookup1D_FLOAT32_IEEE 0 VBU0513_CM_single_cnt -3.4028234663852886E+38 3.4028234663852886E+38
 /begin AXIS_DESCR COM_AXIS NO_INPUT_QUANTITY VBU0513_CM_single_cnt 3 -3.4028234663852886E+38 3.4028234663852886E+38 AXIS_PTS_REF TQCMP_stDrvMode_CUR_x /end AXIS_DESCR
/end CHARACTERISTIC
/begin AXIS_PTS TQCMP_stDrvMode_CUR_x "" 0x70011b64 NO_INPUT_QUANTITY Lookup1D_X_FLOAT32_IEEE 0 VBU0513_CM_single_cnt 3 -3.4028234663852886E+38 3.4028234663852886E+38 /end AXIS_PTS
/begin CHARACTERISTIC TQDIS_facAccDmpFilterRA_MAP_v "" MAP 0x70014452 Lookup2D_FLOAT32_IEEE 0 VBU0513_CM_single_pct 0.0 1.0
 /begin AXIS_DESCR COM_AXIS APD_pctAccPedPos VBU0513_CM_single_pct 5 0.0 100.0 AXIS_PTS_REF TQDIS_pctDmpFilter_MAP_y /end AXIS_DESCR
 /begin AXIS_DESCR COM_AXIS NO_INPUT_QUANTITY VBU0513_CM_single_cnt 4 0.0 3.0 AXIS_PTS_REF TQDIS_stDmpFilter_MAP_x /end AXIS_DESCR
/end CHARACTERISTIC
/begin AXIS_PTS TQDIS_stDmpFilter_MAP_x "" 0x70011d7a NO_INPUT_QUANTITY Lookup2D_X_FLOAT32_IEEE 0 VBU0513_CM_single_cnt 4 0.0 3.0 /end AXIS_PTS
/begin AXIS_PTS TQDIS_pctDmpFilter_MAP_y "" 0x700120a6 APD_pctAccPedPos Lookup2D_X_FLOAT32_IEEE 0 VBU0513_CM_single_pct 5 0.0 100.0 /end AXIS_PTS
/begin CHARACTERISTIC TQDIS_facSpdDmpFilterRA_MAP_v "" MAP 0x700144a2 Lookup2D_FLOAT32_IEEE 0 VBU0513_CM_single_cnt -3.4028234663852886E+38 3.4028234663852886E+38
 /begin AXIS_DESCR COM_AXIS SPD_vVehSpd VBU0513_CM_single_cnt 5 -3.4028234663852886E+38 3.4028234663852886E+38 AXIS_PTS_REF TQDIS_vDmpFilter_MAP_y /end AXIS_DESCR
 /begin AXIS_DESCR COM_AXIS NO_INPUT_QUANTITY VBU0513_CM_single_cnt 4 0.0 3.0 AXIS_PTS_REF TQDIS_stDmpFilter_MAP_x /end AXIS_DESCR
/end CHARACTERISTIC
/begin AXIS_PTS TQDIS_vDmpFilter_MAP_y "" 0x700120ba SPD_vVehSpd Lookup2D_X_FLOAT32_IEEE 0 VBU0513_CM_single_cnt 5 -3.4028234663852886E+38 3.4028234663852886E+38 /end AXIS_PTS
/begin CHARACTERISTIC TQO_facShftChangeHi_CUR_v "" CURVE 0x7001246a Lookup1D_FLOAT32_IEEE 0 VBU0513_CM_single_cnt -3.4028234663852886E+38 3.4028234663852886E+38
 /begin AXIS_DESCR COM_AXIS NO_INPUT_QUANTITY VBU0513_CM_single_cnt 6 -3.4028234663852886E+38 3.4028234663852886E+38 AXIS_PTS_REF TQO_trqShftChange_CUR_x /end AXIS_DESCR
/end CHARACTERISTIC
/begin AXIS_PTS TQO_trqShftChange_CUR_x "" 0x700124b2 NO_INPUT_QUANTITY Lookup1D_X_FLOAT32_IEEE 0 VBU0513_CM_single_cnt 6 -3.4028234663852886E+38 3.4028234663852886E+38 /end AXIS_PTS
/begin CHARACTERISTIC TQO_facShftChangeLo_CUR_v "" CURVE 0x70012482 Lookup1D_FLOAT32_IEEE 0 VBU0513_CM_single_cnt -3.4028234663852886E+38 3.4028234663852886E+38
 /begin AXIS_DESCR COM_AXIS NO_INPUT_QUANTITY VBU0513_CM_single_cnt 6 -3.4028234663852886E+38 3.4028234663852886E+38 AXIS_PTS_REF TQO_trqShftChange_CUR_x /end AXIS_DESCR
/end CHARACTERISTIC
/begin CHARACTERISTIC TQO_facShftChangeSlope_CUR_v "" CURVE 0x7001249a Lookup1D_FLOAT32_IEEE 0 VBU0513_CM_single_cnt -3.4028234663852886E+38 3.4028234663852886E+38
 /begin AXIS_DESCR COM_AXIS NO_INPUT_QUANTITY VBU0513_CM_single_cnt 6 -3.4028234663852886E+38 3.4028234663852886E+38 AXIS_PTS_REF TQO_trqShftChange_CUR_x /end AXIS_DESCR
/end CHARACTERISTIC
/begin CHARACTERISTIC CaSOH_CellCapacityWrite_Ah "" VAL_BLK 0x7001a1c2 Scalar_FLOAT32_IEEE 0 VBU0513_CM_single_cnt -3.4028234663852886E+38 3.4028234663852886E+38 NUMBER 198 /end CHARACTERISTIC
/begin CHARACTERISTIC CaSOH_InvalidCellCapacity_Ah "" VAL_BLK 0x7001a4da Scalar_FLOAT32_IEEE 0 VBU0513_CM_single_cnt -3.4028234663852886E+38 3.4028234663852886E+38 NUMBER 198 /end CHARACTERISTIC
/begin CHARACTERISTIC CaSOH_InvalidHistoryCurrentData_A "" VAL_BLK 0x70011e8a Scalar_FLOAT32_IEEE 0 VBU0513_CM_single_cnt -3.4028234663852886E+38 3.4028234663852886E+38 NUMBER 5 /end CHARACTERISTIC
/begin CHARACTERISTIC CcFCC_ChargeCurrentDerateSocDelta_pct "" VALUE 0x700106ec Scalar_FLOAT32_IEEE 0 VBU0513_CM_single_cnt -3.4028234663852886E+38 3.4028234663852886E+38 /end CHARACTERISTIC
/begin CHARACTERISTIC CcFCC_ChargeCurrentDerateSoc_pct "" VALUE 0x700106f0 Scalar_FLOAT32_IEEE 0 VBU0513_CM_single_cnt -3.4028234663852886E+38 3.4028234663852886E+38 /end CHARACTERISTIC
/begin CHARACTERISTIC CcFCC_ChargeVoltageDelta_V "" VALUE 0x7001071c Scalar_FLOAT32_IEEE 0 VBU0513_CM_single_cnt -3.4028234663852886E+38 3.4028234663852886E+38 /end CHARACTERISTIC
/begin CHARACTERISTIC CcFCC_ComputeResistanceTempMax_C "" VALUE 0x70010730 Scalar_FLOAT32_IEEE 0 VBU0513_CM_single_C -40.0 200.0 /end CHARACTERISTIC
/begin CHARACTERISTIC CcFCC_ComputeResistanceTempMin_C "" VALUE 0x70010734 Scalar_FLOAT32_IEEE 0 VBU0513_CM_single_C -40.0 200.0 /end CHARACTERISTIC
/begin CHARACTERISTIC CcSOC_BatteryDisplaySocChargeDecRate_n "" VALUE 0x700107c8 Scalar_FLOAT32_IEEE 0 VBU0513_CM_single_cnt -3.4028234663852886E+38 3.4028234663852886E+38 /end CHARACTERISTIC
/begin CHARACTERISTIC CcSOC_BatteryDisplaySocChargeIncRate_n "" VALUE 0x700107cc Scalar_FLOAT32_IEEE 0 VBU0513_CM_single_cnt -3.4028234663852886E+38 3.4028234663852886E+38 /end CHARACTERISTIC
/begin CHARACTERISTIC CcSOC_CurrentWinAvePeriodTime_ms "" VALUE 0x7001084c Scalar_FLOAT32_IEEE 0 VBU0513_CM_single_cnt -3.4028234663852886E+38 3.4028234663852886E+38 /end CHARACTERISTIC
/begin CHARACTERISTIC CcSOC_FastChargeTOCDeltaVolSOC_pct "" VALUE 0x70010864 Scalar_FLOAT32_IEEE 0 VBU0513_CM_single -3.4E+38 3.4E+38 /end CHARACTERISTIC
/begin CHARACTERISTIC CcSOC_iAOcvShortTimeCurrentLimit "" VALUE 0x7001089c Scalar_FLOAT32_IEEE 0 VBU0513_CM_single_cnt -3.4028234663852886E+38 3.4028234663852886E+38 /end CHARACTERISTIC
/begin CHARACTERISTIC CcSOE_CellVoltageLowerLimit_mV "" VALUE 0x700108ac Scalar_FLOAT32_IEEE 0 VBU0513_CM_single_cnt -3.4028234663852886E+38 3.4028234663852886E+38 /end CHARACTERISTIC
/begin CHARACTERISTIC CcSOF_DischargeLowOCVStepSlope_V "" VALUE 0x70010944 Scalar_FLOAT32_IEEE 0 VBU0513_CM_single_cnt -3.4028234663852886E+38 3.4028234663852886E+38 /end CHARACTERISTIC
/begin CHARACTERISTIC CcSOF_LowVoltageChargeCurrentMax_A "" VALUE 0x700109b4 Scalar_FLOAT32_IEEE 0 VBU0513_CM_single_cnt -3.4028234663852886E+38 3.4028234663852886E+38 /end CHARACTERISTIC
/begin CHARACTERISTIC CcSOF_LowVoltageChargeCurrentSlopeDec_A "" VALUE 0x700109b8 Scalar_FLOAT32_IEEE 0 VBU0513_CM_single_cnt -3.4028234663852886E+38 3.4028234663852886E+38 /end CHARACTERISTIC
/begin CHARACTERISTIC CcSOF_LowVoltageChargeCurrentSlopeInc_A "" VALUE 0x700109bc Scalar_FLOAT32_IEEE 0 VBU0513_CM_single_cnt -3.4028234663852886E+38 3.4028234663852886E+38 /end CHARACTERISTIC
/begin CHARACTERISTIC CcSOF_SocpDischargePowerMin_Kw "" VALUE 0x700109ec Scalar_FLOAT32_IEEE 0 VBU0513_CM_single_cnt -3.4028234663852886E+38 3.4028234663852886E+38 /end CHARACTERISTIC
/begin CHARACTERISTIC CcSOF_SocpDischargePowerSlope_Kw "" VALUE 0x700109f0 Scalar_FLOAT32_IEEE 0 VBU0513_CM_single_cnt -3.4028234663852886E+38 3.4028234663852886E+38 /end CHARACTERISTIC
/begin CHARACTERISTIC CcSOH_CellCapacityLowThershold_Ah "" VALUE 0x70010a54 Scalar_FLOAT32_IEEE 0 VBU0513_CM_single_cnt -3.4028234663852886E+38 3.4028234663852886E+38 /end CHARACTERISTIC
/begin CHARACTERISTIC CcSOH_ComResisTempLowerLimit_C "" VALUE 0x70010a68 Scalar_FLOAT32_IEEE 0 VBU0513_CM_single_cnt -3.4028234663852886E+38 3.4028234663852886E+38 /end CHARACTERISTIC
/begin CHARACTERISTIC CcSOH_ComResisTempUpperLimit_C "" VALUE 0x70010a6c Scalar_FLOAT32_IEEE 0 VBU0513_CM_single_cnt -3.4028234663852886E+38 3.4028234663852886E+38 /end CHARACTERISTIC
/begin CHARACTERISTIC CcSOH_DeltaModuleCurrent_A "" VALUE 0x70010a70 Scalar_FLOAT32_IEEE 0 VBU0513_CM_single_cnt -3.4028234663852886E+38 3.4028234663852886E+38 /end CHARACTERISTIC
/begin CHARACTERISTIC CcSOH_DeltaSocLowerLimit_pct "" VALUE 0x70010a74 Scalar_FLOAT32_IEEE 0 VBU0513_CM_single_cnt -3.4028234663852886E+38 3.4028234663852886E+38 /end CHARACTERISTIC
/begin CHARACTERISTIC CcSOH_DeltaSocThreshold_pct "" VALUE 0x70010a78 Scalar_FLOAT32_IEEE 0 VBU0513_CM_single_cnt -3.4028234663852886E+38 3.4028234663852886E+38 /end CHARACTERISTIC
/begin CHARACTERISTIC CcSOH_DeltaSocUpperLimit_pct "" VALUE 0x70010a7c Scalar_FLOAT32_IEEE 0 VBU0513_CM_single_cnt -3.4028234663852886E+38 3.4028234663852886E+38 /end CHARACTERISTIC
/begin CHARACTERISTIC CcSOH_DeltaTemThreshold_C "" VALUE 0x70010a80 Scalar_FLOAT32_IEEE 0 VBU0513_CM_single_cnt -3.4028234663852886E+38 3.4028234663852886E+38 /end CHARACTERISTIC
/begin CHARACTERISTIC CcSOH_LowTemThreshold_C "" VALUE 0x70010a8c Scalar_FLOAT32_IEEE 0 VBU0513_CM_single_cnt -3.4028234663852886E+38 3.4028234663852886E+38 /end CHARACTERISTIC
/begin CHARACTERISTIC CcSOH_UdSocInvalidLowerLimit_pct "" VALUE 0x70010aac Scalar_FLOAT32_IEEE 0 VBU0513_CM_single_cnt -3.4028234663852886E+38 3.4028234663852886E+38 /end CHARACTERISTIC
/begin CHARACTERISTIC CcSOH_UdSocInvalidUpperLimit_pct "" VALUE 0x70010ab0 Scalar_FLOAT32_IEEE 0 VBU0513_CM_single_cnt -3.4028234663852886E+38 3.4028234663852886E+38 /end CHARACTERISTIC
/begin CHARACTERISTIC CcSYS_ResisCalFCCPulseCurrent_A "" VALUE 0x70010ad4 Scalar_FLOAT32_IEEE 0 VBU0513_CM_single_cnt 0.0 1.0E+23 /end CHARACTERISTIC
/begin CHARACTERISTIC CcSYS_ResisCalPulseCurrentDurationTime_ms "" VALUE 0x70010ad8 Scalar_FLOAT32_IEEE 0 VBU0513_CM_single_cnt 0.0 1.0E+23 /end CHARACTERISTIC
/begin CHARACTERISTIC CcSYS_ResisCalRelaxationCurrent_A "" VALUE 0x70010adc Scalar_FLOAT32_IEEE 0 VBU0513_CM_single_cnt -3.4028234663852886E+38 3.4028234663852886E+38 /end CHARACTERISTIC
/begin CHARACTERISTIC CcTHM_CoolantSensorGradient_C "" VALUE 0x70010aec Scalar_FLOAT32_IEEE 0 VBU0513_CM_single_cnt -3.4028234663852886E+38 3.4028234663852886E+38 /end CHARACTERISTIC
/begin CHARACTERISTIC CcTHM_FccCellTempHighThreshold_C "" VALUE 0x70010b00 Scalar_FLOAT32_IEEE 0 VBU0513_CM_single_cnt -3.4028234663852886E+38 3.4028234663852886E+38 /end CHARACTERISTIC
/begin CHARACTERISTIC CcTHM_FccChargeHysterSOC_pct "" VALUE 0x70010b04 Scalar_FLOAT32_IEEE 0 VBU0513_CM_single_cnt -3.4028234663852886E+38 3.4028234663852886E+38 /end CHARACTERISTIC
/begin CHARACTERISTIC CcTHM_FccChargeTempRequestHysterTemp_C "" VALUE 0x70010b08 Scalar_FLOAT32_IEEE 0 VBU0513_CM_single_cnt -3.4028234663852886E+38 3.4028234663852886E+38 /end CHARACTERISTIC
/begin CHARACTERISTIC CcTHM_FccSocHighThreshold_pct "" VALUE 0x70010b10 Scalar_FLOAT32_IEEE 0 VBU0513_CM_single_cnt -3.4028234663852886E+38 3.4028234663852886E+38 /end CHARACTERISTIC
/begin CHARACTERISTIC CcTHM_ObcCellTempHighThreshold_C "" VALUE 0x70010b24 Scalar_FLOAT32_IEEE 0 VBU0513_CM_single_cnt -3.4028234663852886E+38 3.4028234663852886E+38 /end CHARACTERISTIC
/begin CHARACTERISTIC CcTHM_ObcChargeHysterSOC_pct "" VALUE 0x70010b28 Scalar_FLOAT32_IEEE 0 VBU0513_CM_single_cnt -3.4028234663852886E+38 3.4028234663852886E+38 /end CHARACTERISTIC
/begin CHARACTERISTIC CcTHM_ObcChargeTempRequestHysterTemp_C "" VALUE 0x70010b2c Scalar_FLOAT32_IEEE 0 VBU0513_CM_single_cnt -3.4028234663852886E+38 3.4028234663852886E+38 /end CHARACTERISTIC
/begin CHARACTERISTIC CcTHM_ObcChargeTempRequestLowThreshold_C "" VALUE 0x70010b30 Scalar_FLOAT32_IEEE 0 VBU0513_CM_single_cnt -3.4028234663852886E+38 3.4028234663852886E+38 /end CHARACTERISTIC
/begin CHARACTERISTIC CcTHM_ObcSocHighThreshold_pct "" VALUE 0x70010b34 Scalar_FLOAT32_IEEE 0 VBU0513_CM_single_cnt -3.4028234663852886E+38 3.4028234663852886E+38 /end CHARACTERISTIC
/begin CHARACTERISTIC CcTHM_ObcSohTempLowThreshold_C "" VALUE 0x70010b38 Scalar_FLOAT32_IEEE 0 VBU0513_CM_single_cnt -3.4028234663852886E+38 3.4028234663852886E+38 /end CHARACTERISTIC
/begin CHARACTERISTIC DCH_iBMSZeroCrntDlyStopCh_C "" VALUE 0x70010cc0 Scalar_FLOAT32_IEEE 0 VBU0513_CM_single_cnt -3.4028234663852886E+38 3.4028234663852886E+38 /end CHARACTERISTIC
/begin CHARACTERISTIC DCH_iCCSChgCrnt_C "" VALUE 0x70010cc4 Scalar_FLOAT32_IEEE 0 VBU0513_CM_single_cnt -3.4028234663852886E+38 3.4028234663852886E+38 /end CHARACTERISTIC
/begin CHARACTERISTIC DCH_iOpenDCChRly_C "" VALUE 0x70010ce0 Scalar_FLOAT32_IEEE 0 VBU0513_CM_single_cnt -3.4028234663852886E+38 3.4028234663852886E+38 /end CHARACTERISTIC
/begin CHARACTERISTIC DCH_tiAPlusVldDly_C "" VALUE 0x70010da8 Scalar_FLOAT32_IEEE 0 VBU0513_CM_single_cnt -3.4028234663852886E+38 3.4028234663852886E+38 /end CHARACTERISTIC
/begin CHARACTERISTIC DCH_tiAplusConfirmT_C "" VALUE 0x70010dac Scalar_FLOAT32_IEEE 0 VBU0513_CM_single_cnt -3.4028234663852886E+38 3.4028234663852886E+38 /end CHARACTERISTIC
/begin CHARACTERISTIC DCH_tiBMSChAvlDly_C "" VALUE 0x70010dbc Scalar_FLOAT32_IEEE 0 VBU0513_CM_single_cnt -3.4028234663852886E+38 3.4028234663852886E+38 /end CHARACTERISTIC
/begin CHARACTERISTIC DCH_tiBMSChAvlTrnOffDly_C "" VALUE 0x70010dc0 Scalar_FLOAT32_IEEE 0 VBU0513_CM_single_cnt -3.4028234663852886E+38 3.4028234663852886E+38 /end CHARACTERISTIC
/begin CHARACTERISTIC DCH_tiCC2ConfirmT_C "" VALUE 0x70010dc4 Scalar_FLOAT32_IEEE 0 VBU0513_CM_single_cnt -3.4028234663852886E+38 3.4028234663852886E+38 /end CHARACTERISTIC
/begin CHARACTERISTIC DCH_tiCC2OffCnfrm_C "" VALUE 0x70010dc8 Scalar_FLOAT32_IEEE 0 VBU0513_CM_single_cnt -3.4028234663852886E+38 3.4028234663852886E+38 /end CHARACTERISTIC
/begin CHARACTERISTIC DCH_tiCSTTrigDly_C "" VALUE 0x70010dec Scalar_FLOAT32_IEEE 0 VBU0513_CM_single_cnt -3.4028234663852886E+38 3.4028234663852886E+38 /end CHARACTERISTIC
/begin CHARACTERISTIC DCH_tiDCChRlyTurnOffConfrmDly_C "" VALUE 0x70010e00 Scalar_FLOAT32_IEEE 0 VBU0513_CM_single_cnt -3.4028234663852886E+38 3.4028234663852886E+38 /end CHARACTERISTIC
/begin CHARACTERISTIC DCH_uDCRlyClosedJudged_C "" VALUE 0x70010e58 Scalar_FLOAT32_IEEE 0 VBU0513_CM_single -3.4E+38 3.4E+38 /end CHARACTERISTIC
/begin CHARACTERISTIC DCH_uMaxCCToConn_C "" VALUE 0x70010e60 Scalar_FLOAT32_IEEE 0 VBU0513_CM_single_cnt -3.4028234663852886E+38 3.4028234663852886E+38 /end CHARACTERISTIC
/begin CHARACTERISTIC DCH_uMinCCToConn_C "" VALUE 0x70010e64 Scalar_FLOAT32_IEEE 0 VBU0513_CM_single_cnt -3.4028234663852886E+38 3.4028234663852886E+38 /end CHARACTERISTIC
/begin CHARACTERISTIC DCH_vMaxSpdLim_C "" VALUE 0x70010e68 Scalar_FLOAT32_IEEE 0 VBU0513_CM_single_cnt -3.4028234663852886E+38 3.4028234663852886E+38 /end CHARACTERISTIC
/begin CHARACTERISTIC DCH_vMinSpdLim_C "" VALUE 0x70010e6c Scalar_FLOAT32_IEEE 0 VBU0513_CM_single_cnt -3.4028234663852886E+38 3.4028234663852886E+38 /end CHARACTERISTIC
/begin CHARACTERISTIC DIAGS_stPsvResp_SY "" VALUE 0x70010e70 Scalar_FLOAT32_IEEE 0 VBU0513_CM_single_cnt -3.4028234663852886E+38 3.4028234663852886E+38 /end CHARACTERISTIC
/begin CHARACTERISTIC DSPL_facBMSEnergyStep1_C "" VALUE 0x70010e74 Scalar_FLOAT32_IEEE 0 VBU0513_CM_single_fac 0.0 1.0 /end CHARACTERISTIC
/begin CHARACTERISTIC DSPL_facBMSEnergyStep2_C "" VALUE 0x70010e78 Scalar_FLOAT32_IEEE 0 VBU0513_CM_single_fac 0.0 1.0 /end CHARACTERISTIC
/begin CHARACTERISTIC DSPL_facBMSEnergyStep3_C "" VALUE 0x70010e7c Scalar_FLOAT32_IEEE 0 VBU0513_CM_single_fac 0.0 1.0 /end CHARACTERISTIC
/begin CHARACTERISTIC DSPL_facBMSEnergyStep4_C "" VALUE 0x70010e80 Scalar_FLOAT32_IEEE 0 VBU0513_CM_single_fac 0.0 1.0 /end CHARACTERISTIC
/begin CHARACTERISTIC DSPL_facBMSEnergyStep5_C "" VALUE 0x70010e84 Scalar_FLOAT32_IEEE 0 VBU0513_CM_single_fac 0.0 1.0 /end CHARACTERISTIC
/begin CHARACTERISTIC DSPL_facEnergyComsume10kmFactor1_C "" VALUE 0x70010ec4 Scalar_FLOAT32_IEEE 0 VBU0513_CM_single_fac 0.0 1.0 /end CHARACTERISTIC
/begin CHARACTERISTIC DSPL_facEnergyComsume10kmFactor2_C "" VALUE 0x70010ec8 Scalar_FLOAT32_IEEE 0 VBU0513_CM_single_fac 0.0 1.0 /end CHARACTERISTIC
/begin CHARACTERISTIC DSPL_facEnergyComsume10kmFactor3_C "" VALUE 0x70010ecc Scalar_FLOAT32_IEEE 0 VBU0513_CM_single_fac 0.0 1.0 /end CHARACTERISTIC
/begin CHARACTERISTIC DSPL_facEnergyComsume10kmFactor4_C "" VALUE 0x70010ed0 Scalar_FLOAT32_IEEE 0 VBU0513_CM_single_fac 0.0 1.0 /end CHARACTERISTIC
/begin CHARACTERISTIC DSPL_facEnergyComsume10kmNegFactor_C "" VALUE 0x70010ed4 Scalar_FLOAT32_IEEE 0 VBU0513_CM_single_fac 0.0 1.0 /end CHARACTERISTIC
/begin CHARACTERISTIC DSPL_facEnergyComsume10kmPosFactor_C "" VALUE 0x70010ed8 Scalar_FLOAT32_IEEE 0 VBU0513_CM_single_fac 0.0 1.0 /end CHARACTERISTIC
/begin CHARACTERISTIC DSPL_facEnergyComsume10kmStep1_C "" VALUE 0x70010edc Scalar_FLOAT32_IEEE 0 VBU0513_CM_single_fac 0.0 1.0 /end CHARACTERISTIC
/begin CHARACTERISTIC DSPL_facEnergyComsume10kmStep2_C "" VALUE 0x70010ee0 Scalar_FLOAT32_IEEE 0 VBU0513_CM_single_fac 0.0 1.0 /end CHARACTERISTIC
/begin CHARACTERISTIC DSPL_facEnergyComsume10kmStep3_C "" VALUE 0x70010ee4 Scalar_FLOAT32_IEEE 0 VBU0513_CM_single_fac 0.0 1.0 /end CHARACTERISTIC
/begin CHARACTERISTIC DSPL_facEnergyComsume50kmCalFilter1_C "" VALUE 0x70010ee8 Scalar_FLOAT32_IEEE 0 VBU0513_CM_single_fac 0.0 1.0 /end CHARACTERISTIC
/begin CHARACTERISTIC DSPL_facEnergyComsume50kmCalFilter2_C "" VALUE 0x70010eec Scalar_FLOAT32_IEEE 0 VBU0513_CM_single_fac 0.0 1.0 /end CHARACTERISTIC
/begin CHARACTERISTIC DSPL_facEnergyComsume50kmCalFilter3_C "" VALUE 0x70010ef0 Scalar_FLOAT32_IEEE 0 VBU0513_CM_single_fac 0.0 1.0 /end CHARACTERISTIC
/begin CHARACTERISTIC DSPL_facEnergyComsume50kmInitFactor1_C "" VALUE 0x70010ef4 Scalar_FLOAT32_IEEE 0 VBU0513_CM_single_fac 0.0 1.0 /end CHARACTERISTIC
/begin CHARACTERISTIC DSPL_facEnergyComsume50kmInitFactor2_C "" VALUE 0x70010ef8 Scalar_FLOAT32_IEEE 0 VBU0513_CM_single_fac 0.0 1.0 /end CHARACTERISTIC
/begin CHARACTERISTIC DSPL_facEnergyComsume50kmInitFactor3_C "" VALUE 0x70010efc Scalar_FLOAT32_IEEE 0 VBU0513_CM_single_fac 0.0 1.0 /end CHARACTERISTIC
/begin CHARACTERISTIC DSPL_facEnergyComsume50kmInitFactorDefault_C "" VALUE 0x70010f00 Scalar_FLOAT32_IEEE 0 VBU0513_CM_single_fac 0.0 1.0 /end CHARACTERISTIC
/begin CHARACTERISTIC DSPL_facEnergyComsume50kmInitStep1_C "" VALUE 0x70010f04 Scalar_FLOAT32_IEEE 0 VBU0513_CM_single_fac 0.0 1.0 /end CHARACTERISTIC
/begin CHARACTERISTIC DSPL_facEnergyComsume50kmInitStep2_C "" VALUE 0x70010f08 Scalar_FLOAT32_IEEE 0 VBU0513_CM_single_fac 0.0 1.0 /end CHARACTERISTIC
/begin CHARACTERISTIC DSPL_facEnergyComsume50kmInitStep3_C "" VALUE 0x70010f0c Scalar_FLOAT32_IEEE 0 VBU0513_CM_single_fac 0.0 1.0 /end CHARACTERISTIC
/begin CHARACTERISTIC DSPL_facEnergyComsumeCalFilter10_C "" VALUE 0x70010f10 Scalar_FLOAT32_IEEE 0 VBU0513_CM_single_fac 0.0 1.0 /end CHARACTERISTIC
/begin CHARACTERISTIC DSPL_facEnergyComsumeCalFilter11_C "" VALUE 0x70010f14 Scalar_FLOAT32_IEEE 0 VBU0513_CM_single_fac 0.0 1.0 /end CHARACTERISTIC
/begin CHARACTERISTIC DSPL_facEnergyComsumeCalFilter1_C "" VALUE 0x70010f18 Scalar_FLOAT32_IEEE 0 VBU0513_CM_single_fac 0.0 1.0 /end CHARACTERISTIC
/begin CHARACTERISTIC DSPL_facEnergyComsumeCalFilter2_C "" VALUE 0x70010f1c Scalar_FLOAT32_IEEE 0 VBU0513_CM_single_fac 0.0 1.0 /end CHARACTERISTIC
/begin CHARACTERISTIC DSPL_facEnergyComsumeCalFilter3_C "" VALUE 0x70010f20 Scalar_FLOAT32_IEEE 0 VBU0513_CM_single_fac 0.0 1.0 /end CHARACTERISTIC
/begin CHARACTERISTIC DSPL_facEnergyComsumeCalFilter4_C "" VALUE 0x70010f24 Scalar_FLOAT32_IEEE 0 VBU0513_CM_single_fac 0.0 1.0 /end CHARACTERISTIC
/begin CHARACTERISTIC DSPL_facEnergyComsumeCalFilter5_C "" VALUE 0x70010f28 Scalar_FLOAT32_IEEE 0 VBU0513_CM_single_fac 0.0 1.0 /end CHARACTERISTIC
/begin CHARACTERISTIC DSPL_facEnergyComsumeCalFilter6_C "" VALUE 0x70010f2c Scalar_FLOAT32_IEEE 0 VBU0513_CM_single_fac 0.0 1.0 /end CHARACTERISTIC
/begin CHARACTERISTIC DSPL_facEnergyComsumeCalFilter7_C "" VALUE 0x70010f30 Scalar_FLOAT32_IEEE 0 VBU0513_CM_single_fac 0.0 1.0 /end CHARACTERISTIC
/begin CHARACTERISTIC DSPL_facEnergyComsumeCalFilter8_C "" VALUE 0x70010f34 Scalar_FLOAT32_IEEE 0 VBU0513_CM_single_fac 0.0 1.0 /end CHARACTERISTIC
/begin CHARACTERISTIC DSPL_facEnergyComsumeCalFilter9_C "" VALUE 0x70010f38 Scalar_FLOAT32_IEEE 0 VBU0513_CM_single_fac 0.0 1.0 /end CHARACTERISTIC
/begin CHARACTERISTIC DSPL_facEnergyComsumeDownMin_C "" VALUE 0x70010f3c Scalar_FLOAT32_IEEE 0 VBU0513_CM_single_fac 0.0 1.0 /end CHARACTERISTIC
/begin CHARACTERISTIC DSPL_facEnergyComsumeInitFactor1_C "" VALUE 0x70010f40 Scalar_FLOAT32_IEEE 0 VBU0513_CM_single_fac 0.0 1.0 /end CHARACTERISTIC
/begin CHARACTERISTIC DSPL_facEnergyComsumeInitFactor2_C "" VALUE 0x70010f44 Scalar_FLOAT32_IEEE 0 VBU0513_CM_single_fac 0.0 1.0 /end CHARACTERISTIC
/begin CHARACTERISTIC DSPL_facEnergyComsumeInitFactor3_C "" VALUE 0x70010f48 Scalar_FLOAT32_IEEE 0 VBU0513_CM_single_fac 0.0 1.0 /end CHARACTERISTIC
/begin CHARACTERISTIC DSPL_facEnergyComsumeInitFactorDefault_C "" VALUE 0x70010f4c Scalar_FLOAT32_IEEE 0 VBU0513_CM_single_fac 0.0 1.0 /end CHARACTERISTIC
/begin CHARACTERISTIC DSPL_facEnergyComsumeInitStep1_C "" VALUE 0x70010f50 Scalar_FLOAT32_IEEE 0 VBU0513_CM_single_fac 0.0 1.0 /end CHARACTERISTIC
/begin CHARACTERISTIC DSPL_facEnergyComsumeInitStep2_C "" VALUE 0x70010f54 Scalar_FLOAT32_IEEE 0 VBU0513_CM_single_fac 0.0 1.0 /end CHARACTERISTIC
/begin CHARACTERISTIC DSPL_facEnergyComsumeInitStep3_C "" VALUE 0x70010f58 Scalar_FLOAT32_IEEE 0 VBU0513_CM_single_fac 0.0 1.0 /end CHARACTERISTIC
/begin CHARACTERISTIC DSPL_facEnergyComsumeUPMax_C "" VALUE 0x70010f5c Scalar_FLOAT32_IEEE 0 VBU0513_CM_single_fac 0.0 1.0 /end CHARACTERISTIC
/begin CHARACTERISTIC DSPL_kmChrgDownStepMin_C "" VALUE 0x70010fb4 Scalar_FLOAT32_IEEE 0 VBU0513_CM_single_km -1.0E+7 1.0E+10 /end CHARACTERISTIC
/begin CHARACTERISTIC DSPL_kmChrgUpStepMax_C "" VALUE 0x70010fb8 Scalar_FLOAT32_IEEE 0 VBU0513_CM_single_km -1.0E+7 1.0E+10 /end CHARACTERISTIC
/begin CHARACTERISTIC DSPL_kmDrvRngStepMax_C "" VALUE 0x70010fd4 Scalar_FLOAT32_IEEE 0 VBU0513_CM_single_km -1.0E+7 1.0E+10 /end CHARACTERISTIC
/begin CHARACTERISTIC DSPL_kmRange10kmCalCell_C "" VALUE 0x70010ff8 Scalar_FLOAT32_IEEE 0 VBU0513_CM_single_km 0.0 1.0E+11 /end CHARACTERISTIC
/begin CHARACTERISTIC DSPL_kmRange50kmCalCell_C "" VALUE 0x70010ffc Scalar_FLOAT32_IEEE 0 VBU0513_CM_single_km 0.0 1.0E+11 /end CHARACTERISTIC
/begin CHARACTERISTIC DSPL_kmRemainingRangeDisplayStep_C "" VALUE 0x70011000 Scalar_FLOAT32_IEEE 0 VBU0513_CM_single_km 0.0 1.0E+23 /end CHARACTERISTIC
/begin CHARACTERISTIC DSPL_numSOCJump_C "" VALUE 0x70011008 Scalar_FLOAT32_IEEE 0 VBU0513_CM_single_cnt 0.0 1.0E+15 /end CHARACTERISTIC
/begin CHARACTERISTIC DSPL_pctBMSEnergyStep1_C "" VALUE 0x70011014 Scalar_FLOAT32_IEEE 0 VBU0513_CM_single_pct 0.0 100.0 /end CHARACTERISTIC
/begin CHARACTERISTIC DSPL_pctBMSEnergyStep2_C "" VALUE 0x70011018 Scalar_FLOAT32_IEEE 0 VBU0513_CM_single_pct 0.0 100.0 /end CHARACTERISTIC
/begin CHARACTERISTIC DSPL_pctBMSEnergyStep3_C "" VALUE 0x7001101c Scalar_FLOAT32_IEEE 0 VBU0513_CM_single_pct 0.0 100.0 /end CHARACTERISTIC
/begin CHARACTERISTIC DSPL_pctBMSEnergyStep4_C "" VALUE 0x70011020 Scalar_FLOAT32_IEEE 0 VBU0513_CM_single_pct 0.0 100.0 /end CHARACTERISTIC
/begin CHARACTERISTIC DSPL_pctBMSEnergyStep5_C "" VALUE 0x70011024 Scalar_FLOAT32_IEEE 0 VBU0513_CM_single_pct 0.0 100.0 /end CHARACTERISTIC
/begin CHARACTERISTIC DSPL_pctBMSEnergyStep6_C "" VALUE 0x70011028 Scalar_FLOAT32_IEEE 0 VBU0513_CM_single_pct 0.0 100.0 /end CHARACTERISTIC
/begin CHARACTERISTIC DSPL_pctBMSSOCMinStep_C "" VALUE 0x7001102c Scalar_FLOAT32_IEEE 0 VBU0513_CM_single_pct 0.0 100.0 /end CHARACTERISTIC
/begin CHARACTERISTIC DSPL_pctSOCFullChrg_C "" VALUE 0x70011038 Scalar_FLOAT32_IEEE 0 VBU0513_CM_single_pct 0.0 100.0 /end CHARACTERISTIC
/begin CHARACTERISTIC DSPL_pctSOCJumpHi_C "" VALUE 0x7001103c Scalar_FLOAT32_IEEE 0 VBU0513_CM_single_pct 0.0 100.0 /end CHARACTERISTIC
/begin CHARACTERISTIC DSPL_pctSOCJumpLo_C "" VALUE 0x70011040 Scalar_FLOAT32_IEEE 0 VBU0513_CM_single_pct 0.0 100.0 /end CHARACTERISTIC
/begin CHARACTERISTIC DSPL_pctSocFull_C "" VALUE 0x70011044 Scalar_FLOAT32_IEEE 0 VBU0513_CM_single_pct 0.0 100.0 /end CHARACTERISTIC
/begin CHARACTERISTIC DSPL_pwrVehicleDrivePowerMoving_C "" VALUE 0x70011050 Scalar_FLOAT32_IEEE 0 VBU0513_CM_single_cnt 0.0 1.0E+18 /end CHARACTERISTIC
/begin CHARACTERISTIC DSPL_pwrVehicleDrivePowerStandstill_C "" VALUE 0x70011054 Scalar_FLOAT32_IEEE 0 VBU0513_CM_single_cnt 0.0 1.0E+18 /end CHARACTERISTIC
/begin CHARACTERISTIC DSPL_tiBmsSocFullDelay_C "" VALUE 0x70011060 Scalar_FLOAT32_IEEE 0 VBU0513_CM_single_s 0.0 1.0E+23 /end CHARACTERISTIC
/begin CHARACTERISTIC DSPL_tiBmsSocVldDelay_C "" VALUE 0x70011064 Scalar_FLOAT32_IEEE 0 VBU0513_CM_single_s 0.0 1.0E+23 /end CHARACTERISTIC
/begin CHARACTERISTIC DSPL_tiBmsSocZeroDelay_C "" VALUE 0x70011068 Scalar_FLOAT32_IEEE 0 VBU0513_CM_single_s 0.0 1.0E+23 /end CHARACTERISTIC
/begin CHARACTERISTIC DSPL_tiDelayTimeChrgFallingEdge_C "" VALUE 0x70011070 Scalar_FLOAT32_IEEE 0 VBU0513_CM_single_s 0.0 1.0E+23 /end CHARACTERISTIC
/begin CHARACTERISTIC DSPL_tiEnergyCalTrigleDelay_C "" VALUE 0x70011088 Scalar_FLOAT32_IEEE 0 VBU0513_CM_single_s 0.0 1.0E+23 /end CHARACTERISTIC
/begin CHARACTERISTIC DSPL_tiSOCJumpDelay_C "" VALUE 0x700110a0 Scalar_FLOAT32_IEEE 0 VBU0513_CM_single_s 0.0 1.0E+23 /end CHARACTERISTIC
/begin CHARACTERISTIC EDIS_facVehSpd2MotSpd_C "" VALUE 0x700110dc Scalar_FLOAT32_IEEE 0 VBU0513_CM_single_cnt -3.4028234663852886E+38 3.4028234663852886E+38 /end CHARACTERISTIC
/begin CHARACTERISTIC EDIS_numChOverLim_C "" VALUE 0x700110e4 Scalar_FLOAT32_IEEE 0 VBU0513_CM_single_cnt -3.4028234663852886E+38 3.4028234663852886E+38 /end CHARACTERISTIC
/begin CHARACTERISTIC EDIS_numChPwrOverCntEEPROMInit_SY "" VALUE 0x700110e8 Scalar_FLOAT32_IEEE 0 VBU0513_CM_single_cnt -3.4028234663852886E+38 3.4028234663852886E+38 /end CHARACTERISTIC
/begin CHARACTERISTIC EDIS_pwrChRed40vLim_C "" VALUE 0x70011134 Scalar_FLOAT32_IEEE 0 VBU0513_CM_single_cnt -3.4028234663852886E+38 3.4028234663852886E+38 /end CHARACTERISTIC
/begin CHARACTERISTIC EDIS_pwrOfflineChDyn_C "" VALUE 0x70011180 Scalar_FLOAT32_IEEE 0 VBU0513_CM_single_kW -3.4028234663852886E+38 3.4028234663852886E+38 /end CHARACTERISTIC
/begin CHARACTERISTIC EDIS_pwrOfflineChLT_C "" VALUE 0x70011184 Scalar_FLOAT32_IEEE 0 VBU0513_CM_single_kW -3.4028234663852886E+38 3.4028234663852886E+38 /end CHARACTERISTIC
/begin CHARACTERISTIC EDIS_pwrOfflineDisChDyn_C "" VALUE 0x70011188 Scalar_FLOAT32_IEEE 0 VBU0513_CM_single_kW 0.0 1000.0 /end CHARACTERISTIC
/begin CHARACTERISTIC EDIS_pwrOfflineDisChLT_C "" VALUE 0x7001118c Scalar_FLOAT32_IEEE 0 VBU0513_CM_single_kW 0.0 1000.0 /end CHARACTERISTIC
/begin CHARACTERISTIC EDIS_pwrOfflineDisChST_C "" VALUE 0x70011190 Scalar_FLOAT32_IEEE 0 VBU0513_CM_single_kW 0.0 1000.0 /end CHARACTERISTIC
/begin CHARACTERISTIC EDIS_pwrOfflineDownStep_C "" VALUE 0x70011194 Scalar_FLOAT32_IEEE 0 VBU0513_CM_single_kW -1000.0 1000.0 /end CHARACTERISTIC
/begin CHARACTERISTIC EDIS_pwrOfflineUpStep_C "" VALUE 0x70011198 Scalar_FLOAT32_IEEE 0 VBU0513_CM_single_kW -1000.0 1000.0 /end CHARACTERISTIC
/begin CHARACTERISTIC EDIS_pwrOnlineDownStep_C "" VALUE 0x7001119c Scalar_FLOAT32_IEEE 0 VBU0513_CM_single_kW -1000.0 1000.0 /end CHARACTERISTIC
/begin CHARACTERISTIC EDIS_pwrOnlineUpStep_C "" VALUE 0x700111a0 Scalar_FLOAT32_IEEE 0 VBU0513_CM_single_kW -1000.0 1000.0 /end CHARACTERISTIC
/begin CHARACTERISTIC EDIS_tiBattOverChrg_C "" VALUE 0x700111bc Scalar_FLOAT32_IEEE 0 VBU0513_CM_single_cnt -3.4028234663852886E+38 3.4028234663852886E+38 /end CHARACTERISTIC
/begin CHARACTERISTIC EDIS_wChOverEnrgLim_C "" VALUE 0x700111dc Scalar_FLOAT32_IEEE 0 VBU0513_CM_single_cnt -3.4028234663852886E+38 3.4028234663852886E+38 /end CHARACTERISTIC
/begin CHARACTERISTIC LVC_stDcDcFailure_SY "" VALUE 0x70011398 Scalar_FLOAT32_IEEE 0 VBU0513_CM_single_cnt -3.4028234663852886E+38 3.4028234663852886E+38 /end CHARACTERISTIC
/begin CHARACTERISTIC LVC_stDcDcStandby_SY "" VALUE 0x0000 Scalar_FLOAT32_IEEE 0 VBU0513_CM_single_cnt -3.4028234663852886E+38 3.4028234663852886E+38 /end CHARACTERISTIC
/begin CHARACTERISTIC LVC_stDcDcWorking_SY "" VALUE 0x0000 Scalar_FLOAT32_IEEE 0 VBU0513_CM_single_cnt -3.4028234663852886E+38 3.4028234663852886E+38 /end CHARACTERISTIC
/begin CHARACTERISTIC LVC_tiWaitForOk_C "" VALUE 0x700113c4 Scalar_FLOAT32_IEEE 0 VBU0513_CM_single_cnt -3.4028234663852886E+38 3.4028234663852886E+38 /end CHARACTERISTIC
/begin CHARACTERISTIC MILIAMPERES_PER_AMPERE "" VALUE 0x700113f8 Scalar_FLOAT32_IEEE 0 VBU0513_CM_single_cnt -3.4028234663852886E+38 3.4028234663852886E+38 /end CHARACTERISTIC
/begin CHARACTERISTIC PMM_tiDlyIgnOff_C "" VALUE 0x7001157c Scalar_FLOAT32_IEEE 0 VBU0513_CM_single_cnt -3.4028234663852886E+38 3.4028234663852886E+38 /end CHARACTERISTIC
/begin CHARACTERISTIC PMM_tiDlyNMWkup_C "" VALUE 0x70011588 Scalar_FLOAT32_IEEE 0 VBU0513_CM_single_cnt -3.4028234663852886E+38 3.4028234663852886E+38 /end CHARACTERISTIC
/begin CHARACTERISTIC PMM_tiDlyPEUDCVltg_C "" VALUE 0x70011590 Scalar_FLOAT32_IEEE 0 VBU0513_CM_single_cnt -3.4028234663852886E+38 3.4028234663852886E+38 /end CHARACTERISTIC
/begin CHARACTERISTIC PMM_tiDlyVCUStpNMAbnrml_C "" VALUE 0x700115a8 Scalar_FLOAT32_IEEE 0 VBU0513_CM_single_cnt -3.4028234663852886E+38 3.4028234663852886E+38 /end CHARACTERISTIC
/begin CHARACTERISTIC PMM_tiDlyVCUStpNMNrml_C "" VALUE 0x700115ac Scalar_FLOAT32_IEEE 0 VBU0513_CM_single_cnt -3.4028234663852886E+38 3.4028234663852886E+38 /end CHARACTERISTIC
/begin CHARACTERISTIC PMM_tiDlyWaitNMStp_C "" VALUE 0x700115b4 Scalar_FLOAT32_IEEE 0 VBU0513_CM_single_cnt -3.4028234663852886E+38 3.4028234663852886E+38 /end CHARACTERISTIC
/begin CHARACTERISTIC TQCMP_pBrkCrpOffThd_C "" VALUE 0x70011704 Scalar_FLOAT32_IEEE 0 VBU0513_CM_single_cnt -3.4028234663852886E+38 3.4028234663852886E+38 /end CHARACTERISTIC
/begin CHARACTERISTIC TQCMP_tiPulseThd_C "" VALUE 0x70011708 Scalar_FLOAT32_IEEE 0 VBU0513_CM_single_cnt -3.4028234663852886E+38 3.4028234663852886E+38 /end CHARACTERISTIC
/begin CHARACTERISTIC TQDIS_facDenRA2_CUR_x "" VAL_BLK 0x70011b7c Scalar_FLOAT32_IEEE 0 VBU0513_CM_single_cnt -3.4028234663852886E+38 3.4028234663852886E+38 NUMBER 3 /end CHARACTERISTIC
/begin CHARACTERISTIC TQDIS_facDenRA_CUR_x "" VAL_BLK 0x70011b88 Scalar_FLOAT32_IEEE 0 VBU0513_CM_single_cnt -3.4028234663852886E+38 3.4028234663852886E+38 NUMBER 3 /end CHARACTERISTIC
/begin CHARACTERISTIC TQDIS_facNumRA2_CUR_x "" VAL_BLK 0x70011b94 Scalar_FLOAT32_IEEE 0 VBU0513_CM_single_cnt -3.4028234663852886E+38 3.4028234663852886E+38 NUMBER 3 /end CHARACTERISTIC
/begin CHARACTERISTIC TQDIS_facNumRA_CUR_x "" VAL_BLK 0x70011ba0 Scalar_FLOAT32_IEEE 0 VBU0513_CM_single_cnt -3.4028234663852886E+38 3.4028234663852886E+38 NUMBER 3 /end CHARACTERISTIC
/begin CHARACTERISTIC TQDIS_tiSWResetDly_C "" VALUE 0x70011800 Scalar_FLOAT32_IEEE 0 VBU0513_CM_single_cnt -3.4028234663852886E+38 3.4028234663852886E+38 /end CHARACTERISTIC
/begin CHARACTERISTIC TQDIS_trqDmpDeadZone_C "" VALUE 0x7001180c Scalar_FLOAT32_IEEE 0 VBU0513_CM_single_cnt -3.4028234663852886E+38 3.4028234663852886E+38 /end CHARACTERISTIC
/begin CHARACTERISTIC TQDIS_trqNumDenThdRA_C "" VALUE 0x70011810 Scalar_FLOAT32_IEEE 0 VBU0513_CM_single_cnt -3.4028234663852886E+38 3.4028234663852886E+38 /end CHARACTERISTIC
/begin CHARACTERISTIC TQDIS_trqRADecMax_C "" VALUE 0x70011814 Scalar_FLOAT32_IEEE 0 VBU0513_CM_single_cnt -3.4028234663852886E+38 3.4028234663852886E+38 /end CHARACTERISTIC
/begin CHARACTERISTIC TQDIS_trqRADecMin_C "" VALUE 0x70011818 Scalar_FLOAT32_IEEE 0 VBU0513_CM_single_cnt -3.4028234663852886E+38 3.4028234663852886E+38 /end CHARACTERISTIC
/begin CHARACTERISTIC TQDIS_trqRAIncMax_C "" VALUE 0x7001181c Scalar_FLOAT32_IEEE 0 VBU0513_CM_single_cnt -3.4028234663852886E+38 3.4028234663852886E+38 /end CHARACTERISTIC
/begin CHARACTERISTIC TQDIS_trqRAIncMin_C "" VALUE 0x70011820 Scalar_FLOAT32_IEEE 0 VBU0513_CM_single_cnt -3.4028234663852886E+38 3.4028234663852886E+38 /end CHARACTERISTIC
/begin CHARACTERISTIC TQDMP_facDenRA_CUR_x "" VAL_BLK 0x70011bc4 Scalar_FLOAT32_IEEE 0 VBU0513_CM_single_cnt -3.4028234663852886E+38 3.4028234663852886E+38 NUMBER 3 /end CHARACTERISTIC
/begin CHARACTERISTIC TQDMP_facNumRA_CUR_x "" VAL_BLK 0x70011bd0 Scalar_FLOAT32_IEEE 0 VBU0513_CM_single_cnt -3.4028234663852886E+38 3.4028234663852886E+38 NUMBER 3 /end CHARACTERISTIC
/begin CHARACTERISTIC TQDMP_facRAV2N_C "" VALUE 0x7001183c Scalar_FLOAT32_IEEE 0 VBU0513_CM_single_cnt -3.4028234663852886E+38 3.4028234663852886E+38 /end CHARACTERISTIC
/begin CHARACTERISTIC TQDMP_nRPMHysRA_C "" VALUE 0x70011840 Scalar_FLOAT32_IEEE 0 VBU0513_CM_single_cnt -3.4028234663852886E+38 3.4028234663852886E+38 /end CHARACTERISTIC
/begin CHARACTERISTIC TQDMP_pctDmpDisbThd_C "" VALUE 0x70011854 Scalar_FLOAT32_IEEE 0 VBU0513_CM_single_cnt -3.4028234663852886E+38 3.4028234663852886E+38 /end CHARACTERISTIC
/begin CHARACTERISTIC TQDMP_tiCalcChgLeadFilRA_C "" VALUE 0x70011878 Scalar_FLOAT32_IEEE 0 VBU0513_CM_single_cnt -3.4028234663852886E+38 3.4028234663852886E+38 /end CHARACTERISTIC
/begin CHARACTERISTIC TQDMP_trqDmpEnaThdRA_C "" VALUE 0x7001189c Scalar_FLOAT32_IEEE 0 VBU0513_CM_single_cnt -3.4028234663852886E+38 3.4028234663852886E+38 /end CHARACTERISTIC
/begin CHARACTERISTIC TQDMP_trqNumDenThdRA_C "" VALUE 0x700118a8 Scalar_FLOAT32_IEEE 0 VBU0513_CM_single_cnt -3.4028234663852886E+38 3.4028234663852886E+38 /end CHARACTERISTIC
/begin CHARACTERISTIC TQO_ti10ms_SY "" VALUE 0x700118ec Scalar_FLOAT32_IEEE 0 VBU0513_CM_single_cnt -3.4028234663852886E+38 3.4028234663852886E+38 /end CHARACTERISTIC
/begin CHARACTERISTIC TQO_trqPTMax_C "" VALUE 0x700118f8 Scalar_FLOAT32_IEEE 0 VBU0513_CM_single_cnt -3.4028234663852886E+38 3.4028234663852886E+38 /end CHARACTERISTIC
/begin CHARACTERISTIC CaSOC_CCCorrectionMapDimension_n "" VAL_BLK 0x0000 Scalar_ULONG 0 VBU0513_CM_uint32_cnt 0.0 4.294967295E+9 NUMBER 2 /end CHARACTERISTIC
/begin CHARACTERISTIC CcFCC_ComputeResistanceRelaxationTime_ms "" VALUE 0x7001072c Scalar_ULONG 0 VBU0513_CM_uint32_cnt 0.0 4.294967295E+9 /end CHARACTERISTIC
/begin CHARACTERISTIC CcSOC_FastChargePreCorrectionVolTime_ms "" VALUE 0x70010858 Scalar_ULONG 0 VBU0513_CM_uint32 0 4294967295 /end CHARACTERISTIC
/begin CHARACTERISTIC CcSOH_AfertSlowChargeEndTime_ms "" VALUE 0x70010a40 Scalar_ULONG 0 VBU0513_CM_uint32_cnt 0.0 4.294967295E+9 /end CHARACTERISTIC
/begin CHARACTERISTIC CcSOH_AfertSlowChargeStartTime_ms "" VALUE 0x70010a44 Scalar_ULONG 0 VBU0513_CM_uint32_cnt 0.0 4.294967295E+9 /end CHARACTERISTIC
/begin CHARACTERISTIC CcSOC_FastChargePreCorrectionVolThld_mV "" VALUE 0x700100c4 Scalar_SWORD 0 VBU0513_CM_int16 -32768 32767 /end CHARACTERISTIC
/begin CHARACTERISTIC CcFCC_BatteryVoltageMaxLimitDebounceTime_s "" VALUE 0x70010096 Scalar_UWORD 0 VBU0513_CM_uint16_cnt 0.0 65535.0 /end CHARACTERISTIC
/begin CHARACTERISTIC CcFCC_CellVoltageMaxLimitDebounceTime_s "" VALUE 0x70010098 Scalar_UWORD 0 VBU0513_CM_uint16_cnt 0.0 65535.0 /end CHARACTERISTIC
/begin CHARACTERISTIC CcFCC_ComputeResistanceDelayTime_ms "" VALUE 0x7001009c Scalar_UWORD 0 VBU0513_CM_uint16_cnt 0.0 65535.0 /end CHARACTERISTIC
/begin CHARACTERISTIC CcFCC_ComputeResistanceEndVoltage_mV "" VALUE 0x7001009e Scalar_UWORD 0 VBU0513_CM_uint16_cnt 0.0 65535.0 /end CHARACTERISTIC
/begin CHARACTERISTIC CcFCC_ComputeResistanceStartVoltage_mV "" VALUE 0x700100a0 Scalar_UWORD 0 VBU0513_CM_uint16_cnt 0.0 65535.0 /end CHARACTERISTIC
/begin CHARACTERISTIC CcFCC_HighTempDebounceTime_s "" VALUE 0x700100aa Scalar_UWORD 0 VBU0513_CM_uint16_cnt 0.0 65535.0 /end CHARACTERISTIC
/begin CHARACTERISTIC CcSOC_FastChargeTOCDeltaVolMax_mV "" VALUE 0x700100c6 Scalar_UWORD 0 VBU0513_CM_uint16 0 65535 /end CHARACTERISTIC
/begin CHARACTERISTIC CcSOF_LowVoltChgCurtSloDelay_ms "" VALUE 0x700100f6 Scalar_UWORD 0 VBU0513_CM_uint16_cnt 0.0 65535.0 /end CHARACTERISTIC
/begin CHARACTERISTIC CcSOF_LowVoltagePowerOnDelay_ms "" VALUE 0x700100fa Scalar_UWORD 0 VBU0513_CM_uint16_cnt 0.0 65535.0 /end CHARACTERISTIC
/begin CHARACTERISTIC CcSOH_HistoryDataDimension_n "" VALUE 0x70010110 Scalar_UWORD 0 VBU0513_CM_uint16_cnt 0.0 65535.0 /end CHARACTERISTIC
/begin CHARACTERISTIC CcSYS_BalanceResistance_ohm "" VALUE 0x70010112 Scalar_UWORD 0 VBU0513_CM_uint16_cnt 0.0 65535.0 /end CHARACTERISTIC
/begin CHARACTERISTIC CcSYS_CellBalanceDutyCycle_pct "" VALUE 0x70010114 Scalar_UWORD 0 VBU0513_CM_uint16_cnt 0.0 65535.0 /end CHARACTERISTIC
/begin CHARACTERISTIC CcTHM_CoolantTempOorDebounceTime_s "" VALUE 0x70010120 Scalar_UWORD 0 VBU0513_CM_uint16_cnt 0.0 65535.0 /end CHARACTERISTIC
/begin CHARACTERISTIC CbFCC_BatteryVoltageMaxlimitEnable_flg "" VALUE 0x70020b06 Scalar_BOOLEAN 0 VBU0513_CM_boolean_cnt 0.0 1.0 /end CHARACTERISTIC
/begin CHARACTERISTIC CbFCC_CellVoltageMaxlimitEnable_flg "" VALUE 0x70020b07 Scalar_BOOLEAN 0 VBU0513_CM_boolean_cnt 0.0 1.0 /end CHARACTERISTIC
/begin CHARACTERISTIC CbFCC_ComputeResistanceEnable_flg "" VALUE 0x70020b0b Scalar_BOOLEAN 0 VBU0513_CM_boolean_cnt 0.0 1.0 /end CHARACTERISTIC
/begin CHARACTERISTIC CbFCC_NoChargeHighTempEnable_flg "" VALUE 0x70020b0c Scalar_BOOLEAN 0 VBU0513_CM_boolean_cnt 0.0 1.0 /end CHARACTERISTIC
/begin CHARACTERISTIC CbFCC_NoChargeLowTempEnable_flg "" VALUE 0x70020b0d Scalar_BOOLEAN 0 VBU0513_CM_boolean_cnt 0.0 1.0 /end CHARACTERISTIC
/begin CHARACTERISTIC CbSOC_DisplaySOCRateDynamicEnable_flg "" VALUE 0x70020b1c Scalar_BOOLEAN 0 VBU0513_CM_boolean_cnt 0.0 1.0 /end CHARACTERISTIC
/begin CHARACTERISTIC CbSOC_FastChargeCCCorrection2Enable_flg "" VALUE 0x0000 Scalar_BOOLEAN 0 VBU0513_CM_boolean_cnt 0.0 1.0 /end CHARACTERISTIC
/begin CHARACTERISTIC CbSOH_EepromWriteCellCapacity_flg "" VALUE 0x70020b2a Scalar_BOOLEAN 0 VBU0513_CM_boolean_cnt 0.0 1.0 /end CHARACTERISTIC
/begin CHARACTERISTIC CcSOF_LowVoltageChargeLimitEnable_flg "" VALUE 0x70020c4c Scalar_BOOLEAN 0 VBU0513_CM_boolean_cnt 0.0 1.0 /end CHARACTERISTIC
/begin CHARACTERISTIC CcTHM_CoolantGradientCheckEnable_flg "" VALUE 0x70020c57 Scalar_BOOLEAN 0 VBU0513_CM_boolean_cnt 0.0 1.0 /end CHARACTERISTIC
/begin CHARACTERISTIC CcTHM_CoolantSensorValidEnable_flg "" VALUE 0x70020c58 Scalar_BOOLEAN 0 VBU0513_CM_boolean_cnt 0.0 1.0 /end CHARACTERISTIC
/begin CHARACTERISTIC DCH_flgAllowNGearCh_C "" VALUE 0x70020cb0 Scalar_BOOLEAN 0 VBU0513_CM_boolean_cnt 0.0 1.0 /end CHARACTERISTIC
/begin CHARACTERISTIC EDIS_flgOverPwrLimNum_C "" VALUE 0x70020db7 Scalar_BOOLEAN 0 VBU0513_CM_boolean_cnt 0.0 1.0 /end CHARACTERISTIC
/begin CHARACTERISTIC EDIS_flgUseEEPROMStroeVal_C "" VALUE 0x70020dbb Scalar_BOOLEAN 0 VBU0513_CM_boolean_cnt 0.0 1.0 /end CHARACTERISTIC
/begin CHARACTERISTIC EDIS_flgUsePowSpPredict_C "" VALUE 0x70020dbc Scalar_BOOLEAN 0 VBU0513_CM_boolean_cnt 0.0 1.0 /end CHARACTERISTIC
/begin CHARACTERISTIC PMM_flgVCUStpNMOvrdSwt_C "" VALUE 0x70020e90 Scalar_BOOLEAN 0 VBU0513_CM_boolean_cnt 0.0 1.0 /end CHARACTERISTIC
/begin CHARACTERISTIC PMM_flgVCUStpNMOvrdVal_C "" VALUE 0x70020e91 Scalar_BOOLEAN 0 VBU0513_CM_boolean_cnt 0.0 1.0 /end CHARACTERISTIC
/begin CHARACTERISTIC TQARB_flgTrqCompSwitch_C "" VALUE 0x70020ef0 Scalar_BOOLEAN 0 VBU0513_CM_boolean 0 1 /end CHARACTERISTIC
/begin CHARACTERISTIC TQDIS_flgDMPByPass_C "" VALUE 0x70020ef7 Scalar_BOOLEAN 0 VBU0513_CM_boolean 0 1 /end CHARACTERISTIC
/begin CHARACTERISTIC TQDIS_flgDmpFilterRA2_C "" VALUE 0x70020ef8 Scalar_BOOLEAN 0 VBU0513_CM_boolean_cnt 0.0 1.0 /end CHARACTERISTIC
/begin CHARACTERISTIC TQDMP_flgLowFilterDnRA_C "" VALUE 0x70020ef9 Scalar_BOOLEAN 0 VBU0513_CM_boolean_cnt 0.0 1.0 /end CHARACTERISTIC
/begin CHARACTERISTIC TQDMP_flgRAVCUDmpEna_C "" VALUE 0x70020efa Scalar_BOOLEAN 0 VBU0513_CM_boolean_cnt 0.0 1.0 /end CHARACTERISTIC
/begin CHARACTERISTIC BATTERY_BOL_SOH "" VALUE 0x70020a10 Scalar_UBYTE 0 VBU0513_CM_uint8_cnt 0.0 255.0 /end CHARACTERISTIC
/begin CHARACTERISTIC BATTERY_EOL_SOH "" VALUE 0x70020a17 Scalar_UBYTE 0 VBU0513_CM_uint8_cnt 0.0 255.0 /end CHARACTERISTIC
/begin CHARACTERISTIC CaFCC_VCRVCUAuxPowerFactorVoltageTempMapDimension_n "" VAL_BLK 0x70020f3c Scalar_UBYTE 0 VBU0513_CM_uint8_cnt 0.0 255.0 NUMBER 2 /end CHARACTERISTIC
/begin CHARACTERISTIC CcSOE_MaxInterationNumber_n "" VALUE 0x70020c45 Scalar_UBYTE 0 VBU0513_CM_uint8_cnt 0.0 255.0 /end CHARACTERISTIC
/begin CHARACTERISTIC DCH_stBEM00TOutMSK_SY "" VALUE 0x70020d3b Scalar_UBYTE 0 VBU0513_CM_uint8_cnt 0.0 255.0 /end CHARACTERISTIC
/begin CHARACTERISTIC DCH_stBEMAATOutMSK_SY "" VALUE 0x70020d3c Scalar_UBYTE 0 VBU0513_CM_uint8_cnt 0.0 255.0 /end CHARACTERISTIC
/begin CHARACTERISTIC DCH_stBEMChCapTOutMSK_SY "" VALUE 0x70020d3d Scalar_UBYTE 0 VBU0513_CM_uint8_cnt 0.0 255.0 /end CHARACTERISTIC
/begin CHARACTERISTIC DCH_stBEMChRdyTOutMSK_SY "" VALUE 0x70020d3f Scalar_UBYTE 0 VBU0513_CM_uint8_cnt 0.0 255.0 /end CHARACTERISTIC
/begin CHARACTERISTIC DCH_stBEMChStTOutMSK_SY "" VALUE 0x70020d41 Scalar_UBYTE 0 VBU0513_CM_uint8_cnt 0.0 255.0 /end CHARACTERISTIC
/begin CHARACTERISTIC DCH_stBEMChgrStopTOutMSK_SY "" VALUE 0x70020d43 Scalar_UBYTE 0 VBU0513_CM_uint8_cnt 0.0 255.0 /end CHARACTERISTIC
/begin CHARACTERISTIC DCH_stBEMStatsDataTOutMSK_SY "" VALUE 0x70020d47 Scalar_UBYTE 0 VBU0513_CM_uint8_cnt 0.0 255.0 /end CHARACTERISTIC
/begin CHARACTERISTIC DCH_stBMSChCmpt_SY "" VALUE 0x70020d49 Scalar_UBYTE 0 VBU0513_CM_uint8_cnt 0.0 255.0 /end CHARACTERISTIC
/begin CHARACTERISTIC DCH_stCDCStopCharging_SY "" VALUE 0x70020d51 Scalar_UBYTE 0 VBU0513_CM_uint8_cnt 0.0 255.0 /end CHARACTERISTIC
/begin CHARACTERISTIC DCH_stCurrDismatchErrMSK_SY "" VALUE 0x70020d5d Scalar_UBYTE 0 VBU0513_CM_uint8_cnt 0.0 255.0 /end CHARACTERISTIC
/begin CHARACTERISTIC DCH_stEnergNotTrnsmtFultMSK_SY "" VALUE 0x70020d5f Scalar_UBYTE 0 VBU0513_CM_uint8_cnt 0.0 255.0 /end CHARACTERISTIC
/begin CHARACTERISTIC DCH_stFaultStopMSK_SY "" VALUE 0x70020d60 Scalar_UBYTE 0 VBU0513_CM_uint8_cnt 0.0 255.0 /end CHARACTERISTIC
/begin CHARACTERISTIC DCH_stKeyRaw_SY "" VALUE 0x70020d66 Scalar_UBYTE 0 VBU0513_CM_uint8_cnt 0.0 255.0 /end CHARACTERISTIC
/begin CHARACTERISTIC DCH_stNGear_SY "" VALUE 0x70020d68 Scalar_UBYTE 0 VBU0513_CM_uint8_cnt 0.0 255.0 /end CHARACTERISTIC
/begin CHARACTERISTIC DCH_stOtherStaStpFultMSK_SY "" VALUE 0x70020d6c Scalar_UBYTE 0 VBU0513_CM_uint8_cnt 0.0 255.0 /end CHARACTERISTIC
/begin CHARACTERISTIC DCH_stPGear_SY "" VALUE 0x70020d6d Scalar_UBYTE 0 VBU0513_CM_uint8_cnt 0.0 255.0 /end CHARACTERISTIC
/begin CHARACTERISTIC DCH_stStaCntorFultMSK_SY "" VALUE 0x70020d71 Scalar_UBYTE 0 VBU0513_CM_uint8_cnt 0.0 255.0 /end CHARACTERISTIC
/begin CHARACTERISTIC DCH_stStaEmergStpFultMSK_SY "" VALUE 0x70020d72 Scalar_UBYTE 0 VBU0513_CM_uint8_cnt 0.0 255.0 /end CHARACTERISTIC
/begin CHARACTERISTIC DCH_stStaIntOverTempFultMSK_SY "" VALUE 0x70020d73 Scalar_UBYTE 0 VBU0513_CM_uint8_cnt 0.0 255.0 /end CHARACTERISTIC
/begin CHARACTERISTIC DCH_stStaOverTempFaultMSK_SY "" VALUE 0x70020d74 Scalar_UBYTE 0 VBU0513_CM_uint8_cnt 0.0 255.0 /end CHARACTERISTIC
/begin CHARACTERISTIC DCH_stStaStopCondReachMSK_SY "" VALUE 0x70020d75 Scalar_UBYTE 0 VBU0513_CM_uint8_cnt 0.0 255.0 /end CHARACTERISTIC
/begin CHARACTERISTIC DCH_stSysIsoCriticalFault_SY "" VALUE 0x70020d87 Scalar_UBYTE 0 VBU0513_CM_uint8_cnt 0.0 255.0 /end CHARACTERISTIC
/begin CHARACTERISTIC DCH_stVehIsoCriticalFault_SY "" VALUE 0x70020d89 Scalar_UBYTE 0 VBU0513_CM_uint8_cnt 0.0 255.0 /end CHARACTERISTIC
/begin CHARACTERISTIC DCH_stVehSoftwUpdate_SY "" VALUE 0x70020d8a Scalar_UBYTE 0 VBU0513_CM_uint8_cnt 0.0 255.0 /end CHARACTERISTIC
/begin CHARACTERISTIC DCH_stVoltAbnormalErrMSK_SY "" VALUE 0x70020d8b Scalar_UBYTE 0 VBU0513_CM_uint8_cnt 0.0 255.0 /end CHARACTERISTIC
/begin CHARACTERISTIC DSPL_stEnergyConsumptionCaled_C "" VALUE 0x70020da9 Scalar_UBYTE 0 VBU0513_CM_uint8_cnt 0.0 255.0 /end CHARACTERISTIC
/begin CHARACTERISTIC DSPL_stEnergyConsumptionProcess_C "" VALUE 0x70020daa Scalar_UBYTE 0 VBU0513_CM_uint8_cnt 0.0 255.0 /end CHARACTERISTIC
/begin CHARACTERISTIC PMM_stAPlushld_SY "" VALUE 0x70020e9a Scalar_UBYTE 0 VBU0513_CM_uint8_cnt 0.0 255.0 /end CHARACTERISTIC
/begin CHARACTERISTIC SOC_JUMP_ABNORMAL_POWER_OFF "" VALUE 0x70020ec1 Scalar_UBYTE 0 VBU0513_CM_uint8_cnt 0.0 255.0 /end CHARACTERISTIC
/begin CHARACTERISTIC SOC_JUMP_ABNORMAL_RESET "" VALUE 0x70020ec2 Scalar_UBYTE 0 VBU0513_CM_uint8_cnt 0.0 255.0 /end CHARACTERISTIC
/begin CHARACTERISTIC SOC_JUMP_NONE "" VALUE 0x70020ec3 Scalar_UBYTE 0 VBU0513_CM_uint8_cnt 0.0 255.0 /end CHARACTERISTIC
/begin CHARACTERISTIC SOC_JUMP_OCV_CORRECTION "" VALUE 0x70020ec4 Scalar_UBYTE 0 VBU0513_CM_uint8_cnt 0.0 255.0 /end CHARACTERISTIC
/begin MEASUREMENT AVAS_SoftwareVersion "" ULONG VBU0513_CM_uint32 0 0 0 4294967295 ECU_ADDRESS 0x9000223e /end MEASUREMENT
/begin MEASUREMENT VCT_numBMSProtocalVersion "" ULONG VBU0513_CM_uint32 0 0 0 4294967295 ECU_ADDRESS 0x9000235e /end MEASUREMENT
/begin MEASUREMENT T_BOXGPS_Latitude "" ULONG VBU0513_CM_ufix28 0 0 0 2.68435455E+8 ECU_ADDRESS 0x90002316 /end MEASUREMENT
/begin MEASUREMENT T_BOXGPS_Longitude "" ULONG VBU0513_CM_ufix28 0 0 0 2.68435455E+8 ECU_ADDRESS 0x9000231a /end MEASUREMENT
/begin MEASUREMENT IC_VehOdometer "" ULONG VBU0513_CM_ufix24 0 0 0 1.6777215E+7 ECU_ADDRESS 0x900022ca /end MEASUREMENT
/begin MEASUREMENT SPD_vFA "" FLOAT32_IEEE VBU0513_CM_single 0 0 -3.4E+38 3.4E+38 ECU_ADDRESS 0x90001fea /end MEASUREMENT
/begin MEASUREMENT SPD_vRA "" FLOAT32_IEEE VBU0513_CM_single 0 0 -3.4E+38 3.4E+38 ECU_ADDRESS 0x90001ff2 /end MEASUREMENT
/begin MEASUREMENT SPD_vVehSpd "" FLOAT32_IEEE VBU0513_CM_single 0 0 -3.4E+38 3.4E+38 ECU_ADDRESS 0x90001ff6 /end MEASUREMENT
/begin MEASUREMENT TQDMP_trqDmpRA "" FLOAT32_IEEE VBU0513_CM_single 0 0 -10000.0 10000.0 ECU_ADDRESS 0x900020a6 /end MEASUREMENT
/begin MEASUREMENT TQDMP_dnMotrR "" FLOAT32_IEEE VBU0513_CM_single 0 0 -3.4E+38 3.4E+38 ECU_ADDRESS 0x9000208a /end MEASUREMENT
/begin MEASUREMENT TQDMP_trqCompRA0 "" FLOAT32_IEEE VBU0513_CM_single 0 0 -10000.0 10000.0 ECU_ADDRESS 0x9000209a /end MEASUREMENT
/begin MEASUREMENT TQO_facShftChangeLo "" FLOAT32_IEEE VBU0513_CM_single 0 0 0.0 1.0 ECU_ADDRESS 0x900020ce /end MEASUREMENT
/begin MEASUREMENT TQDIS_trqRMotrDir "" FLOAT32_IEEE VBU0513_CM_single 0 0 -10000.0 10000.0 ECU_ADDRESS 0x90002086 /end MEASUREMENT
/begin MEASUREMENT TQO_trqRMotr "" FLOAT32_IEEE VBU0513_CM_single 0 0 -10000.0 10000.0 ECU_ADDRESS 0x900020d6 /end MEASUREMENT
/begin MEASUREMENT TQARB_trqPreFnlRA "" FLOAT32_IEEE VBU0513_CM_single 0 0 -10000.0 10000.0 ECU_ADDRESS 0x90002036 /end MEASUREMENT
/begin MEASUREMENT TQARB_trqPreDisPropRA "" FLOAT32_IEEE VBU0513_CM_single 0 0 -10000.0 10000.0 ECU_ADDRESS 0x9000202e /end MEASUREMENT
/begin MEASUREMENT TQARB_trqPreDisRgnRA "" FLOAT32_IEEE VBU0513_CM_single 0 0 -10000.0 10000.0 ECU_ADDRESS 0x90002032 /end MEASUREMENT
/begin MEASUREMENT TQDIS_trqRAIncLim "" FLOAT32_IEEE VBU0513_CM_single 0 0 -10000.0 10000.0 ECU_ADDRESS 0x90002076 /end MEASUREMENT
/begin MEASUREMENT TQDIS_trqRADecLim "" FLOAT32_IEEE VBU0513_CM_single 0 0 -10000.0 10000.0 ECU_ADDRESS 0x9000206a /end MEASUREMENT
/begin MEASUREMENT TQDIS_trqFltRA "" FLOAT32_IEEE VBU0513_CM_single 0 0 -10000.0 10000.0 ECU_ADDRESS 0x90002066 /end MEASUREMENT
/begin MEASUREMENT TQDIS_trqDmpRA "" FLOAT32_IEEE VBU0513_CM_single 0 0 -3.4E+38 3.4E+38 ECU_ADDRESS 0x9000251a /end MEASUREMENT
/begin MEASUREMENT EDIS_pwrDownStep "" FLOAT32_IEEE VBU0513_CM_single 0 0 -1000.0 1000.0 ECU_ADDRESS 0x90002142 /end MEASUREMENT
/begin MEASUREMENT EDIS_pwrUpStep "" FLOAT32_IEEE VBU0513_CM_single 0 0 -1000.0 1000.0 ECU_ADDRESS 0x9000216a /end MEASUREMENT
/begin MEASUREMENT EDIS_pwrDownStepCh "" FLOAT32_IEEE VBU0513_CM_single 0 0 -3.4E+38 3.4E+38 ECU_ADDRESS 0x90001ec2 /end MEASUREMENT
/begin MEASUREMENT EDIS_pwrUpStepCh "" FLOAT32_IEEE VBU0513_CM_single 0 0 -3.4E+38 3.4E+38 ECU_ADDRESS 0x90001eca /end MEASUREMENT
/begin MEASUREMENT EDIS_pwrDrvPwrLimFilter "" FLOAT32_IEEE VBU0513_CM_single 0 0 0.0 1000.0 ECU_ADDRESS 0x9000214a /end MEASUREMENT
/begin MEASUREMENT EDIS_pwrChDynSp "" FLOAT32_IEEE VBU0513_CM_single 0 0 -3.4E+38 3.4E+38 ECU_ADDRESS 0x90001eae /end MEASUREMENT
/begin MEASUREMENT EDIS_pwrChSp "" FLOAT32_IEEE VBU0513_CM_single 0 0 -3.4E+38 3.4E+38 ECU_ADDRESS 0x90001eb2 /end MEASUREMENT
/begin MEASUREMENT PEUR_uDCRlyOutsideVltg "" FLOAT32_IEEE VBU0513_CM_single 0 0 -3.4E+38 3.4E+38 ECU_ADDRESS 0x90002466 /end MEASUREMENT
/begin MEASUREMENT BCU_vWhlRL "" FLOAT32_IEEE VBU0513_CM_single 0 0 -3.4E+38 3.4E+38 ECU_ADDRESS 0x90002242 /end MEASUREMENT
/begin MEASUREMENT BCU_vWhlRR "" FLOAT32_IEEE VBU0513_CM_single 0 0 -3.4E+38 3.4E+38 ECU_ADDRESS 0x90002246 /end MEASUREMENT
/begin MEASUREMENT PEUR_stActvDisCh "" FLOAT32_IEEE VBU0513_CM_single 0 0 -3.4E+38 3.4E+38 ECU_ADDRESS 0x900022f6 /end MEASUREMENT
/begin MEASUREMENT PEUR_nMotr "" FLOAT32_IEEE VBU0513_CM_single 0 0 -3.4E+38 3.4E+38 ECU_ADDRESS 0x900022f2 /end MEASUREMENT
/begin MEASUREMENT PEUR_iCalcDC "" FLOAT32_IEEE VBU0513_CM_single 0 0 -1000.0 1000.0 ECU_ADDRESS 0x90001f16 /end MEASUREMENT
/begin MEASUREMENT VCT_uMaximumPermitChargeCellVoltage "" FLOAT32_IEEE VBU0513_CM_single 0 0 -3.4E+38 3.4E+38 ECU_ADDRESS 0x900023d2 /end MEASUREMENT
/begin MEASUREMENT VCT_iABMSDischgCurrentLimit "" FLOAT32_IEEE VBU0513_CM_single 0 0 -3.4E+38 3.4E+38 ECU_ADDRESS 0x90002332 /end MEASUREMENT
/begin MEASUREMENT VCT_uBMSVoltageLimitMax "" FLOAT32_IEEE VBU0513_CM_single 0 0 -3.4E+38 3.4E+38 ECU_ADDRESS 0x900023c6 /end MEASUREMENT
/begin MEASUREMENT VCT_uBMSVoltageLimitMin "" FLOAT32_IEEE VBU0513_CM_single 0 0 -3.4E+38 3.4E+38 ECU_ADDRESS 0x900023ca /end MEASUREMENT
/begin MEASUREMENT VCT_iABMSPackCrnt "" FLOAT32_IEEE VBU0513_CM_single 0 0 -3.4E+38 3.4E+38 ECU_ADDRESS 0x90002336 /end MEASUREMENT
/begin MEASUREMENT VCT_uBMSPackVoltage "" FLOAT32_IEEE VBU0513_CM_single 0 0 -3.4E+38 3.4E+38 ECU_ADDRESS 0x900023c2 /end MEASUREMENT
/begin MEASUREMENT VCT_pctBMSSOC "" FLOAT32_IEEE VBU0513_CM_single 0 0 -3.4E+38 3.4E+38 ECU_ADDRESS 0x90002372 /end MEASUREMENT
/begin MEASUREMENT VCT_numBMSRollingCounter225 "" FLOAT32_IEEE VBU0513_CM_single 0 0 -3.4E+38 3.4E+38 ECU_ADDRESS 0x90002362 /end MEASUREMENT
/begin MEASUREMENT VCT_pctBMSCustomerUsageSOC "" FLOAT32_IEEE VBU0513_CM_single 0 0 -3.4E+38 3.4E+38 ECU_ADDRESS 0x9000236a /end MEASUREMENT
/begin MEASUREMENT VCT_tBMSTemperatureMax "" FLOAT32_IEEE VBU0513_CM_single 0 0 -3.4E+38 3.4E+38 ECU_ADDRESS 0x90002392 /end MEASUREMENT
/begin MEASUREMENT VCT_tBMSTemperatureMin "" FLOAT32_IEEE VBU0513_CM_single 0 0 -3.4E+38 3.4E+38 ECU_ADDRESS 0x90002396 /end MEASUREMENT
/begin MEASUREMENT VCT_tBMSInletWaterTemp "" FLOAT32_IEEE VBU0513_CM_single 0 0 -3.4E+38 3.4E+38 ECU_ADDRESS 0x9000237e /end MEASUREMENT
/begin MEASUREMENT VCT_tBMSOutletWaterTemp "" FLOAT32_IEEE VBU0513_CM_single 0 0 -3.4E+38 3.4E+38 ECU_ADDRESS 0x9000238a /end MEASUREMENT
/begin MEASUREMENT VCT_tBMSTemperatureAverage "" FLOAT32_IEEE VBU0513_CM_single 0 0 -3.4E+38 3.4E+38 ECU_ADDRESS 0x9000238e /end MEASUREMENT
/begin MEASUREMENT VCT_tBMSCellTempStandardDeviation "" FLOAT32_IEEE VBU0513_CM_single 0 0 -3.4E+38 3.4E+38 ECU_ADDRESS 0x90002376 /end MEASUREMENT
/begin MEASUREMENT VCT_tBMSInletTempRequest "" FLOAT32_IEEE VBU0513_CM_single 0 0 -3.4E+38 3.4E+38 ECU_ADDRESS 0x9000237a /end MEASUREMENT
/begin MEASUREMENT VCT_iAMaximumChargingCurrent "" FLOAT32_IEEE VBU0513_CM_single 0 0 -3.4E+38 3.4E+38 ECU_ADDRESS 0x9000233a /end MEASUREMENT
/begin MEASUREMENT VCT_kWhBatteryNomalCapacity "" FLOAT32_IEEE VBU0513_CM_single 0 0 -3.4E+38 3.4E+38 ECU_ADDRESS 0x90002526 /end MEASUREMENT
/begin MEASUREMENT VCT_uMaximumChargingVoltage "" FLOAT32_IEEE VBU0513_CM_single 0 0 -3.4E+38 3.4E+38 ECU_ADDRESS 0x900023ce /end MEASUREMENT
/begin MEASUREMENT VCT_tMaximumPermitTemp "" FLOAT32_IEEE VBU0513_CM_single 0 0 -3.4E+38 3.4E+38 ECU_ADDRESS 0x9000239a /end MEASUREMENT
/begin MEASUREMENT VCT_HVBattStopDchaThd_pct "" FLOAT32_IEEE VBU0513_CM_single 0 0 -3.4E+38 3.4E+38 ECU_ADDRESS 0x90002322 /end MEASUREMENT
/begin MEASUREMENT VCT_numBMSRollingCounterAF "" FLOAT32_IEEE VBU0513_CM_single 0 0 -3.4E+38 3.4E+38 ECU_ADDRESS 0x90002366 /end MEASUREMENT
/begin MEASUREMENT VCT_tBMSMaximumCellTemp "" FLOAT32_IEEE VBU0513_CM_single 0 0 -3.4E+38 3.4E+38 ECU_ADDRESS 0x90002382 /end MEASUREMENT
/begin MEASUREMENT VCT_tBMSMinimumCellTemp "" FLOAT32_IEEE VBU0513_CM_single 0 0 -3.4E+38 3.4E+38 ECU_ADDRESS 0x90002386 /end MEASUREMENT
/begin MEASUREMENT VCT_pctBMSDCChrgFinalSOC "" FLOAT32_IEEE VBU0513_CM_single 0 0 -3.4E+38 3.4E+38 ECU_ADDRESS 0x9000236e /end MEASUREMENT
/begin MEASUREMENT VCT_uBMSBatteryRatedVoltage "" FLOAT32_IEEE VBU0513_CM_single 0 0 -3.4E+38 3.4E+38 ECU_ADDRESS 0x900023a6 /end MEASUREMENT
/begin MEASUREMENT VCT_iABMSDCChargingCurrentMeasurement "" FLOAT32_IEEE VBU0513_CM_single 0 0 -3.4E+38 3.4E+38 ECU_ADDRESS 0x9000232a /end MEASUREMENT
/begin MEASUREMENT VCT_uBMSDCChargingVoltageMeasurement "" FLOAT32_IEEE VBU0513_CM_single 0 0 -3.4E+38 3.4E+38 ECU_ADDRESS 0x900023b6 /end MEASUREMENT
/begin MEASUREMENT VCT_uBMSMaxPermitDCChargeVoltage "" FLOAT32_IEEE VBU0513_CM_single 0 0 -3.4E+38 3.4E+38 ECU_ADDRESS 0x900023be /end MEASUREMENT
/begin MEASUREMENT VCT_AhBMSBatteryRatedCapacity "" FLOAT32_IEEE VBU0513_CM_single 0 0 -3.4E+38 3.4E+38 ECU_ADDRESS 0x9000231e /end MEASUREMENT
/begin MEASUREMENT VCT_kwBMSChgPowerLimitST "" FLOAT32_IEEE VBU0513_CM_single 0 0 -3.4E+38 3.4E+38 ECU_ADDRESS 0x9000234a /end MEASUREMENT
/begin MEASUREMENT VCT_kwBMSChgPowerLimitLT "" FLOAT32_IEEE VBU0513_CM_single 0 0 -3.4E+38 3.4E+38 ECU_ADDRESS 0x90002346 /end MEASUREMENT
/begin MEASUREMENT VCT_kwBMSChgPowerLimitDynamic "" FLOAT32_IEEE VBU0513_CM_single 0 0 -3.4E+38 3.4E+38 ECU_ADDRESS 0x90002342 /end MEASUREMENT
/begin MEASUREMENT VCT_timinEstimatePercTime "" FLOAT32_IEEE VBU0513_CM_single 0 0 -3.4E+38 3.4E+38 ECU_ADDRESS 0x900023a2 /end MEASUREMENT
/begin MEASUREMENT VCT_uBMSCellVoltageMax "" FLOAT32_IEEE VBU0513_CM_single 0 0 -3.4E+38 3.4E+38 ECU_ADDRESS 0x900023ae /end MEASUREMENT
/begin MEASUREMENT VCT_uBMSCellVoltageMin "" FLOAT32_IEEE VBU0513_CM_single 0 0 -3.4E+38 3.4E+38 ECU_ADDRESS 0x900023b2 /end MEASUREMENT
/begin MEASUREMENT VCT_timinBMSEstimateChargingTime "" FLOAT32_IEEE VBU0513_CM_single 0 0 -3.4E+38 3.4E+38 ECU_ADDRESS 0x9000239e /end MEASUREMENT
/begin MEASUREMENT VCT_uBMSCellVoltageAve "" FLOAT32_IEEE VBU0513_CM_single 0 0 -3.4E+38 3.4E+38 ECU_ADDRESS 0x900023aa /end MEASUREMENT
/begin MEASUREMENT VCT_kwBMSDischgPowerLimitLT "" FLOAT32_IEEE VBU0513_CM_single 0 0 -3.4E+38 3.4E+38 ECU_ADDRESS 0x90002352 /end MEASUREMENT
/begin MEASUREMENT VCT_kwBMSDischgPowerLimitST "" FLOAT32_IEEE VBU0513_CM_single 0 0 -3.4E+38 3.4E+38 ECU_ADDRESS 0x90002356 /end MEASUREMENT
/begin MEASUREMENT VCT_kwBMSDischgPowerLimitDynamic "" FLOAT32_IEEE VBU0513_CM_single 0 0 -3.4E+38 3.4E+38 ECU_ADDRESS 0x9000234e /end MEASUREMENT
/begin MEASUREMENT VCT_kohmBMSInsulationResistanceValue "" FLOAT32_IEEE VBU0513_CM_single 0 0 -3.4E+38 3.4E+38 ECU_ADDRESS 0x9000233e /end MEASUREMENT
/begin MEASUREMENT VCT_iABMSDCChrgCrntReq "" FLOAT32_IEEE VBU0513_CM_single 0 0 -3.4E+38 3.4E+38 ECU_ADDRESS 0x9000232e /end MEASUREMENT
/begin MEASUREMENT VCT_uBMSDCChrgVoltageReq "" FLOAT32_IEEE VBU0513_CM_single 0 0 -3.4E+38 3.4E+38 ECU_ADDRESS 0x900023ba /end MEASUREMENT
/begin MEASUREMENT VCT_iABMSChgCurrentLimit "" FLOAT32_IEEE VBU0513_CM_single 0 0 -3.4E+38 3.4E+38 ECU_ADDRESS 0x90002326 /end MEASUREMENT
/begin MEASUREMENT VCT_kwhBMSPackEnergyAvailable "" FLOAT32_IEEE VBU0513_CM_single 0 0 -3.4E+38 3.4E+38 ECU_ADDRESS 0x9000235a /end MEASUREMENT
/begin MEASUREMENT SOH_pctPackSoh "" FLOAT32_IEEE VBU0513_CM_single 0 0 -3.4E+38 3.4E+38 ECU_ADDRESS 0x900024f2 /end MEASUREMENT
/begin MEASUREMENT SOH_iABeforeStepAveCurrent "" FLOAT32_IEEE VBU0513_CM_single 0 0 -3.4E+38 3.4E+38 ECU_ADDRESS 0x900024ee /end MEASUREMENT
/begin MEASUREMENT SOF_iAContinuousChargeCurrentLimitBase "" FLOAT32_IEEE VBU0513_CM_single 0 0 -3.4E+38 3.4E+38 ECU_ADDRESS 0x90001f3a /end MEASUREMENT
/begin MEASUREMENT SOF_iAShortPulseChargeCurrentLimitBase "" FLOAT32_IEEE VBU0513_CM_single 0 0 -3.4E+38 3.4E+38 ECU_ADDRESS 0x90001f7e /end MEASUREMENT
/begin MEASUREMENT SOF_iAContinuousDischargeCurrentLimitTarget "" FLOAT32_IEEE VBU0513_CM_single 0 0 -3.4E+38 3.4E+38 ECU_ADDRESS 0x90001f56 /end MEASUREMENT
/begin MEASUREMENT SOF_iAShortPulseDischargeCurrentLimitTarget "" FLOAT32_IEEE VBU0513_CM_single 0 0 -3.4E+38 3.4E+38 ECU_ADDRESS 0x90001f9a /end MEASUREMENT
/begin MEASUREMENT SOF_iADynamicDischargeCurrentLimitTarget "" FLOAT32_IEEE VBU0513_CM_single 0 0 -3.4E+38 3.4E+38 ECU_ADDRESS 0x90001f6e /end MEASUREMENT
/begin MEASUREMENT SOF_iAContinuousChargeCurrentLimitTarget "" FLOAT32_IEEE VBU0513_CM_single 0 0 -3.4E+38 3.4E+38 ECU_ADDRESS 0x90001f4a /end MEASUREMENT
/begin MEASUREMENT SOF_iAShortPulseChargeCurrentLimitTarget "" FLOAT32_IEEE VBU0513_CM_single 0 0 -3.4E+38 3.4E+38 ECU_ADDRESS 0x90001f8a /end MEASUREMENT
/begin MEASUREMENT SOF_iADynamicChargeCurrentLimitTarget "" FLOAT32_IEEE VBU0513_CM_single 0 0 -3.4E+38 3.4E+38 ECU_ADDRESS 0x90001f62 /end MEASUREMENT
/begin MEASUREMENT SOF_kwContinuousDischargePowerLimitTarget "" FLOAT32_IEEE VBU0513_CM_single 0 0 -3.4E+38 3.4E+38 ECU_ADDRESS 0x90001fae /end MEASUREMENT
/begin MEASUREMENT SOF_kwDischargePowerLimitTarget "" FLOAT32_IEEE VBU0513_CM_single 0 0 -3.4E+38 3.4E+38 ECU_ADDRESS 0x90001fb6 /end MEASUREMENT
/begin MEASUREMENT LaSOC_pctCellSocFastChargePreCorrection "" FLOAT32_IEEE VBU0513_CM_single 0 0 -3.4E+38 3.4E+38 ARRAY_SIZE 198 ECU_ADDRESS 0x900012d0 /end MEASUREMENT
/begin MEASUREMENT LaSOC_CellTemp_C "" FLOAT32_IEEE VBU0513_CM_single 0 0 -3.4E+38 3.4E+38 ARRAY_SIZE 198 ECU_ADDRESS 0x90000fb8 /end MEASUREMENT
/begin MEASUREMENT LaSOC_pctCellSocFastChargeTOC "" FLOAT32_IEEE VBU0513_CM_single 0 0 -3.4E+38 3.4E+38 ARRAY_SIZE 198 ECU_ADDRESS 0x900015e8 /end MEASUREMENT
/begin MEASUREMENT SOC_pctCellVoltageMaxCorrectionSoc "" FLOAT32_IEEE VBU0513_CM_single 0 0 -3.4E+38 3.4E+38 ECU_ADDRESS 0x90002486 /end MEASUREMENT
/begin MEASUREMENT LaSOC_pctCellSocFastChargeCorrection "" FLOAT32_IEEE VBU0513_CM_single 0 0 0.0 100.0 ARRAY_SIZE 198 ECU_ADDRESS 0x6003b9c6 /end MEASUREMENT
/begin MEASUREMENT SOC_pctBatteryDisplaySocDischargeDecRate "" FLOAT32_IEEE VBU0513_CM_single 0 0 -3.4E+38 3.4E+38 ECU_ADDRESS 0x9000247a /end MEASUREMENT
/begin MEASUREMENT SOC_pctBatteryDisplaySocDischargeIncRate "" FLOAT32_IEEE VBU0513_CM_single 0 0 -3.4E+38 3.4E+38 ECU_ADDRESS 0x9000247e /end MEASUREMENT
/begin MEASUREMENT SOC_pctBatteryDisplaySocChargeDecRate "" FLOAT32_IEEE VBU0513_CM_single 0 0 -3.4E+38 3.4E+38 ECU_ADDRESS 0x90002472 /end MEASUREMENT
/begin MEASUREMENT SOC_pctBatteryDisplaySocChargeIncRate "" FLOAT32_IEEE VBU0513_CM_single 0 0 -3.4E+38 3.4E+38 ECU_ADDRESS 0x90002476 /end MEASUREMENT
/begin MEASUREMENT FCC_kwChargePowerReqFnl "" FLOAT32_IEEE VBU0513_CM_single 0 0 -3.4E+38 3.4E+38 ECU_ADDRESS 0x90002426 /end MEASUREMENT
/begin MEASUREMENT FCC_uChargeVoltageRequestFnl "" FLOAT32_IEEE VBU0513_CM_single 0 0 -3.4E+38 3.4E+38 ECU_ADDRESS 0x90002442 /end MEASUREMENT
/begin MEASUREMENT FCC_iAChargeCurrentRequestRaw "" FLOAT32_IEEE VBU0513_CM_single 0 0 -3.4E+38 3.4E+38 ECU_ADDRESS 0x9000253e /end MEASUREMENT
/begin MEASUREMENT AVAS_HardwareVersion "" UWORD VBU0513_CM_uint16 0 0 0 65535 ECU_ADDRESS 0x90003796 /end MEASUREMENT
/begin MEASUREMENT ACCompActSpeed "" UWORD VBU0513_CM_uint16 0 0 0 65535 ECU_ADDRESS 0x90003794 /end MEASUREMENT
/begin MEASUREMENT EPS_Steering_Angle "" UWORD VBU0513_CM_ufix16_Sp1_Bn1080 0 0 -1080.0 5473.5 ECU_ADDRESS 0x9000393c /end MEASUREMENT
/begin MEASUREMENT EPS_TORque_Motor "" UWORD VBU0513_CM_ufix16_Sp001_Bn20 0 0 -20.0 45.535 ECU_ADDRESS 0x9000393e /end MEASUREMENT
/begin MEASUREMENT DragForce "" UWORD VBU0513_CM_ufix16_En3 0 0 0 8191.875 ECU_ADDRESS 0x9000393a /end MEASUREMENT
/begin MEASUREMENT MCU_MotorSpeed "" UWORD VBU0513_CM_ufix16_Bn30000 0 0 -30000.0 35535.0 ECU_ADDRESS 0x90003986 /end MEASUREMENT
/begin MEASUREMENT MCU_AllowMaxTorque "" UWORD VBU0513_CM_ufix14_Sp1_Bn450 0 0 -450.0 1188.3000000000002 ECU_ADDRESS 0x9000397e /end MEASUREMENT
/begin MEASUREMENT MCU_MotorTorque "" UWORD VBU0513_CM_ufix14_Sp1_Bn450 0 0 -450.0 1188.3000000000002 ECU_ADDRESS 0x90003988 /end MEASUREMENT
/begin MEASUREMENT ABS_WheelSpeed_RL "" UWORD VBU0513_CM_ufix13_Sp05625 0 0 0 460.74375000000003 ECU_ADDRESS 0x90003790 /end MEASUREMENT
/begin MEASUREMENT ABS_WheelSpeed_RR "" UWORD VBU0513_CM_ufix13_Sp05625 0 0 0 460.74375000000003 ECU_ADDRESS 0x90003792 /end MEASUREMENT
/begin MEASUREMENT ABS_WheelSpeed_FL "" UWORD VBU0513_CM_ufix13_Sp05625 0 0 0 460.74375000000003 ECU_ADDRESS 0x9000378c /end MEASUREMENT
/begin MEASUREMENT ABS_WheelSpeed_FR "" UWORD VBU0513_CM_ufix13_Sp05625 0 0 0 460.74375000000003 ECU_ADDRESS 0x9000378e /end MEASUREMENT
/begin MEASUREMENT ABS_VehicleSpeed "" UWORD VBU0513_CM_ufix13_Sp05625 0 0 0 460.74375000000003 ECU_ADDRESS 0x90003782 /end MEASUREMENT
/begin MEASUREMENT DCDCOutputCurrent "" UWORD VBU0513_CM_ufix12_Sp1 0 0 0 409.5 ECU_ADDRESS 0x90003936 /end MEASUREMENT
/begin MEASUREMENT MCU_CalDCCurrent "" UWORD VBU0513_CM_ufix12 0 0 0 4095.0 ECU_ADDRESS 0x90003980 /end MEASUREMENT
/begin MEASUREMENT DCDCOutputVoltage "" UWORD VBU0513_CM_ufix10_Sp1 0 0 0 102.30000000000001 ECU_ADDRESS 0x90003938 /end MEASUREMENT
/begin MEASUREMENT DCDCInputVoltage "" UWORD VBU0513_CM_ufix10 0 0 0 1023.0 ECU_ADDRESS 0x90003934 /end MEASUREMENT
/begin MEASUREMENT ABS_WheelSpeedPlusCounter_FL "" UWORD VBU0513_CM_ufix10 0 0 0 1023.0 ECU_ADDRESS 0x90003784 /end MEASUREMENT
/begin MEASUREMENT ABS_WheelSpeedPlusCounter_FR "" UWORD VBU0513_CM_ufix10 0 0 0 1023.0 ECU_ADDRESS 0x90003786 /end MEASUREMENT
/begin MEASUREMENT ABS_WheelSpeedPlusCounter_RL "" UWORD VBU0513_CM_ufix10 0 0 0 1023.0 ECU_ADDRESS 0x90003788 /end MEASUREMENT
/begin MEASUREMENT ABS_WheelSpeedPlusCounter_RR "" UWORD VBU0513_CM_ufix10 0 0 0 1023.0 ECU_ADDRESS 0x9000378a /end MEASUREMENT
/begin MEASUREMENT MCU_DCRelayOutSideVoltage "" UWORD VBU0513_CM_ufix10 0 0 0 1023.0 ECU_ADDRESS 0x90003982 /end MEASUREMENT
/begin MEASUREMENT MCU_DC_BUSVoltage "" UWORD VBU0513_CM_ufix10 0 0 0 1023.0 ECU_ADDRESS 0x90003984 /end MEASUREMENT
/begin MEASUREMENT LVC_stDCDCEnaResp "" UBYTE VBU0513_CM_uint8 0 0 0.0 255.0 ECU_ADDRESS 0x90004058 /end MEASUREMENT
/begin MEASUREMENT LVC_stDCDCDisblResp "" UBYTE VBU0513_CM_uint8 0 0 0.0 255.0 ECU_ADDRESS 0x90004057 /end MEASUREMENT
/begin MEASUREMENT CDC_stRgnMode "" UBYTE VBU0513_CM_uint8 0 0 0 255 ECU_ADDRESS 0x900042c4 /end MEASUREMENT
/begin MEASUREMENT CDC_stDrvMode "" UBYTE VBU0513_CM_uint8 0 0 0 255 ECU_ADDRESS 0x90004297 /end MEASUREMENT
/begin MEASUREMENT CDC_checksum "" UBYTE VBU0513_CM_uint8 0 0 0 255 ECU_ADDRESS 0x900040fd /end MEASUREMENT
/begin MEASUREMENT ABS_Checksum "" UBYTE VBU0513_CM_uint8 0 0 0 255 ECU_ADDRESS 0x900040b9 /end MEASUREMENT
/begin MEASUREMENT MCU_checksum "" UBYTE VBU0513_CM_uint8 0 0 0 255 ECU_ADDRESS 0x900041a8 /end MEASUREMENT
/begin MEASUREMENT EPS_ECU_msg_counter "" UBYTE VBU0513_CM_uint8 0 0 0 255 ECU_ADDRESS 0x90004138 /end MEASUREMENT
/begin MEASUREMENT VCT_stBMSIfBmsSocSet "" UBYTE VBU0513_CM_uint8 0 0 0 255 ECU_ADDRESS 0x90004232 /end MEASUREMENT
/begin MEASUREMENT VCT_stBMSIfPackVoltageSet "" UBYTE VBU0513_CM_uint8 0 0 0 255 ECU_ADDRESS 0x90004234 /end MEASUREMENT
/begin MEASUREMENT VCT_stBMSIfCellVoltageSet "" UBYTE VBU0513_CM_uint8 0 0 0 255 ECU_ADDRESS 0x90004233 /end MEASUREMENT
/begin MEASUREMENT VCT_stBMSHvIsolation "" UBYTE VBU0513_CM_uint8 0 0 0 255 ECU_ADDRESS 0x90004231 /end MEASUREMENT
/begin MEASUREMENT VCT_stBMSConnectorOvertemp "" UBYTE VBU0513_CM_uint8 0 0 0 255 ECU_ADDRESS 0x9000422b /end MEASUREMENT
/begin MEASUREMENT VCT_stBMSChrgConnOvertemp "" UBYTE VBU0513_CM_uint8 0 0 0 255 ECU_ADDRESS 0x9000422a /end MEASUREMENT
/begin MEASUREMENT VCT_stBMSChrgConnError "" UBYTE VBU0513_CM_uint8 0 0 0 255 ECU_ADDRESS 0x90004229 /end MEASUREMENT
/begin MEASUREMENT VCT_stBMSPackOverTemp "" UBYTE VBU0513_CM_uint8 0 0 0 255 ECU_ADDRESS 0x90004238 /end MEASUREMENT
/begin MEASUREMENT VCT_stBMSHvConectorError "" UBYTE VBU0513_CM_uint8 0 0 0 255 ECU_ADDRESS 0x90004230 /end MEASUREMENT
/begin MEASUREMENT VCT_stBMSOtherError "" UBYTE VBU0513_CM_uint8 0 0 0 255 ECU_ADDRESS 0x90004236 /end MEASUREMENT
/begin MEASUREMENT VCT_stBMSOverCurrent "" UBYTE VBU0513_CM_uint8 0 0 0 255 ECU_ADDRESS 0x90004237 /end MEASUREMENT
/begin MEASUREMENT VCT_stBMSVolMismatch "" UBYTE VBU0513_CM_uint8 0 0 0 255 ECU_ADDRESS 0x9000423c /end MEASUREMENT
/begin MEASUREMENT VCT_stBMSIsolationLevel "" UBYTE VBU0513_CM_uint8 0 0 0 255 ECU_ADDRESS 0x90004235 /end MEASUREMENT
/begin MEASUREMENT VCT_stBMSFaultCat "" UBYTE VBU0513_CM_uint8 0 0 0 255 ECU_ADDRESS 0x9000422e /end MEASUREMENT
/begin MEASUREMENT VCT_stBMSFaultLvl "" UBYTE VBU0513_CM_uint8 0 0 0 255 ECU_ADDRESS 0x9000422f /end MEASUREMENT
/begin MEASUREMENT VCT_stBMSContactorState "" UBYTE VBU0513_CM_uint8 0 0 0 255 ECU_ADDRESS 0x9000422c /end MEASUREMENT
/begin MEASUREMENT VCT_stInhibitPrechargeCause "" UBYTE VBU0513_CM_uint8 0 0 0 255 ECU_ADDRESS 0x90004254 /end MEASUREMENT
/begin MEASUREMENT VCT_stBMSSts "" UBYTE VBU0513_CM_uint8 0 0 0 255 ECU_ADDRESS 0x9000423b /end MEASUREMENT
/begin MEASUREMENT VCT_numBMSMaxVoltageSubSysNumber "" UBYTE VBU0513_CM_uint8 0 0 0 255 ECU_ADDRESS 0x9000421f /end MEASUREMENT
/begin MEASUREMENT VCT_numBMSMinimumCellVoltageNumber "" UBYTE VBU0513_CM_uint8 0 0 0 255 ECU_ADDRESS 0x90004224 /end MEASUREMENT
/begin MEASUREMENT VCT_numBMSMinVoltageSubSysNumber "" UBYTE VBU0513_CM_uint8 0 0 0 255 ECU_ADDRESS 0x90004223 /end MEASUREMENT
/begin MEASUREMENT VCT_numBMSMaxTempSubSysNumber "" UBYTE VBU0513_CM_uint8 0 0 0 255 ECU_ADDRESS 0x9000421e /end MEASUREMENT
/begin MEASUREMENT VCT_numBMSMinTempSubSysNumber "" UBYTE VBU0513_CM_uint8 0 0 0 255 ECU_ADDRESS 0x90004222 /end MEASUREMENT
/begin MEASUREMENT VCT_stBMSCellVoltageOverUnder "" UBYTE VBU0513_CM_uint8 0 0 0 255 ECU_ADDRESS 0x90004227 /end MEASUREMENT
/begin MEASUREMENT VCT_stBMSSOCOverUnder "" UBYTE VBU0513_CM_uint8 0 0 0 255 ECU_ADDRESS 0x9000423a /end MEASUREMENT
/begin MEASUREMENT VCT_stBMSDCChargeCurrentOverUnder "" UBYTE VBU0513_CM_uint8 0 0 0 255 ECU_ADDRESS 0x9000422d /end MEASUREMENT
/begin MEASUREMENT VCT_stBatteryTempOver "" UBYTE VBU0513_CM_uint8 0 0 0 255 ECU_ADDRESS 0x90004243 /end MEASUREMENT
/begin MEASUREMENT VCT_stBatteryOutputConnectorState "" UBYTE VBU0513_CM_uint8 0 0 0 255 ECU_ADDRESS 0x90004241 /end MEASUREMENT
/begin MEASUREMENT VCT_stDCChargingPermitStatus "" UBYTE VBU0513_CM_uint8 0 0 0 255 ECU_ADDRESS 0x90004253 /end MEASUREMENT
/begin MEASUREMENT VCT_stBetteryPckVoltOverAlarm "" UBYTE VBU0513_CM_uint8 0 0 0 255 ECU_ADDRESS 0x90004249 /end MEASUREMENT
/begin MEASUREMENT VCT_stBetteryPckVoltUnderAlarm "" UBYTE VBU0513_CM_uint8 0 0 0 255 ECU_ADDRESS 0x9000424a /end MEASUREMENT
/begin MEASUREMENT VCT_stBatteryConsistencyAlarm "" UBYTE VBU0513_CM_uint8 0 0 0 255 ECU_ADDRESS 0x90004240 /end MEASUREMENT
/begin MEASUREMENT VCT_stBatteryTempDifferAlarm "" UBYTE VBU0513_CM_uint8 0 0 0 255 ECU_ADDRESS 0x90004242 /end MEASUREMENT
/begin MEASUREMENT VCT_stBetteryCellTempHighAlarm "" UBYTE VBU0513_CM_uint8 0 0 0 255 ECU_ADDRESS 0x90004245 /end MEASUREMENT
/begin MEASUREMENT VCT_stBetteryCellTempLowAlarm "" UBYTE VBU0513_CM_uint8 0 0 0 255 ECU_ADDRESS 0x90004246 /end MEASUREMENT
/begin MEASUREMENT VCT_stBetteryCellVolHighAlarm "" UBYTE VBU0513_CM_uint8 0 0 0 255 ECU_ADDRESS 0x90004247 /end MEASUREMENT
/begin MEASUREMENT VCT_stBetteryCellVolLowAlarm "" UBYTE VBU0513_CM_uint8 0 0 0 255 ECU_ADDRESS 0x90004248 /end MEASUREMENT
/begin MEASUREMENT VCT_stSOCJumpAlarm "" UBYTE VBU0513_CM_uint8 0 0 0 255 ECU_ADDRESS 0x90004255 /end MEASUREMENT
/begin MEASUREMENT VCT_stSOCJumpReason "" UBYTE VBU0513_CM_uint8 0 0 0 255 ECU_ADDRESS 0x90004256 /end MEASUREMENT
/begin MEASUREMENT VCT_stBatteryTypeDismatchAlarm "" UBYTE VBU0513_CM_uint8 0 0 0 255 ECU_ADDRESS 0x90004244 /end MEASUREMENT
/begin MEASUREMENT VCT_numBMSMaximumCellVoltageNumber "" UBYTE VBU0513_CM_uint8 0 0 0 255 ECU_ADDRESS 0x90004220 /end MEASUREMENT
/begin MEASUREMENT VCT_numBMSMaximumTempNumber "" UBYTE VBU0513_CM_uint8 0 0 0 255 ECU_ADDRESS 0x90004221 /end MEASUREMENT
/begin MEASUREMENT VCT_numBMSMinimumTempNumber "" UBYTE VBU0513_CM_uint8 0 0 0 255 ECU_ADDRESS 0x90004225 /end MEASUREMENT
/begin MEASUREMENT VCT_stBMSReadyDCCharging "" UBYTE VBU0513_CM_uint8 0 0 0 255 ECU_ADDRESS 0x90004239 /end MEASUREMENT
/begin MEASUREMENT VCT_stBMSBatteryType "" UBYTE VBU0513_CM_uint8 0 0 0 255 ECU_ADDRESS 0x90004226 /end MEASUREMENT
/begin MEASUREMENT VCT_stDCChargeMode "" UBYTE VBU0513_CM_uint8 0 0 0 255 ECU_ADDRESS 0x90004252 /end MEASUREMENT
/begin MEASUREMENT VCT_stCTMCellThermalRunaway "" UBYTE VBU0513_CM_uint8 0 0 0 255 ECU_ADDRESS 0x90004251 /end MEASUREMENT
/begin MEASUREMENT THM_flgInletTempValid "" UBYTE VBU0513_CM_uint8 0 0 0 255 ECU_ADDRESS 0x900041cf /end MEASUREMENT
/begin MEASUREMENT THM_flgOutletTempValid "" UBYTE VBU0513_CM_uint8 0 0 0 255 ECU_ADDRESS 0x900041d0 /end MEASUREMENT
/begin MEASUREMENT EPS_Torque_Steering "" UBYTE VBU0513_CM_ufix8_Sp1_Bn12p8 0 0 -12.8 12.7 ECU_ADDRESS 0x9000414a /end MEASUREMENT
/begin MEASUREMENT DCDCInputCurrent "" UBYTE VBU0513_CM_ufix8_Sp1 0 0 0 25.5 ECU_ADDRESS 0x9000411d /end MEASUREMENT
/begin MEASUREMENT ACCompCurrent "" UBYTE VBU0513_CM_ufix8_Sp1 0 0 0 25.5 ECU_ADDRESS 0x900040c7 /end MEASUREMENT
/begin MEASUREMENT ACCompVoltage "" UBYTE VBU0513_CM_ufix8_E2 0 0 0 1020.0 ECU_ADDRESS 0x900040c9 /end MEASUREMENT
/begin MEASUREMENT MCU_UVWMaxCurrent "" UBYTE VBU0513_CM_ufix8_E2 0 0 0 1020.0 ECU_ADDRESS 0x900041a7 /end MEASUREMENT
/begin MEASUREMENT EPS_steering_angle_spd "" UBYTE VBU0513_CM_ufix8_E2 0 0 0 1020.0 ECU_ADDRESS 0x9000414b /end MEASUREMENT
/begin MEASUREMENT MCU_IGBTMaxTemperature "" UBYTE VBU0513_CM_ufix8_Bn40 0 0 -40.0 215.0 ECU_ADDRESS 0x90004196 /end MEASUREMENT
/begin MEASUREMENT MCU_IPM_Temperature "" UBYTE VBU0513_CM_ufix8_Bn40 0 0 -40.0 215.0 ECU_ADDRESS 0x9000419b /end MEASUREMENT
/begin MEASUREMENT MCU_MotorTemperature "" UBYTE VBU0513_CM_ufix8_Bn40 0 0 -40.0 215.0 ECU_ADDRESS 0x900041a0 /end MEASUREMENT
/begin MEASUREMENT DCDCTemperature "" UBYTE VBU0513_CM_ufix8_Bn40 0 0 -40.0 215.0 ECU_ADDRESS 0x90004123 /end MEASUREMENT
/begin MEASUREMENT T_BOXTime_Year "" UBYTE VBU0513_CM_ufix8_B2000 0 0 2000.0 2255.0 ECU_ADDRESS 0x900041d8 /end MEASUREMENT
/begin MEASUREMENT CheckSum "" UBYTE VBU0513_CM_ufix7 0 0 0 127.0 ECU_ADDRESS 0x90004118 /end MEASUREMENT
/begin MEASUREMENT T_BOXTime_Min "" UBYTE VBU0513_CM_ufix6 0 0 0 63.0 ECU_ADDRESS 0x900041d5 /end MEASUREMENT
/begin MEASUREMENT T_BOXTime_Sec "" UBYTE VBU0513_CM_ufix6 0 0 0 63.0 ECU_ADDRESS 0x900041d7 /end MEASUREMENT
/begin MEASUREMENT T_BOXTime_Day "" UBYTE VBU0513_CM_ufix5_B1 0 0 1.0 32.0 ECU_ADDRESS 0x900041d3 /end MEASUREMENT
/begin MEASUREMENT T_BOXTime_Hour "" UBYTE VBU0513_CM_ufix5 0 0 0 31.0 ECU_ADDRESS 0x900041d4 /end MEASUREMENT
/begin MEASUREMENT T_BOXTime_Month "" UBYTE VBU0513_CM_ufix4_B1 0 0 1.0 16.0 ECU_ADDRESS 0x900041d6 /end MEASUREMENT
/begin MEASUREMENT DCDCrollingcounter "" UBYTE VBU0513_CM_ufix4 0 0 0 15.0 ECU_ADDRESS 0x90004127 /end MEASUREMENT
/begin MEASUREMENT CDC_rollingcounter "" UBYTE VBU0513_CM_ufix4 0 0 0 15.0 ECU_ADDRESS 0x900040fe /end MEASUREMENT
/begin MEASUREMENT ABS_Rolling_Counter "" UBYTE VBU0513_CM_ufix4 0 0 0 15.0 ECU_ADDRESS 0x900040bc /end MEASUREMENT
/begin MEASUREMENT MCU_rollingcounter "" UBYTE VBU0513_CM_ufix4 0 0 0 15.0 ECU_ADDRESS 0x900041a9 /end MEASUREMENT
/begin MEASUREMENT EPS_ECU_MODE_CONT "" UBYTE VBU0513_CM_ufix4 0 0 0 15.0 ECU_ADDRESS 0x90004137 /end MEASUREMENT
/begin MEASUREMENT EPB_Control_Mode "" UBYTE VBU0513_CM_ufix4 0 0 0 15.0 ECU_ADDRESS 0x9000412a /end MEASUREMENT
/begin MEASUREMENT EPB_Fault_Level "" UBYTE VBU0513_CM_ufix4 0 0 0 15.0 ECU_ADDRESS 0x9000412b /end MEASUREMENT
/begin MEASUREMENT EPB_state "" UBYTE VBU0513_CM_ufix4 0 0 0 15.0 ECU_ADDRESS 0x90004130 /end MEASUREMENT
/begin MEASUREMENT Rollingcounter "" UBYTE VBU0513_CM_ufix4 0 0 0 15.0 ECU_ADDRESS 0x900041cc /end MEASUREMENT
/begin MEASUREMENT DCDCWorkstatus "" UBYTE VBU0513_CM_ufix2 0 0 0 3.0 ECU_ADDRESS 0x90004126 /end MEASUREMENT
/begin MEASUREMENT CDC_DriveMode "" UBYTE VBU0513_CM_ufix2 0 0 0 3.0 ECU_ADDRESS 0x900040f9 /end MEASUREMENT
/begin MEASUREMENT CDC_RegenMode "" UBYTE VBU0513_CM_ufix2 0 0 0 3.0 ECU_ADDRESS 0x900040fb /end MEASUREMENT
/begin MEASUREMENT CDC_TowMode "" UBYTE VBU0513_CM_ufix2 0 0 0 3.0 ECU_ADDRESS 0x900040fc /end MEASUREMENT
/begin MEASUREMENT BCM_Automatic_headlight_gear "" UBYTE VBU0513_CM_ufix2 0 0 0 3.0 ECU_ADDRESS 0x900040d5 /end MEASUREMENT
/begin MEASUREMENT BCM_Automatic_wiper_gear "" UBYTE VBU0513_CM_ufix2 0 0 0 3.0 ECU_ADDRESS 0x900040d6 /end MEASUREMENT
/begin MEASUREMENT BCM_Day_Light_Status "" UBYTE VBU0513_CM_ufix2 0 0 0 3.0 ECU_ADDRESS 0x900040d8 /end MEASUREMENT
/begin MEASUREMENT BCM_FrontFogLight "" UBYTE VBU0513_CM_ufix2 0 0 0 3.0 ECU_ADDRESS 0x900040da /end MEASUREMENT
/begin MEASUREMENT BCM_HI_Wiper_Status "" UBYTE VBU0513_CM_ufix2 0 0 0 3.0 ECU_ADDRESS 0x900040db /end MEASUREMENT
/begin MEASUREMENT BCM_HighBeam "" UBYTE VBU0513_CM_ufix2 0 0 0 3.0 ECU_ADDRESS 0x900040dc /end MEASUREMENT
/begin MEASUREMENT BCM_LeftTurnLightStatus "" UBYTE VBU0513_CM_ufix2 0 0 0 3.0 ECU_ADDRESS 0x900040df /end MEASUREMENT
/begin MEASUREMENT BCM_LowBeam "" UBYTE VBU0513_CM_ufix2 0 0 0 3.0 ECU_ADDRESS 0x900040e0 /end MEASUREMENT
/begin MEASUREMENT BCM_Low_Wiper_Status "" UBYTE VBU0513_CM_ufix2 0 0 0 3.0 ECU_ADDRESS 0x900040e1 /end MEASUREMENT
/begin MEASUREMENT BCM_Park_Light_Status "" UBYTE VBU0513_CM_ufix2 0 0 0 3.0 ECU_ADDRESS 0x900040e2 /end MEASUREMENT
/begin MEASUREMENT BCM_RearFogLight "" UBYTE VBU0513_CM_ufix2 0 0 0 3.0 ECU_ADDRESS 0x900040e4 /end MEASUREMENT
/begin MEASUREMENT BCM_RightTurnLightStatus "" UBYTE VBU0513_CM_ufix2 0 0 0 3.0 ECU_ADDRESS 0x900040e6 /end MEASUREMENT
/begin MEASUREMENT ACCompStatus "" UBYTE VBU0513_CM_ufix2 0 0 0 3.0 ECU_ADDRESS 0x900040c8 /end MEASUREMENT
/begin MEASUREMENT ABS_WheelSpeed_RL_Status "" UBYTE VBU0513_CM_ufix2 0 0 0 3.0 ECU_ADDRESS 0x900040c4 /end MEASUREMENT
/begin MEASUREMENT ABS_WheelSpeed_RR_Status "" UBYTE VBU0513_CM_ufix2 0 0 0 3.0 ECU_ADDRESS 0x900040c5 /end MEASUREMENT
/begin MEASUREMENT ABS_WheelSpeed_FL_Status "" UBYTE VBU0513_CM_ufix2 0 0 0 3.0 ECU_ADDRESS 0x900040c2 /end MEASUREMENT
/begin MEASUREMENT ABS_WheelSpeed_FR_Status "" UBYTE VBU0513_CM_ufix2 0 0 0 3.0 ECU_ADDRESS 0x900040c3 /end MEASUREMENT
/begin MEASUREMENT MCU_FaultLevel "" UBYTE VBU0513_CM_ufix2 0 0 0 3.0 ECU_ADDRESS 0x90004192 /end MEASUREMENT
/begin MEASUREMENT MCU_ActiveRelease "" UBYTE VBU0513_CM_ufix2 0 0 0 3.0 ECU_ADDRESS 0x9000418b /end MEASUREMENT
/begin MEASUREMENT MCU_MotorMode "" UBYTE VBU0513_CM_ufix2 0 0 0 3.0 ECU_ADDRESS 0x9000419d /end MEASUREMENT
/begin MEASUREMENT EPB_Key_Err "" UBYTE VBU0513_CM_ufix2 0 0 0 3.0 ECU_ADDRESS 0x9000412c /end MEASUREMENT
/begin MEASUREMENT EPB_Key_Sta "" UBYTE VBU0513_CM_ufix2 0 0 0 3.0 ECU_ADDRESS 0x9000412d /end MEASUREMENT
/begin MEASUREMENT EPB_PSensor_Err "" UBYTE VBU0513_CM_ufix2 0 0 0 3.0 ECU_ADDRESS 0x9000412e /end MEASUREMENT
/begin MEASUREMENT EPB_SolValve_ErrInd "" UBYTE VBU0513_CM_ufix2 0 0 0 3.0 ECU_ADDRESS 0x9000412f /end MEASUREMENT
/begin MEASUREMENT IGN "" UBYTE VBU0513_CM_ufix2 0 0 0 3.0 ECU_ADDRESS 0x9000416d /end MEASUREMENT
/begin MEASUREMENT Park_LED_Sta "" UBYTE VBU0513_CM_ufix2 0 0 0 3.0 ECU_ADDRESS 0x900041bc /end MEASUREMENT
/begin MEASUREMENT DCDCEnableFeedback "" UBYTE VBU0513_CM_ufix1 0 0 0 1.0 ECU_ADDRESS 0x9000411c /end MEASUREMENT
/begin MEASUREMENT CDC_CreepOnOff "" UBYTE VBU0513_CM_ufix1 0 0 0 1.0 ECU_ADDRESS 0x900040f8 /end MEASUREMENT
/begin MEASUREMENT CDC_GoNotifierOnOff "" UBYTE VBU0513_CM_ufix1 0 0 0 1.0 ECU_ADDRESS 0x900040fa /end MEASUREMENT
/begin MEASUREMENT BCM_Brake_Light_Status "" UBYTE VBU0513_CM_ufix1 0 0 0 1.0 ECU_ADDRESS 0x900040d7 /end MEASUREMENT
/begin MEASUREMENT BCM_DoorStatus "" UBYTE VBU0513_CM_ufix1 0 0 0 1.0 ECU_ADDRESS 0x900040d9 /end MEASUREMENT
/begin MEASUREMENT BCM_Horn_Status "" UBYTE VBU0513_CM_ufix1 0 0 0 1.0 ECU_ADDRESS 0x900040dd /end MEASUREMENT
/begin MEASUREMENT BCM_IG1_Power "" UBYTE VBU0513_CM_ufix1 0 0 0 1.0 ECU_ADDRESS 0x900040de /end MEASUREMENT
/begin MEASUREMENT BCM_Prak_Switch_Status "" UBYTE VBU0513_CM_ufix1 0 0 0 1.0 ECU_ADDRESS 0x900040e3 /end MEASUREMENT
/begin MEASUREMENT BCM_Reversing_Switch_Status "" UBYTE VBU0513_CM_ufix1 0 0 0 1.0 ECU_ADDRESS 0x900040e5 /end MEASUREMENT
/begin MEASUREMENT BCM_Wash_Motor_Status "" UBYTE VBU0513_CM_ufix1 0 0 0 1.0 ECU_ADDRESS 0x900040e7 /end MEASUREMENT
/begin MEASUREMENT AVAS_WorkingStatus "" UBYTE VBU0513_CM_ufix1 0 0 0 1.0 ECU_ADDRESS 0x900040d3 /end MEASUREMENT
/begin MEASUREMENT ACComFault "" UBYTE VBU0513_CM_ufix1 0 0 0 1.0 ECU_ADDRESS 0x900040c6 /end MEASUREMENT
/begin MEASUREMENT ACOverCurrent "" UBYTE VBU0513_CM_ufix1 0 0 0 1.0 ECU_ADDRESS 0x900040ca /end MEASUREMENT
/begin MEASUREMENT ACOverVoltage "" UBYTE VBU0513_CM_ufix1 0 0 0 1.0 ECU_ADDRESS 0x900040cb /end MEASUREMENT
/begin MEASUREMENT ACOver_current_FreqReduction "" UBYTE VBU0513_CM_ufix1 0 0 0 1.0 ECU_ADDRESS 0x900040cc /end MEASUREMENT
/begin MEASUREMENT ACSpeedFault "" UBYTE VBU0513_CM_ufix1 0 0 0 1.0 ECU_ADDRESS 0x900040cd /end MEASUREMENT
/begin MEASUREMENT ACStandby_overvoltage "" UBYTE VBU0513_CM_ufix1 0 0 0 1.0 ECU_ADDRESS 0x900040ce /end MEASUREMENT
/begin MEASUREMENT ACStandby_undervoltage "" UBYTE VBU0513_CM_ufix1 0 0 0 1.0 ECU_ADDRESS 0x900040cf /end MEASUREMENT
/begin MEASUREMENT ACUnderVoltage "" UBYTE VBU0513_CM_ufix1 0 0 0 1.0 ECU_ADDRESS 0x900040d0 /end MEASUREMENT
/begin MEASUREMENT ABS_WheelSpeedPlusCounter_FL_inv "" UBYTE VBU0513_CM_ufix1 0 0 0 1.0 ECU_ADDRESS 0x900040be /end MEASUREMENT
/begin MEASUREMENT ABS_WheelSpeedPlusCounter_FR_inv "" UBYTE VBU0513_CM_ufix1 0 0 0 1.0 ECU_ADDRESS 0x900040bf /end MEASUREMENT
/begin MEASUREMENT ABS_WheelSpeedPlusCounter_RL_inv "" UBYTE VBU0513_CM_ufix1 0 0 0 1.0 ECU_ADDRESS 0x900040c0 /end MEASUREMENT
/begin MEASUREMENT ABS_WheelSpeedPlusCounter_RR_inv "" UBYTE VBU0513_CM_ufix1 0 0 0 1.0 ECU_ADDRESS 0x900040c1 /end MEASUREMENT
/begin MEASUREMENT MCU_BusOverVoltage "" UBYTE VBU0513_CM_ufix1 0 0 0 1.0 ECU_ADDRESS 0x9000418c /end MEASUREMENT
/begin MEASUREMENT MCU_BusUnderVoltage "" UBYTE VBU0513_CM_ufix1 0 0 0 1.0 ECU_ADDRESS 0x9000418d /end MEASUREMENT
/begin MEASUREMENT MCU_CAN_Fault "" UBYTE VBU0513_CM_ufix1 0 0 0 1.0 ECU_ADDRESS 0x9000418e /end MEASUREMENT
/begin MEASUREMENT MCU_CPLD_Status "" UBYTE VBU0513_CM_ufix1 0 0 0 1.0 ECU_ADDRESS 0x9000418f /end MEASUREMENT
/begin MEASUREMENT MCU_Drive_Downarm_failure "" UBYTE VBU0513_CM_ufix1 0 0 0 1.0 ECU_ADDRESS 0x90004190 /end MEASUREMENT
/begin MEASUREMENT MCU_Drive_Uparm_failure "" UBYTE VBU0513_CM_ufix1 0 0 0 1.0 ECU_ADDRESS 0x90004191 /end MEASUREMENT
/begin MEASUREMENT MCU_HallFault "" UBYTE VBU0513_CM_ufix1 0 0 0 1.0 ECU_ADDRESS 0x90004193 /end MEASUREMENT
/begin MEASUREMENT MCU_Hardware_OverVoltage "" UBYTE VBU0513_CM_ufix1 0 0 0 1.0 ECU_ADDRESS 0x90004194 /end MEASUREMENT
/begin MEASUREMENT MCU_Hardware_UnderVoltage "" UBYTE VBU0513_CM_ufix1 0 0 0 1.0 ECU_ADDRESS 0x90004195 /end MEASUREMENT
/begin MEASUREMENT MCU_IGBT_Junction_overTem_limit "" UBYTE VBU0513_CM_ufix1 0 0 0 1.0 ECU_ADDRESS 0x90004197 /end MEASUREMENT
/begin MEASUREMENT MCU_IGBT_NTC_overTem_limit "" UBYTE VBU0513_CM_ufix1 0 0 0 1.0 ECU_ADDRESS 0x90004198 /end MEASUREMENT
/begin MEASUREMENT MCU_IGBTfault "" UBYTE VBU0513_CM_ufix1 0 0 0 1.0 ECU_ADDRESS 0x90004199 /end MEASUREMENT
/begin MEASUREMENT MCU_IGBToverheat "" UBYTE VBU0513_CM_ufix1 0 0 0 1.0 ECU_ADDRESS 0x9000419a /end MEASUREMENT
/begin MEASUREMENT MCU_MotorOverheat "" UBYTE VBU0513_CM_ufix1 0 0 0 1.0 ECU_ADDRESS 0x9000419e /end MEASUREMENT
/begin MEASUREMENT MCU_Motor_overTem_limit "" UBYTE VBU0513_CM_ufix1 0 0 0 1.0 ECU_ADDRESS 0x900041a1 /end MEASUREMENT
/begin MEASUREMENT MCU_OutputFault "" UBYTE VBU0513_CM_ufix1 0 0 0 1.0 ECU_ADDRESS 0x900041a2 /end MEASUREMENT
/begin MEASUREMENT MCU_OverCurrent "" UBYTE VBU0513_CM_ufix1 0 0 0 1.0 ECU_ADDRESS 0x900041a3 /end MEASUREMENT
/begin MEASUREMENT MCU_OverSpeed "" UBYTE VBU0513_CM_ufix1 0 0 0 1.0 ECU_ADDRESS 0x900041a4 /end MEASUREMENT
/begin MEASUREMENT MCU_Radiator_overTem_limit "" UBYTE VBU0513_CM_ufix1 0 0 0 1.0 ECU_ADDRESS 0x900041a5 /end MEASUREMENT
/begin MEASUREMENT MCU_ResolverFault "" UBYTE VBU0513_CM_ufix1 0 0 0 1.0 ECU_ADDRESS 0x900041a6 /end MEASUREMENT
/begin MEASUREMENT MCU_MotorHillHold "" UBYTE VBU0513_CM_ufix1 0 0 0 1.0 ECU_ADDRESS 0x9000419c /end MEASUREMENT
/begin MEASUREMENT MCU_MotorSpeedValid "" UBYTE VBU0513_CM_ufix1 0 0 0 1.0 ECU_ADDRESS 0x9000419f /end MEASUREMENT
/begin MEASUREMENT IC_BrakeDisWarning "" UBYTE VBU0513_CM_ufix1 0 0 0 1.0 ECU_ADDRESS 0x9000416a /end MEASUREMENT
/begin MEASUREMENT IC_BrakeFluidWarning "" UBYTE VBU0513_CM_ufix1 0 0 0 1.0 ECU_ADDRESS 0x9000416b /end MEASUREMENT
/begin MEASUREMENT IC_SeatbeltUnlock "" UBYTE VBU0513_CM_ufix1 0 0 0 1.0 ECU_ADDRESS 0x9000416c /end MEASUREMENT
/begin MEASUREMENT EPS_AMismathcR "" UBYTE VBU0513_CM_ufix1 0 0 0 1.0 ECU_ADDRESS 0x90004131 /end MEASUREMENT
/begin MEASUREMENT EPS_ASteeringAngleOutRange "" UBYTE VBU0513_CM_ufix1 0 0 0 1.0 ECU_ADDRESS 0x90004132 /end MEASUREMENT
/begin MEASUREMENT EPS_CAN_BUS_OFF "" UBYTE VBU0513_CM_ufix1 0 0 0 1.0 ECU_ADDRESS 0x90004133 /end MEASUREMENT
/begin MEASUREMENT EPS_CurrentOverDevition "" UBYTE VBU0513_CM_ufix1 0 0 0 1.0 ECU_ADDRESS 0x90004134 /end MEASUREMENT
/begin MEASUREMENT EPS_ECUCaliFail "" UBYTE VBU0513_CM_ufix1 0 0 0 1.0 ECU_ADDRESS 0x90004135 /end MEASUREMENT
/begin MEASUREMENT EPS_ECUCurrentSensorInvalid "" UBYTE VBU0513_CM_ufix1 0 0 0 1.0 ECU_ADDRESS 0x90004136 /end MEASUREMENT
/begin MEASUREMENT EPS_InvalidSpeed "" UBYTE VBU0513_CM_ufix1 0 0 0 1.0 ECU_ADDRESS 0x90004139 /end MEASUREMENT
/begin MEASUREMENT EPS_LVOverVoltage "" UBYTE VBU0513_CM_ufix1 0 0 0 1.0 ECU_ADDRESS 0x9000413a /end MEASUREMENT
/begin MEASUREMENT EPS_LVUnderVoltage "" UBYTE VBU0513_CM_ufix1 0 0 0 1.0 ECU_ADDRESS 0x9000413b /end MEASUREMENT
/begin MEASUREMENT EPS_MotorCurrentinvalid "" UBYTE VBU0513_CM_ufix1 0 0 0 1.0 ECU_ADDRESS 0x9000413c /end MEASUREMENT
/begin MEASUREMENT EPS_MotorDriverCircurtFail "" UBYTE VBU0513_CM_ufix1 0 0 0 1.0 ECU_ADDRESS 0x9000413d /end MEASUREMENT
/begin MEASUREMENT EPS_MotorPoSensorFault "" UBYTE VBU0513_CM_ufix1 0 0 0 1.0 ECU_ADDRESS 0x9000413e /end MEASUREMENT
/begin MEASUREMENT EPS_PTReadyLostFrame "" UBYTE VBU0513_CM_ufix1 0 0 0 1.0 ECU_ADDRESS 0x9000413f /end MEASUREMENT
/begin MEASUREMENT EPS_RSteeringAngleOutRange "" UBYTE VBU0513_CM_ufix1 0 0 0 1.0 ECU_ADDRESS 0x90004140 /end MEASUREMENT
/begin MEASUREMENT EPS_RelayFail "" UBYTE VBU0513_CM_ufix1 0 0 0 1.0 ECU_ADDRESS 0x90004141 /end MEASUREMENT
/begin MEASUREMENT EPS_SpeedLose "" UBYTE VBU0513_CM_ufix1 0 0 0 1.0 ECU_ADDRESS 0x90004142 /end MEASUREMENT
/begin MEASUREMENT EPS_SpeedOut "" UBYTE VBU0513_CM_ufix1 0 0 0 1.0 ECU_ADDRESS 0x90004143 /end MEASUREMENT
/begin MEASUREMENT EPS_T1T2Mismatch "" UBYTE VBU0513_CM_ufix1 0 0 0 1.0 ECU_ADDRESS 0x90004144 /end MEASUREMENT
/begin MEASUREMENT EPS_T1TorqueOutRange "" UBYTE VBU0513_CM_ufix1 0 0 0 1.0 ECU_ADDRESS 0x90004145 /end MEASUREMENT
/begin MEASUREMENT EPS_T2TorqueOutRange "" UBYTE VBU0513_CM_ufix1 0 0 0 1.0 ECU_ADDRESS 0x90004146 /end MEASUREMENT
/begin MEASUREMENT EPS_TemOverHigh "" UBYTE VBU0513_CM_ufix1 0 0 0 1.0 ECU_ADDRESS 0x90004147 /end MEASUREMENT
/begin MEASUREMENT EPS_TemOverLow "" UBYTE VBU0513_CM_ufix1 0 0 0 1.0 ECU_ADDRESS 0x90004148 /end MEASUREMENT
/begin MEASUREMENT EPS_TorqueSensorVoltError "" UBYTE VBU0513_CM_ufix1 0 0 0 1.0 ECU_ADDRESS 0x90004149 /end MEASUREMENT
/begin MEASUREMENT Communication "" UBYTE VBU0513_CM_ufix1 0 0 0 1.0 ECU_ADDRESS 0x9000411a /end MEASUREMENT
/begin MEASUREMENT DCDCDeriting "" UBYTE VBU0513_CM_ufix1 0 0 0 1.0 ECU_ADDRESS 0x9000411b /end MEASUREMENT
/begin MEASUREMENT DCDCOverHeat "" UBYTE VBU0513_CM_ufix1 0 0 0 1.0 ECU_ADDRESS 0x9000411e /end MEASUREMENT
/begin MEASUREMENT DCDCOverInputCurrent "" UBYTE VBU0513_CM_ufix1 0 0 0 1.0 ECU_ADDRESS 0x9000411f /end MEASUREMENT
/begin MEASUREMENT DCDCOverInputVoltage "" UBYTE VBU0513_CM_ufix1 0 0 0 1.0 ECU_ADDRESS 0x90004120 /end MEASUREMENT
/begin MEASUREMENT DCDCOverOutputCurrent "" UBYTE VBU0513_CM_ufix1 0 0 0 1.0 ECU_ADDRESS 0x90004121 /end MEASUREMENT
/begin MEASUREMENT DCDCOverOutputVoltage "" UBYTE VBU0513_CM_ufix1 0 0 0 1.0 ECU_ADDRESS 0x90004122 /end MEASUREMENT
/begin MEASUREMENT DCDCUnderInputVoltage "" UBYTE VBU0513_CM_ufix1 0 0 0 1.0 ECU_ADDRESS 0x90004124 /end MEASUREMENT
/begin MEASUREMENT DCDCUnderOutputVoltage "" UBYTE VBU0513_CM_ufix1 0 0 0 1.0 ECU_ADDRESS 0x90004125 /end MEASUREMENT
/begin MEASUREMENT ABS_Active "" UBYTE VBU0513_CM_ufix1 0 0 0 1.0 ECU_ADDRESS 0x900040b8 /end MEASUREMENT
/begin MEASUREMENT ABS_EBDFailed "" UBYTE VBU0513_CM_ufix1 0 0 0 1.0 ECU_ADDRESS 0x900040ba /end MEASUREMENT
/begin MEASUREMENT ABS_Failed "" UBYTE VBU0513_CM_ufix1 0 0 0 1.0 ECU_ADDRESS 0x900040bb /end MEASUREMENT
/begin MEASUREMENT ABS_VehicleSpeedValid "" UBYTE VBU0513_CM_ufix1 0 0 0 1.0 ECU_ADDRESS 0x900040bd /end MEASUREMENT
/begin MEASUREMENT EBD_Active "" UBYTE VBU0513_CM_ufix1 0 0 0 1.0 ECU_ADDRESS 0x90004129 /end MEASUREMENT
/begin MEASUREMENT SPD_flgRARvs "" UBYTE VBU0513_CM_boolean 0 0 0.0 1.0 ECU_ADDRESS 0x90004077 /end MEASUREMENT
/begin MEASUREMENT TQO_flgShftRD "" UBYTE VBU0513_CM_boolean 0 0 0.0 1.0 ECU_ADDRESS 0x9000408d /end MEASUREMENT
/begin MEASUREMENT TQCMP_flgPulseTrig "" UBYTE VBU0513_CM_boolean 0 0 0.0 1.0 ECU_ADDRESS 0x90004083 /end MEASUREMENT
/begin MEASUREMENT TQCMP_flgShftOn "" UBYTE VBU0513_CM_boolean 0 0 0.0 1.0 ECU_ADDRESS 0x90004084 /end MEASUREMENT
/begin MEASUREMENT PMM_flgInitToHVRlyClReq "" UBYTE VBU0513_CM_boolean 0 0 0 1 ECU_ADDRESS 0x900040b1 /end MEASUREMENT
/begin MEASUREMENT PMM_flgOffLoadToACTst "" UBYTE VBU0513_CM_boolean 0 0 0 1 ECU_ADDRESS 0x900040b2 /end MEASUREMENT
/begin MEASUREMENT DCH_flgBmsChCrntOver "" UBYTE VBU0513_CM_boolean 0 0 0.0 1.0 ECU_ADDRESS 0x90003ff8 /end MEASUREMENT
/begin MEASUREMENT DCH_flgBmsIsoCriticalFault "" UBYTE VBU0513_CM_boolean 0 0 0.0 1.0 ECU_ADDRESS 0x90003ff9 /end MEASUREMENT
/begin MEASUREMENT DCH_flgStopForManual "" UBYTE VBU0513_CM_boolean 0 0 0.0 1.0 ECU_ADDRESS 0x90004018 /end MEASUREMENT
/begin MEASUREMENT DCH_flgBMSChCmpt "" UBYTE VBU0513_CM_boolean 0 0 0.0 1.0 ECU_ADDRESS 0x90003ff1 /end MEASUREMENT
/begin MEASUREMENT DCH_flgHalfConn "" UBYTE VBU0513_CM_boolean 0 0 0.0 1.0 ECU_ADDRESS 0x90004007 /end MEASUREMENT
/begin MEASUREMENT DCH_flgCC2Conn "" UBYTE VBU0513_CM_boolean 0 0 0.0 1.0 ECU_ADDRESS 0x90003ffa /end MEASUREMENT
/begin MEASUREMENT PEUR_flgtrqActVld "" UBYTE VBU0513_CM_boolean 0 0 0.0 1.0 ECU_ADDRESS 0x90004062 /end MEASUREMENT
/begin MEASUREMENT PEUR_flgMotrHillHld "" UBYTE VBU0513_CM_boolean 0 0 0.0 1.0 ECU_ADDRESS 0x90004060 /end MEASUREMENT
/begin MEASUREMENT VCT_flgBMSBalanceStatus "" UBYTE VBU0513_CM_boolean 0 0 0 1 ECU_ADDRESS 0x9000420c /end MEASUREMENT
/begin MEASUREMENT VCT_stBMSChargeState "" UBYTE VBU0513_CM_boolean 0 0 0 1 ECU_ADDRESS 0x90004228 /end MEASUREMENT
/begin MEASUREMENT VCT_flgChargeCurrentDerate "" UBYTE VBU0513_CM_boolean 0 0 0 1 ECU_ADDRESS 0x9000421b /end MEASUREMENT
/begin MEASUREMENT VCT_flgHVBattSOCLowCrit "" UBYTE VBU0513_CM_boolean 0 0 0 1 ECU_ADDRESS 0x9000421c /end MEASUREMENT
/begin MEASUREMENT VCT_flgChargeAvailable "" UBYTE VBU0513_CM_boolean 0 0 0 1 ECU_ADDRESS 0x9000421a /end MEASUREMENT
/begin MEASUREMENT VCT_flgHVBattSOCLowWarn "" UBYTE VBU0513_CM_boolean 0 0 0 1 ECU_ADDRESS 0x9000421d /end MEASUREMENT
/begin MEASUREMENT VCT_flgBMSESSInletTempMask "" UBYTE VBU0513_CM_boolean 0 0 0 1 ECU_ADDRESS 0x90004210 /end MEASUREMENT
/begin MEASUREMENT VCT_flgBMSESSOutletTempMask "" UBYTE VBU0513_CM_boolean 0 0 0 1 ECU_ADDRESS 0x90004212 /end MEASUREMENT
/begin MEASUREMENT VCT_flgBMSHVShutdownReq "" UBYTE VBU0513_CM_boolean 0 0 0 1 ECU_ADDRESS 0x90004214 /end MEASUREMENT
/begin MEASUREMENT VCT_flgBMSESSInletTempValidity "" UBYTE VBU0513_CM_boolean 0 0 0 1 ECU_ADDRESS 0x90004211 /end MEASUREMENT
/begin MEASUREMENT VCT_flgBMSESSOutletTempValidity "" UBYTE VBU0513_CM_boolean 0 0 0 1 ECU_ADDRESS 0x90004213 /end MEASUREMENT
/begin MEASUREMENT VCT_flgBMSTempMaxValidity "" UBYTE VBU0513_CM_boolean 0 0 0 1 ECU_ADDRESS 0x90004216 /end MEASUREMENT
/begin MEASUREMENT VCT_flgBMSTempAverageValidity "" UBYTE VBU0513_CM_boolean 0 0 0 1 ECU_ADDRESS 0x90004215 /end MEASUREMENT
/begin MEASUREMENT VCT_flgBMSTempMinValidity "" UBYTE VBU0513_CM_boolean 0 0 0 1 ECU_ADDRESS 0x90004217 /end MEASUREMENT
/begin MEASUREMENT VCT_flgBMSTempRequestValid "" UBYTE VBU0513_CM_boolean 0 0 0 1 ECU_ADDRESS 0x90004218 /end MEASUREMENT
/begin MEASUREMENT VCT_flgBMSCellVoltageMaxValidity "" UBYTE VBU0513_CM_boolean 0 0 0 1 ECU_ADDRESS 0x9000420e /end MEASUREMENT
/begin MEASUREMENT VCT_flgBMSCellVoltageMinValidity "" UBYTE VBU0513_CM_boolean 0 0 0 1 ECU_ADDRESS 0x9000420f /end MEASUREMENT
/begin MEASUREMENT VCT_flgBMSCellVoltageAveValidity "" UBYTE VBU0513_CM_boolean 0 0 0 1 ECU_ADDRESS 0x9000420d /end MEASUREMENT
/begin MEASUREMENT VCT_flgCTMCellThermalRunawayFaultValid "" UBYTE VBU0513_CM_boolean 0 0 0 1 ECU_ADDRESS 0x90004219 /end MEASUREMENT
/begin MEASUREMENT SOH_flgBeforeStepCurrentEnable "" UBYTE VBU0513_CM_boolean 0 0 0 1 ECU_ADDRESS 0x90004075 /end MEASUREMENT
/begin MEASUREMENT SOH_flgSingalSocStart "" UBYTE VBU0513_CM_boolean 0 0 0 1 ECU_ADDRESS 0x90004076 /end MEASUREMENT
/begin MEASUREMENT SOC_flgSocFastChargeTOC "" UBYTE VBU0513_CM_boolean 0 0 0 1 ECU_ADDRESS 0x900042b6 /end MEASUREMENT
/begin MEASUREMENT SOC_flgOcvShortTimeCurrentEnable "" UBYTE VBU0513_CM_boolean 0 0 0.0 1.0 ECU_ADDRESS 0x90004069 /end MEASUREMENT
/begin MEASUREMENT SOC_flgSocFastChargeCorrection "" UBYTE VBU0513_CM_boolean 0 0 0.0 1.0 ECU_ADDRESS 0x9000406d /end MEASUREMENT
/begin MEASUREMENT FCC_flgCellTempLowProhibitCharge "" UBYTE VBU0513_CM_boolean 0 0 0.0 1.0 ECU_ADDRESS 0x9000402c /end MEASUREMENT
/begin MEASUREMENT FCC_flgCellTempProhibitCharge "" UBYTE VBU0513_CM_boolean 0 0 0.0 1.0 ECU_ADDRESS 0x9000402d /end MEASUREMENT
/begin MEASUREMENT FCC_flgVoltageProhibitCharge "" UBYTE VBU0513_CM_boolean 0 0 0.0 1.0 ECU_ADDRESS 0x9000403b /end MEASUREMENT
/begin MEASUREMENT FCC_flgFullChargeComplete "" UBYTE VBU0513_CM_boolean 0 0 0.0 1.0 ECU_ADDRESS 0x90004037 /end MEASUREMENT
/begin MEASUREMENT FCC_flgComputeResistancePrecondition "" UBYTE VBU0513_CM_boolean 0 0 0.0 1.0 ECU_ADDRESS 0x90004033 /end MEASUREMENT
/begin COMPU_METHOD VBU0513_CM_single_C "Q = V" RAT_FUNC "%8.6" "C" COEFFS 0 1 0 0 0 1 /end COMPU_METHOD
/begin COMPU_METHOD VBU0513_CM_single_cnt "Q = V" RAT_FUNC "%8.6" "cnt" COEFFS 0 1 0 0 0 1 /end COMPU_METHOD
/begin COMPU_METHOD VBU0513_CM_uint16_cnt "Q = V" RAT_FUNC "%5.0" "cnt" COEFFS 0 1 0 0 0 1 /end COMPU_METHOD
/begin COMPU_METHOD VBU0513_CM_single_pct "Q = V" RAT_FUNC "%8.6" "pct" COEFFS 0 1 0 0 0 1 /end COMPU_METHOD
/begin COMPU_METHOD VBU0513_CM_single_fac "Q = V" RAT_FUNC "%8.6" "fac" COEFFS 0 1 0 0 0 1 /end COMPU_METHOD
/begin COMPU_METHOD VBU0513_CM_uint8 "Q = V" RAT_FUNC "%3.0" "" COEFFS 0 1 0 0 0 1 /end COMPU_METHOD
/begin COMPU_METHOD VBU0513_CM_single_km "Q = V" RAT_FUNC "%8.6" "km" COEFFS 0 1 0 0 0 1 /end COMPU_METHOD
/begin COMPU_METHOD VBU0513_CM_uint16 "Q = V" RAT_FUNC "%5.0" "" COEFFS 0 1 0 0 0 1 /end COMPU_METHOD
/begin COMPU_METHOD VBU0513_CM_single "Q = V" RAT_FUNC "%8.6" "" COEFFS 0 1 0 0 0 1 /end COMPU_METHOD
/begin COMPU_METHOD VBU0513_CM_single_s "Q = V" RAT_FUNC "%8.6" "s" COEFFS 0 1 0 0 0 1 /end COMPU_METHOD
/begin COMPU_METHOD VBU0513_CM_single_kW "Q = V" RAT_FUNC "%8.6" "kW" COEFFS 0 1 0 0 0 1 /end COMPU_METHOD
/begin COMPU_METHOD VBU0513_CM_uint32_cnt "Q = V" RAT_FUNC "%10.0" "cnt" COEFFS 0 1 0 0 0 1 /end COMPU_METHOD
/begin COMPU_METHOD VBU0513_CM_uint32 "Q = V" RAT_FUNC "%10.0" "" COEFFS 0 1 0 0 0 1 /end COMPU_METHOD
/begin COMPU_METHOD VBU0513_CM_int16 "Q = V" RAT_FUNC "%5.0" "" COEFFS 0 1 0 0 0 1 /end COMPU_METHOD
/begin COMPU_METHOD VBU0513_CM_boolean_cnt "Q = V" RAT_FUNC "%1.0" "cnt" COEFFS 0 1 0 0 0 1 /end COMPU_METHOD
/begin COMPU_METHOD VBU0513_CM_boolean "Q = V" RAT_FUNC "%1.0" "" COEFFS 0 1 0 0 0 1 /end COMPU_METHOD
/begin COMPU_METHOD VBU0513_CM_uint8_cnt "Q = V" RAT_FUNC "%3.0" "cnt" COEFFS 0 1 0 0 0 1 /end COMPU_METHOD
/begin COMPU_METHOD VBU0513_CM_ufix28 "Q = V/1.000000" RAT_FUNC "%10.0" "" COEFFS 0 1.000000 0.000000 0 0 1.000000 /end COMPU_METHOD
/begin COMPU_METHOD VBU0513_CM_ufix24 "Q = V/1.000000" RAT_FUNC "%10.0" "" COEFFS 0 1.000000 0.000000 0 0 1.000000 /end COMPU_METHOD
/begin COMPU_METHOD VBU0513_CM_ufix16_Sp1_Bn1080 "Q = (V+1080.000000)*10.000000" RAT_FUNC "%0.6" "" COEFFS 0 10.000000 10800.000000 0 0 1.000000 /end COMPU_METHOD
/begin COMPU_METHOD VBU0513_CM_ufix16_Sp001_Bn20 "Q = (V+20.000000)*1000.000000" RAT_FUNC "%0.6" "" COEFFS 0 1000.000000 20000.000000 0 0 1.000000 /end COMPU_METHOD
/begin COMPU_METHOD VBU0513_CM_ufix16_En3 "Q = V*8.000000" RAT_FUNC "%7.3" "" COEFFS 0 8.000000 0.000000 0 0 1.000000 /end COMPU_METHOD
/begin COMPU_METHOD VBU0513_CM_ufix16_Bn30000 "Q = (V+30000.000000)/1.000000" RAT_FUNC "%0.6" "" COEFFS 0 1.000000 30000.000000 0 0 1.000000 /end COMPU_METHOD
/begin COMPU_METHOD VBU0513_CM_ufix14_Sp1_Bn450 "Q = (V+450.000000)*10.000000" RAT_FUNC "%0.6" "" COEFFS 0 10.000000 4500.000000 0 0 1.000000 /end COMPU_METHOD
/begin COMPU_METHOD VBU0513_CM_ufix13_Sp05625 "Q = V*17.777778" RAT_FUNC "%0.6" "" COEFFS 0 17.777778 0.000000 0 0 1.000000 /end COMPU_METHOD
/begin COMPU_METHOD VBU0513_CM_ufix12_Sp1 "Q = V*10.000000" RAT_FUNC "%0.6" "" COEFFS 0 10.000000 0.000000 0 0 1.000000 /end COMPU_METHOD
/begin COMPU_METHOD VBU0513_CM_ufix12 "Q = V/1.000000" RAT_FUNC "%5.0" "" COEFFS 0 1.000000 0.000000 0 0 1.000000 /end COMPU_METHOD
/begin COMPU_METHOD VBU0513_CM_ufix10_Sp1 "Q = V*10.000000" RAT_FUNC "%0.6" "" COEFFS 0 10.000000 0.000000 0 0 1.000000 /end COMPU_METHOD
/begin COMPU_METHOD VBU0513_CM_ufix10 "Q = V/1.000000" RAT_FUNC "%5.0" "" COEFFS 0 1.000000 0.000000 0 0 1.000000 /end COMPU_METHOD
/begin COMPU_METHOD VBU0513_CM_ufix8_Sp1_Bn12p8 "Q = (V+12.800000)*10.000000" RAT_FUNC "%0.6" "" COEFFS 0 10.000000 128.000000 0 0 1.000000 /end COMPU_METHOD
/begin COMPU_METHOD VBU0513_CM_ufix8_Sp1 "Q = V*10.000000" RAT_FUNC "%0.6" "" COEFFS 0 10.000000 0.000000 0 0 1.000000 /end COMPU_METHOD
/begin COMPU_METHOD VBU0513_CM_ufix8_E2 "Q = V/4.000000" RAT_FUNC "%3.0" "" COEFFS 0 1.000000 0.000000 0 0 4.000000 /end COMPU_METHOD
/begin COMPU_METHOD VBU0513_CM_ufix8_Bn40 "Q = (V+40.000000)/1.000000" RAT_FUNC "%0.6" "" COEFFS 0 1.000000 40.000000 0 0 1.000000 /end COMPU_METHOD
/begin COMPU_METHOD VBU0513_CM_ufix8_B2000 "Q = (V-2000.000000)/1.000000" RAT_FUNC "%0.6" "" COEFFS 0 1.000000 -2000.000000 0 0 1.000000 /end COMPU_METHOD
/begin COMPU_METHOD VBU0513_CM_ufix7 "Q = V/1.000000" RAT_FUNC "%3.0" "" COEFFS 0 1.000000 0.000000 0 0 1.000000 /end COMPU_METHOD
/begin COMPU_METHOD VBU0513_CM_ufix6 "Q = V/1.000000" RAT_FUNC "%3.0" "" COEFFS 0 1.000000 0.000000 0 0 1.000000 /end COMPU_METHOD
/begin COMPU_METHOD VBU0513_CM_ufix5_B1 "Q = (V-1.000000)/1.000000" RAT_FUNC "%0.6" "" COEFFS 0 1.000000 -1.000000 0 0 1.000000 /end COMPU_METHOD
/begin COMPU_METHOD VBU0513_CM_ufix5 "Q = V/1.000000" RAT_FUNC "%3.0" "" COEFFS 0 1.000000 0.000000 0 0 1.000000 /end COMPU_METHOD
/begin COMPU_METHOD VBU0513_CM_ufix4_B1 "Q = (V-1.000000)/1.000000" RAT_FUNC "%0.6" "" COEFFS 0 1.000000 -1.000000 0 0 1.000000 /end COMPU_METHOD
/begin COMPU_METHOD VBU0513_CM_ufix4 "Q = V/1.000000" RAT_FUNC "%3.0" "" COEFFS 0 1.000000 0.000000 0 0 1.000000 /end COMPU_METHOD
/begin COMPU_METHOD VBU0513_CM_ufix2 "Q = V/1.000000" RAT_FUNC "%3.0" "" COEFFS 0 1.000000 0.000000 0 0 1.000000 /end COMPU_METHOD
/begin COMPU_METHOD VBU0513_CM_ufix1 "Q = V/1.000000" RAT_FUNC "%3.0" "" COEFFS 0 1.000000 0.000000 0 0 1.000000 /end COMPU_METHOD
/begin GROUP S798_Override_Voltage_Request "VBU0513/VBUSystem/BMS/FCC /FCC/Subsystem/Determine_Fastcharge_Request/Charge_Request_Protection/Override_Voltage_Request" /begin SUB_GROUP S804_Override_Block3 /end SUB_GROUP /begin REF_CHARACTERISTIC CcFCC_ChargeVoltageDelta_V /end REF_CHARACTERISTIC /begin REF_MEASUREMENT FCC_uChargeVoltageRequestFnl /end REF_MEASUREMENT /end GROUP
/begin GROUP S798_Rate_Limiter "VBU0513/VBUSystem/BMS/FCC /FCC/Subsystem/Determine_Fastcharge_Request/Charge_Request_Protection/Rate_Limiter" /begin REF_MEASUREMENT FCC_kwChargePowerReqFnl /end REF_MEASUREMENT /end GROUP
/begin GROUP S799_Determine_ComputeResistanceCondition "VBU0513/VBUSystem/BMS/FCC /FCC/Subsystem/Determine_Fastcharge_Request/DetermineComputeResistancePulseCurrent/Determine_ComputeResistanceCondition" /begin SUB_GROUP S812_Delay_FallingEdge S812_RS_Flip_Flop S812_S_H /end SUB_GROUP
 /begin REF_CHARACTERISTIC CbFCC_ComputeResistanceEnable_flg CcFCC_ComputeResistanceDelayTime_ms CcFCC_ComputeResistanceEndVoltage_mV CcFCC_ComputeResistanceRelaxationTime_ms CcFCC_ComputeResistanceStartVoltage_mV CcFCC_ComputeResistanceTempMax_C CcFCC_ComputeResistanceTempMin_C CcSYS_ResisCalPulseCurrentDurationTime_ms /end REF_CHARACTERISTIC
 /begin REF_MEASUREMENT FCC_flgComputeResistancePrecondition /end REF_MEASUREMENT
/end GROUP
/begin GROUP S799_Determine_ComputeResistancePulseRequest "VBU0513/VBUSystem/BMS/FCC /FCC/Subsystem/Determine_Fastcharge_Request/DetermineComputeResistancePulseCurrent/Determine_ComputeResistancePulseRequest"
 /begin REF_CHARACTERISTIC CcSYS_ResisCalFCCPulseCurrent_A CcSYS_ResisCalRelaxationCurrent_A /end REF_CHARACTERISTIC
/end GROUP
/begin GROUP S799_Determine_FastChargeRequest "VBU0513/VBUSystem/BMS/FCC /FCC/Subsystem/Determine_Fastcharge_Request/DetermineComputeResistancePulseCurrent/Determine_FastChargeRequest" /begin REF_MEASUREMENT FCC_iAChargeCurrentRequestRaw /end REF_MEASUREMENT /end GROUP
/begin GROUP S800_Request_At_Charging "VBU0513/VBUSystem/BMS/FCC /FCC/Subsystem/Determine_Fastcharge_Request/Determine_Base_ChargeRequest/Request_At_Charging"
 /begin REF_CHARACTERISTIC CaFCC_VCRVCUAuxPowerFactorVoltageTempMapDimension_n CaFCC_VCRVCUAuxPowerFactorVoltageTempMapZ_nbr CcFCC_ChargeCurrentDerateSocDelta_pct CcFCC_ChargeCurrentDerateSoc_pct /end REF_CHARACTERISTIC
/end GROUP
/begin GROUP S800_Request_At_NoCharging "VBU0513/VBUSystem/BMS/FCC /FCC/Subsystem/Determine_Fastcharge_Request/Determine_Base_ChargeRequest/Request_At_NoCharging"
 /begin REF_CHARACTERISTIC CaFCC_VCRVCUAuxPowerFactorVoltageTempMapDimension_n CaFCC_VCRVCUAuxPowerFactorVoltageTempMapZ_nbr CcFCC_ChargeVoltageDelta_V /end REF_CHARACTERISTIC
/end GROUP
/begin GROUP S832_Cell_Temp_Protection "VBU0513/VBUSystem/BMS/FCC /FCC/Subsystem/Fastcharge_Conditions_Check/Condition_Categorize/Cell_Temp_Protection"
 /begin REF_CHARACTERISTIC CbFCC_NoChargeHighTempEnable_flg CbFCC_NoChargeLowTempEnable_flg CcFCC_HighTempDebounceTime_s /end REF_CHARACTERISTIC
 /begin REF_MEASUREMENT FCC_flgCellTempLowProhibitCharge FCC_flgCellTempProhibitCharge /end REF_MEASUREMENT
/end GROUP
/begin GROUP S832_Full_Charge_Determination "VBU0513/VBUSystem/BMS/FCC /FCC/Subsystem/Fastcharge_Conditions_Check/Condition_Categorize/Full_Charge_Determination"
 /begin SUB_GROUP S841_FullCharge_criteria1 S841_FullCharge_criteria2 S841_FullCharge_criteria4 /end SUB_GROUP
 /begin REF_MEASUREMENT FCC_flgFullChargeComplete /end REF_MEASUREMENT
/end GROUP
/begin GROUP S832_Voltage_Protection "VBU0513/VBUSystem/BMS/FCC /FCC/Subsystem/Fastcharge_Conditions_Check/Condition_Categorize/Voltage_Protection"
 /begin REF_CHARACTERISTIC CbFCC_BatteryVoltageMaxlimitEnable_flg CbFCC_CellVoltageMaxlimitEnable_flg CcFCC_BatteryVoltageMaxLimitDebounceTime_s CcFCC_CellVoltageMaxLimitDebounceTime_s /end REF_CHARACTERISTIC
 /begin REF_MEASUREMENT FCC_flgVoltageProhibitCharge /end REF_MEASUREMENT
/end GROUP
/begin GROUP S986_Determine_Cell_Balanced_Capacity "VBU0513/VBUSystem/BMS/SOC/Subsystem5/Subsystem/Determine_AhIntegral_SoC/Determine_AhIntegral_Capacity/Determine_Cell_Balanced_Capacity"
 /begin REF_CHARACTERISTIC CcSYS_BalanceResistance_ohm CcSYS_CellBalanceDutyCycle_pct MILIAMPERES_PER_AMPERE /end REF_CHARACTERISTIC
/end GROUP
/begin GROUP S1021_Determine_SOC_RateLimit "VBU0513/VBUSystem/BMS/SOC/Subsystem5/Subsystem/Determine_Display_SOC/DisplaySOC_Driving_Calculation/Determine_SOC_RateLimit"
 /begin REF_CHARACTERISTIC CaSOC_BatteryDisplaySocDischargeDecRateY_n CaSOC_BatteryDisplaySocDischargeIncRateY_n CaSOC_SOCDisChargeDecOffsetY_n CaSOC_SOCDisChargeIncOffsetY_n CbSOC_DisplaySOCRateDynamicEnable_flg CcSOC_BatteryDisplaySocChargeDecRate_n CcSOC_BatteryDisplaySocChargeIncRate_n /end REF_CHARACTERISTIC
 /begin REF_MEASUREMENT SOC_pctBatteryDisplaySocChargeDecRate SOC_pctBatteryDisplaySocChargeIncRate SOC_pctBatteryDisplaySocDischargeDecRate SOC_pctBatteryDisplaySocDischargeIncRate /end REF_MEASUREMENT
/end GROUP
/begin GROUP S1045_FastCharge_DynamicCorrection_Enable "VBU0513/VBUSystem/BMS/SOC/Subsystem5/Subsystem/Determine_FastChargeCorrection_Soc/FastCharge_DynamicCorrection/FastCharge_DynamicCorrection_Enable"
 /begin SUB_GROUP S1055_Calculate_WindowAverage_BatteryCurrent S1055_Determine_CurrentStable_Condition S1055_VoltThldEdge S1055_VoltThldEdge1 /end SUB_GROUP
 /begin REF_CHARACTERISTIC BATTERY_BOL_SOH BATTERY_EOL_SOH CaSOC_CCCorrectionMapDimension_n CaSOC_FastChargeCCCorrectionBOLVoltThd1Z_mV CaSOC_FastChargeCCCorrectionEOLVoltThd1Z_mV CaSOC_FastChargeCCCorrectionSoc1Z_pct CaSOC_FastChargeCCCorrectionSoc2Z_pct CaSOC_FastChargeCCCorrectionVoltThd2Z_mV CbSOC_FastChargeCCCorrection2Enable_flg /end REF_CHARACTERISTIC
 /begin REF_MEASUREMENT LaSOC_pctCellSocFastChargeCorrection SOC_flgSocFastChargeCorrection SOC_pctCellVoltageMaxCorrectionSoc /end REF_MEASUREMENT
/end GROUP
/begin GROUP S1046_Calculate_WindowAverage_BatteryCurrent "VBU0513/VBUSystem/BMS/SOC/Subsystem5/Subsystem/Determine_FastChargeCorrection_Soc/FastCharge_PreCorrection/Calculate_WindowAverage_BatteryCurrent" /begin REF_CHARACTERISTIC CcSOC_CurrentWinAvePeriodTime_ms /end REF_CHARACTERISTIC /end GROUP
/begin GROUP S1046_FastCharge_PreCorrectionMain "VBU0513/VBUSystem/BMS/SOC/Subsystem5/Subsystem/Determine_FastChargeCorrection_Soc/FastCharge_PreCorrection/FastCharge_PreCorrectionMain"
 /begin SUB_GROUP S1067_FastCharge_PreCorrectionSOC S1067_FastCharge_PreCorrectionVoltage /end SUB_GROUP
 /begin REF_CHARACTERISTIC CcSOC_FastChargePreCorrectionVolThld_mV CcSOC_FastChargePreCorrectionVolTime_ms /end REF_CHARACTERISTIC
 /begin REF_MEASUREMENT LaSOC_pctCellSocFastChargePreCorrection /end REF_MEASUREMENT
/end GROUP
/begin GROUP S1047_Calculate_WindowAverage_BatteryCurrent "VBU0513/VBUSystem/BMS/SOC/Subsystem5/Subsystem/Determine_FastChargeCorrection_Soc/FastCharge_TopofChargeCorrection/Calculate_WindowAverage_BatteryCurrent" /begin REF_CHARACTERISTIC CcSOC_CurrentWinAvePeriodTime_ms /end REF_CHARACTERISTIC /end GROUP
/begin GROUP S1047_FastCharge_TOCAdjustAllSOC "VBU0513/VBUSystem/BMS/SOC/Subsystem5/Subsystem/Determine_FastChargeCorrection_Soc/FastCharge_TopofChargeCorrection/FastCharge_TOCAdjustAllSOC"
 /begin REF_CHARACTERISTIC CcSOC_FastChargeTOCDeltaVolMax_mV CcSOC_FastChargeTOCDeltaVolSOC_pct /end REF_CHARACTERISTIC
 /begin REF_MEASUREMENT LaSOC_pctCellSocFastChargeTOC /end REF_MEASUREMENT
/end GROUP
/begin GROUP S1047_RiseEdge "VBU0513/VBUSystem/BMS/SOC/Subsystem5/Subsystem/Determine_FastChargeCorrection_Soc/FastCharge_TopofChargeCorrection/RiseEdge" /begin REF_MEASUREMENT SOC_flgSocFastChargeTOC /end REF_MEASUREMENT /end GROUP
/begin GROUP S1086_After_Startup "VBU0513/VBUSystem/BMS/SOC/Subsystem5/Subsystem/Determine_Initial_SoC/Determine_Soc_Jump/After_Startup"
 /begin REF_CHARACTERISTIC SOC_JUMP_ABNORMAL_POWER_OFF SOC_JUMP_ABNORMAL_RESET SOC_JUMP_NONE SOC_JUMP_OCV_CORRECTION /end REF_CHARACTERISTIC
/end GROUP
/begin GROUP S1086_Startup "VBU0513/VBUSystem/BMS/SOC/Subsystem5/Subsystem/Determine_Initial_SoC/Determine_Soc_Jump/Startup"
 /begin REF_CHARACTERISTIC SOC_JUMP_ABNORMAL_POWER_OFF SOC_JUMP_ABNORMAL_RESET SOC_JUMP_NONE SOC_JUMP_OCV_CORRECTION /end REF_CHARACTERISTIC
/end GROUP
/begin GROUP S1110_Calculate_Cell_Temperature "VBU0513/VBUSystem/BMS/SOC/Subsystem5/Subsystem/Determine_OcvSoc/Replace_Invalid_CellTemperature/Calculate_Cell_Temperature" /begin REF_MEASUREMENT LaSOC_CellTemp_C /end REF_MEASUREMENT /end GROUP
/begin GROUP S1115_Current_Limit "VBU0513/VBUSystem/BMS/SOC/Subsystem5/Subsystem/Determine_ShortTimeCorrection_Condition/Current_Limit_Condition/Current_Limit" /begin REF_CHARACTERISTIC CcSOC_iAOcvShortTimeCurrentLimit /end REF_CHARACTERISTIC /begin REF_MEASUREMENT SOC_flgOcvShortTimeCurrentEnable /end REF_MEASUREMENT /end GROUP
/begin GROUP S1149_Calculate_Energy_Retention_Factor "VBU0513/VBUSystem/BMS/SOE/Subsystem2/Subsystem/Calculate_Pack_Remaining_Energy/Discharge_Mode/Calculate_Energy_Retention_Factor" /begin REF_CHARACTERISTIC CaSOE_SocOcvMapZ_mV CaSOE_SocResistanceLongMapZ_mohm /end REF_CHARACTERISTIC /end GROUP
/begin GROUP S1149_Predict_SOC_End "VBU0513/VBUSystem/BMS/SOE/Subsystem2/Subsystem/Calculate_Pack_Remaining_Energy/Discharge_Mode/Predict_SOC_End"
 /begin REF_CHARACTERISTIC CaSOE_SocOcvMapZ_mV CaSOE_SocResistanceLongMapZ_mohm CcSOE_CellVoltageLowerLimit_mV CcSOE_MaxInterationNumber_n /end REF_CHARACTERISTIC
/end GROUP
/begin GROUP S1196_Rate_Limiter "VBU0513/VBUSystem/BMS/SOF/Subsystem6/Subsystem/Calculate_PowerLimit/Calculate_Pack_OCV/Rate_Limiter" /begin REF_CHARACTERISTIC CcSOF_DischargeLowOCVStepSlope_V /end REF_CHARACTERISTIC /end GROUP
/begin GROUP S1197_Power_Limit_Cycle_Level1 "VBU0513/VBUSystem/BMS/SOF/Subsystem6/Subsystem/Calculate_PowerLimit/Determine_Capacity_Cycle_PowerLimit/Power_Limit_Cycle_Level1"
 /begin SUB_GROUP S1205_Power_Limit_Level1_ChargePowerLimit S1205_Power_Limit_Level1_DischargePowerLimit /end SUB_GROUP
/end GROUP
/begin GROUP S1197_Power_Limit_Cycle_Level2 "VBU0513/VBUSystem/BMS/SOF/Subsystem6/Subsystem/Calculate_PowerLimit/Determine_Capacity_Cycle_PowerLimit/Power_Limit_Cycle_Level2"
 /begin SUB_GROUP S1206_Power_Limit_Cycle_Level2_ChargePowerLimit S1206_Power_Limit_Cycle_Level2_DischargePowerLimit /end SUB_GROUP
/end GROUP
/begin GROUP S1197_Power_Limit_Cycle_Level3 "VBU0513/VBUSystem/BMS/SOF/Subsystem6/Subsystem/Calculate_PowerLimit/Determine_Capacity_Cycle_PowerLimit/Power_Limit_Cycle_Level3"
 /begin SUB_GROUP S1207_Power_Limit_Cycle_Level3_ChargePowerLimit S1207_Power_Limit_Cycle_Level3_DischargePowerLimit /end SUB_GROUP
/end GROUP
/begin GROUP S1198_Determine_ContinuousDischargePowerLimitTarget "VBU0513/VBUSystem/BMS/SOF/Subsystem6/Subsystem/Calculate_PowerLimit/Determine_SOCP_PowerLimit/Determine_ContinuousDischargePowerLimitTarget" /begin SUB_GROUP S1215_Determine_SOCP_Condition /end SUB_GROUP
 /begin REF_CHARACTERISTIC CcSOF_SocpDischargePowerMin_Kw CcSOF_SocpDischargePowerSlope_Kw /end REF_CHARACTERISTIC
 /begin REF_MEASUREMENT SOF_kwContinuousDischargePowerLimitTarget /end REF_MEASUREMENT
/end GROUP
/begin GROUP S1198_Determine_DischargePowerLimitTarget "VBU0513/VBUSystem/BMS/SOF/Subsystem6/Subsystem/Calculate_PowerLimit/Determine_SOCP_PowerLimit/Determine_DischargePowerLimitTarget" /begin SUB_GROUP S1216_Determine_SOCP_Condition /end SUB_GROUP
 /begin REF_CHARACTERISTIC CcSOF_SocpDischargePowerMin_Kw CcSOF_SocpDischargePowerSlope_Kw /end REF_CHARACTERISTIC
 /begin REF_MEASUREMENT SOF_kwDischargePowerLimitTarget /end REF_MEASUREMENT
/end GROUP
/begin GROUP S1228_Calculate_CurrentLimit_Base "VBU0513/VBUSystem/BMS/SOF/Subsystem6/Subsystem/Determine_Currentlimit_Target/Calculate_CurrentLimit_Target/Calculate_CurrentLimit_Base"
 /begin SUB_GROUP S1230_Calculate_ContinuousChargeCurrent S1230_Calculate_ContinuousDischargeCurrent S1230_Calculate_ShortPulseChargeCurrent S1230_Calculate_ShortPulseDischargeCurrent S1230_Determine_LowVoltageLimitChargeCurrent /end SUB_GROUP
 /begin REF_CHARACTERISTIC CcSOF_LowVoltChgCurtSloDelay_ms CcSOF_LowVoltageChargeCurrentMax_A CcSOF_LowVoltageChargeCurrentSlopeDec_A CcSOF_LowVoltageChargeCurrentSlopeInc_A CcSOF_LowVoltageChargeLimitEnable_flg CcSOF_LowVoltagePowerOnDelay_ms /end REF_CHARACTERISTIC
 /begin REF_MEASUREMENT SOF_iAContinuousChargeCurrentLimitBase SOF_iAShortPulseChargeCurrentLimitBase /end REF_MEASUREMENT
/end GROUP
/begin GROUP S1228_Calculate_Dynamic_CurrentLimit "VBU0513/VBUSystem/BMS/SOF/Subsystem6/Subsystem/Determine_Currentlimit_Target/Calculate_CurrentLimit_Target/Calculate_Dynamic_CurrentLimit"
 /begin SUB_GROUP S1231_Calculate_Dynamic_ChargeCurrentLimit S1231_Calculate_Dynamic_DischargeCurrentLimit /end SUB_GROUP
/end GROUP
/begin GROUP S1228_CurrentLimit_FastCharge_Check "VBU0513/VBUSystem/BMS/SOF/Subsystem6/Subsystem/Determine_Currentlimit_Target/Calculate_CurrentLimit_Target/CurrentLimit_FastCharge_Check"
 /begin SUB_GROUP S1232_FastChrgOneThirdRateCurrentLimitCheck S1232_SegmentChargeCheck /end SUB_GROUP
/end GROUP
/begin GROUP S1228_CurrentLimit_Fault_Correct "VBU0513/VBUSystem/BMS/SOF/Subsystem6/Subsystem/Determine_Currentlimit_Target/Calculate_CurrentLimit_Target/CurrentLimit_Fault_Correct" /begin SUB_GROUP S1233_CAT4 S1233_Determine_StopCharge_Condition /end SUB_GROUP
 /begin REF_MEASUREMENT SOF_iAContinuousChargeCurrentLimitTarget SOF_iAContinuousDischargeCurrentLimitTarget SOF_iADynamicChargeCurrentLimitTarget SOF_iADynamicDischargeCurrentLimitTarget SOF_iAShortPulseChargeCurrentLimitTarget SOF_iAShortPulseDischargeCurrentLimitTarget /end REF_MEASUREMENT
/end GROUP
/begin GROUP S1228_CurrentLimit_Voltage_Correct "VBU0513/VBUSystem/BMS/SOF/Subsystem6/Subsystem/Determine_Currentlimit_Target/Calculate_CurrentLimit_Target/CurrentLimit_Voltage_Correct" /begin SUB_GROUP S1234_Correct_CurrentLimit S1234_Enable_Voltage_Correction /end SUB_GROUP /end GROUP
/begin GROUP S1422_Caculate_CellCapacity_LifeTimeQ "VBU0513/VBUSystem/BMS/SOH/Subsystem4/Subsystem1/Calculate_Capacity/Calculate_CellCapacity/Caculate_CellCapacity_LifeTimeQ"
 /begin SUB_GROUP S1427_Caculate_WeightingLifeTimeCharge S1427_NVM_ReadWrite_Check /end SUB_GROUP
 /begin REF_CHARACTERISTIC CaSOH_CellCapacity_Ah CaSOH_InvalidCellCapacity_Ah /end REF_CHARACTERISTIC
/end GROUP
/begin GROUP S1422_CellCapacity_Limit "VBU0513/VBUSystem/BMS/SOH/Subsystem4/Subsystem1/Calculate_Capacity/Calculate_CellCapacity/CellCapacity_Limit" /begin SUB_GROUP S1428_LimittedByNVMvalue /end SUB_GROUP /begin REF_CHARACTERISTIC CcSOH_CellCapacityLowThershold_Ah /end REF_CHARACTERISTIC /end GROUP
/begin GROUP S1422_Determine_CellCapacity "VBU0513/VBUSystem/BMS/SOH/Subsystem4/Subsystem1/Calculate_Capacity/Calculate_CellCapacity/Determine_CellCapacity" /begin SUB_GROUP S1429_MMASVC1 /end SUB_GROUP /end GROUP
/begin GROUP S1422_Determine_PackSoh "VBU0513/VBUSystem/BMS/SOH/Subsystem4/Subsystem1/Calculate_Capacity/Calculate_CellCapacity/Determine_PackSoh" /begin REF_MEASUREMENT SOH_pctPackSoh /end REF_MEASUREMENT /end GROUP
/begin GROUP S1422_PackSoh_Storage "VBU0513/VBUSystem/BMS/SOH/Subsystem4/Subsystem1/Calculate_Capacity/Calculate_CellCapacity/PackSoh_Storage"
 /begin REF_CHARACTERISTIC CaSOH_CellCapacityWrite_Ah CaSOH_LifeTimeDischargeLookUp_Ah CbSOH_EepromWriteCellCapacity_flg /end REF_CHARACTERISTIC
/end GROUP
/begin GROUP S1423_Determine_AhIntegral_DeltaQ "VBU0513/VBUSystem/BMS/SOH/Subsystem4/Subsystem1/Calculate_Capacity/Calculate_CellCapacity_SlowCharge/Determine_AhIntegral_DeltaQ"
 /begin SUB_GROUP S1461_Determine_AhIntegral_Q S1461_Determine_Module_Current /end SUB_GROUP
/end GROUP
/begin GROUP S1423_Determine_Soc "VBU0513/VBUSystem/BMS/SOH/Subsystem4/Subsystem1/Calculate_Capacity/Calculate_CellCapacity_SlowCharge/Determine_Soc" /begin SUB_GROUP S1463_Determine_Module_Current S1463_Lookup_Table_Cal_Soc /end SUB_GROUP /end GROUP
/begin GROUP S1423_Determine_SocEndandCondition "VBU0513/VBUSystem/BMS/SOH/Subsystem4/Subsystem1/Calculate_Capacity/Calculate_CellCapacity_SlowCharge/Determine_SocEndandCondition"
 /begin REF_CHARACTERISTIC CcSOH_DeltaSocLowerLimit_pct CcSOH_DeltaSocThreshold_pct CcSOH_DeltaSocUpperLimit_pct CcSOH_DeltaTemThreshold_C CcSOH_LowTemThreshold_C /end REF_CHARACTERISTIC
/end GROUP
/begin GROUP S1423_Determine_SocStart "VBU0513/VBUSystem/BMS/SOH/Subsystem4/Subsystem1/Calculate_Capacity/Calculate_CellCapacity_SlowCharge/Determine_SocStart"
 /begin REF_CHARACTERISTIC CcSOH_UdSocInvalidLowerLimit_pct CcSOH_UdSocInvalidUpperLimit_pct /end REF_CHARACTERISTIC
 /begin REF_MEASUREMENT SOH_flgSingalSocStart /end REF_MEASUREMENT
/end GROUP
/begin GROUP S1425_Determine_SlowCharge "VBU0513/VBUSystem/BMS/SOH/Subsystem4/Subsystem1/Calculate_Capacity/Determine_CalculateCellCapacity_Condition/Determine_SlowCharge" /begin SUB_GROUP S1483_OBC_CHARGE_MODE1 /end SUB_GROUP /begin REF_CHARACTERISTIC CcSOH_AfertSlowChargeEndTime_ms /end REF_CHARACTERISTIC /end GROUP
/begin GROUP S1425_Determine_SlowChargeStart "VBU0513/VBUSystem/BMS/SOH/Subsystem4/Subsystem1/Calculate_Capacity/Determine_CalculateCellCapacity_Condition/Determine_SlowChargeStart" /begin REF_CHARACTERISTIC CcSOH_AfertSlowChargeStartTime_ms /end REF_CHARACTERISTIC /end GROUP
/begin GROUP S1491_BeforStep_DuringStep_AfterStep_Check "VBU0513/VBUSystem/BMS/SOH/Subsystem4/Subsystem1/Calculate_Resistance/BasicCellResistance_Calculation_Check/BeforStep_DuringStep_AfterStep_Check" /begin SUB_GROUP S1500_DuringStep_AfterStep_Check /end SUB_GROUP /end GROUP
/begin GROUP S1491_ResistanceCalc_Check "VBU0513/VBUSystem/BMS/SOH/Subsystem4/Subsystem1/Calculate_Resistance/BasicCellResistance_Calculation_Check/ResistanceCalc_Check" /begin SUB_GROUP S1501_NVM_ReadWrite_Check /end SUB_GROUP /end GROUP
/begin GROUP S1494_CalCurrent_Data_BeforeStep "VBU0513/VBUSystem/BMS/SOH/Subsystem4/Subsystem1/Calculate_Resistance/Calculate_Relaxation_Average_CurrentVoltage/CalCurrent_Data_BeforeStep"
 /begin REF_CHARACTERISTIC CaSOH_InvalidHistoryCurrentData_A CcSOH_ComResisTempLowerLimit_C CcSOH_ComResisTempUpperLimit_C CcSOH_DeltaModuleCurrent_A CcSOH_HistoryDataDimension_n CcSYS_ResisCalRelaxationCurrent_A /end REF_CHARACTERISTIC
 /begin REF_MEASUREMENT SOH_flgBeforeStepCurrentEnable SOH_iABeforeStepAveCurrent /end REF_MEASUREMENT
/end GROUP
/begin GROUP S1498_Calculate_Pulse_Average_CurrentVoltage "VBU0513/VBUSystem/BMS/SOH/Subsystem4/Subsystem1/Calculate_Resistance/Determine_Condition_Calculate_Pulse_Average_CurrentVoltage/Calculate_Pulse_Average_CurrentVoltage" /begin SUB_GROUP S1515_Cal_Pulse_Current_Data /end SUB_GROUP /end GROUP
/begin GROUP S1498_Determine_Condition "VBU0513/VBUSystem/BMS/SOH/Subsystem4/Subsystem1/Calculate_Resistance/Determine_Condition_Calculate_Pulse_Average_CurrentVoltage/Determine_Condition"
 /begin SUB_GROUP S1516_Determine_FCCPulseCurrent_Condition S1516_Determine_OBCPulseCurrent_Condition /end SUB_GROUP
/end GROUP
/begin GROUP S1557_Determine_InletTemp_Validation "VBU0513/VBUSystem/BMS/THM/Subsystem/Subsystem/Calculate_PipeTemperature/Determine_CoolantSensorTemp_Validation/Determine_InletTemp_Validation" /begin SUB_GROUP S1558_Determinate_InletTempValidationDelay /end SUB_GROUP
 /begin REF_CHARACTERISTIC CcTHM_CoolantGradientCheckEnable_flg CcTHM_CoolantSensorGradient_C CcTHM_CoolantSensorValidEnable_flg CcTHM_CoolantTempOorDebounceTime_s /end REF_CHARACTERISTIC
 /begin REF_MEASUREMENT THM_flgInletTempValid /end REF_MEASUREMENT
/end GROUP
/begin GROUP S1557_Determine_OutletTemp_Validation "VBU0513/VBUSystem/BMS/THM/Subsystem/Subsystem/Calculate_PipeTemperature/Determine_CoolantSensorTemp_Validation/Determine_OutletTemp_Validation" /begin SUB_GROUP S1559_Determinate_OutletTempValidationDelay /end SUB_GROUP
 /begin REF_CHARACTERISTIC CcTHM_CoolantGradientCheckEnable_flg CcTHM_CoolantSensorGradient_C CcTHM_CoolantSensorValidEnable_flg CcTHM_CoolantTempOorDebounceTime_s /end REF_CHARACTERISTIC
 /begin REF_MEASUREMENT THM_flgOutletTempValid /end REF_MEASUREMENT
/end GROUP
/begin GROUP S1569_Normal_Condition "VBU0513/VBUSystem/BMS/THM/Subsystem/Subsystem/Charge_Mode_Temp_Request/OBC_Temp_Request/Normal_Condition"
 /begin REF_CHARACTERISTIC CaTHM_ObcHighSocRequestTempMapZ_C CaTHM_ObcSohFactorMapY_n CcTHM_ObcChargeTempRequestLowThreshold_C CcTHM_ObcSohTempLowThreshold_C /end REF_CHARACTERISTIC
/end GROUP
/begin GROUP S1610_SOC_Hysteretic_Determination "VBU0513/VBUSystem/BMS/THM/Subsystem/Subsystem/Valid_Condition_Determination/FCC_Temp_Valid/SOC_Hysteretic_Determination" /begin REF_CHARACTERISTIC CcTHM_FccChargeHysterSOC_pct CcTHM_FccSocHighThreshold_pct /end REF_CHARACTERISTIC /end GROUP
/begin GROUP S1610_Temp_Hysteretic_Determination "VBU0513/VBUSystem/BMS/THM/Subsystem/Subsystem/Valid_Condition_Determination/FCC_Temp_Valid/Temp_Hysteretic_Determination"
 /begin REF_CHARACTERISTIC CcTHM_FccCellTempHighThreshold_C CcTHM_FccChargeTempRequestHysterTemp_C /end REF_CHARACTERISTIC
/end GROUP
/begin GROUP S1612_Hysteretic_Determination "VBU0513/VBUSystem/BMS/THM/Subsystem/Subsystem/Valid_Condition_Determination/OBC_Temp_Valid/Hysteretic_Determination"
 /begin REF_CHARACTERISTIC CcTHM_ObcCellTempHighThreshold_C CcTHM_ObcChargeTempRequestHysterTemp_C /end REF_CHARACTERISTIC
/end GROUP
/begin GROUP S1612_SOC_Hysteretic_Determination "VBU0513/VBUSystem/BMS/THM/Subsystem/Subsystem/Valid_Condition_Determination/OBC_Temp_Valid/SOC_Hysteretic_Determination" /begin REF_CHARACTERISTIC CcTHM_ObcChargeHysterSOC_pct CcTHM_ObcSocHighThreshold_pct /end REF_CHARACTERISTIC /end GROUP
/begin GROUP S1637_LOW_HIGH1 "VBU0513/VBUSystem/BMS/VCT/Subsystem/Subsystem/Determine_BMS_VCU_267/Override/LOW_HIGH1" /begin REF_MEASUREMENT VCT_uBMSDCChrgVoltageReq /end REF_MEASUREMENT /end GROUP
/begin GROUP S1637_LOW_HIGH17 "VBU0513/VBUSystem/BMS/VCT/Subsystem/Subsystem/Determine_BMS_VCU_267/Override/LOW_HIGH17" /begin REF_MEASUREMENT VCT_iABMSDCChrgCrntReq /end REF_MEASUREMENT /end GROUP
/begin GROUP S1637_LOW_HIGH2 "VBU0513/VBUSystem/BMS/VCT/Subsystem/Subsystem/Determine_BMS_VCU_267/Override/LOW_HIGH2" /begin REF_MEASUREMENT VCT_iABMSChgCurrentLimit /end REF_MEASUREMENT /end GROUP
/begin GROUP S1637_LOW_HIGH3 "VBU0513/VBUSystem/BMS/VCT/Subsystem/Subsystem/Determine_BMS_VCU_267/Override/LOW_HIGH3" /begin REF_MEASUREMENT VCT_kwhBMSPackEnergyAvailable /end REF_MEASUREMENT /end GROUP
/begin GROUP S1637_LOW_HIGH4 "VBU0513/VBUSystem/BMS/VCT/Subsystem/Subsystem/Determine_BMS_VCU_267/Override/LOW_HIGH4" /begin REF_MEASUREMENT VCT_stDCChargeMode /end REF_MEASUREMENT /end GROUP
/begin GROUP S1637_LOW_HIGH5 "VBU0513/VBUSystem/BMS/VCT/Subsystem/Subsystem/Determine_BMS_VCU_267/Override/LOW_HIGH5" /begin REF_MEASUREMENT VCT_stCTMCellThermalRunaway /end REF_MEASUREMENT /end GROUP
/begin GROUP S1637_LOW_HIGH7 "VBU0513/VBUSystem/BMS/VCT/Subsystem/Subsystem/Determine_BMS_VCU_267/Override/LOW_HIGH7" /begin REF_MEASUREMENT VCT_flgCTMCellThermalRunawayFaultValid /end REF_MEASUREMENT /end GROUP
/begin GROUP S1646_LOW_HIGH1 "VBU0513/VBUSystem/BMS/VCT/Subsystem/Subsystem/Determine_BMS_VCU_268/Override/LOW_HIGH1" /begin REF_MEASUREMENT VCT_kwBMSDischgPowerLimitST /end REF_MEASUREMENT /end GROUP
/begin GROUP S1646_LOW_HIGH14 "VBU0513/VBUSystem/BMS/VCT/Subsystem/Subsystem/Determine_BMS_VCU_268/Override/LOW_HIGH14" /begin REF_MEASUREMENT VCT_kwBMSDischgPowerLimitLT /end REF_MEASUREMENT /end GROUP
/begin GROUP S1646_LOW_HIGH2 "VBU0513/VBUSystem/BMS/VCT/Subsystem/Subsystem/Determine_BMS_VCU_268/Override/LOW_HIGH2" /begin REF_MEASUREMENT VCT_kwBMSDischgPowerLimitDynamic /end REF_MEASUREMENT /end GROUP
/begin GROUP S1646_LOW_HIGH3 "VBU0513/VBUSystem/BMS/VCT/Subsystem/Subsystem/Determine_BMS_VCU_268/Override/LOW_HIGH3" /begin REF_MEASUREMENT VCT_kohmBMSInsulationResistanceValue /end REF_MEASUREMENT /end GROUP
/begin GROUP S1654_LOW_HIGH1 "VBU0513/VBUSystem/BMS/VCT/Subsystem/Subsystem/Determine_BMS_VCU_269/Override/LOW_HIGH1" /begin REF_MEASUREMENT VCT_uBMSCellVoltageMin /end REF_MEASUREMENT /end GROUP
/begin GROUP S1654_LOW_HIGH17 "VBU0513/VBUSystem/BMS/VCT/Subsystem/Subsystem/Determine_BMS_VCU_269/Override/LOW_HIGH17" /begin REF_MEASUREMENT VCT_uBMSCellVoltageMax /end REF_MEASUREMENT /end GROUP
/begin GROUP S1654_LOW_HIGH2 "VBU0513/VBUSystem/BMS/VCT/Subsystem/Subsystem/Determine_BMS_VCU_269/Override/LOW_HIGH2" /begin REF_MEASUREMENT VCT_timinBMSEstimateChargingTime /end REF_MEASUREMENT /end GROUP
/begin GROUP S1654_LOW_HIGH3 "VBU0513/VBUSystem/BMS/VCT/Subsystem/Subsystem/Determine_BMS_VCU_269/Override/LOW_HIGH3" /begin REF_MEASUREMENT VCT_uBMSCellVoltageAve /end REF_MEASUREMENT /end GROUP
/begin GROUP S1654_LOW_HIGH4 "VBU0513/VBUSystem/BMS/VCT/Subsystem/Subsystem/Determine_BMS_VCU_269/Override/LOW_HIGH4" /begin REF_MEASUREMENT VCT_flgBMSCellVoltageMaxValidity /end REF_MEASUREMENT /end GROUP
/begin GROUP S1654_LOW_HIGH5 "VBU0513/VBUSystem/BMS/VCT/Subsystem/Subsystem/Determine_BMS_VCU_269/Override/LOW_HIGH5" /begin REF_MEASUREMENT VCT_flgBMSCellVoltageAveValidity /end REF_MEASUREMENT /end GROUP
/begin GROUP S1654_LOW_HIGH6 "VBU0513/VBUSystem/BMS/VCT/Subsystem/Subsystem/Determine_BMS_VCU_269/Override/LOW_HIGH6" /begin REF_MEASUREMENT VCT_flgBMSCellVoltageMinValidity /end REF_MEASUREMENT /end GROUP
/begin GROUP S1662_LOW_HIGH1 "VBU0513/VBUSystem/BMS/VCT/Subsystem/Subsystem/Determine_BMS_VCU_26A/Override/LOW_HIGH1" /begin REF_MEASUREMENT VCT_kwBMSChgPowerLimitLT /end REF_MEASUREMENT /end GROUP
/begin GROUP S1662_LOW_HIGH14 "VBU0513/VBUSystem/BMS/VCT/Subsystem/Subsystem/Determine_BMS_VCU_26A/Override/LOW_HIGH14" /begin REF_MEASUREMENT VCT_kwBMSChgPowerLimitST /end REF_MEASUREMENT /end GROUP
/begin GROUP S1662_LOW_HIGH2 "VBU0513/VBUSystem/BMS/VCT/Subsystem/Subsystem/Determine_BMS_VCU_26A/Override/LOW_HIGH2" /begin REF_MEASUREMENT VCT_kwBMSChgPowerLimitDynamic /end REF_MEASUREMENT /end GROUP
/begin GROUP S1662_LOW_HIGH3 "VBU0513/VBUSystem/BMS/VCT/Subsystem/Subsystem/Determine_BMS_VCU_26A/Override/LOW_HIGH3" /begin REF_MEASUREMENT VCT_timinEstimatePercTime /end REF_MEASUREMENT /end GROUP
/begin GROUP S1667_LOW_HIGH1 "VBU0513/VBUSystem/BMS/VCT/Subsystem/Subsystem/Determine_BMS_VCU_26F/Override/LOW_HIGH1" /begin REF_MEASUREMENT VCT_stBMSBatteryType /end REF_MEASUREMENT /end GROUP
/begin GROUP S1667_LOW_HIGH14 "VBU0513/VBUSystem/BMS/VCT/Subsystem/Subsystem/Determine_BMS_VCU_26F/Override/LOW_HIGH14" /begin REF_MEASUREMENT VCT_numBMSProtocalVersion /end REF_MEASUREMENT /end GROUP
/begin GROUP S1667_LOW_HIGH2 "VBU0513/VBUSystem/BMS/VCT/Subsystem/Subsystem/Determine_BMS_VCU_26F/Override/LOW_HIGH2" /begin REF_MEASUREMENT VCT_uBMSMaxPermitDCChargeVoltage /end REF_MEASUREMENT /end GROUP
/begin GROUP S1667_LOW_HIGH3 "VBU0513/VBUSystem/BMS/VCT/Subsystem/Subsystem/Determine_BMS_VCU_26F/Override/LOW_HIGH3" /begin REF_MEASUREMENT VCT_AhBMSBatteryRatedCapacity /end REF_MEASUREMENT /end GROUP
/begin GROUP S1673_LOW_HIGH1 "VBU0513/VBUSystem/BMS/VCT/Subsystem/Subsystem/Determine_BMS_VCU_270/Override/LOW_HIGH1" /begin REF_MEASUREMENT VCT_stBMSReadyDCCharging /end REF_MEASUREMENT /end GROUP
/begin GROUP S1673_LOW_HIGH14 "VBU0513/VBUSystem/BMS/VCT/Subsystem/Subsystem/Determine_BMS_VCU_270/Override/LOW_HIGH14" /begin REF_MEASUREMENT VCT_uBMSBatteryRatedVoltage /end REF_MEASUREMENT /end GROUP
/begin GROUP S1673_LOW_HIGH2 "VBU0513/VBUSystem/BMS/VCT/Subsystem/Subsystem/Determine_BMS_VCU_270/Override/LOW_HIGH2" /begin REF_MEASUREMENT VCT_iABMSDCChargingCurrentMeasurement /end REF_MEASUREMENT /end GROUP
/begin GROUP S1673_LOW_HIGH3 "VBU0513/VBUSystem/BMS/VCT/Subsystem/Subsystem/Determine_BMS_VCU_270/Override/LOW_HIGH3" /begin REF_MEASUREMENT VCT_uBMSDCChargingVoltageMeasurement /end REF_MEASUREMENT /end GROUP
/begin GROUP S1678_LOW_HIGH1 "VBU0513/VBUSystem/BMS/VCT/Subsystem/Subsystem/Determine_BMS_VCU_271/Override/LOW_HIGH1" /begin REF_MEASUREMENT VCT_numBMSMaximumTempNumber /end REF_MEASUREMENT /end GROUP
/begin GROUP S1678_LOW_HIGH14 "VBU0513/VBUSystem/BMS/VCT/Subsystem/Subsystem/Determine_BMS_VCU_271/Override/LOW_HIGH14" /begin REF_MEASUREMENT VCT_numBMSMaximumCellVoltageNumber /end REF_MEASUREMENT /end GROUP
/begin GROUP S1678_LOW_HIGH2 "VBU0513/VBUSystem/BMS/VCT/Subsystem/Subsystem/Determine_BMS_VCU_271/Override/LOW_HIGH2" /begin REF_MEASUREMENT VCT_numBMSMinimumTempNumber /end REF_MEASUREMENT /end GROUP
/begin GROUP S1678_LOW_HIGH3 "VBU0513/VBUSystem/BMS/VCT/Subsystem/Subsystem/Determine_BMS_VCU_271/Override/LOW_HIGH3" /begin REF_MEASUREMENT VCT_tBMSMaximumCellTemp /end REF_MEASUREMENT /end GROUP
/begin GROUP S1678_LOW_HIGH4 "VBU0513/VBUSystem/BMS/VCT/Subsystem/Subsystem/Determine_BMS_VCU_271/Override/LOW_HIGH4" /begin REF_MEASUREMENT VCT_tBMSMinimumCellTemp /end REF_MEASUREMENT /end GROUP
/begin GROUP S1678_LOW_HIGH5 "VBU0513/VBUSystem/BMS/VCT/Subsystem/Subsystem/Determine_BMS_VCU_271/Override/LOW_HIGH5" /begin REF_MEASUREMENT VCT_pctBMSDCChrgFinalSOC /end REF_MEASUREMENT /end GROUP
/begin GROUP S1686_LOW_HIGH1 "VBU0513/VBUSystem/BMS/VCT/Subsystem/Subsystem/Determine_BMS_VCU_272/Override/LOW_HIGH1" /begin REF_MEASUREMENT VCT_stBMSSOCOverUnder /end REF_MEASUREMENT /end GROUP
/begin GROUP S1686_LOW_HIGH10 "VBU0513/VBUSystem/BMS/VCT/Subsystem/Subsystem/Determine_BMS_VCU_272/Override/LOW_HIGH10" /begin REF_MEASUREMENT VCT_stBatteryTempDifferAlarm /end REF_MEASUREMENT /end GROUP
/begin GROUP S1686_LOW_HIGH11 "VBU0513/VBUSystem/BMS/VCT/Subsystem/Subsystem/Determine_BMS_VCU_272/Override/LOW_HIGH11" /begin REF_MEASUREMENT VCT_stBetteryCellTempHighAlarm /end REF_MEASUREMENT /end GROUP
/begin GROUP S1686_LOW_HIGH12 "VBU0513/VBUSystem/BMS/VCT/Subsystem/Subsystem/Determine_BMS_VCU_272/Override/LOW_HIGH12" /begin REF_MEASUREMENT VCT_stBetteryCellTempLowAlarm /end REF_MEASUREMENT /end GROUP
/begin GROUP S1686_LOW_HIGH13 "VBU0513/VBUSystem/BMS/VCT/Subsystem/Subsystem/Determine_BMS_VCU_272/Override/LOW_HIGH13" /begin REF_MEASUREMENT VCT_stSOCJumpReason /end REF_MEASUREMENT /end GROUP
/begin GROUP S1686_LOW_HIGH14 "VBU0513/VBUSystem/BMS/VCT/Subsystem/Subsystem/Determine_BMS_VCU_272/Override/LOW_HIGH14" /begin REF_MEASUREMENT VCT_stBatteryTypeDismatchAlarm /end REF_MEASUREMENT /end GROUP
/begin GROUP S1686_LOW_HIGH16 "VBU0513/VBUSystem/BMS/VCT/Subsystem/Subsystem/Determine_BMS_VCU_272/Override/LOW_HIGH16" /begin REF_MEASUREMENT VCT_stBetteryCellVolLowAlarm /end REF_MEASUREMENT /end GROUP
/begin GROUP S1686_LOW_HIGH17 "VBU0513/VBUSystem/BMS/VCT/Subsystem/Subsystem/Determine_BMS_VCU_272/Override/LOW_HIGH17" /begin REF_MEASUREMENT VCT_stSOCJumpAlarm /end REF_MEASUREMENT /end GROUP
/begin GROUP S1686_LOW_HIGH18 "VBU0513/VBUSystem/BMS/VCT/Subsystem/Subsystem/Determine_BMS_VCU_272/Override/LOW_HIGH18" /begin REF_MEASUREMENT VCT_stBetteryCellVolHighAlarm /end REF_MEASUREMENT /end GROUP
/begin GROUP S1686_LOW_HIGH2 "VBU0513/VBUSystem/BMS/VCT/Subsystem/Subsystem/Determine_BMS_VCU_272/Override/LOW_HIGH2" /begin REF_MEASUREMENT VCT_stBMSDCChargeCurrentOverUnder /end REF_MEASUREMENT /end GROUP
/begin GROUP S1686_LOW_HIGH3 "VBU0513/VBUSystem/BMS/VCT/Subsystem/Subsystem/Determine_BMS_VCU_272/Override/LOW_HIGH3" /begin REF_MEASUREMENT VCT_stBMSCellVoltageOverUnder /end REF_MEASUREMENT /end GROUP
/begin GROUP S1686_LOW_HIGH4 "VBU0513/VBUSystem/BMS/VCT/Subsystem/Subsystem/Determine_BMS_VCU_272/Override/LOW_HIGH4" /begin REF_MEASUREMENT VCT_stBatteryTempOver /end REF_MEASUREMENT /end GROUP
/begin GROUP S1686_LOW_HIGH5 "VBU0513/VBUSystem/BMS/VCT/Subsystem/Subsystem/Determine_BMS_VCU_272/Override/LOW_HIGH5" /begin REF_MEASUREMENT VCT_stBatteryOutputConnectorState /end REF_MEASUREMENT /end GROUP
/begin GROUP S1686_LOW_HIGH6 "VBU0513/VBUSystem/BMS/VCT/Subsystem/Subsystem/Determine_BMS_VCU_272/Override/LOW_HIGH6" /begin REF_MEASUREMENT VCT_stDCChargingPermitStatus /end REF_MEASUREMENT /end GROUP
/begin GROUP S1686_LOW_HIGH7 "VBU0513/VBUSystem/BMS/VCT/Subsystem/Subsystem/Determine_BMS_VCU_272/Override/LOW_HIGH7" /begin REF_MEASUREMENT VCT_stBetteryPckVoltUnderAlarm /end REF_MEASUREMENT /end GROUP
/begin GROUP S1686_LOW_HIGH8 "VBU0513/VBUSystem/BMS/VCT/Subsystem/Subsystem/Determine_BMS_VCU_272/Override/LOW_HIGH8" /begin REF_MEASUREMENT VCT_stBatteryConsistencyAlarm /end REF_MEASUREMENT /end GROUP
/begin GROUP S1686_LOW_HIGH9 "VBU0513/VBUSystem/BMS/VCT/Subsystem/Subsystem/Determine_BMS_VCU_272/Override/LOW_HIGH9" /begin REF_MEASUREMENT VCT_stBetteryPckVoltOverAlarm /end REF_MEASUREMENT /end GROUP
/begin GROUP S1731_LOW_HIGH1 "VBU0513/VBUSystem/BMS/VCT/Subsystem/Subsystem/Determine_BMS_VCU_273/Override/LOW_HIGH1" /begin REF_MEASUREMENT VCT_numBMSMaxTempSubSysNumber /end REF_MEASUREMENT /end GROUP
/begin GROUP S1731_LOW_HIGH2 "VBU0513/VBUSystem/BMS/VCT/Subsystem/Subsystem/Determine_BMS_VCU_273/Override/LOW_HIGH2" /begin REF_MEASUREMENT VCT_numBMSMinTempSubSysNumber /end REF_MEASUREMENT /end GROUP
/begin GROUP S1731_LOW_HIGH3 "VBU0513/VBUSystem/BMS/VCT/Subsystem/Subsystem/Determine_BMS_VCU_273/Override/LOW_HIGH3" /begin REF_MEASUREMENT VCT_numBMSMaxVoltageSubSysNumber /end REF_MEASUREMENT /end GROUP
/begin GROUP S1731_LOW_HIGH4 "VBU0513/VBUSystem/BMS/VCT/Subsystem/Subsystem/Determine_BMS_VCU_273/Override/LOW_HIGH4" /begin REF_MEASUREMENT VCT_numBMSMinimumCellVoltageNumber /end REF_MEASUREMENT /end GROUP
/begin GROUP S1731_LOW_HIGH5 "VBU0513/VBUSystem/BMS/VCT/Subsystem/Subsystem/Determine_BMS_VCU_273/Override/LOW_HIGH5" /begin REF_MEASUREMENT VCT_numBMSMinVoltageSubSysNumber /end REF_MEASUREMENT /end GROUP
/begin GROUP S1742_LOW_HIGH1 "VBU0513/VBUSystem/BMS/VCT/Subsystem/Subsystem/Determine_BMS_VCU_34/Override/LOW_HIGH1" /begin REF_MEASUREMENT VCT_stInhibitPrechargeCause /end REF_MEASUREMENT /end GROUP
/begin GROUP S1742_LOW_HIGH2 "VBU0513/VBUSystem/BMS/VCT/Subsystem/Subsystem/Determine_BMS_VCU_34/Override/LOW_HIGH2" /begin REF_MEASUREMENT VCT_stBMSContactorState /end REF_MEASUREMENT /end GROUP
/begin GROUP S1742_LOW_HIGH3 "VBU0513/VBUSystem/BMS/VCT/Subsystem/Subsystem/Determine_BMS_VCU_34/Override/LOW_HIGH3" /begin REF_MEASUREMENT VCT_stBMSSts /end REF_MEASUREMENT /end GROUP
/begin GROUP S1742_LOW_HIGH5 "VBU0513/VBUSystem/BMS/VCT/Subsystem/Subsystem/Determine_BMS_VCU_34/Override/LOW_HIGH5" /begin REF_MEASUREMENT VCT_numBMSRollingCounterAF /end REF_MEASUREMENT /end GROUP
/begin GROUP S1748_LOW_HIGH1 "VBU0513/VBUSystem/BMS/VCT/Subsystem/Subsystem/Determine_BMS_VCU_372/Override/LOW_HIGH1" /begin REF_MEASUREMENT VCT_kWhBatteryNomalCapacity /end REF_MEASUREMENT /end GROUP
/begin GROUP S1748_LOW_HIGH16 "VBU0513/VBUSystem/BMS/VCT/Subsystem/Subsystem/Determine_BMS_VCU_372/Override/LOW_HIGH16" /begin REF_MEASUREMENT VCT_iAMaximumChargingCurrent /end REF_MEASUREMENT /end GROUP
/begin GROUP S1748_LOW_HIGH2 "VBU0513/VBUSystem/BMS/VCT/Subsystem/Subsystem/Determine_BMS_VCU_372/Override/LOW_HIGH2" /begin REF_MEASUREMENT VCT_uMaximumChargingVoltage /end REF_MEASUREMENT /end GROUP
/begin GROUP S1748_LOW_HIGH3 "VBU0513/VBUSystem/BMS/VCT/Subsystem/Subsystem/Determine_BMS_VCU_372/Override/LOW_HIGH3" /begin REF_MEASUREMENT VCT_tMaximumPermitTemp /end REF_MEASUREMENT /end GROUP
/begin GROUP S1748_LOW_HIGH4 "VBU0513/VBUSystem/BMS/VCT/Subsystem/Subsystem/Determine_BMS_VCU_372/Override/LOW_HIGH4" /begin REF_MEASUREMENT VCT_HVBattStopDchaThd_pct /end REF_MEASUREMENT /end GROUP
/begin GROUP S1757_LOW_HIGH1 "VBU0513/VBUSystem/BMS/VCT/Subsystem/Subsystem/Determine_BMS_VCU_373/Override/LOW_HIGH1" /begin REF_MEASUREMENT VCT_tBMSTemperatureMin /end REF_MEASUREMENT /end GROUP
/begin GROUP S1757_LOW_HIGH10 "VBU0513/VBUSystem/BMS/VCT/Subsystem/Subsystem/Determine_BMS_VCU_373/Override/LOW_HIGH10" /begin REF_MEASUREMENT VCT_flgBMSTempMaxValidity /end REF_MEASUREMENT /end GROUP
/begin GROUP S1757_LOW_HIGH11 "VBU0513/VBUSystem/BMS/VCT/Subsystem/Subsystem/Determine_BMS_VCU_373/Override/LOW_HIGH11" /begin REF_MEASUREMENT VCT_flgBMSTempAverageValidity /end REF_MEASUREMENT /end GROUP
/begin GROUP S1757_LOW_HIGH12 "VBU0513/VBUSystem/BMS/VCT/Subsystem/Subsystem/Determine_BMS_VCU_373/Override/LOW_HIGH12" /begin REF_MEASUREMENT VCT_flgBMSTempMinValidity /end REF_MEASUREMENT /end GROUP
/begin GROUP S1757_LOW_HIGH13 "VBU0513/VBUSystem/BMS/VCT/Subsystem/Subsystem/Determine_BMS_VCU_373/Override/LOW_HIGH13" /begin REF_MEASUREMENT VCT_tBMSCellTempStandardDeviation /end REF_MEASUREMENT /end GROUP
/begin GROUP S1757_LOW_HIGH14 "VBU0513/VBUSystem/BMS/VCT/Subsystem/Subsystem/Determine_BMS_VCU_373/Override/LOW_HIGH14" /begin REF_MEASUREMENT VCT_tBMSInletTempRequest /end REF_MEASUREMENT /end GROUP
/begin GROUP S1757_LOW_HIGH15 "VBU0513/VBUSystem/BMS/VCT/Subsystem/Subsystem/Determine_BMS_VCU_373/Override/LOW_HIGH15" /begin REF_MEASUREMENT VCT_flgBMSTempRequestValid /end REF_MEASUREMENT /end GROUP
/begin GROUP S1757_LOW_HIGH17 "VBU0513/VBUSystem/BMS/VCT/Subsystem/Subsystem/Determine_BMS_VCU_373/Override/LOW_HIGH17" /begin REF_MEASUREMENT VCT_tBMSTemperatureMax /end REF_MEASUREMENT /end GROUP
/begin GROUP S1757_LOW_HIGH2 "VBU0513/VBUSystem/BMS/VCT/Subsystem/Subsystem/Determine_BMS_VCU_373/Override/LOW_HIGH2" /begin REF_MEASUREMENT VCT_tBMSInletWaterTemp /end REF_MEASUREMENT /end GROUP
/begin GROUP S1757_LOW_HIGH3 "VBU0513/VBUSystem/BMS/VCT/Subsystem/Subsystem/Determine_BMS_VCU_373/Override/LOW_HIGH3" /begin REF_MEASUREMENT VCT_tBMSOutletWaterTemp /end REF_MEASUREMENT /end GROUP
/begin GROUP S1757_LOW_HIGH4 "VBU0513/VBUSystem/BMS/VCT/Subsystem/Subsystem/Determine_BMS_VCU_373/Override/LOW_HIGH4" /begin REF_MEASUREMENT VCT_flgBMSESSInletTempMask /end REF_MEASUREMENT /end GROUP
/begin GROUP S1757_LOW_HIGH5 "VBU0513/VBUSystem/BMS/VCT/Subsystem/Subsystem/Determine_BMS_VCU_373/Override/LOW_HIGH5" /begin REF_MEASUREMENT VCT_tBMSTemperatureAverage /end REF_MEASUREMENT /end GROUP
/begin GROUP S1757_LOW_HIGH6 "VBU0513/VBUSystem/BMS/VCT/Subsystem/Subsystem/Determine_BMS_VCU_373/Override/LOW_HIGH6" /begin REF_MEASUREMENT VCT_flgBMSESSOutletTempMask /end REF_MEASUREMENT /end GROUP
/begin GROUP S1757_LOW_HIGH7 "VBU0513/VBUSystem/BMS/VCT/Subsystem/Subsystem/Determine_BMS_VCU_373/Override/LOW_HIGH7" /begin REF_MEASUREMENT VCT_flgBMSHVShutdownReq /end REF_MEASUREMENT /end GROUP
/begin GROUP S1757_LOW_HIGH8 "VBU0513/VBUSystem/BMS/VCT/Subsystem/Subsystem/Determine_BMS_VCU_373/Override/LOW_HIGH8" /begin REF_MEASUREMENT VCT_flgBMSESSInletTempValidity /end REF_MEASUREMENT /end GROUP
/begin GROUP S1757_LOW_HIGH9 "VBU0513/VBUSystem/BMS/VCT/Subsystem/Subsystem/Determine_BMS_VCU_373/Override/LOW_HIGH9" /begin REF_MEASUREMENT VCT_flgBMSESSOutletTempValidity /end REF_MEASUREMENT /end GROUP
/begin GROUP S1776_LOW_HIGH1 "VBU0513/VBUSystem/BMS/VCT/Subsystem/Subsystem/Determine_BMS_VCU_AC/Override/LOW_HIGH1" /begin REF_MEASUREMENT VCT_stBMSFaultCat /end REF_MEASUREMENT /end GROUP
/begin GROUP S1776_LOW_HIGH10 "VBU0513/VBUSystem/BMS/VCT/Subsystem/Subsystem/Determine_BMS_VCU_AC/Override/LOW_HIGH10" /begin REF_MEASUREMENT VCT_pctBMSCustomerUsageSOC /end REF_MEASUREMENT /end GROUP
/begin GROUP S1776_LOW_HIGH17 "VBU0513/VBUSystem/BMS/VCT/Subsystem/Subsystem/Determine_BMS_VCU_AC/Override/LOW_HIGH17" /begin REF_MEASUREMENT VCT_iABMSPackCrnt /end REF_MEASUREMENT /end GROUP
/begin GROUP S1776_LOW_HIGH2 "VBU0513/VBUSystem/BMS/VCT/Subsystem/Subsystem/Determine_BMS_VCU_AC/Override/LOW_HIGH2" /begin REF_MEASUREMENT VCT_stBMSFaultLvl /end REF_MEASUREMENT /end GROUP
/begin GROUP S1776_LOW_HIGH3 "VBU0513/VBUSystem/BMS/VCT/Subsystem/Subsystem/Determine_BMS_VCU_AC/Override/LOW_HIGH3" /begin REF_MEASUREMENT VCT_uBMSPackVoltage /end REF_MEASUREMENT /end GROUP
/begin GROUP S1776_LOW_HIGH4 "VBU0513/VBUSystem/BMS/VCT/Subsystem/Subsystem/Determine_BMS_VCU_AC/Override/LOW_HIGH4" /begin REF_MEASUREMENT VCT_pctBMSSOC /end REF_MEASUREMENT /end GROUP
/begin GROUP S1776_LOW_HIGH5 "VBU0513/VBUSystem/BMS/VCT/Subsystem/Subsystem/Determine_BMS_VCU_AC/Override/LOW_HIGH5" /begin REF_MEASUREMENT VCT_flgHVBattSOCLowCrit /end REF_MEASUREMENT /end GROUP
/begin GROUP S1776_LOW_HIGH7 "VBU0513/VBUSystem/BMS/VCT/Subsystem/Subsystem/Determine_BMS_VCU_AC/Override/LOW_HIGH7" /begin REF_MEASUREMENT VCT_flgChargeAvailable /end REF_MEASUREMENT /end GROUP
/begin GROUP S1776_LOW_HIGH8 "VBU0513/VBUSystem/BMS/VCT/Subsystem/Subsystem/Determine_BMS_VCU_AC/Override/LOW_HIGH8" /begin REF_MEASUREMENT VCT_numBMSRollingCounter225 /end REF_MEASUREMENT /end GROUP
/begin GROUP S1776_LOW_HIGH9 "VBU0513/VBUSystem/BMS/VCT/Subsystem/Subsystem/Determine_BMS_VCU_AC/Override/LOW_HIGH9" /begin REF_MEASUREMENT VCT_flgHVBattSOCLowWarn /end REF_MEASUREMENT /end GROUP
/begin GROUP S1789_LOW_HIGH17 "VBU0513/VBUSystem/BMS/VCT/Subsystem/Subsystem/Determine_BMS_VCU_AD/Override/LOW_HIGH17" /begin REF_MEASUREMENT VCT_iABMSDischgCurrentLimit /end REF_MEASUREMENT /end GROUP
/begin GROUP S1789_LOW_HIGH2 "VBU0513/VBUSystem/BMS/VCT/Subsystem/Subsystem/Determine_BMS_VCU_AD/Override/LOW_HIGH2" /begin REF_MEASUREMENT VCT_flgBMSBalanceStatus /end REF_MEASUREMENT /end GROUP
/begin GROUP S1789_LOW_HIGH3 "VBU0513/VBUSystem/BMS/VCT/Subsystem/Subsystem/Determine_BMS_VCU_AD/Override/LOW_HIGH3" /begin REF_MEASUREMENT VCT_uBMSVoltageLimitMax /end REF_MEASUREMENT /end GROUP
/begin GROUP S1789_LOW_HIGH4 "VBU0513/VBUSystem/BMS/VCT/Subsystem/Subsystem/Determine_BMS_VCU_AD/Override/LOW_HIGH4" /begin REF_MEASUREMENT VCT_stBMSIsolationLevel /end REF_MEASUREMENT /end GROUP
/begin GROUP S1789_LOW_HIGH5 "VBU0513/VBUSystem/BMS/VCT/Subsystem/Subsystem/Determine_BMS_VCU_AD/Override/LOW_HIGH5" /begin REF_MEASUREMENT VCT_stBMSChargeState /end REF_MEASUREMENT /end GROUP
/begin GROUP S1789_LOW_HIGH6 "VBU0513/VBUSystem/BMS/VCT/Subsystem/Subsystem/Determine_BMS_VCU_AD/Override/LOW_HIGH6" /begin REF_MEASUREMENT VCT_uBMSVoltageLimitMin /end REF_MEASUREMENT /end GROUP
/begin GROUP S1789_LOW_HIGH7 "VBU0513/VBUSystem/BMS/VCT/Subsystem/Subsystem/Determine_BMS_VCU_AD/Override/LOW_HIGH7" /begin REF_MEASUREMENT VCT_flgChargeCurrentDerate /end REF_MEASUREMENT /end GROUP
/begin GROUP S1801_LOW_HIGH1 "VBU0513/VBUSystem/BMS/VCT/Subsystem/Subsystem/Determine_BMS_VCU_AE/Override/LOW_HIGH1" /begin REF_MEASUREMENT VCT_stBMSIfPackVoltageSet /end REF_MEASUREMENT /end GROUP
/begin GROUP S1801_LOW_HIGH10 "VBU0513/VBUSystem/BMS/VCT/Subsystem/Subsystem/Determine_BMS_VCU_AE/Override/LOW_HIGH10" /begin REF_MEASUREMENT VCT_stBMSOverCurrent /end REF_MEASUREMENT /end GROUP
/begin GROUP S1801_LOW_HIGH11 "VBU0513/VBUSystem/BMS/VCT/Subsystem/Subsystem/Determine_BMS_VCU_AE/Override/LOW_HIGH11" /begin REF_MEASUREMENT VCT_uMaximumPermitChargeCellVoltage /end REF_MEASUREMENT /end GROUP
/begin GROUP S1801_LOW_HIGH12 "VBU0513/VBUSystem/BMS/VCT/Subsystem/Subsystem/Determine_BMS_VCU_AE/Override/LOW_HIGH12" /begin REF_MEASUREMENT VCT_stBMSVolMismatch /end REF_MEASUREMENT /end GROUP
/begin GROUP S1801_LOW_HIGH17 "VBU0513/VBUSystem/BMS/VCT/Subsystem/Subsystem/Determine_BMS_VCU_AE/Override/LOW_HIGH17" /begin REF_MEASUREMENT VCT_stBMSIfBmsSocSet /end REF_MEASUREMENT /end GROUP
/begin GROUP S1801_LOW_HIGH2 "VBU0513/VBUSystem/BMS/VCT/Subsystem/Subsystem/Determine_BMS_VCU_AE/Override/LOW_HIGH2" /begin REF_MEASUREMENT VCT_stBMSIfCellVoltageSet /end REF_MEASUREMENT /end GROUP
/begin GROUP S1801_LOW_HIGH3 "VBU0513/VBUSystem/BMS/VCT/Subsystem/Subsystem/Determine_BMS_VCU_AE/Override/LOW_HIGH3" /begin REF_MEASUREMENT VCT_stBMSHvIsolation /end REF_MEASUREMENT /end GROUP
/begin GROUP S1801_LOW_HIGH4 "VBU0513/VBUSystem/BMS/VCT/Subsystem/Subsystem/Determine_BMS_VCU_AE/Override/LOW_HIGH4" /begin REF_MEASUREMENT VCT_stBMSConnectorOvertemp /end REF_MEASUREMENT /end GROUP
/begin GROUP S1801_LOW_HIGH5 "VBU0513/VBUSystem/BMS/VCT/Subsystem/Subsystem/Determine_BMS_VCU_AE/Override/LOW_HIGH5" /begin REF_MEASUREMENT VCT_stBMSChrgConnError /end REF_MEASUREMENT /end GROUP
/begin GROUP S1801_LOW_HIGH6 "VBU0513/VBUSystem/BMS/VCT/Subsystem/Subsystem/Determine_BMS_VCU_AE/Override/LOW_HIGH6" /begin REF_MEASUREMENT VCT_stBMSChrgConnOvertemp /end REF_MEASUREMENT /end GROUP
/begin GROUP S1801_LOW_HIGH7 "VBU0513/VBUSystem/BMS/VCT/Subsystem/Subsystem/Determine_BMS_VCU_AE/Override/LOW_HIGH7" /begin REF_MEASUREMENT VCT_stBMSPackOverTemp /end REF_MEASUREMENT /end GROUP
/begin GROUP S1801_LOW_HIGH8 "VBU0513/VBUSystem/BMS/VCT/Subsystem/Subsystem/Determine_BMS_VCU_AE/Override/LOW_HIGH8" /begin REF_MEASUREMENT VCT_stBMSHvConectorError /end REF_MEASUREMENT /end GROUP
/begin GROUP S1801_LOW_HIGH9 "VBU0513/VBUSystem/BMS/VCT/Subsystem/Subsystem/Determine_BMS_VCU_AE/Override/LOW_HIGH9" /begin REF_MEASUREMENT VCT_stBMSOtherError /end REF_MEASUREMENT /end GROUP
/begin GROUP S2103_override_signal "VBU0513/VBUSystem/HALIn/PTCAN/Subsystem/20ms/ABS_0x79/Input_CAN_Signal_No_Range_Check/override_signal" /begin REF_MEASUREMENT BCU_vWhlRL /end REF_MEASUREMENT /end GROUP
/begin GROUP S2105_override_signal "VBU0513/VBUSystem/HALIn/PTCAN/Subsystem/20ms/ABS_0x79/Input_CAN_Signal_No_Range_Check2/override_signal" /begin REF_MEASUREMENT BCU_vWhlRR /end REF_MEASUREMENT /end GROUP
/begin GROUP S2187_override_signal "VBU0513/VBUSystem/HALIn/PTCAN/Subsystem/20ms/MCU_205/Input_CAN_Signal_No_Range_Check1/override_signal" /begin REF_MEASUREMENT PEUR_flgtrqActVld /end REF_MEASUREMENT /end GROUP
/begin GROUP S2189_override_signal "VBU0513/VBUSystem/HALIn/PTCAN/Subsystem/20ms/MCU_205/Input_CAN_Signal_No_Range_Check3/override_signal" /begin REF_MEASUREMENT PEUR_flgMotrHillHld /end REF_MEASUREMENT /end GROUP
/begin GROUP S2190_override_signal "VBU0513/VBUSystem/HALIn/PTCAN/Subsystem/20ms/MCU_205/Input_CAN_Signal_No_Range_Check4/override_signal" /begin REF_MEASUREMENT PEUR_stActvDisCh /end REF_MEASUREMENT /end GROUP
/begin GROUP S2191_override_signal "VBU0513/VBUSystem/HALIn/PTCAN/Subsystem/20ms/MCU_205/Input_CAN_Signal_No_Range_Check5/override_signal" /begin REF_MEASUREMENT PEUR_nMotr /end REF_MEASUREMENT /end GROUP
/begin GROUP S2193_override_signal "VBU0513/VBUSystem/HALIn/PTCAN/Subsystem/20ms/MCU_205/Input_CAN_Signal_No_Range_Check7/override_signal" /begin REF_MEASUREMENT PEUR_iCalcDC /end REF_MEASUREMENT /end GROUP
/begin GROUP S2281_override_signal "VBU0513/VBUSystem/HALIn/PTCAN/Subsystem/50ms/MCU_305/Input_CAN_Signal_No_Range_Check/override_signal" /begin REF_MEASUREMENT PEUR_uDCRlyOutsideVltg /end REF_MEASUREMENT /end GROUP
/begin GROUP S2418_ABS_VehicleSpeedAndStatus "VBU0513/VBUSystem/HALIn/PTCAN/Subsystem/CanMsgUnpack/MsgRxData_Unpack1/CanRxData_Unpack/ABS_VehicleSpeedAndStatus"
 /begin REF_MEASUREMENT ABS_Active ABS_EBDFailed ABS_Failed ABS_VehicleSpeed ABS_VehicleSpeedValid EBD_Active /end REF_MEASUREMENT
/end GROUP
/begin GROUP S2420_DCDC_VCU_509 "VBU0513/VBUSystem/HALIn/PTCAN/Subsystem/CanMsgUnpack/MsgRxData_Unpack10/CanRxData_Unpack/DCDC_VCU_509"
 /begin REF_MEASUREMENT DCDCDeriting DCDCOverHeat DCDCOverInputCurrent DCDCOverInputVoltage DCDCOverOutputCurrent DCDCOverOutputVoltage DCDCTemperature DCDCUnderInputVoltage DCDCUnderOutputVoltage /end REF_MEASUREMENT
/end GROUP
/begin GROUP S2422_EPB_State "VBU0513/VBUSystem/HALIn/PTCAN/Subsystem/CanMsgUnpack/MsgRxData_Unpack11/CanRxData_Unpack/EPB_State"
 /begin REF_MEASUREMENT CheckSum Communication DragForce EPB_Control_Mode EPB_Fault_Level EPB_Key_Err EPB_Key_Sta EPB_PSensor_Err EPB_SolValve_ErrInd EPB_state IGN Park_LED_Sta Rollingcounter /end REF_MEASUREMENT
/end GROUP
/begin GROUP S2424_EPS_DM1 "VBU0513/VBUSystem/HALIn/PTCAN/Subsystem/CanMsgUnpack/MsgRxData_Unpack12/CanRxData_Unpack/EPS_DM1"
 /begin REF_MEASUREMENT EPS_AMismathcR EPS_ASteeringAngleOutRange EPS_CAN_BUS_OFF EPS_CurrentOverDevition EPS_ECUCaliFail EPS_ECUCurrentSensorInvalid EPS_InvalidSpeed EPS_LVOverVoltage EPS_LVUnderVoltage EPS_MotorCurrentinvalid EPS_MotorDriverCircurtFail EPS_MotorPoSensorFault EPS_PTReadyLostFrame EPS_RSteeringAngleOutRange EPS_RelayFail EPS_SpeedLose EPS_SpeedOut EPS_T1T2Mismatch EPS_T1TorqueOutRange EPS_T2TorqueOutRange EPS_TemOverHigh EPS_TemOverLow EPS_TorqueSensorVoltError /end REF_MEASUREMENT
/end GROUP
/begin GROUP S2426_EPS_FEEDBACK_STA "VBU0513/VBUSystem/HALIn/PTCAN/Subsystem/CanMsgUnpack/MsgRxData_Unpack13/CanRxData_Unpack/EPS_FEEDBACK_STA"
 /begin REF_MEASUREMENT EPS_ECU_MODE_CONT EPS_ECU_msg_counter EPS_Steering_Angle EPS_TORque_Motor EPS_Torque_Steering EPS_steering_angle_spd /end REF_MEASUREMENT
/end GROUP
/begin GROUP S2428_IC_401 "VBU0513/VBUSystem/HALIn/PTCAN/Subsystem/CanMsgUnpack/MsgRxData_Unpack14/CanRxData_Unpack/IC_401"
 /begin REF_MEASUREMENT IC_BrakeDisWarning IC_BrakeFluidWarning IC_SeatbeltUnlock IC_VehOdometer /end REF_MEASUREMENT
/end GROUP
/begin GROUP S2430_MCU_205 "VBU0513/VBUSystem/HALIn/PTCAN/Subsystem/CanMsgUnpack/MsgRxData_Unpack15/CanRxData_Unpack/MCU_205"
 /begin REF_MEASUREMENT MCU_ActiveRelease MCU_CalDCCurrent MCU_MotorHillHold MCU_MotorMode MCU_MotorSpeed MCU_MotorSpeedValid MCU_MotorTorque MCU_checksum MCU_rollingcounter /end REF_MEASUREMENT
/end GROUP
/begin GROUP S2432_MCU_305 "VBU0513/VBUSystem/HALIn/PTCAN/Subsystem/CanMsgUnpack/MsgRxData_Unpack16/CanRxData_Unpack/MCU_305"
 /begin REF_MEASUREMENT MCU_AllowMaxTorque MCU_DCRelayOutSideVoltage MCU_DC_BUSVoltage /end REF_MEASUREMENT
/end GROUP
/begin GROUP S2434_MCU_405 "VBU0513/VBUSystem/HALIn/PTCAN/Subsystem/CanMsgUnpack/MsgRxData_Unpack17/CanRxData_Unpack/MCU_405"
 /begin REF_MEASUREMENT MCU_IGBTMaxTemperature MCU_IPM_Temperature MCU_MotorTemperature MCU_UVWMaxCurrent /end REF_MEASUREMENT
/end GROUP
/begin GROUP S2436_MCU_505 "VBU0513/VBUSystem/HALIn/PTCAN/Subsystem/CanMsgUnpack/MsgRxData_Unpack18/CanRxData_Unpack/MCU_505"
 /begin REF_MEASUREMENT MCU_BusOverVoltage MCU_BusUnderVoltage MCU_CAN_Fault MCU_CPLD_Status MCU_Drive_Downarm_failure MCU_Drive_Uparm_failure MCU_FaultLevel MCU_HallFault MCU_Hardware_OverVoltage MCU_Hardware_UnderVoltage MCU_IGBT_Junction_overTem_limit MCU_IGBT_NTC_overTem_limit MCU_IGBTfault MCU_IGBToverheat MCU_MotorOverheat MCU_Motor_overTem_limit MCU_OutputFault MCU_OverCurrent MCU_OverSpeed MCU_Radiator_overTem_limit MCU_ResolverFault /end REF_MEASUREMENT
/end GROUP
/begin GROUP S2438_T_BOX_510 "VBU0513/VBUSystem/HALIn/PTCAN/Subsystem/CanMsgUnpack/MsgRxData_Unpack19/CanRxData_Unpack/T_BOX_510" /begin REF_MEASUREMENT T_BOXGPS_Latitude T_BOXGPS_Longitude /end REF_MEASUREMENT /end GROUP
/begin GROUP S2440_ABS_WheelSpeed_Front_Whl "VBU0513/VBUSystem/HALIn/PTCAN/Subsystem/CanMsgUnpack/MsgRxData_Unpack2/CanRxData_Unpack/ABS_WheelSpeed_Front_Whl"
 /begin REF_MEASUREMENT ABS_Checksum ABS_Rolling_Counter ABS_WheelSpeed_FL ABS_WheelSpeed_FL_Status ABS_WheelSpeed_FR ABS_WheelSpeed_FR_Status /end REF_MEASUREMENT
/end GROUP
/begin GROUP S2442_T_BOX_511 "VBU0513/VBUSystem/HALIn/PTCAN/Subsystem/CanMsgUnpack/MsgRxData_Unpack20/CanRxData_Unpack/T_BOX_511"
 /begin REF_MEASUREMENT T_BOXTime_Day T_BOXTime_Hour T_BOXTime_Min T_BOXTime_Month T_BOXTime_Sec T_BOXTime_Year /end REF_MEASUREMENT
/end GROUP
/begin GROUP S2444_ABS_WheelSpeed_PulseCounter "VBU0513/VBUSystem/HALIn/PTCAN/Subsystem/CanMsgUnpack/MsgRxData_Unpack3/CanRxData_Unpack/ABS_WheelSpeed_PulseCounter"
 /begin REF_MEASUREMENT ABS_WheelSpeedPlusCounter_FL ABS_WheelSpeedPlusCounter_FL_inv ABS_WheelSpeedPlusCounter_FR ABS_WheelSpeedPlusCounter_FR_inv ABS_WheelSpeedPlusCounter_RL ABS_WheelSpeedPlusCounter_RL_inv ABS_WheelSpeedPlusCounter_RR ABS_WheelSpeedPlusCounter_RR_inv /end REF_MEASUREMENT
/end GROUP
/begin GROUP S2446_ABS_WheelSpeed_Rear_Whl "VBU0513/VBUSystem/HALIn/PTCAN/Subsystem/CanMsgUnpack/MsgRxData_Unpack4/CanRxData_Unpack/ABS_WheelSpeed_Rear_Whl"
 /begin REF_MEASUREMENT ABS_WheelSpeed_RL ABS_WheelSpeed_RL_Status ABS_WheelSpeed_RR ABS_WheelSpeed_RR_Status /end REF_MEASUREMENT
/end GROUP
/begin GROUP S2448_AC_VCU "VBU0513/VBUSystem/HALIn/PTCAN/Subsystem/CanMsgUnpack/MsgRxData_Unpack5/CanRxData_Unpack/AC_VCU"
 /begin REF_MEASUREMENT ACComFault ACCompActSpeed ACCompCurrent ACCompStatus ACCompVoltage ACOverCurrent ACOverVoltage ACOver_current_FreqReduction ACSpeedFault ACStandby_overvoltage ACStandby_undervoltage ACUnderVoltage /end REF_MEASUREMENT
/end GROUP
/begin GROUP S2450_AVAS "VBU0513/VBUSystem/HALIn/PTCAN/Subsystem/CanMsgUnpack/MsgRxData_Unpack6/CanRxData_Unpack/AVAS"
 /begin REF_MEASUREMENT AVAS_HardwareVersion AVAS_SoftwareVersion AVAS_WorkingStatus /end REF_MEASUREMENT
/end GROUP
/begin GROUP S2452_BCM_VCU "VBU0513/VBUSystem/HALIn/PTCAN/Subsystem/CanMsgUnpack/MsgRxData_Unpack7/CanRxData_Unpack/BCM_VCU"
 /begin REF_MEASUREMENT BCM_Automatic_headlight_gear BCM_Automatic_wiper_gear BCM_Brake_Light_Status BCM_Day_Light_Status BCM_DoorStatus BCM_FrontFogLight BCM_HI_Wiper_Status BCM_HighBeam BCM_Horn_Status BCM_IG1_Power BCM_LeftTurnLightStatus BCM_LowBeam BCM_Low_Wiper_Status BCM_Park_Light_Status BCM_Prak_Switch_Status BCM_RearFogLight BCM_Reversing_Switch_Status BCM_RightTurnLightStatus BCM_Wash_Motor_Status /end REF_MEASUREMENT
/end GROUP
/begin GROUP S2454_CDC_VCU "VBU0513/VBUSystem/HALIn/PTCAN/Subsystem/CanMsgUnpack/MsgRxData_Unpack8/CanRxData_Unpack/CDC_VCU"
 /begin REF_MEASUREMENT CDC_CreepOnOff CDC_DriveMode CDC_GoNotifierOnOff CDC_RegenMode CDC_TowMode CDC_checksum CDC_rollingcounter /end REF_MEASUREMENT
/end GROUP
/begin GROUP S2456_DCDC_VCU_303 "VBU0513/VBUSystem/HALIn/PTCAN/Subsystem/CanMsgUnpack/MsgRxData_Unpack9/CanRxData_Unpack/DCDC_VCU_303"
 /begin REF_MEASUREMENT DCDCEnableFeedback DCDCInputCurrent DCDCInputVoltage DCDCOutputCurrent DCDCOutputVoltage DCDCWorkstatus DCDCrollingcounter /end REF_MEASUREMENT
/end GROUP
/begin GROUP S2652_override_signal "VBU0513/VBUSystem/HALIn/PTCAN/Subsystem/Subsystem4/CDC_220/Input_CAN_Signal_No_Range_Check3/override_signal" /begin REF_MEASUREMENT CDC_stRgnMode /end REF_MEASUREMENT /end GROUP
/begin GROUP S2653_override_signal "VBU0513/VBUSystem/HALIn/PTCAN/Subsystem/Subsystem4/CDC_220/Input_CAN_Signal_No_Range_Check4/override_signal" /begin REF_MEASUREMENT CDC_stDrvMode /end REF_MEASUREMENT /end GROUP
/begin GROUP S3256_DCH_BMSChAvlDebounce "VBU0513/VBUSystem/VCU /DCH/DCH_Overall/DCH_DCChargeCtrlOverall/DCH_DCChargeCtrlStateflow/DCH_InputSignalPreProcess/DCH_BMSChAvlDebounce" /begin SUB_GROUP S3260_Turn_Off_Delay_Time /end SUB_GROUP /begin REF_CHARACTERISTIC DCH_tiBMSChAvlDly_C DCH_tiBMSChAvlTrnOffDly_C /end REF_CHARACTERISTIC /end GROUP
/begin GROUP S3256_DCH_DCRelayCloseDiagnose "VBU0513/VBUSystem/VCU /DCH/DCH_Overall/DCH_DCChargeCtrlOverall/DCH_DCChargeCtrlStateflow/DCH_InputSignalPreProcess/DCH_DCRelayCloseDiagnose" /begin SUB_GROUP S3261_Turn_Off_Delay_Time2 /end SUB_GROUP /begin REF_CHARACTERISTIC DCH_tiDCChRlyTurnOffConfrmDly_C DCH_uDCRlyClosedJudged_C /end REF_CHARACTERISTIC /end GROUP
/begin GROUP S3256_DCH_VehStateAnalyze "VBU0513/VBUSystem/VCU /DCH/DCH_Overall/DCH_DCChargeCtrlOverall/DCH_DCChargeCtrlStateflow/DCH_InputSignalPreProcess/DCH_VehStateAnalyze" /begin SUB_GROUP S3262_Turn_Off_Delay_Time2 /end SUB_GROUP
 /begin REF_CHARACTERISTIC DCH_tiAPlusVldDly_C DCH_tiAplusConfirmT_C DCH_tiCC2ConfirmT_C DCH_uMaxCCToConn_C DCH_uMinCCToConn_C DCH_vMaxSpdLim_C DCH_vMinSpdLim_C /end REF_CHARACTERISTIC
 /begin REF_MEASUREMENT DCH_flgCC2Conn /end REF_MEASUREMENT
/end GROUP
/begin GROUP S3257_DCH_BMSErrorDetect "VBU0513/VBUSystem/VCU /DCH/DCH_Overall/DCH_DCChargeCtrlOverall/DCH_DCChargeCtrlStateflow/DCH_SignalPreProcessForStateflow/DCH_BMSErrorDetect" /begin REF_CHARACTERISTIC DCH_stSysIsoCriticalFault_SY DCH_stVehIsoCriticalFault_SY /end REF_CHARACTERISTIC /begin REF_MEASUREMENT DCH_flgBmsChCrntOver DCH_flgBmsIsoCriticalFault /end REF_MEASUREMENT /end GROUP
/begin GROUP S3257_DCH_ChargeStopCalc "VBU0513/VBUSystem/VCU /DCH/DCH_Overall/DCH_DCChargeCtrlOverall/DCH_DCChargeCtrlStateflow/DCH_SignalPreProcessForStateflow/DCH_ChargeStopCalc"
 /begin REF_CHARACTERISTIC DCH_stBMSChCmpt_SY DCH_stCDCStopCharging_SY DCH_stVehSoftwUpdate_SY /end REF_CHARACTERISTIC
 /begin REF_MEASUREMENT DCH_flgBMSChCmpt DCH_flgStopForManual /end REF_MEASUREMENT
/end GROUP
/begin GROUP S3257_DCH_ChgerZeroCurrentDiagnose "VBU0513/VBUSystem/VCU /DCH/DCH_Overall/DCH_DCChargeCtrlOverall/DCH_DCChargeCtrlStateflow/DCH_SignalPreProcessForStateflow/DCH_ChgerZeroCurrentDiagnose" /begin REF_CHARACTERISTIC DCH_iBMSZeroCrntDlyStopCh_C DCH_iCCSChgCrnt_C /end REF_CHARACTERISTIC /end GROUP
/begin GROUP S3257_DCH_ChgrAvlDiagnose "VBU0513/VBUSystem/VCU /DCH/DCH_Overall/DCH_DCChargeCtrlOverall/DCH_DCChargeCtrlStateflow/DCH_SignalPreProcessForStateflow/DCH_ChgrAvlDiagnose"
 /begin REF_CHARACTERISTIC DCH_flgAllowNGearCh_C DCH_stNGear_SY DCH_stPGear_SY DCH_stVehSoftwUpdate_SY /end REF_CHARACTERISTIC
 /begin REF_MEASUREMENT DCH_flgHalfConn /end REF_MEASUREMENT
/end GROUP
/begin GROUP S3257_DCH_OpenPDURelayValid "VBU0513/VBUSystem/VCU /DCH/DCH_Overall/DCH_DCChargeCtrlOverall/DCH_DCChargeCtrlStateflow/DCH_SignalPreProcessForStateflow/DCH_OpenPDURelayValid" /begin REF_CHARACTERISTIC DCH_iOpenDCChRly_C DCH_tiCC2OffCnfrm_C /end REF_CHARACTERISTIC /end GROUP
/begin GROUP S3300_DCH_BSTOrCSTTrigger "VBU0513/VBUSystem/VCU /DCH/DCH_Overall/DCH_DCChargeCtrlOverall/DCH_EepromStore/DCH_ChargeStopErrDiagnose/DCH_BSTOrCSTTrigger" /begin REF_CHARACTERISTIC DCH_tiCSTTrigDly_C /end REF_CHARACTERISTIC /end GROUP
/begin GROUP S3301_BEM_EEPROM "VBU0513/VBUSystem/VCU /DCH/DCH_Overall/DCH_DCChargeCtrlOverall/DCH_EepromStore/DCH_ChargeTimeOutDiagnose/BEM_EEPROM"
 /begin REF_CHARACTERISTIC DCH_stBEM00TOutMSK_SY DCH_stBEMAATOutMSK_SY DCH_stBEMChCapTOutMSK_SY DCH_stBEMChRdyTOutMSK_SY DCH_stBEMChStTOutMSK_SY DCH_stBEMChgrStopTOutMSK_SY DCH_stBEMStatsDataTOutMSK_SY DCH_stKeyRaw_SY /end REF_CHARACTERISTIC
/end GROUP
/begin GROUP S3302_CSTTrigDly "VBU0513/VBUSystem/VCU /DCH/DCH_Overall/DCH_DCChargeCtrlOverall/DCH_EepromStore/DataConvertandCSTEEPROM/CSTTrigDly" /begin REF_CHARACTERISTIC DCH_tiCSTTrigDly_C /end REF_CHARACTERISTIC /end GROUP
/begin GROUP S3302_CST_EEPROM "VBU0513/VBUSystem/VCU /DCH/DCH_Overall/DCH_DCChargeCtrlOverall/DCH_EepromStore/DataConvertandCSTEEPROM/CST_EEPROM"
 /begin REF_CHARACTERISTIC DCH_stCurrDismatchErrMSK_SY DCH_stEnergNotTrnsmtFultMSK_SY DCH_stFaultStopMSK_SY DCH_stKeyRaw_SY DCH_stOtherStaStpFultMSK_SY DCH_stStaCntorFultMSK_SY DCH_stStaEmergStpFultMSK_SY DCH_stStaIntOverTempFultMSK_SY DCH_stStaOverTempFaultMSK_SY DCH_stStaStopCondReachMSK_SY DCH_stVoltAbnormalErrMSK_SY /end REF_CHARACTERISTIC
/end GROUP
/begin GROUP S3366_DSPL_EnergyComsumptionCal "VBU0513/VBUSystem/VCU /DSPL /DSPL/DriveRange/DSPL_Consumption/DSPL_EnergySelfLearn/DSPL_EnergyComsumptionCal" /begin REF_CHARACTERISTIC DSPL_pctBMSSOCMinStep_C /end REF_CHARACTERISTIC /end GROUP
/begin GROUP S3366_DSPL_EnergyFactorCal "VBU0513/VBUSystem/VCU /DSPL /DSPL/DriveRange/DSPL_Consumption/DSPL_EnergySelfLearn/DSPL_EnergyFactorCal" /begin SUB_GROUP S3370_DSPL_EnergyFactorInit S3370_DSPL_EnergyFactorUpdate /end SUB_GROUP /end GROUP
/begin GROUP S3366_DSPL_EnergyRemainingCal "VBU0513/VBUSystem/VCU /DSPL /DSPL/DriveRange/DSPL_Consumption/DSPL_EnergySelfLearn/DSPL_EnergyRemainingCal"
 /begin REF_CHARACTERISTIC DSPL_facBMSEnergyStep1_C DSPL_facBMSEnergyStep2_C DSPL_facBMSEnergyStep3_C DSPL_facBMSEnergyStep4_C DSPL_facBMSEnergyStep5_C DSPL_pctBMSEnergyStep1_C DSPL_pctBMSEnergyStep2_C DSPL_pctBMSEnergyStep3_C DSPL_pctBMSEnergyStep4_C DSPL_pctBMSEnergyStep5_C DSPL_pctBMSEnergyStep6_C /end REF_CHARACTERISTIC
/end GROUP
/begin GROUP S3367_Comsumption "VBU0513/VBUSystem/VCU /DSPL /DSPL/DriveRange/DSPL_Consumption/Range10kmConsumption/Comsumption"
 /begin REF_CHARACTERISTIC DSPL_facEnergyComsume10kmFactor1_C DSPL_facEnergyComsume10kmFactor2_C DSPL_facEnergyComsume10kmFactor3_C DSPL_facEnergyComsume10kmFactor4_C DSPL_facEnergyComsume10kmNegFactor_C DSPL_facEnergyComsume10kmPosFactor_C DSPL_facEnergyComsume10kmStep1_C DSPL_facEnergyComsume10kmStep2_C DSPL_facEnergyComsume10kmStep3_C DSPL_facEnergyComsumeCalFilter10_C DSPL_facEnergyComsumeCalFilter11_C DSPL_facEnergyComsumeCalFilter1_C DSPL_facEnergyComsumeCalFilter2_C DSPL_facEnergyComsumeCalFilter3_C DSPL_facEnergyComsumeCalFilter4_C DSPL_facEnergyComsumeCalFilter5_C DSPL_facEnergyComsumeCalFilter6_C DSPL_facEnergyComsumeCalFilter7_C DSPL_facEnergyComsumeCalFilter8_C DSPL_facEnergyComsumeCalFilter9_C DSPL_facEnergyComsumeDownMin_C DSPL_facEnergyComsumeInitFactor1_C DSPL_facEnergyComsumeInitFactor2_C DSPL_facEnergyComsumeInitFactor3_C DSPL_facEnergyComsumeInitFactorDefault_C DSPL_facEnergyComsumeInitStep1_C DSPL_facEnergyComsumeInitStep2_C DSPL_facEnergyComsumeInitStep3_C DSPL_facEnergyComsumeUPMax_C DSPL_facEnergyFactorDeviation_CUR_v DSPL_kmRange10kmCalCell_C DSPL_pwrVehicleDrivePowerMoving_C DSPL_pwrVehicleDrivePowerStandstill_C DSPL_stEnergyConsumptionCaled_C DSPL_stEnergyConsumptionProcess_C DSPL_tiEnergyCalTrigleDelay_C /end REF_CHARACTERISTIC
/end GROUP
/begin GROUP S3367_DSPLRange10kmCondition "VBU0513/VBUSystem/VCU /DSPL /DSPL/DriveRange/DSPL_Consumption/Range10kmConsumption/DSPLRange10kmCondition" /begin REF_CHARACTERISTIC DSPL_kmRange10kmCalCell_C /end REF_CHARACTERISTIC /end GROUP
/begin GROUP S3368_DSPLRange50kmComsumptionCal "VBU0513/VBUSystem/VCU /DSPL /DSPL/DriveRange/DSPL_Consumption/Range50kmConsumption/DSPLRange50kmComsumptionCal"
 /begin REF_CHARACTERISTIC DSPL_facEnergyComsume50kmCalFilter1_C DSPL_facEnergyComsume50kmCalFilter2_C DSPL_facEnergyComsume50kmCalFilter3_C DSPL_facEnergyComsume50kmInitFactor1_C DSPL_facEnergyComsume50kmInitFactor2_C DSPL_facEnergyComsume50kmInitFactor3_C DSPL_facEnergyComsume50kmInitFactorDefault_C DSPL_facEnergyComsume50kmInitStep1_C DSPL_facEnergyComsume50kmInitStep2_C DSPL_facEnergyComsume50kmInitStep3_C DSPL_facEnergyComsumeDownMin_C DSPL_facEnergyComsumeUPMax_C DSPL_kmRange50kmCalCell_C DSPL_pwrVehicleDrivePowerMoving_C DSPL_pwrVehicleDrivePowerStandstill_C DSPL_stEnergyConsumptionCaled_C DSPL_stEnergyConsumptionProcess_C DSPL_tiEnergyCalTrigleDelay_C /end REF_CHARACTERISTIC
/end GROUP
/begin GROUP S3368_DSPLRange50kmCondition "VBU0513/VBUSystem/VCU /DSPL /DSPL/DriveRange/DSPL_Consumption/Range50kmConsumption/DSPLRange50kmCondition" /begin REF_CHARACTERISTIC DSPL_kmRange50kmCalCell_C /end REF_CHARACTERISTIC /end GROUP
/begin GROUP S3419_FullRangeCalculation "VBU0513/VBUSystem/VCU /DSPL /DSPL/DriveRange/RemainingRange/FullRangeAndSocDeclineFactor/FullRangeCalculation" /begin SUB_GROUP S3445_SwitchParameter /end SUB_GROUP
 /begin REF_CHARACTERISTIC DSPL_facRngAmbTempCorr_CUR_v_Md_Default DSPL_kmRngNEDCMAP_CUR_y_Md_Default DSPL_pctSocFull_C /end REF_CHARACTERISTIC
/end GROUP
/begin GROUP S3419_SOCDecRate "VBU0513/VBUSystem/VCU /DSPL /DSPL/DriveRange/RemainingRange/FullRangeAndSocDeclineFactor/SOCDecRate" /begin REF_CHARACTERISTIC DSPL_kmDrvRngStepMax_C /end REF_CHARACTERISTIC /end GROUP
/begin GROUP S3419_SOCDeclineFactorCalculation "VBU0513/VBUSystem/VCU /DSPL /DSPL/DriveRange/RemainingRange/FullRangeAndSocDeclineFactor/SOCDeclineFactorCalculation"
 /begin SUB_GROUP S3447_SwitchParameter S3447_SwitchParameter1 S3447_SwitchParameter2 /end SUB_GROUP
 /begin REF_CHARACTERISTIC DSPL_facRngAmbTempCorr_CUR_v_Md_Default DSPL_tiDelayTimeChrgFallingEdge_C /end REF_CHARACTERISTIC
/end GROUP
/begin GROUP S3421_Charge "VBU0513/VBUSystem/VCU /DSPL /DSPL/DriveRange/RemainingRange/SelectDisplayRange/Charge"
 /begin REF_CHARACTERISTIC DSPL_kmChrgDownStepMin_C DSPL_kmChrgUpStepMax_C DSPL_pctSOCFullChrg_C DSPL_pctSocFull_C DSPL_tiBmsSocFullDelay_C /end REF_CHARACTERISTIC
/end GROUP
/begin GROUP S3421_Drive "VBU0513/VBUSystem/VCU /DSPL /DSPL/DriveRange/RemainingRange/SelectDisplayRange/Drive"
 /begin REF_CHARACTERISTIC DSPL_numSOCJump_C DSPL_pctSOCJumpHi_C DSPL_pctSOCJumpLo_C DSPL_tiBmsSocZeroDelay_C DSPL_tiSOCJumpDelay_C /end REF_CHARACTERISTIC
/end GROUP
/begin GROUP S3421_storeRange "VBU0513/VBUSystem/VCU /DSPL /DSPL/DriveRange/RemainingRange/SelectDisplayRange/storeRange" /begin SUB_GROUP S3460_SwitchParameter /end SUB_GROUP
 /begin REF_CHARACTERISTIC DSPL_kmRemainingRangeDisplayStep_C DSPL_kmRngNEDCMAP_CUR_y_Md_Default DSPL_tiBmsSocVldDelay_C DSPL_tiBmsSocZeroDelay_C /end REF_CHARACTERISTIC
/end GROUP
/begin GROUP S3511_LowpassT "VBU0513/VBUSystem/VCU /EDIS/EDIS_Ctrl/BatDis_Power_Lim_Calc/Power_Arbitration/drive_power_limit_calculate/LowpassT" /begin REF_MEASUREMENT EDIS_pwrDrvPwrLimFilter /end REF_MEASUREMENT /end GROUP
/begin GROUP S3530_fid_action "VBU0513/VBUSystem/VCU /EDIS/EDIS_Ctrl/battery_power_calculate/charge_power_calculate/ChPowSetPoint/fid_action" /begin SUB_GROUP S3532_GradientLimiter S3532_GradientLimiter1 /end SUB_GROUP
 /begin REF_CHARACTERISTIC EDIS_pwrOfflineChDyn_C EDIS_pwrOfflineChLT_C EDIS_pwrOfflineDisChDyn_C EDIS_pwrOfflineDownStep_C EDIS_pwrOfflineUpStep_C EDIS_pwrOnlineDownStep_C EDIS_pwrOnlineUpStep_C /end REF_CHARACTERISTIC
 /begin REF_MEASUREMENT EDIS_pwrDownStepCh EDIS_pwrUpStepCh /end REF_MEASUREMENT
/end GROUP
/begin GROUP S3530_setpiont "VBU0513/VBUSystem/VCU /EDIS/EDIS_Ctrl/battery_power_calculate/charge_power_calculate/ChPowSetPoint/setpiont"
 /begin REF_CHARACTERISTIC EDIS_facBMSSOCCh_CUR_v EDIS_facChPwrDeltaBaseDiff_CUR_v EDIS_facMaxBMSCh_CUR_v EDIS_facMinBMSCh_CUR_v EDIS_facRgnReqCapDelta_CUR_v EDIS_facVehSpd2MotSpd_C EDIS_flgOverPwrLimNum_C EDIS_flgUseEEPROMStroeVal_C EDIS_flgUsePowSpPredict_C EDIS_numChOverLim_C EDIS_numChPwrOverCntEEPROMInit_SY EDIS_pwrChRed40vLim_C EDIS_pwrSpBaseChDyn_CUR_v EDIS_tiBattOverChrg_C EDIS_wChOverEnrgLim_C /end REF_CHARACTERISTIC
 /begin REF_MEASUREMENT EDIS_pwrChDynSp EDIS_pwrChSp /end REF_MEASUREMENT
/end GROUP
/begin GROUP S3545_fid_action "VBU0513/VBUSystem/VCU /EDIS/EDIS_Ctrl/battery_power_calculate/discharge_power_calculate/DchPowSetpiont/fid_action"
 /begin SUB_GROUP S3547_GradientLimiter S3547_GradientLimiter1 S3547_GradientLimiter2 /end SUB_GROUP
 /begin REF_CHARACTERISTIC EDIS_pwrOfflineDisChDyn_C EDIS_pwrOfflineDisChLT_C EDIS_pwrOfflineDisChST_C EDIS_pwrOfflineDownStep_C EDIS_pwrOfflineUpStep_C EDIS_pwrOnlineDownStep_C EDIS_pwrOnlineUpStep_C /end REF_CHARACTERISTIC
 /begin REF_MEASUREMENT EDIS_pwrDownStep EDIS_pwrUpStep /end REF_MEASUREMENT
/end GROUP
/begin GROUP S3545_setpoint "VBU0513/VBUSystem/VCU /EDIS/EDIS_Ctrl/battery_power_calculate/discharge_power_calculate/DchPowSetpiont/setpoint" /begin SUB_GROUP S3548_batt_stpower_overrite S3548_discharge_setpoint /end SUB_GROUP /end GROUP
/begin GROUP S3545_temperature_correction "VBU0513/VBUSystem/VCU /EDIS/EDIS_Ctrl/battery_power_calculate/discharge_power_calculate/DchPowSetpiont/temperature_correction" /begin SUB_GROUP S3549_BattDisChaCold S3549_BattDisChaHot S3549_MinSel /end SUB_GROUP /end GROUP
/begin GROUP S3620_Disenable "VBU0513/VBUSystem/VCU /LVC/LVC/LowVoltageBalanceControl/LVC_DcdcStCtl/RoutineControl/Disenable"
 /begin REF_CHARACTERISTIC DIAGS_stPsvResp_SY LVC_stDcDcFailure_SY LVC_stDcDcStandby_SY LVC_stDcDcWorking_SY LVC_tiWaitForOk_C /end REF_CHARACTERISTIC
 /begin REF_MEASUREMENT LVC_stDCDCDisblResp /end REF_MEASUREMENT
/end GROUP
/begin GROUP S3620_Enable "VBU0513/VBUSystem/VCU /LVC/LVC/LowVoltageBalanceControl/LVC_DcdcStCtl/RoutineControl/Enable"
 /begin REF_CHARACTERISTIC DIAGS_stPsvResp_SY LVC_stDcDcFailure_SY LVC_stDcDcStandby_SY LVC_stDcDcWorking_SY LVC_tiWaitForOk_C /end REF_CHARACTERISTIC
 /begin REF_MEASUREMENT LVC_stDCDCEnaResp /end REF_MEASUREMENT
/end GROUP
/begin GROUP S3650_StopNM "VBU0513/VBUSystem/VCU /PMM/PMM_Ctrl/LvWakeUp_Ctrl/LvWakeUp_State_Calc/LVWSrc/StopNM"
 /begin REF_CHARACTERISTIC PMM_flgVCUStpNMOvrdSwt_C PMM_flgVCUStpNMOvrdVal_C PMM_tiDlyIgnOff_C PMM_tiDlyVCUStpNMAbnrml_C PMM_tiDlyVCUStpNMNrml_C PMM_tiDlyWaitNMStp_C /end REF_CHARACTERISTIC
/end GROUP
/begin GROUP S3650_VCUActSrc "VBU0513/VBUSystem/VCU /PMM/PMM_Ctrl/LvWakeUp_Ctrl/LvWakeUp_State_Calc/LVWSrc/VCUActSrc" /begin REF_CHARACTERISTIC PMM_tiDlyPEUDCVltg_C /end REF_CHARACTERISTIC /end GROUP
/begin GROUP S3650_VCUWakeUp "VBU0513/VBUSystem/VCU /PMM/PMM_Ctrl/LvWakeUp_Ctrl/LvWakeUp_State_Calc/LVWSrc/VCUWakeUp" /begin REF_CHARACTERISTIC PMM_stAPlushld_SY PMM_tiDlyNMWkup_C /end REF_CHARACTERISTIC /end GROUP
/begin GROUP S3708_Turn_On_Delay_Time "VBU0513/VBUSystem/VCU /PMM/PMM_Ctrl/PwrMod_Ctrl/PwrMod_PowerUp/stateflowcondition/Turn_On_Delay_Time" /begin REF_MEASUREMENT PMM_flgInitToHVRlyClReq /end REF_MEASUREMENT /end GROUP
/begin GROUP S3708_Turn_On_Delay_Time1 "VBU0513/VBUSystem/VCU /PMM/PMM_Ctrl/PwrMod_Ctrl/PwrMod_PowerUp/stateflowcondition/Turn_On_Delay_Time1" /begin REF_MEASUREMENT PMM_flgOffLoadToACTst /end REF_MEASUREMENT /end GROUP
/begin GROUP S3768_Front "VBU0513/VBUSystem/VCU /SPD/SPD/SignalProcessing_10ms/Subsystem1/v_Axle/Front" /begin REF_MEASUREMENT SPD_vFA /end REF_MEASUREMENT /end GROUP
/begin GROUP S3768_Rear "VBU0513/VBUSystem/VCU /SPD/SPD/SignalProcessing_10ms/Subsystem1/v_Axle/Rear" /begin REF_MEASUREMENT SPD_vRA /end REF_MEASUREMENT /end GROUP
/begin GROUP S3771_SR_Flip_Flop "VBU0513/VBUSystem/VCU /SPD/SPD/SignalProcessing_10ms/VehDir/RearWhl/SR_Flip_Flop" /begin REF_MEASUREMENT SPD_flgRARvs /end REF_MEASUREMENT /end GROUP
/begin GROUP S3773_First_Order_Low_Pass_Filter "VBU0513/VBUSystem/VCU /SPD/SPD/SignalProcessing_10ms/VehSpdNorm/Normal_VehSpdCal/First_Order_Low_Pass_Filter" /begin REF_MEASUREMENT SPD_vVehSpd /end REF_MEASUREMENT /end GROUP
/begin GROUP S3915_SignalProcess "VBU0513/VBUSystem/VCU /TQO/TQOAll/TQARB/TQARB/TrqArb/SignalProcess" /begin REF_CHARACTERISTIC TQARB_flgTrqCompSwitch_C /end REF_CHARACTERISTIC
 /begin REF_MEASUREMENT TQARB_trqPreDisPropRA TQARB_trqPreDisRgnRA TQARB_trqPreFnlRA /end REF_MEASUREMENT
/end GROUP
/begin GROUP S3920_PulseTime "VBU0513/VBUSystem/VCU /TQO/TQOAll/TQCMP/TQCMP/TrqPulse/PulseTime" /begin REF_CHARACTERISTIC TQCMP_tiPulseThd_C /end REF_CHARACTERISTIC /end GROUP
/begin GROUP S3920_PulseTrig "VBU0513/VBUSystem/VCU /TQO/TQOAll/TQCMP/TQCMP/TrqPulse/PulseTrig" /begin REF_CHARACTERISTIC TQCMP_pBrkCrpOffThd_C /end REF_CHARACTERISTIC /begin REF_MEASUREMENT TQCMP_flgPulseTrig TQCMP_flgShftOn /end REF_MEASUREMENT /end GROUP
/begin GROUP S3920_PulseTrq "VBU0513/VBUSystem/VCU /TQO/TQOAll/TQCMP/TQCMP/TrqPulse/PulseTrq" /begin REF_CHARACTERISTIC TQCMP_stPulseRAEna_CUR_v TQCMP_trqPulse_CUR_v /end REF_CHARACTERISTIC /end GROUP
/begin GROUP S3929_DmpFilter "VBU0513/VBUSystem/VCU /TQO/TQOAll/TQDIS/TQDIS/Dmp/DmpFilter" /begin SUB_GROUP S3933_BandStopInit /end SUB_GROUP
 /begin REF_CHARACTERISTIC TQDIS_facAccDmpFilterRA_MAP_v TQDIS_facDenRA2_CUR_x TQDIS_facDenRA_CUR_x TQDIS_facNumRA2_CUR_x TQDIS_facNumRA_CUR_x TQDIS_facSpdDmpFilterRA_MAP_v TQDIS_flgDMPByPass_C TQDIS_flgDmpFilterRA2_C TQDIS_trqDmpDeadZone_C TQDIS_trqNumDenThdRA_C /end REF_CHARACTERISTIC
 /begin REF_MEASUREMENT TQDIS_trqDmpRA /end REF_MEASUREMENT
/end GROUP
/begin GROUP S3930_Arb "VBU0513/VBUSystem/VCU /TQO/TQOAll/TQDIS/TQDIS/TrqFilter/Arb"
 /begin REF_CHARACTERISTIC TQDIS_trqRADecMax_C TQDIS_trqRADecMin_C TQDIS_trqRAIncMax_C TQDIS_trqRAIncMin_C /end REF_CHARACTERISTIC
 /begin REF_MEASUREMENT TQDIS_trqRADecLim TQDIS_trqRAIncLim /end REF_MEASUREMENT
/end GROUP
/begin GROUP S3930_DrvLim "VBU0513/VBUSystem/VCU /TQO/TQOAll/TQDIS/TQDIS/TrqFilter/DrvLim" /begin SUB_GROUP S3943_AccPdlIdl S3943_Creep S3943_RADrvDec S3943_RADrvInc /end SUB_GROUP /end GROUP
/begin GROUP S3930_Subsystem "VBU0513/VBUSystem/VCU /TQO/TQOAll/TQDIS/TQDIS/TrqFilter/Subsystem" /begin REF_CHARACTERISTIC TQDIS_tiSWResetDly_C /end REF_CHARACTERISTIC /begin REF_MEASUREMENT TQDIS_trqFltRA /end REF_MEASUREMENT /end GROUP
/begin GROUP S3966_CalcSpdHiFre "VBU0513/VBUSystem/VCU /TQO/TQOAll/TQDMP/TQDMP/RAROTC/CalcSpdHiFre"
 /begin REF_CHARACTERISTIC TQDMP_facRAV2N_C TQDMP_flgLowFilterDnRA_C TQDMP_nRPMHysRA_C TQDMP_tiCalcChgLeadFilRA_C TQO_ti10ms_SY /end REF_CHARACTERISTIC
 /begin REF_MEASUREMENT TQDMP_dnMotrR /end REF_MEASUREMENT
/end GROUP
/begin GROUP S3966_Foreback "VBU0513/VBUSystem/VCU /TQO/TQOAll/TQDMP/TQDMP/RAROTC/Foreback"
 /begin REF_CHARACTERISTIC TQDMP_facDenRA_CUR_x TQDMP_facNumRA_CUR_x TQDMP_pctDmpDisbThd_C TQDMP_trqDmpEnaThdRA_C TQDMP_trqNumDenThdRA_C /end REF_CHARACTERISTIC
 /begin REF_MEASUREMENT TQDMP_trqDmpRA /end REF_MEASUREMENT
/end GROUP
/begin GROUP S3966_ROTCArbRA "VBU0513/VBUSystem/VCU /TQO/TQOAll/TQDMP/TQDMP/RAROTC/ROTCArbRA" /begin REF_CHARACTERISTIC TQDMP_flgRAVCUDmpEna_C /end REF_CHARACTERISTIC /begin REF_MEASUREMENT TQDMP_trqCompRA0 /end REF_MEASUREMENT /end GROUP
/begin GROUP S3966_ROTCConidtion "VBU0513/VBUSystem/VCU /TQO/TQOAll/TQDMP/TQDMP/RAROTC/ROTCConidtion"
 /begin SUB_GROUP S3972_ConditionRAArb S3972_SpeedHoldEnableRA S3972_TipInRA S3972_TipOutRA S3972_TipinEnaRA S3972_TipoutEnaRA S3972_VrtlRA /end SUB_GROUP
/end GROUP
/begin GROUP S3966_TorqueCal "VBU0513/VBUSystem/VCU /TQO/TQOAll/TQDMP/TQDMP/RAROTC/TorqueCal" /begin SUB_GROUP S3973_CompensationPhase S3973_DeltaTrqArb S3973_TorqueLim /end SUB_GROUP /end GROUP
/begin GROUP S4007_ShftChange "VBU0513/VBUSystem/VCU /TQO/TQOAll/TQO/TQO/MotorTorque/ShftChange"
 /begin REF_CHARACTERISTIC TQO_facShftChangeHi_CUR_v TQO_facShftChangeLo_CUR_v TQO_facShftChangeSlope_CUR_v /end REF_CHARACTERISTIC
 /begin REF_MEASUREMENT TQO_facShftChangeLo TQO_flgShftRD /end REF_MEASUREMENT
/end GROUP
/begin GROUP S4007_Subsystem "VBU0513/VBUSystem/VCU /TQO/TQOAll/TQO/TQO/MotorTorque/Subsystem" /begin SUB_GROUP S4012_GradientLimiter /end SUB_GROUP /begin REF_MEASUREMENT TQDIS_trqRMotrDir TQO_trqRMotr /end REF_MEASUREMENT /end GROUP
/begin GROUP S4008_VirtualAPD "VBU0513/VBUSystem/VCU /TQO/TQOAll/TQO/TQO/Subsystem/VirtualAPD" /begin REF_CHARACTERISTIC TQO_trqPTMax_C /end REF_CHARACTERISTIC /end GROUP
/begin GROUP S4009_TrqProtect "VBU0513/VBUSystem/VCU /TQO/TQOAll/TQO/TQO/Trq/TrqProtect" /begin REF_CHARACTERISTIC TQO_trqPTMax_C /end REF_CHARACTERISTIC /end GROUP
/begin GROUP S324_Determine_CellBlanceTime "VBU0513/VBUSystem/BMS/CBL/Subsystem8/Subsystem/Determine_CSCCellBalanceRequest/Determine_CellBalanceRequest/Cell0/Determine_CellBlanceTime" /begin REF_CHARACTERISTIC MILIAMPERES_PER_AMPERE /end REF_CHARACTERISTIC /end GROUP
/begin GROUP S1055_Calculate_WindowAverage_BatteryCurrent "VBU0513/VBUSystem/BMS/SOC/Subsystem5/Subsystem/Determine_FastChargeCorrection_Soc/FastCharge_DynamicCorrection/FastCharge_DynamicCorrection_Enable/Calculate_WindowAverage_BatteryCurrent" /begin REF_CHARACTERISTIC CcSOC_CurrentWinAvePeriodTime_ms /end REF_CHARACTERISTIC /end GROUP
/begin GROUP S1232_FastChrgOneThirdRateCurrentLimitCheck "VBU0513/VBUSystem/BMS/SOF/Subsystem6/Subsystem/Determine_Currentlimit_Target/Calculate_CurrentLimit_Target/CurrentLimit_FastCharge_Check/FastChrgOneThirdRateCurrentLimitCheck" /begin REF_CHARACTERISTIC BATTERY_BOL_SOH BATTERY_EOL_SOH /end REF_CHARACTERISTIC /end GROUP
/begin GROUP S1515_Cal_Pulse_Current_Data "VBU0513/VBUSystem/BMS/SOH/Subsystem4/Subsystem1/Calculate_Resistance/Determine_Condition_Calculate_Pulse_Average_CurrentVoltage/Calculate_Pulse_Average_CurrentVoltage/Cal_Pulse_Current_Data"
 /begin REF_CHARACTERISTIC CaSOH_InvalidHistoryCurrentData_A CcSOH_HistoryDataDimension_n /end REF_CHARACTERISTIC
/end GROUP
/begin GROUP S1516_Determine_FCCPulseCurrent_Condition "VBU0513/VBUSystem/BMS/SOH/Subsystem4/Subsystem1/Calculate_Resistance/Determine_Condition_Calculate_Pulse_Average_CurrentVoltage/Determine_Condition/Determine_FCCPulseCurrent_Condition"
 /begin REF_CHARACTERISTIC CcSOH_DeltaModuleCurrent_A CcSYS_ResisCalFCCPulseCurrent_A CcSYS_ResisCalPulseCurrentDurationTime_ms /end REF_CHARACTERISTIC
/end GROUP
/begin GROUP S1516_Determine_OBCPulseCurrent_Condition "VBU0513/VBUSystem/BMS/SOH/Subsystem4/Subsystem1/Calculate_Resistance/Determine_Condition_Calculate_Pulse_Average_CurrentVoltage/Determine_Condition/Determine_OBCPulseCurrent_Condition"
 /begin REF_CHARACTERISTIC CcSOH_DeltaModuleCurrent_A CcSYS_ResisCalPulseCurrentDurationTime_ms /end REF_CHARACTERISTIC
/end GROUP
/begin GROUP S3548_discharge_setpoint "VBU0513/VBUSystem/VCU /EDIS/EDIS_Ctrl/battery_power_calculate/discharge_power_calculate/DchPowSetpiont/setpoint/discharge_setpoint" /begin REF_CHARACTERISTIC EDIS_flgOverPwrLimNum_C EDIS_flgUseEEPROMStroeVal_C /end REF_CHARACTERISTIC /end GROUP
/begin GROUP S3972_TipInRA "VBU0513/VBUSystem/VCU /TQO/TQOAll/TQDMP/TQDMP/RAROTC/ROTCConidtion/TipInRA" /begin REF_CHARACTERISTIC TQO_ti10ms_SY /end REF_CHARACTERISTIC /end GROUP
/begin GROUP S3972_TipOutRA "VBU0513/VBUSystem/VCU /TQO/TQOAll/TQDMP/TQDMP/RAROTC/ROTCConidtion/TipOutRA" /begin REF_CHARACTERISTIC TQO_ti10ms_SY /end REF_CHARACTERISTIC /end GROUP
/begin GROUP S3972_TipoutEnaRA "VBU0513/VBUSystem/VCU /TQO/TQOAll/TQDMP/TQDMP/RAROTC/ROTCConidtion/TipoutEnaRA" /begin REF_CHARACTERISTIC TQO_ti10ms_SY /end REF_CHARACTERISTIC /end GROUP
/begin GROUP S1467_Determine_Cell_Balanced_Capacity "VBU0513/VBUSystem/BMS/SOH/Subsystem4/Subsystem1/Calculate_Capacity/Calculate_CellCapacity_SlowCharge/Determine_AhIntegral_DeltaQ/Determine_AhIntegral_Q/Determine_Cell_Balanced_Capacity"
 /begin REF_CHARACTERISTIC CcSYS_BalanceResistance_ohm CcSYS_CellBalanceDutyCycle_pct MILIAMPERES_PER_AMPERE /end REF_CHARACTERISTIC
/end GROUP
/end MODULE
/end PROJECT
