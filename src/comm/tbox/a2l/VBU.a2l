ASAP2_VERSION 1 31
/begin PROJECT ProjectName "Project Comment Goes Here"
/begin HEADER "Header Comments go here" /end HEADER
/begin MODULE ModuleName "Module Comment Goes Here"
/begin MOD_COMMON "Mod Common Comment Here" BYTE_ORDER MSB_LAST /end MOD_COMMON
/begin RECORD_LAYOUT Scalar_BOOLEAN FNC_VALUES 1 UBYTE COLUMN_DIR DIRECT /end RECORD_LAYOUT
/begin RECORD_LAYOUT Scalar_UBYTE FNC_VALUES 1 UBYTE COLUMN_DIR DIRECT /end RECORD_LAYOUT
/begin RECORD_LAYOUT Scalar_BYTE FNC_VALUES 1 SBYTE COLUMN_DIR DIRECT /end RECORD_LAYOUT
/begin RECORD_LAYOUT Scalar_UWORD FNC_VALUES 1 UWORD COLUMN_DIR DIRECT /end RECORD_LAYOUT
/begin RECORD_LAYOUT Scalar_ULONG FNC_VALUES 1 ULONG COLUMN_DIR DIRECT /end RECORD_LAYOUT
/begin RECORD_LAYOUT Scalar_FLOAT32_IEEE FNC_VALUES 1 FLOAT32_IEEE COLUMN_DIR DIRECT /end RECORD_LAYOUT
/begin RECORD_LAYOUT Lookup1D_X_UBYTE AXIS_PTS_X 1 UBYTE INDEX_INCR DIRECT /end RECORD_LAYOUT
/begin RECORD_LAYOUT Lookup1D_UWORD FNC_VALUES 1 UWORD COLUMN_DIR DIRECT /end RECORD_LAYOUT
/begin RECORD_LAYOUT Lookup1D_WORD FNC_VALUES 1 SWORD COLUMN_DIR DIRECT /end RECORD_LAYOUT
/begin RECORD_LAYOUT Lookup1D_X_WORD AXIS_PTS_X 1 SWORD INDEX_INCR DIRECT /end RECORD_LAYOUT
/begin RECORD_LAYOUT Lookup1D_FLOAT32_IEEE FNC_VALUES 1 FLOAT32_IEEE COLUMN_DIR DIRECT /end RECORD_LAYOUT
/begin RECORD_LAYOUT Lookup1D_X_FLOAT32_IEEE AXIS_PTS_X 1 FLOAT32_IEEE INDEX_INCR DIRECT /end RECORD_LAYOUT
/begin RECORD_LAYOUT Lookup2D_X_UWORD AXIS_PTS_X 1 UWORD INDEX_INCR DIRECT /end RECORD_LAYOUT
/begin RECORD_LAYOUT Lookup2D_FLOAT32_IEEE FNC_VALUES 1 FLOAT32_IEEE COLUMN_DIR DIRECT /end RECORD_LAYOUT
/begin RECORD_LAYOUT Lookup2D_X_FLOAT32_IEEE AXIS_PTS_X 1 FLOAT32_IEEE INDEX_INCR DIRECT /end RECORD_LAYOUT
/begin CHARACTERISTIC CaOCV_RelaxationTimeCurveY_s "" CURVE 0x7001320e Lookup1D_FLOAT32_IEEE 0 VBU0513_CM_single_cnt -3.4028234663852886E+38 3.4028234663852886E+38
 /begin AXIS_DESCR COM_AXIS CTM_tCellTempMin VBU0513_CM_single_cnt 12 -3.4028234663852886E+38 3.4028234663852886E+38 AXIS_PTS_REF CaOCV_RelaxationTimeCurveX_C /end AXIS_DESCR
/end CHARACTERISTIC
/begin AXIS_PTS CaOCV_RelaxationTimeCurveX_C "" 0x700131de CTM_tCellTempMin Lookup1D_X_FLOAT32_IEEE 0 VBU0513_CM_single_cnt 12 -3.4028234663852886E+38 3.4028234663852886E+38 /end AXIS_PTS
/begin CHARACTERISTIC CaOCV_RelaxaShortTimeCurveY_s "" CURVE 0x70011c4a Lookup1D_FLOAT32_IEEE 0 VBU0513_CM_single_cnt -3.4028234663852886E+38 3.4028234663852886E+38
 /begin AXIS_DESCR COM_AXIS CTM_tCellTempMin VBU0513_CM_single_cnt 4 -3.4028234663852886E+38 3.4028234663852886E+38 AXIS_PTS_REF CaOCV_RelaxaShortTimeCurveX_C /end AXIS_DESCR
/end CHARACTERISTIC
/begin AXIS_PTS CaOCV_RelaxaShortTimeCurveX_C "" 0x70011c3a CTM_tCellTempMin Lookup1D_X_FLOAT32_IEEE 0 VBU0513_CM_single_cnt 4 -3.4028234663852886E+38 3.4028234663852886E+38 /end AXIS_PTS
/begin CHARACTERISTIC CaSOC_SOCPLowY_pct "" CURVE 0x70012546 Lookup1D_FLOAT32_IEEE 0 VBU0513_CM_single_cnt -3.4028234663852886E+38 3.4028234663852886E+38
 /begin AXIS_DESCR COM_AXIS CTM_tCellTempMin VBU0513_CM_single_cnt 7 -3.4028234663852886E+38 3.4028234663852886E+38 AXIS_PTS_REF CaSOC_SOCPLowX_C /end AXIS_DESCR
/end CHARACTERISTIC
/begin AXIS_PTS CaSOC_SOCPLowX_C "" 0x7001252a CTM_tCellTempMin Lookup1D_X_FLOAT32_IEEE 0 VBU0513_CM_single_cnt 7 -3.4028234663852886E+38 3.4028234663852886E+38 /end AXIS_PTS
/begin CHARACTERISTIC CaSOC_OcvShortTimeSocErrorCurveY_pct "" CURVE 0x70011c6a Lookup1D_FLOAT32_IEEE 0 VBU0513_CM_single_cnt -3.4028234663852886E+38 3.4028234663852886E+38
 /begin AXIS_DESCR COM_AXIS CTM_tCellTempMin VBU0513_CM_single_cnt 4 -3.4028234663852886E+38 3.4028234663852886E+38 AXIS_PTS_REF CaSOC_OcvShortTimeSocErrorCurveX_C /end AXIS_DESCR
/end CHARACTERISTIC
/begin AXIS_PTS CaSOC_OcvShortTimeSocErrorCurveX_C "" 0x70011c5a CTM_tCellTempMin Lookup1D_X_FLOAT32_IEEE 0 VBU0513_CM_single_cnt 4 -3.4028234663852886E+38 3.4028234663852886E+38 /end AXIS_PTS
/begin CHARACTERISTIC CaSOC_OcvShortTimeDischargeSocZ_pct "" MAP 0x70015302 Lookup2D_FLOAT32_IEEE 0 VBU0513_CM_single_cnt -3.4028234663852886E+38 3.4028234663852886E+38
 /begin AXIS_DESCR COM_AXIS NO_INPUT_QUANTITY VBU0513_CM_uint16_cnt 11 0.0 65535.0 AXIS_PTS_REF CaSOC_OcvShortTimeDischargeVolY_mV /end AXIS_DESCR
 /begin AXIS_DESCR COM_AXIS CTM_tCellTempMin VBU0513_CM_single_cnt 4 -3.4028234663852886E+38 3.4028234663852886E+38 AXIS_PTS_REF CaSOC_OcvShortTimeTemX_C /end AXIS_DESCR
/end CHARACTERISTIC
/begin AXIS_PTS CaSOC_OcvShortTimeTemX_C "" 0x70011c7a CTM_tCellTempMin Lookup2D_X_FLOAT32_IEEE 0 VBU0513_CM_single_cnt 4 -3.4028234663852886E+38 3.4028234663852886E+38 /end AXIS_PTS
/begin AXIS_PTS CaSOC_OcvShortTimeDischargeVolY_mV "" 0x7001210c NO_INPUT_QUANTITY Lookup2D_X_UWORD 0 VBU0513_CM_uint16_cnt 11 0.0 65535.0 /end AXIS_PTS
/begin CHARACTERISTIC CaSOC_OcvShortTimeChargeSocZ_pct "" MAP 0x70015252 Lookup2D_FLOAT32_IEEE 0 VBU0513_CM_single_cnt -3.4028234663852886E+38 3.4028234663852886E+38
 /begin AXIS_DESCR COM_AXIS NO_INPUT_QUANTITY VBU0513_CM_uint16_cnt 11 0.0 65535.0 AXIS_PTS_REF CaSOC_OcvShortTimeChargeVolY_mV /end AXIS_DESCR
 /begin AXIS_DESCR COM_AXIS CTM_tCellTempMin VBU0513_CM_single_cnt 4 -3.4028234663852886E+38 3.4028234663852886E+38 AXIS_PTS_REF CaSOC_OcvShortTimeTemX_C /end AXIS_DESCR
/end CHARACTERISTIC
/begin AXIS_PTS CaSOC_OcvShortTimeChargeVolY_mV "" 0x700120f6 NO_INPUT_QUANTITY Lookup2D_X_UWORD 0 VBU0513_CM_uint16_cnt 11 0.0 65535.0 /end AXIS_PTS
/begin CHARACTERISTIC CaSOE_DispalySocFactorMapY_pct "" CURVE 0x7001326e Lookup1D_FLOAT32_IEEE 0 VBU0513_CM_single_cnt -3.4028234663852886E+38 3.4028234663852886E+38
 /begin AXIS_DESCR COM_AXIS SOC_pctBatteryDisplaySoc VBU0513_CM_single_cnt 12 -3.4028234663852886E+38 3.4028234663852886E+38 AXIS_PTS_REF CaSOE_DispalySocFactorMapX_pct /end AXIS_DESCR
/end CHARACTERISTIC
/begin AXIS_PTS CaSOE_DispalySocFactorMapX_pct "" 0x7001323e SOC_pctBatteryDisplaySoc Lookup1D_X_FLOAT32_IEEE 0 VBU0513_CM_single_cnt 12 -3.4028234663852886E+38 3.4028234663852886E+38 /end AXIS_PTS
/begin CHARACTERISTIC CaSOF_DischargePowerSlopeSocTempMapZ_Kw "" MAP 0x7001936e Lookup2D_FLOAT32_IEEE 0 VBU0513_CM_single_cnt -3.4028234663852886E+38 3.4028234663852886E+38
 /begin AXIS_DESCR COM_AXIS SOC_pctCellSocMin VBU0513_CM_single_cnt 13 -3.4028234663852886E+38 3.4028234663852886E+38 AXIS_PTS_REF CaSOF_DischargePowerSlopeSocTempMapY_pct /end AXIS_DESCR
 /begin AXIS_DESCR COM_AXIS NO_INPUT_QUANTITY VBU0513_CM_single_cnt 14 -3.4028234663852886E+38 3.4028234663852886E+38 AXIS_PTS_REF CaSOF_DischargePowerSlopeSocTempMapX_C /end AXIS_DESCR
/end CHARACTERISTIC
/begin AXIS_PTS CaSOF_DischargePowerSlopeSocTempMapX_C "" 0x70013ab6 NO_INPUT_QUANTITY Lookup2D_X_FLOAT32_IEEE 0 VBU0513_CM_single_cnt 14 -3.4028234663852886E+38 3.4028234663852886E+38 /end AXIS_PTS
/begin AXIS_PTS CaSOF_DischargePowerSlopeSocTempMapY_pct "" 0x700135f2 SOC_pctCellSocMin Lookup2D_X_FLOAT32_IEEE 0 VBU0513_CM_single_cnt 13 -3.4028234663852886E+38 3.4028234663852886E+38 /end AXIS_PTS
/begin CHARACTERISTIC CaSOF_ChargePowerSlopeSocTempMapZ_Kw "" MAP 0x70018536 Lookup2D_FLOAT32_IEEE 0 VBU0513_CM_single_cnt -3.4028234663852886E+38 3.4028234663852886E+38
 /begin AXIS_DESCR COM_AXIS SOC_pctCellSocMax VBU0513_CM_single_cnt 13 -3.4028234663852886E+38 3.4028234663852886E+38 AXIS_PTS_REF CaSOF_ChargePowerSlopeSocTempMapY_pct /end AXIS_DESCR
 /begin AXIS_DESCR COM_AXIS NO_INPUT_QUANTITY VBU0513_CM_single_cnt 14 -3.4028234663852886E+38 3.4028234663852886E+38 AXIS_PTS_REF CaSOF_ChargePowerSlopeSocTempMapX_C /end AXIS_DESCR
/end CHARACTERISTIC
/begin AXIS_PTS CaSOF_ChargePowerSlopeSocTempMapX_C "" 0x7001399e NO_INPUT_QUANTITY Lookup2D_X_FLOAT32_IEEE 0 VBU0513_CM_single_cnt 14 -3.4028234663852886E+38 3.4028234663852886E+38 /end AXIS_PTS
/begin AXIS_PTS CaSOF_ChargePowerSlopeSocTempMapY_pct "" 0x700134ee SOC_pctCellSocMax Lookup2D_X_FLOAT32_IEEE 0 VBU0513_CM_single_cnt 13 -3.4028234663852886E+38 3.4028234663852886E+38 /end AXIS_PTS
/begin CHARACTERISTIC CaTHM_OutletCoolantTempMapZ_C "" MAP 0x70014fea Lookup2D_FLOAT32_IEEE 0 VBU0513_CM_single_cnt -40.0 80.0
 /begin AXIS_DESCR COM_AXIS THM_tInletCoolantTemp VBU0513_CM_single_cnt 5 -40.0 80.0 AXIS_PTS_REF CaTHM_InletCoolantTempMapY_C /end AXIS_DESCR
 /begin AXIS_DESCR COM_AXIS CTM_tCellTempAve VBU0513_CM_single_cnt 7 -40.0 80.0 AXIS_PTS_REF CaTHM_CellTempAveMapX_C /end AXIS_DESCR
/end CHARACTERISTIC
/begin AXIS_PTS CaTHM_CellTempAveMapX_C "" 0x7001257e CTM_tCellTempAve Lookup2D_X_FLOAT32_IEEE 0 VBU0513_CM_single_cnt 7 -40.0 80.0 /end AXIS_PTS
/begin AXIS_PTS CaTHM_InletCoolantTempMapY_C "" 0x70011ec6 THM_tInletCoolantTemp Lookup2D_X_FLOAT32_IEEE 0 VBU0513_CM_single_cnt 5 -40.0 80.0 /end AXIS_PTS
/begin CHARACTERISTIC CcSOC_BatterySocHighFault10Cycles_pct "" VALUE 0x700107e0 Scalar_FLOAT32_IEEE 0 VBU0513_CM_single_cnt -3.4028234663852886E+38 3.4028234663852886E+38 /end CHARACTERISTIC
/begin CHARACTERISTIC CcSOC_BatterySocHighFault70Cycles_pct "" VALUE 0x700107e4 Scalar_FLOAT32_IEEE 0 VBU0513_CM_single_cnt -3.4028234663852886E+38 3.4028234663852886E+38 /end CHARACTERISTIC
/begin CHARACTERISTIC CcSOC_BatterySocHighFault_pct "" VALUE 0x700107e8 Scalar_FLOAT32_IEEE 0 VBU0513_CM_single_cnt -3.4028234663852886E+38 3.4028234663852886E+38 /end CHARACTERISTIC
/begin CHARACTERISTIC CcSOC_BatterySocLowFault10Cycles_pct "" VALUE 0x700107ec Scalar_FLOAT32_IEEE 0 VBU0513_CM_single_cnt -3.4028234663852886E+38 3.4028234663852886E+38 /end CHARACTERISTIC
/begin CHARACTERISTIC CcSOC_BatterySocLowFault70Cycles_pct "" VALUE 0x700107f0 Scalar_FLOAT32_IEEE 0 VBU0513_CM_single_cnt -3.4028234663852886E+38 3.4028234663852886E+38 /end CHARACTERISTIC
/begin CHARACTERISTIC CcSOC_BatterySocLowFault_pct "" VALUE 0x700107f4 Scalar_FLOAT32_IEEE 0 VBU0513_CM_single_cnt -3.4028234663852886E+38 3.4028234663852886E+38 /end CHARACTERISTIC
/begin CHARACTERISTIC CcSOC_BatterySocLowerLimit_pct "" VALUE 0x700107f8 Scalar_FLOAT32_IEEE 0 VBU0513_CM_single_cnt -3.4028234663852886E+38 3.4028234663852886E+38 /end CHARACTERISTIC
/begin CHARACTERISTIC CcSOC_BatterySocUpperLimit_pct "" VALUE 0x70010800 Scalar_FLOAT32_IEEE 0 VBU0513_CM_single_cnt -3.4028234663852886E+38 3.4028234663852886E+38 /end CHARACTERISTIC
/begin CHARACTERISTIC CcSOC_BatteryUsableSocLowerLimit10Cycles_pct "" VALUE 0x70010804 Scalar_FLOAT32_IEEE 0 VBU0513_CM_single_cnt -3.4028234663852886E+38 3.4028234663852886E+38 /end CHARACTERISTIC
/begin CHARACTERISTIC CcSOC_BatteryUsableSocLowerLimit70Cycles_pct "" VALUE 0x70010808 Scalar_FLOAT32_IEEE 0 VBU0513_CM_single_cnt -3.4028234663852886E+38 3.4028234663852886E+38 /end CHARACTERISTIC
/begin CHARACTERISTIC CcSOC_BatteryUsableSocLowerLimitHomo_pct "" VALUE 0x7001080c Scalar_FLOAT32_IEEE 0 VBU0513_CM_single_cnt -3.4028234663852886E+38 3.4028234663852886E+38 /end CHARACTERISTIC
/begin CHARACTERISTIC CcSOC_BatteryUsableSocLowerLimit_pct "" VALUE 0x70010810 Scalar_FLOAT32_IEEE 0 VBU0513_CM_single_cnt -3.4028234663852886E+38 3.4028234663852886E+38 /end CHARACTERISTIC
/begin CHARACTERISTIC CcSOC_BatteryUsableSocUpperLimit10Cycles_pct "" VALUE 0x70010814 Scalar_FLOAT32_IEEE 0 VBU0513_CM_single_cnt -3.4028234663852886E+38 3.4028234663852886E+38 /end CHARACTERISTIC
/begin CHARACTERISTIC CcSOC_BatteryUsableSocUpperLimit70Cycles_pct "" VALUE 0x70010818 Scalar_FLOAT32_IEEE 0 VBU0513_CM_single_cnt -3.4028234663852886E+38 3.4028234663852886E+38 /end CHARACTERISTIC
/begin CHARACTERISTIC CcSOC_BatteryUsableSocUpperLimitHomo_pct "" VALUE 0x7001081c Scalar_FLOAT32_IEEE 0 VBU0513_CM_single_cnt -3.4028234663852886E+38 3.4028234663852886E+38 /end CHARACTERISTIC
/begin CHARACTERISTIC CcSOC_BatteryUsableSocUpperLimit_pct "" VALUE 0x70010820 Scalar_FLOAT32_IEEE 0 VBU0513_CM_single_cnt -3.4028234663852886E+38 3.4028234663852886E+38 /end CHARACTERISTIC
/begin CHARACTERISTIC CcSOC_CellArraySOCOvrdVal_pct "" VALUE 0x7001082c Scalar_FLOAT32_IEEE 0 VBU0513_CM_single_cnt -3.4028234663852886E+38 3.4028234663852886E+38 /end CHARACTERISTIC
/begin CHARACTERISTIC CcSOC_CellSocLowerLimit_pct "" VALUE 0x7001083c Scalar_FLOAT32_IEEE 0 VBU0513_CM_single_cnt -3.4028234663852886E+38 3.4028234663852886E+38 /end CHARACTERISTIC
/begin CHARACTERISTIC CcSOC_CellSocUpperLimit_pct "" VALUE 0x70010848 Scalar_FLOAT32_IEEE 0 VBU0513_CM_single_cnt -3.4028234663852886E+38 3.4028234663852886E+38 /end CHARACTERISTIC
/begin CHARACTERISTIC CcSOC_OcvShortTimeSocErrorThreshold_pct "" VALUE 0x70010894 Scalar_FLOAT32_IEEE 0 VBU0513_CM_single_cnt -3.4028234663852886E+38 3.4028234663852886E+38 /end CHARACTERISTIC
/begin CHARACTERISTIC CcSOC_OcvShortTimeVolDiffDis_mV "" VALUE 0x70010898 Scalar_FLOAT32_IEEE 0 VBU0513_CM_single_cnt -3.4028234663852886E+38 3.4028234663852886E+38 /end CHARACTERISTIC
/begin CHARACTERISTIC CcSOE_DischargeCutOffSoc_pct "" VALUE 0x700108b0 Scalar_FLOAT32_IEEE 0 VBU0513_CM_single_cnt -3.4028234663852886E+38 3.4028234663852886E+38 /end CHARACTERISTIC
/begin CHARACTERISTIC CcSOE_EnergyDecRate_Kwh "" VALUE 0x700108b4 Scalar_FLOAT32_IEEE 0 VBU0513_CM_single_cnt -3.4028234663852886E+38 3.4028234663852886E+38 /end CHARACTERISTIC
/begin CHARACTERISTIC CcSOE_EnergyIncRate_Kwh "" VALUE 0x700108b8 Scalar_FLOAT32_IEEE 0 VBU0513_CM_single_cnt -3.4028234663852886E+38 3.4028234663852886E+38 /end CHARACTERISTIC
/begin CHARACTERISTIC CcSOF_CapacityScalingFactor_n "" VALUE 0x700108dc Scalar_FLOAT32_IEEE 0 VBU0513_CM_single_cnt -3.4028234663852886E+38 3.4028234663852886E+38 /end CHARACTERISTIC
/begin CHARACTERISTIC CcSOF_ChargeCurrentSlopeFccMode_A "" VALUE 0x700108ec Scalar_FLOAT32_IEEE 0 VBU0513_CM_single_cnt -3.4028234663852886E+38 3.4028234663852886E+38 /end CHARACTERISTIC
/begin CHARACTERISTIC CcSOF_ChargeCurrentSlope_A "" VALUE 0x700108f0 Scalar_FLOAT32_IEEE 0 VBU0513_CM_single_cnt -3.4028234663852886E+38 3.4028234663852886E+38 /end CHARACTERISTIC
/begin CHARACTERISTIC CcSOF_ChargePowerLimitViolationThreshold_Kws "" VALUE 0x700108f4 Scalar_FLOAT32_IEEE 0 VBU0513_CM_single_cnt -3.4028234663852886E+38 3.4028234663852886E+38 /end CHARACTERISTIC
/begin CHARACTERISTIC CcSOF_DischargeCurrentSlope_A "" VALUE 0x70010940 Scalar_FLOAT32_IEEE 0 VBU0513_CM_single_cnt -3.4028234663852886E+38 3.4028234663852886E+38 /end CHARACTERISTIC
/begin CHARACTERISTIC CcSOF_DischargePowerLimitViolationThreshold_Kws "" VALUE 0x70010958 Scalar_FLOAT32_IEEE 0 VBU0513_CM_single_cnt -3.4028234663852886E+38 3.4028234663852886E+38 /end CHARACTERISTIC
/begin CHARACTERISTIC CcSOF_LowTempOverCurrentBufferEmpty_As "" VALUE 0x700109ac Scalar_FLOAT32_IEEE 0 VBU0513_CM_single_cnt -3.4028234663852886E+38 3.4028234663852886E+38 /end CHARACTERISTIC
/begin CHARACTERISTIC CcSOF_LowTempOverCurrent_A "" VALUE 0x700109b0 Scalar_FLOAT32_IEEE 0 VBU0513_CM_single_cnt -3.4028234663852886E+38 3.4028234663852886E+38 /end CHARACTERISTIC
/begin CHARACTERISTIC CcSYS_BatteryChargeCurrentMax_A "" VALUE 0x70010ab4 Scalar_FLOAT32_IEEE 0 VBU0513_CM_single_single -3.4028234663852886E+38 3.4028234663852886E+38 /end CHARACTERISTIC
/begin CHARACTERISTIC CcSYS_BatteryRatedVoltage_V "" VALUE 0x70010ab8 Scalar_FLOAT32_IEEE 0 VBU0513_CM_single_cnt -3.4028234663852886E+38 3.4028234663852886E+38 /end CHARACTERISTIC
/begin CHARACTERISTIC CcSYS_CellSOCLockedMax_pct "" VALUE 0x70010abc Scalar_FLOAT32_IEEE 0 VBU0513_CM_single_cnt -3.4028234663852886E+38 3.4028234663852886E+38 /end CHARACTERISTIC
/begin CHARACTERISTIC CcSYS_CellSOCLockedMin_pct "" VALUE 0x70010ac0 Scalar_FLOAT32_IEEE 0 VBU0513_CM_single_cnt -3.4028234663852886E+38 3.4028234663852886E+38 /end CHARACTERISTIC
/begin CHARACTERISTIC CcSYS_FullChargeSoc_pct "" VALUE 0x70010ac4 Scalar_FLOAT32_IEEE 0 VBU0513_CM_single_pct -3.4028234663852886E+38 3.4028234663852886E+38 /end CHARACTERISTIC
/begin CHARACTERISTIC CcSYS_NoChargeHighTemp_C "" VALUE 0x70010acc Scalar_FLOAT32_IEEE 0 VBU0513_CM_single_cnt -3.4028234663852886E+38 3.4028234663852886E+38 /end CHARACTERISTIC
/begin CHARACTERISTIC CcSYS_TrickleChargeCurrent_A "" VALUE 0x70010ae0 Scalar_FLOAT32_IEEE 0 VBU0513_CM_single_cnt -3.4028234663852886E+38 3.4028234663852886E+38 /end CHARACTERISTIC
/begin CHARACTERISTIC CcTHM_CoolantSensorOorHigh_C "" VALUE 0x70010af0 Scalar_FLOAT32_IEEE 0 VBU0513_CM_single_cnt -3.4028234663852886E+38 3.4028234663852886E+38 /end CHARACTERISTIC
/begin CHARACTERISTIC CcTHM_CoolantSensorOorLow_C "" VALUE 0x70010af4 Scalar_FLOAT32_IEEE 0 VBU0513_CM_single_cnt -3.4028234663852886E+38 3.4028234663852886E+38 /end CHARACTERISTIC
/begin CHARACTERISTIC CcTHM_CoolingReponseCellTemp_C "" VALUE 0x70010af8 Scalar_FLOAT32_IEEE 0 VBU0513_CM_single_cnt -3.4028234663852886E+38 3.4028234663852886E+38 /end CHARACTERISTIC
/begin CHARACTERISTIC CcTHM_CoolingReponseInletTemp_C "" VALUE 0x70010afc Scalar_FLOAT32_IEEE 0 VBU0513_CM_single_cnt -3.4028234663852886E+38 3.4028234663852886E+38 /end CHARACTERISTIC
/begin CHARACTERISTIC CcTHM_InletCoolingTempDeviation_C "" VALUE 0x70010b18 Scalar_FLOAT32_IEEE 0 VBU0513_CM_single_cnt -3.4028234663852886E+38 3.4028234663852886E+38 /end CHARACTERISTIC
/begin CHARACTERISTIC CcTHM_InletOutletTempDeltaThreshold_C "" VALUE 0x70010b1c Scalar_FLOAT32_IEEE 0 VBU0513_CM_single_cnt -3.4028234663852886E+38 3.4028234663852886E+38 /end CHARACTERISTIC
/begin CHARACTERISTIC CcVCT_BatteryRatedVoltage_V "" VALUE 0x70010be4 Scalar_FLOAT32_IEEE 0 VBU0513_CM_single_V -3.4028234663852886E+38 3.4028234663852886E+38 /end CHARACTERISTIC
/begin CHARACTERISTIC CcVCT_BatteryVoltageLimitMax_V "" VALUE 0x70010be8 Scalar_FLOAT32_IEEE 0 VBU0513_CM_single_V -3.4028234663852886E+38 3.4028234663852886E+38 /end CHARACTERISTIC
/begin CHARACTERISTIC CcVCT_BatteryVoltageLimitMin_V "" VALUE 0x70010bec Scalar_FLOAT32_IEEE 0 VBU0513_CM_single_V -3.4028234663852886E+38 3.4028234663852886E+38 /end CHARACTERISTIC
/begin CHARACTERISTIC CcVCT_NominalCellCapacity_Ah "" VALUE 0x70010c08 Scalar_FLOAT32_IEEE 0 VBU0513_CM_single_Ah -3.4028234663852886E+38 3.4028234663852886E+38 /end CHARACTERISTIC
/begin CHARACTERISTIC CcVCT_SOCJumpSOCLow_pct "" VALUE 0x70010c0c Scalar_FLOAT32_IEEE 0 VBU0513_CM_single_pct -3.4028234663852886E+38 3.4028234663852886E+38 /end CHARACTERISTIC
/begin CHARACTERISTIC CcVCT_SOCJumpThreshold_pct "" VALUE 0x70010c10 Scalar_FLOAT32_IEEE 0 VBU0513_CM_single_pct -3.4028234663852886E+38 3.4028234663852886E+38 /end CHARACTERISTIC
/begin CHARACTERISTIC CcVCT_SOCLowWarningThreshold1_pct "" VALUE 0x70010c14 Scalar_FLOAT32_IEEE 0 VBU0513_CM_single_pct -3.4028234663852886E+38 3.4028234663852886E+38 /end CHARACTERISTIC
/begin CHARACTERISTIC CcVCT_SOCLowWarningThreshold2_pct "" VALUE 0x70010c18 Scalar_FLOAT32_IEEE 0 VBU0513_CM_single_pct -3.4028234663852886E+38 3.4028234663852886E+38 /end CHARACTERISTIC
/begin CHARACTERISTIC CcVCT_SocInitializationMaxTime_ms "" VALUE 0x70010c1c Scalar_FLOAT32_IEEE 0 VBU0513_CM_single_ms -3.4028234663852886E+38 3.4028234663852886E+38 /end CHARACTERISTIC
/begin CHARACTERISTIC DCH_facLimitChrCrnntLvl0V_C "" VALUE 0x70010ca0 Scalar_FLOAT32_IEEE 0 VBU0513_CM_single_cnt -3.4028234663852886E+38 3.4028234663852886E+38 /end CHARACTERISTIC
/begin CHARACTERISTIC DCH_facLimitChrCrnntLvl1V_C "" VALUE 0x70010ca4 Scalar_FLOAT32_IEEE 0 VBU0513_CM_single_cnt -3.4028234663852886E+38 3.4028234663852886E+38 /end CHARACTERISTIC
/begin CHARACTERISTIC DCH_facLimitChrCrnntLvl2V_C "" VALUE 0x70010ca8 Scalar_FLOAT32_IEEE 0 VBU0513_CM_single_cnt -3.4028234663852886E+38 3.4028234663852886E+38 /end CHARACTERISTIC
/begin CHARACTERISTIC DCH_facLimitChrCrnntLvl3V_C "" VALUE 0x70010cac Scalar_FLOAT32_IEEE 0 VBU0513_CM_single_cnt -3.4028234663852886E+38 3.4028234663852886E+38 /end CHARACTERISTIC
/begin CHARACTERISTIC DCH_facOneTmpSnsrInvldLmt_C "" VALUE 0x70010cb0 Scalar_FLOAT32_IEEE 0 VBU0513_CM_single_cnt -3.4028234663852886E+38 3.4028234663852886E+38 /end CHARACTERISTIC
/begin CHARACTERISTIC DCH_iBCLCurrReqOvrdVal_C "" VALUE 0x70010cb4 Scalar_FLOAT32_IEEE 0 VBU0513_CM_single_cnt -3.4028234663852886E+38 3.4028234663852886E+38 /end CHARACTERISTIC
/begin CHARACTERISTIC DCH_iCMLMinChCurr_C "" VALUE 0x70010cc8 Scalar_FLOAT32_IEEE 0 VBU0513_CM_single_cnt -3.4028234663852886E+38 3.4028234663852886E+38 /end CHARACTERISTIC
/begin CHARACTERISTIC DCH_iDCChOneSnsrInvldCrntLmt_C "" VALUE 0x70010ccc Scalar_FLOAT32_IEEE 0 VBU0513_CM_single_cnt -3.4028234663852886E+38 3.4028234663852886E+38 /end CHARACTERISTIC
/begin CHARACTERISTIC DCH_iDCChPortFailureChCurr_C "" VALUE 0x70010cd0 Scalar_FLOAT32_IEEE 0 VBU0513_CM_single_cnt -3.4028234663852886E+38 3.4028234663852886E+38 /end CHARACTERISTIC
/begin CHARACTERISTIC DCH_iDCChReqLowLim_C "" VALUE 0x70010cd4 Scalar_FLOAT32_IEEE 0 VBU0513_CM_single_cnt -3.4028234663852886E+38 3.4028234663852886E+38 /end CHARACTERISTIC
/begin CHARACTERISTIC DCH_iDCChReqUpLim_C "" VALUE 0x70010cd8 Scalar_FLOAT32_IEEE 0 VBU0513_CM_single_cnt -3.4028234663852886E+38 3.4028234663852886E+38 /end CHARACTERISTIC
/begin CHARACTERISTIC DCH_iStatnLackCrnntThres_C "" VALUE 0x70010ce4 Scalar_FLOAT32_IEEE 0 VBU0513_CM_single_cnt -3.4028234663852886E+38 3.4028234663852886E+38 /end CHARACTERISTIC
/begin CHARACTERISTIC DCH_numBCSMaxCellNumLowLim_C "" VALUE 0x70010ce8 Scalar_FLOAT32_IEEE 0 VBU0513_CM_single_cnt -3.4028234663852886E+38 3.4028234663852886E+38 /end CHARACTERISTIC
/begin CHARACTERISTIC DCH_numBCSMaxCellNumUpLim_C "" VALUE 0x70010cec Scalar_FLOAT32_IEEE 0 VBU0513_CM_single_cnt -3.4028234663852886E+38 3.4028234663852886E+38 /end CHARACTERISTIC
/begin CHARACTERISTIC DCH_pctBSDChEndSocOvrdVal_C "" VALUE 0x70010d64 Scalar_FLOAT32_IEEE 0 VBU0513_CM_single_cnt -3.4028234663852886E+38 3.4028234663852886E+38 /end CHARACTERISTIC
/begin CHARACTERISTIC DCH_tBCPMaxPermitTempLowLim_C "" VALUE 0x70010d68 Scalar_FLOAT32_IEEE 0 VBU0513_CM_single_cnt -3.4028234663852886E+38 3.4028234663852886E+38 /end CHARACTERISTIC
/begin CHARACTERISTIC DCH_tBCPMaxPermitTempUpLim_C "" VALUE 0x70010d70 Scalar_FLOAT32_IEEE 0 VBU0513_CM_single_cnt -3.4028234663852886E+38 3.4028234663852886E+38 /end CHARACTERISTIC
/begin CHARACTERISTIC DCH_tBSDMaxCellTempOvrdVal_C "" VALUE 0x70010d74 Scalar_FLOAT32_IEEE 0 VBU0513_CM_single_cnt -3.4028234663852886E+38 3.4028234663852886E+38 /end CHARACTERISTIC
/begin CHARACTERISTIC DCH_tBSDMinCellTempOvrdVal_C "" VALUE 0x70010d78 Scalar_FLOAT32_IEEE 0 VBU0513_CM_single_cnt -3.4028234663852886E+38 3.4028234663852886E+38 /end CHARACTERISTIC
/begin CHARACTERISTIC DCH_tBSMMaxCellTempOvrdVal_C "" VALUE 0x70010d7c Scalar_FLOAT32_IEEE 0 VBU0513_CM_single_cnt -3.4028234663852886E+38 3.4028234663852886E+38 /end CHARACTERISTIC
/begin CHARACTERISTIC DCH_tBSMMinCellTempOvrdVal_C "" VALUE 0x70010d80 Scalar_FLOAT32_IEEE 0 VBU0513_CM_single_cnt -3.4028234663852886E+38 3.4028234663852886E+38 /end CHARACTERISTIC
/begin CHARACTERISTIC DCH_tLimitChrCrnntLvl1L_C "" VALUE 0x70010d88 Scalar_FLOAT32_IEEE 0 VBU0513_CM_single_cnt -3.4028234663852886E+38 3.4028234663852886E+38 /end CHARACTERISTIC
/begin CHARACTERISTIC DCH_tLimitChrCrnntLvl1R_C "" VALUE 0x70010d8c Scalar_FLOAT32_IEEE 0 VBU0513_CM_single_cnt -3.4028234663852886E+38 3.4028234663852886E+38 /end CHARACTERISTIC
/begin CHARACTERISTIC DCH_tLimitChrCrnntLvl2L_C "" VALUE 0x70010d90 Scalar_FLOAT32_IEEE 0 VBU0513_CM_single_cnt -3.4028234663852886E+38 3.4028234663852886E+38 /end CHARACTERISTIC
/begin CHARACTERISTIC DCH_tLimitChrCrnntLvl2R_C "" VALUE 0x70010d94 Scalar_FLOAT32_IEEE 0 VBU0513_CM_single_cnt -3.4028234663852886E+38 3.4028234663852886E+38 /end CHARACTERISTIC
/begin CHARACTERISTIC DCH_tLimitChrCrnntLvl3L_C "" VALUE 0x70010d98 Scalar_FLOAT32_IEEE 0 VBU0513_CM_single_cnt -3.4028234663852886E+38 3.4028234663852886E+38 /end CHARACTERISTIC
/begin CHARACTERISTIC DCH_tLimitChrCrnntLvl3R_C "" VALUE 0x70010d9c Scalar_FLOAT32_IEEE 0 VBU0513_CM_single_cnt -3.4028234663852886E+38 3.4028234663852886E+38 /end CHARACTERISTIC
/begin CHARACTERISTIC DCH_tiBCSEstChTiLowLim_C "" VALUE 0x70010db4 Scalar_FLOAT32_IEEE 0 VBU0513_CM_single_cnt -3.4028234663852886E+38 3.4028234663852886E+38 /end CHARACTERISTIC
/begin CHARACTERISTIC DCH_tiBCSEstChTiUpLim_C "" VALUE 0x70010db8 Scalar_FLOAT32_IEEE 0 VBU0513_CM_single_cnt -3.4028234663852886E+38 3.4028234663852886E+38 /end CHARACTERISTIC
/begin CHARACTERISTIC DCH_tiCCSTOut_C "" VALUE 0x70010dcc Scalar_FLOAT32_IEEE 0 VBU0513_CM_single_cnt -3.4028234663852886E+38 3.4028234663852886E+38 /end CHARACTERISTIC
/begin CHARACTERISTIC DCH_tiCHMtoCRMTOut_C "" VALUE 0x70010dd0 Scalar_FLOAT32_IEEE 0 VBU0513_CM_single_cnt -3.4028234663852886E+38 3.4028234663852886E+38 /end CHARACTERISTIC
/begin CHARACTERISTIC DCH_tiCRM00TOutStrtFrmCHM_C "" VALUE 0x70010dd4 Scalar_FLOAT32_IEEE 0 VBU0513_CM_single_cnt -3.4028234663852886E+38 3.4028234663852886E+38 /end CHARACTERISTIC
/begin CHARACTERISTIC DCH_tiCRM00TOut_C "" VALUE 0x70010dd8 Scalar_FLOAT32_IEEE 0 VBU0513_CM_single_cnt -3.4028234663852886E+38 3.4028234663852886E+38 /end CHARACTERISTIC
/begin CHARACTERISTIC DCH_tiCRMAATOut_C "" VALUE 0x70010ddc Scalar_FLOAT32_IEEE 0 VBU0513_CM_single_cnt -3.4028234663852886E+38 3.4028234663852886E+38 /end CHARACTERISTIC
/begin CHARACTERISTIC DCH_tiCROAATOutStrtFrmBRO_C "" VALUE 0x70010de0 Scalar_FLOAT32_IEEE 0 VBU0513_CM_single_cnt -3.4028234663852886E+38 3.4028234663852886E+38 /end CHARACTERISTIC
/begin CHARACTERISTIC DCH_tiCROAATOut_C "" VALUE 0x70010de4 Scalar_FLOAT32_IEEE 0 VBU0513_CM_single_cnt -3.4028234663852886E+38 3.4028234663852886E+38 /end CHARACTERISTIC
/begin CHARACTERISTIC DCH_tiCSTTOut_C "" VALUE 0x70010de8 Scalar_FLOAT32_IEEE 0 VBU0513_CM_single_cnt -3.4028234663852886E+38 3.4028234663852886E+38 /end CHARACTERISTIC
/begin CHARACTERISTIC DCH_tiChCap_C "" VALUE 0x70010df0 Scalar_FLOAT32_IEEE 0 VBU0513_CM_single_cnt -3.4028234663852886E+38 3.4028234663852886E+38 /end CHARACTERISTIC
/begin CHARACTERISTIC DCH_tiChRdy_C "" VALUE 0x70010df4 Scalar_FLOAT32_IEEE 0 VBU0513_CM_single_cnt -3.4028234663852886E+38 3.4028234663852886E+38 /end CHARACTERISTIC
/begin CHARACTERISTIC DCH_tiChgrAvl_C "" VALUE 0x70010df8 Scalar_FLOAT32_IEEE 0 VBU0513_CM_single_cnt -3.4028234663852886E+38 3.4028234663852886E+38 /end CHARACTERISTIC
/begin CHARACTERISTIC DCH_tiDCChRly_C "" VALUE 0x70010e04 Scalar_FLOAT32_IEEE 0 VBU0513_CM_single_cnt -3.4028234663852886E+38 3.4028234663852886E+38 /end CHARACTERISTIC
/begin CHARACTERISTIC DCH_tiDCRlyDiagDly_C "" VALUE 0x70010e08 Scalar_FLOAT32_IEEE 0 VBU0513_CM_single_cnt -3.4028234663852886E+38 3.4028234663852886E+38 /end CHARACTERISTIC
/begin CHARACTERISTIC DCH_tiDlyCCSnotChging_C "" VALUE 0x70010e10 Scalar_FLOAT32_IEEE 0 VBU0513_CM_single_cnt -3.4028234663852886E+38 3.4028234663852886E+38 /end CHARACTERISTIC
/begin CHARACTERISTIC DCH_tiOpenHvRly_C "" VALUE 0x70010e14 Scalar_FLOAT32_IEEE 0 VBU0513_CM_single_cnt -3.4028234663852886E+38 3.4028234663852886E+38 /end CHARACTERISTIC
/begin CHARACTERISTIC DCH_tiReStartChProcess_C "" VALUE 0x70010e18 Scalar_FLOAT32_IEEE 0 VBU0513_CM_single_cnt -3.4028234663852886E+38 3.4028234663852886E+38 /end CHARACTERISTIC
/begin CHARACTERISTIC DCH_tiSmplT_SY "" VALUE 0x70010e1c Scalar_FLOAT32_IEEE 0 VBU0513_CM_single_cnt -3.4028234663852886E+38 3.4028234663852886E+38 /end CHARACTERISTIC
/begin CHARACTERISTIC DCH_tiStatnLackCrnntThres_C "" VALUE 0x70010e20 Scalar_FLOAT32_IEEE 0 VBU0513_CM_single_cnt -3.4028234663852886E+38 3.4028234663852886E+38 /end CHARACTERISTIC
/begin CHARACTERISTIC DCH_tisinceBEMCEMTOut_C "" VALUE 0x70010e24 Scalar_FLOAT32_IEEE 0 VBU0513_CM_single_cnt -3.4028234663852886E+38 3.4028234663852886E+38 /end CHARACTERISTIC
/begin CHARACTERISTIC DCH_tisinceBSTSentOutTOut_C "" VALUE 0x70010e28 Scalar_FLOAT32_IEEE 0 VBU0513_CM_single_cnt -3.4028234663852886E+38 3.4028234663852886E+38 /end CHARACTERISTIC
/begin CHARACTERISTIC DCH_uBCLVltgReqOvrdVal_C "" VALUE 0x70010e2c Scalar_FLOAT32_IEEE 0 VBU0513_CM_single_cnt -3.4028234663852886E+38 3.4028234663852886E+38 /end CHARACTERISTIC
/begin CHARACTERISTIC DCH_uBSDMaxCellVltgOvrdVal_C "" VALUE 0x70010e48 Scalar_FLOAT32_IEEE 0 VBU0513_CM_single_cnt -3.4028234663852886E+38 3.4028234663852886E+38 /end CHARACTERISTIC
/begin CHARACTERISTIC DCH_uBSDMinCellVltgOvrdVal_C "" VALUE 0x70010e4c Scalar_FLOAT32_IEEE 0 VBU0513_CM_single_cnt -3.4028234663852886E+38 3.4028234663852886E+38 /end CHARACTERISTIC
/begin CHARACTERISTIC DCH_uDCChReqLowLim_C "" VALUE 0x70010e50 Scalar_FLOAT32_IEEE 0 VBU0513_CM_single_cnt -3.4028234663852886E+38 3.4028234663852886E+38 /end CHARACTERISTIC
/begin CHARACTERISTIC DCH_uDCChReqUpLim_C "" VALUE 0x70010e54 Scalar_FLOAT32_IEEE 0 VBU0513_CM_single_cnt -3.4028234663852886E+38 3.4028234663852886E+38 /end CHARACTERISTIC
/begin CHARACTERISTIC EDIS_pwrDrvRstn_C "" VALUE 0x70011174 Scalar_FLOAT32_IEEE 0 VBU0513_CM_single_cnt 0.0 1.0E+23 /end CHARACTERISTIC
/begin CHARACTERISTIC WATS_PER_KILOWAT "" VALUE 0x70011a08 Scalar_FLOAT32_IEEE 0 VBU0513_CM_single_cnt -3.4028234663852886E+38 3.4028234663852886E+38 /end CHARACTERISTIC
/begin CHARACTERISTIC CaSOC_OcvShortTimeChMapDimension_n "" VAL_BLK 0x70011a1a Scalar_ULONG 0 VBU0513_CM_uint32_cnt 0.0 4.294967295E+9 NUMBER 2 /end CHARACTERISTIC
/begin CHARACTERISTIC CaSOC_OcvShortTimeDisMapDimension_n "" VAL_BLK 0x70011a22 Scalar_ULONG 0 VBU0513_CM_uint32_cnt 0.0 4.294967295E+9 NUMBER 2 /end CHARACTERISTIC
/begin CHARACTERISTIC CaSOF_ChargePowerSlopeSocTempMapDimension_n "" VAL_BLK 0x70011a4a Scalar_ULONG 0 VBU0513_CM_uint32_cnt 0.0 4.294967295E+9 NUMBER 2 /end CHARACTERISTIC
/begin CHARACTERISTIC CaSOF_DischargePowerSlopeSocTempMapDimension_n "" VAL_BLK 0x70011a82 Scalar_ULONG 0 VBU0513_CM_uint32_cnt 0.0 4.294967295E+9 NUMBER 2 /end CHARACTERISTIC
/begin CHARACTERISTIC CcRTC_ActualTimeDeviationThreshold_s "" VALUE 0x700107a4 Scalar_ULONG 0 VBU0513_CM_uint32_cnt 0.0 4.294967295E+9 /end CHARACTERISTIC
/begin CHARACTERISTIC CcSOC_BatteryCapacity10Cycles_n "" VALUE 0x700107c0 Scalar_ULONG 0 VBU0513_CM_uint32_cnt 0.0 4.294967295E+9 /end CHARACTERISTIC
/begin CHARACTERISTIC CcSOC_BatteryCapacity70Cycles_n "" VALUE 0x700107c4 Scalar_ULONG 0 VBU0513_CM_uint32_cnt 0.0 4.294967295E+9 /end CHARACTERISTIC
/begin CHARACTERISTIC CcSOC_OcvShortTimeDisChDiff_n "" VALUE 0x70010890 Scalar_ULONG 0 VBU0513_CM_uint32_cnt 0.0 4.294967295E+9 /end CHARACTERISTIC
/begin CHARACTERISTIC CcTHM_BatteryCapacityCycle_n "" VALUE 0x70010ae4 Scalar_ULONG 0 VBU0513_CM_uint32_cnt 0.0 4.294967295E+9 /end CHARACTERISTIC
/begin CHARACTERISTIC CcVCT_BMSProtocalVersion_n "" VALUE 0x70010bc0 Scalar_ULONG 0 VBU0513_CM_uint32_n 0.0 4.294967295E+9 /end CHARACTERISTIC
/begin CHARACTERISTIC DCH_numBRMBatChgTOvrdVal_C "" VALUE 0x70010cf4 Scalar_ULONG 0 VBU0513_CM_uint32_cnt 0.0 4.294967295E+9 /end CHARACTERISTIC
/begin CHARACTERISTIC DCH_numBRMBatGrpOvrdVal_C "" VALUE 0x70010cf8 Scalar_ULONG 0 VBU0513_CM_uint32_cnt 0.0 4.294967295E+9 /end CHARACTERISTIC
/begin CHARACTERISTIC DCH_numBRMBatProtcVerNew_C "" VALUE 0x70010cfc Scalar_ULONG 0 VBU0513_CM_uint32_cnt 0.0 4.294967295E+9 /end CHARACTERISTIC
/begin CHARACTERISTIC DCH_numBRMBatProtcVerOld_C "" VALUE 0x70010d00 Scalar_ULONG 0 VBU0513_CM_uint32_cnt 0.0 4.294967295E+9 /end CHARACTERISTIC
/begin CHARACTERISTIC DCH_numBRMBatSfwrVer1OvrdVal_C "" VALUE 0x70010d04 Scalar_ULONG 0 VBU0513_CM_uint32_cnt 0.0 4.294967295E+9 /end CHARACTERISTIC
/begin CHARACTERISTIC DCH_numBRMBatSfwrVer1_C "" VALUE 0x70010d08 Scalar_ULONG 0 VBU0513_CM_uint32_cnt 0.0 4.294967295E+9 /end CHARACTERISTIC
/begin CHARACTERISTIC DCH_numBRMBatSfwrVer2OvrdVal_C "" VALUE 0x70010d0c Scalar_ULONG 0 VBU0513_CM_uint32_cnt 0.0 4.294967295E+9 /end CHARACTERISTIC
/begin CHARACTERISTIC DCH_numBRMBatSfwrVer2_C "" VALUE 0x70010d10 Scalar_ULONG 0 VBU0513_CM_uint32_cnt 0.0 4.294967295E+9 /end CHARACTERISTIC
/begin CHARACTERISTIC DCH_numBRMBatSupOvrdVal_C "" VALUE 0x70010d14 Scalar_ULONG 0 VBU0513_CM_uint32_cnt 0.0 4.294967295E+9 /end CHARACTERISTIC
/begin CHARACTERISTIC DCH_numBRMVin1OvrdVal_C "" VALUE 0x70010d18 Scalar_ULONG 0 VBU0513_CM_uint32_cnt 0.0 4.294967295E+9 /end CHARACTERISTIC
/begin CHARACTERISTIC DCH_numBRMVin1_C "" VALUE 0x70010d1c Scalar_ULONG 0 VBU0513_CM_uint32_cnt 0.0 4.294967295E+9 /end CHARACTERISTIC
/begin CHARACTERISTIC DCH_numBRMVin2OvrdVal_C "" VALUE 0x70010d20 Scalar_ULONG 0 VBU0513_CM_uint32_cnt 0.0 4.294967295E+9 /end CHARACTERISTIC
/begin CHARACTERISTIC DCH_numBRMVin2_C "" VALUE 0x70010d24 Scalar_ULONG 0 VBU0513_CM_uint32_cnt 0.0 4.294967295E+9 /end CHARACTERISTIC
/begin CHARACTERISTIC DCH_numBRMVin3OvrdVal_C "" VALUE 0x70010d28 Scalar_ULONG 0 VBU0513_CM_uint32_cnt 0.0 4.294967295E+9 /end CHARACTERISTIC
/begin CHARACTERISTIC DCH_numBRMVin3_C "" VALUE 0x70010d2c Scalar_ULONG 0 VBU0513_CM_uint32_cnt 0.0 4.294967295E+9 /end CHARACTERISTIC
/begin CHARACTERISTIC DCH_numBSMMaxCellTempNumOvrdVal_C "" VALUE 0x70010d30 Scalar_ULONG 0 VBU0513_CM_uint32_cnt 0.0 4.294967295E+9 /end CHARACTERISTIC
/begin CHARACTERISTIC DCH_numBSMMaxCellVltgNumOvrdVal_C "" VALUE 0x70010d34 Scalar_ULONG 0 VBU0513_CM_uint32_cnt 0.0 4.294967295E+9 /end CHARACTERISTIC
/begin CHARACTERISTIC DCH_numBSMMinCellTempNumOvrdVal_C "" VALUE 0x70010d38 Scalar_ULONG 0 VBU0513_CM_uint32_cnt 0.0 4.294967295E+9 /end CHARACTERISTIC
/begin CHARACTERISTIC DCH_numInitialBRMBatChgT_C "" VALUE 0x70010d3c Scalar_ULONG 0 VBU0513_CM_uint32_cnt 0.0 4.294967295E+9 /end CHARACTERISTIC
/begin CHARACTERISTIC DCH_numInitialBRMBatGrp_C "" VALUE 0x70010d40 Scalar_ULONG 0 VBU0513_CM_uint32_cnt 0.0 4.294967295E+9 /end CHARACTERISTIC
/begin CHARACTERISTIC DCH_numInitialBRMBatSup_C "" VALUE 0x70010d44 Scalar_ULONG 0 VBU0513_CM_uint32_cnt 0.0 4.294967295E+9 /end CHARACTERISTIC
/begin CHARACTERISTIC DCH_numMaxChErrReconn_C "" VALUE 0x70010d48 Scalar_ULONG 0 VBU0513_CM_uint32_cnt 0.0 4.294967295E+9 /end CHARACTERISTIC
/begin CHARACTERISTIC DCH_numTOutCnt_C "" VALUE 0x70010d58 Scalar_ULONG 0 VBU0513_CM_uint32_cnt 0.0 4.294967295E+9 /end CHARACTERISTIC
/begin CHARACTERISTIC THM_INLET_COOLANT_SENSOR_OOR_HIGH_FAULT "" VALUE 0x70011670 Scalar_ULONG 0 VBU0513_CM_uint32_cnt 0.0 4.294967295E+9 /end CHARACTERISTIC
/begin CHARACTERISTIC THM_INLET_COOLANT_SENSOR_OOR_LOW_FAULT "" VALUE 0x70011674 Scalar_ULONG 0 VBU0513_CM_uint32_cnt 0.0 4.294967295E+9 /end CHARACTERISTIC
/begin CHARACTERISTIC THM_INLET_OUTLET_TEMP_DELTA_FAULT "" VALUE 0x70011678 Scalar_ULONG 0 VBU0513_CM_uint32_cnt 0.0 4.294967295E+9 /end CHARACTERISTIC
/begin CHARACTERISTIC THM_OUTLET_COOLANT_SENSOR_OOR_HIGH_FAULT "" VALUE 0x7001167c Scalar_ULONG 0 VBU0513_CM_uint32_cnt 0.0 4.294967295E+9 /end CHARACTERISTIC
/begin CHARACTERISTIC THM_OUTLET_COOLANT_SENSOR_OOR_LOW_FAULT "" VALUE 0x70011680 Scalar_ULONG 0 VBU0513_CM_uint32_cnt 0.0 4.294967295E+9 /end CHARACTERISTIC
/begin CHARACTERISTIC CcISO_DCStationFaultDelayTime_ms "" VALUE 0x700100b0 Scalar_UWORD 0 VBU0513_CM_uint16_ms 0.0 65535.0 /end CHARACTERISTIC
/begin CHARACTERISTIC CcOCV_RelaxationMinRequiredTime_s "" VALUE 0x700100b4 Scalar_UWORD 0 VBU0513_CM_uint16_cnt 0.0 65535.0 /end CHARACTERISTIC
/begin CHARACTERISTIC CcOCV_RelaxationRequiredShortTime_s "" VALUE 0x700100b6 Scalar_UWORD 0 VBU0513_CM_uint16_cnt 0.0 65535.0 /end CHARACTERISTIC
/begin CHARACTERISTIC CcSOC_BDMOutputDelayTime_ms "" VALUE 0x700100bc Scalar_UWORD 0 VBU0513_CM_uint16_cnt 0.0 65535.0 /end CHARACTERISTIC
/begin CHARACTERISTIC CcSOC_OcvCorrectionIntervalTime_s "" VALUE 0x700100cc Scalar_UWORD 0 VBU0513_CM_uint16_cnt 0.0 65535.0 /end CHARACTERISTIC
/begin CHARACTERISTIC CcSOC_OcvShortTimeCorrIntervalTime_s "" VALUE 0x700100ce Scalar_UWORD 0 VBU0513_CM_uint16_cnt 0.0 65535.0 /end CHARACTERISTIC
/begin CHARACTERISTIC CcSOC_OcvShortTimeVolDiffCh_mV "" VALUE 0x700100d0 Scalar_UWORD 0 VBU0513_CM_uint16_cnt 0.0 65535.0 /end CHARACTERISTIC
/begin CHARACTERISTIC CcSOC_OcvShortTimeVolDiffThreshold_mV "" VALUE 0x700100d2 Scalar_UWORD 0 VBU0513_CM_uint16_cnt 0.0 65535.0 /end CHARACTERISTIC
/begin CHARACTERISTIC CcSOC_OcvShortTimeVolThreshold_mV "" VALUE 0x700100d4 Scalar_UWORD 0 VBU0513_CM_uint16_cnt 0.0 65535.0 /end CHARACTERISTIC
/begin CHARACTERISTIC CcSOC_SocInitializationDelayTime_ms "" VALUE 0x700100da Scalar_UWORD 0 VBU0513_CM_uint16_cnt 0.0 65535.0 /end CHARACTERISTIC
/begin CHARACTERISTIC CcSOC_SocInitializationMaxTime_ms "" VALUE 0x700100dc Scalar_UWORD 0 VBU0513_CM_uint16_cnt 0.0 65535.0 /end CHARACTERISTIC
/begin CHARACTERISTIC CcSOE_SocInitializationMaxTime_ms "" VALUE 0x700100de Scalar_UWORD 0 VBU0513_CM_uint16_cnt 0.0 65535.0 /end CHARACTERISTIC
/begin CHARACTERISTIC CcSOF_ChargePowerViolationCurrentDelay_s "" VALUE 0x700100f0 Scalar_UWORD 0 VBU0513_CM_uint16_cnt 0.0 65535.0 /end CHARACTERISTIC
/begin CHARACTERISTIC CcSOF_LowTempOverCurrentCount_C "" VALUE 0x700100f4 Scalar_UWORD 0 VBU0513_CM_uint16_cnt 0.0 65535.0 /end CHARACTERISTIC
/begin CHARACTERISTIC CcSYS_CellVoltageMaxLimit_mV "" VALUE 0x70010116 Scalar_UWORD 0 VBU0513_CM_uint16_mV 0.0 65535.0 /end CHARACTERISTIC
/begin CHARACTERISTIC CcTHM_BdmDelay_s "" VALUE 0x7001011c Scalar_UWORD 0 VBU0513_CM_uint16_cnt 0.0 65535.0 /end CHARACTERISTIC
/begin CHARACTERISTIC CcTHM_CoolingResponseDelay_s "" VALUE 0x70010122 Scalar_UWORD 0 VBU0513_CM_uint16_cnt 0.0 65535.0 /end CHARACTERISTIC
/begin CHARACTERISTIC CcTHM_InletResponseDebounce_s "" VALUE 0x70010124 Scalar_UWORD 0 VBU0513_CM_uint16_cnt 0.0 65535.0 /end CHARACTERISTIC
/begin CHARACTERISTIC MILIVOLTAGES_PER_VOLTAGE "" VALUE 0x70010138 Scalar_UWORD 0 VBU0513_CM_uint16_cnt 0.0 65535.0 /end CHARACTERISTIC
/begin CHARACTERISTIC SAMPLE_TIME_TASK_E "" VALUE 0x70010142 Scalar_UWORD 0 VBU0513_CM_uint16_cnt 0.0 65535.0 /end CHARACTERISTIC
/begin CHARACTERISTIC SOC_BATTERY_SOC_HIGH_FAULT "" VALUE 0x70010146 Scalar_UWORD 0 VBU0513_CM_uint16_cnt 0.0 65535.0 /end CHARACTERISTIC
/begin CHARACTERISTIC SOC_BATTERY_SOC_LOW_FAULT "" VALUE 0x70010148 Scalar_UWORD 0 VBU0513_CM_uint16_cnt 0.0 65535.0 /end CHARACTERISTIC
/begin CHARACTERISTIC ABS_flgMsg068ChksmDisbl_C "" VALUE 0x7002099a Scalar_BOOLEAN 0 VBU0513_CM_boolean_flg 0.0 1.0 /end CHARACTERISTIC
/begin CHARACTERISTIC ABS_flgMsg068RollCntDisbl_C "" VALUE 0x7002099b Scalar_BOOLEAN 0 VBU0513_CM_boolean_flg 0.0 1.0 /end CHARACTERISTIC
/begin CHARACTERISTIC ABS_flgMsg075ChksmDisbl_C "" VALUE 0x7002099c Scalar_BOOLEAN 0 VBU0513_CM_boolean_flg 0.0 1.0 /end CHARACTERISTIC
/begin CHARACTERISTIC ABS_flgMsg075RollCntDisbl_C "" VALUE 0x7002099d Scalar_BOOLEAN 0 VBU0513_CM_boolean_flg 0.0 1.0 /end CHARACTERISTIC
/begin CHARACTERISTIC ABS_flgMsg079ChksmDisbl_C "" VALUE 0x7002099e Scalar_BOOLEAN 0 VBU0513_CM_boolean_flg 0.0 1.0 /end CHARACTERISTIC
/begin CHARACTERISTIC ABS_flgMsg079RollCntDisbl_C "" VALUE 0x7002099f Scalar_BOOLEAN 0 VBU0513_CM_boolean_flg 0.0 1.0 /end CHARACTERISTIC
/begin CHARACTERISTIC ABS_flgMsg115ChksmDisbl_C "" VALUE 0x700209a0 Scalar_BOOLEAN 0 VBU0513_CM_boolean_flg 0.0 1.0 /end CHARACTERISTIC
/begin CHARACTERISTIC ABS_flgMsg115RollCntDisbl_C "" VALUE 0x700209a1 Scalar_BOOLEAN 0 VBU0513_CM_boolean_flg 0.0 1.0 /end CHARACTERISTIC
/begin CHARACTERISTIC AVAS_flgMsg1801D0D3ChksmDisbl_C "" VALUE 0x70020a0e Scalar_BOOLEAN 0 VBU0513_CM_boolean_flg 0.0 1.0 /end CHARACTERISTIC
/begin CHARACTERISTIC AVAS_flgMsg1801D0D3RollCntDisbl_C "" VALUE 0x70020a0f Scalar_BOOLEAN 0 VBU0513_CM_boolean_flg 0.0 1.0 /end CHARACTERISTIC
/begin CHARACTERISTIC BCM_flgMsg18FE0121ChksmDisbl_C "" VALUE 0x70020a22 Scalar_BOOLEAN 0 VBU0513_CM_boolean_flg 0.0 1.0 /end CHARACTERISTIC
/begin CHARACTERISTIC BCM_flgMsg18FE0121RollCntDisbl_C "" VALUE 0x70020a23 Scalar_BOOLEAN 0 VBU0513_CM_boolean_flg 0.0 1.0 /end CHARACTERISTIC
/begin CHARACTERISTIC CCU_flgMsg248ChksmDisbl_C "" VALUE 0x70020a47 Scalar_BOOLEAN 0 VBU0513_CM_boolean_flg 0.0 1.0 /end CHARACTERISTIC
/begin CHARACTERISTIC CCU_flgMsg248RollCntDisbl_C "" VALUE 0x70020a48 Scalar_BOOLEAN 0 VBU0513_CM_boolean_flg 0.0 1.0 /end CHARACTERISTIC
/begin CHARACTERISTIC CDC_flgMsg220ChksmDisbl_C "" VALUE 0x70020a49 Scalar_BOOLEAN 0 VBU0513_CM_boolean_flg 0.0 1.0 /end CHARACTERISTIC
/begin CHARACTERISTIC CDC_flgMsg220RollCntDisbl_C "" VALUE 0x70020a4a Scalar_BOOLEAN 0 VBU0513_CM_boolean_flg 0.0 1.0 /end CHARACTERISTIC
/begin CHARACTERISTIC CbNVM_FirstRun_flg "" VALUE 0x70020b13 Scalar_BOOLEAN 0 VBU0513_CM_boolean_cnt 0.0 1.0 /end CHARACTERISTIC
/begin CHARACTERISTIC CbRTC_flgActualTimeCheckEnable "" VALUE 0x70020b15 Scalar_BOOLEAN 0 VBU0513_CM_boolean_cnt 0.0 1.0 /end CHARACTERISTIC
/begin CHARACTERISTIC CbSOC_BatterySocHighFaultEnable_flg "" VALUE 0x70020b18 Scalar_BOOLEAN 0 VBU0513_CM_boolean_cnt 0.0 1.0 /end CHARACTERISTIC
/begin CHARACTERISTIC CbSOC_BatterySocLowFaultEnable_flg "" VALUE 0x70020b19 Scalar_BOOLEAN 0 VBU0513_CM_boolean_cnt 0.0 1.0 /end CHARACTERISTIC
/begin CHARACTERISTIC CbSOC_CellArraySOCOvrdFlg_flg "" VALUE 0x70020b1a Scalar_BOOLEAN 0 VBU0513_CM_boolean_cnt 0.0 1.0 /end CHARACTERISTIC
/begin CHARACTERISTIC CbSOC_OcvShortTime_flg "" VALUE 0x70020b1e Scalar_BOOLEAN 0 VBU0513_CM_boolean_cnt 0.0 1.0 /end CHARACTERISTIC
/begin CHARACTERISTIC CbSOF_ChargePowerLimitViolationFaultEnable_flg "" VALUE 0x70020b20 Scalar_BOOLEAN 0 VBU0513_CM_boolean_cnt 0.0 1.0 /end CHARACTERISTIC
/begin CHARACTERISTIC CbSOF_CurrentLimitFastChargeCheckEnable_flg "" VALUE 0x70020b21 Scalar_BOOLEAN 0 VBU0513_CM_boolean_cnt 0.0 1.0 /end CHARACTERISTIC
/begin CHARACTERISTIC CbSOF_DischargePowerLimitViolationFaultEnable_flg "" VALUE 0x70020b22 Scalar_BOOLEAN 0 VBU0513_CM_boolean_cnt 0.0 1.0 /end CHARACTERISTIC
/begin CHARACTERISTIC CbSYS_HomoTestEnable_flg "" VALUE 0x70020b2c Scalar_BOOLEAN 0 VBU0513_CM_boolean_cnt 0.0 1.0 /end CHARACTERISTIC
/begin CHARACTERISTIC CbTHM_InletCoolantSensorOorHighFaultEnable_flg "" VALUE 0x70020b2e Scalar_BOOLEAN 0 VBU0513_CM_boolean_cnt 0.0 1.0 /end CHARACTERISTIC
/begin CHARACTERISTIC CbTHM_InletCoolantSensorOorLowFaultEnable_flg "" VALUE 0x70020b2f Scalar_BOOLEAN 0 VBU0513_CM_boolean_cnt 0.0 1.0 /end CHARACTERISTIC
/begin CHARACTERISTIC CbTHM_InletOutletTempDeltaFaultEnable_flg "" VALUE 0x70020b30 Scalar_BOOLEAN 0 VBU0513_CM_boolean_cnt 0.0 1.0 /end CHARACTERISTIC
/begin CHARACTERISTIC CbTHM_OutletCoolantSensorOorHighFaultEnable_flg "" VALUE 0x70020b31 Scalar_BOOLEAN 0 VBU0513_CM_boolean_cnt 0.0 1.0 /end CHARACTERISTIC
/begin CHARACTERISTIC CbTHM_OutletCoolantSensorOorLowFaultEnable_flg "" VALUE 0x70020b32 Scalar_BOOLEAN 0 VBU0513_CM_boolean_cnt 0.0 1.0 /end CHARACTERISTIC
/begin CHARACTERISTIC CcRTC_EnableVCURtcCrection_flg "" VALUE 0x70020c3e Scalar_BOOLEAN 0 VBU0513_CM_boolean_cnt 0.0 1.0 /end CHARACTERISTIC
/begin CHARACTERISTIC CcSOC_SOCPEnable_flg "" VALUE 0x70020c43 Scalar_BOOLEAN 0 VBU0513_CM_boolean_cnt 0.0 1.0 /end CHARACTERISTIC
/begin CHARACTERISTIC CcTHM_TempRequestEnable_flg "" VALUE 0x70020c64 Scalar_BOOLEAN 0 VBU0513_CM_boolean_cnt 0.0 1.0 /end CHARACTERISTIC
/begin CHARACTERISTIC DCDC_flgMsg303ChksmDisbl_C "" VALUE 0x70020caa Scalar_BOOLEAN 0 VBU0513_CM_boolean_flg 0.0 1.0 /end CHARACTERISTIC
/begin CHARACTERISTIC DCDC_flgMsg303RollCntDisbl_C "" VALUE 0x70020cab Scalar_BOOLEAN 0 VBU0513_CM_boolean_flg 0.0 1.0 /end CHARACTERISTIC
/begin CHARACTERISTIC DCDC_flgMsg509ChksmDisbl_C "" VALUE 0x70020cac Scalar_BOOLEAN 0 VBU0513_CM_boolean_flg 0.0 1.0 /end CHARACTERISTIC
/begin CHARACTERISTIC DCDC_flgMsg509RollCntDisbl_C "" VALUE 0x70020cad Scalar_BOOLEAN 0 VBU0513_CM_boolean_flg 0.0 1.0 /end CHARACTERISTIC
/begin CHARACTERISTIC DCH_flgBCLChModeReqOvrd_C "" VALUE 0x70020cb1 Scalar_BOOLEAN 0 VBU0513_CM_boolean_cnt 0.0 1.0 /end CHARACTERISTIC
/begin CHARACTERISTIC DCH_flgBCLCurrReqOvrd_C "" VALUE 0x70020cb2 Scalar_BOOLEAN 0 VBU0513_CM_boolean_cnt 0.0 1.0 /end CHARACTERISTIC
/begin CHARACTERISTIC DCH_flgBCLVltgReqOvrd_C "" VALUE 0x70020cb3 Scalar_BOOLEAN 0 VBU0513_CM_boolean_cnt 0.0 1.0 /end CHARACTERISTIC
/begin CHARACTERISTIC DCH_flgBCPBattVltgOvrd_C "" VALUE 0x70020cb4 Scalar_BOOLEAN 0 VBU0513_CM_boolean_cnt 0.0 1.0 /end CHARACTERISTIC
/begin CHARACTERISTIC DCH_flgBCPMaxCellVltgForChOvrd_C "" VALUE 0x70020cb5 Scalar_BOOLEAN 0 VBU0513_CM_boolean_cnt 0.0 1.0 /end CHARACTERISTIC
/begin CHARACTERISTIC DCH_flgBCPMaxChCurrOvrd_C "" VALUE 0x70020cb6 Scalar_BOOLEAN 0 VBU0513_CM_boolean_cnt 0.0 1.0 /end CHARACTERISTIC
/begin CHARACTERISTIC DCH_flgBCPMaxPermitTempOvrd_C "" VALUE 0x70020cb7 Scalar_BOOLEAN 0 VBU0513_CM_boolean_cnt 0.0 1.0 /end CHARACTERISTIC
/begin CHARACTERISTIC DCH_flgBCPMaxVltgForChOvrd_C "" VALUE 0x70020cb8 Scalar_BOOLEAN 0 VBU0513_CM_boolean_cnt 0.0 1.0 /end CHARACTERISTIC
/begin CHARACTERISTIC DCH_flgBCPNrmCapOvrd_C "" VALUE 0x70020cb9 Scalar_BOOLEAN 0 VBU0513_CM_boolean_cnt 0.0 1.0 /end CHARACTERISTIC
/begin CHARACTERISTIC DCH_flgBCPSocOvrd_C "" VALUE 0x70020cba Scalar_BOOLEAN 0 VBU0513_CM_boolean_cnt 0.0 1.0 /end CHARACTERISTIC
/begin CHARACTERISTIC DCH_flgBCSChCurrMeasureOvrd_C "" VALUE 0x70020cbb Scalar_BOOLEAN 0 VBU0513_CM_boolean_cnt 0.0 1.0 /end CHARACTERISTIC
/begin CHARACTERISTIC DCH_flgBCSChNeedTOvrd_C "" VALUE 0x70020cbc Scalar_BOOLEAN 0 VBU0513_CM_boolean_cnt 0.0 1.0 /end CHARACTERISTIC
/begin CHARACTERISTIC DCH_flgBCSChVltgMeasureOvrd_C "" VALUE 0x70020cbd Scalar_BOOLEAN 0 VBU0513_CM_boolean_cnt 0.0 1.0 /end CHARACTERISTIC
/begin CHARACTERISTIC DCH_flgBCSCurrSocOvrd_C "" VALUE 0x70020cbe Scalar_BOOLEAN 0 VBU0513_CM_boolean_cnt 0.0 1.0 /end CHARACTERISTIC
/begin CHARACTERISTIC DCH_flgBCSMaxCellVltgNumOvrd_C "" VALUE 0x70020cbf Scalar_BOOLEAN 0 VBU0513_CM_boolean_cnt 0.0 1.0 /end CHARACTERISTIC
/begin CHARACTERISTIC DCH_flgBCSMaxCellVltgOvrd_C "" VALUE 0x70020cc0 Scalar_BOOLEAN 0 VBU0513_CM_boolean_cnt 0.0 1.0 /end CHARACTERISTIC
/begin CHARACTERISTIC DCH_flgBEMChCapTOutOvrd_C "" VALUE 0x70020cc1 Scalar_BOOLEAN 0 VBU0513_CM_boolean_cnt 0.0 1.0 /end CHARACTERISTIC
/begin CHARACTERISTIC DCH_flgBEMChRdyTOutOvrd_C "" VALUE 0x70020cc2 Scalar_BOOLEAN 0 VBU0513_CM_boolean_cnt 0.0 1.0 /end CHARACTERISTIC
/begin CHARACTERISTIC DCH_flgBEMChStTOutOvrd_C "" VALUE 0x70020cc3 Scalar_BOOLEAN 0 VBU0513_CM_boolean_cnt 0.0 1.0 /end CHARACTERISTIC
/begin CHARACTERISTIC DCH_flgBEMChgrStopTOutOvrd_C "" VALUE 0x70020cc4 Scalar_BOOLEAN 0 VBU0513_CM_boolean_cnt 0.0 1.0 /end CHARACTERISTIC
/begin CHARACTERISTIC DCH_flgBEMId00TOutOvrd_C "" VALUE 0x70020cc5 Scalar_BOOLEAN 0 VBU0513_CM_boolean_cnt 0.0 1.0 /end CHARACTERISTIC
/begin CHARACTERISTIC DCH_flgBEMIdAATOutOvrd_C "" VALUE 0x70020cc6 Scalar_BOOLEAN 0 VBU0513_CM_boolean_cnt 0.0 1.0 /end CHARACTERISTIC
/begin CHARACTERISTIC DCH_flgBEMStatsDataTOutOvrd_C "" VALUE 0x70020cc7 Scalar_BOOLEAN 0 VBU0513_CM_boolean_cnt 0.0 1.0 /end CHARACTERISTIC
/begin CHARACTERISTIC DCH_flgBRMBatChgTOvrd_C "" VALUE 0x70020cc8 Scalar_BOOLEAN 0 VBU0513_CM_boolean_cnt 0.0 1.0 /end CHARACTERISTIC
/begin CHARACTERISTIC DCH_flgBRMBatDateDayOvrd_C "" VALUE 0x70020cc9 Scalar_BOOLEAN 0 VBU0513_CM_boolean_cnt 0.0 1.0 /end CHARACTERISTIC
/begin CHARACTERISTIC DCH_flgBRMBatDateMonthOvrd_C "" VALUE 0x70020cca Scalar_BOOLEAN 0 VBU0513_CM_boolean_cnt 0.0 1.0 /end CHARACTERISTIC
/begin CHARACTERISTIC DCH_flgBRMBatDateYearOvrd_C "" VALUE 0x70020ccb Scalar_BOOLEAN 0 VBU0513_CM_boolean_cnt 0.0 1.0 /end CHARACTERISTIC
/begin CHARACTERISTIC DCH_flgBRMBatGrpOvrd_C "" VALUE 0x70020ccc Scalar_BOOLEAN 0 VBU0513_CM_boolean_cnt 0.0 1.0 /end CHARACTERISTIC
/begin CHARACTERISTIC DCH_flgBRMBatIdentifyOvrd_C "" VALUE 0x70020ccd Scalar_BOOLEAN 0 VBU0513_CM_boolean_cnt 0.0 1.0 /end CHARACTERISTIC
/begin CHARACTERISTIC DCH_flgBRMBatSfwrVer1Ovrd_C "" VALUE 0x70020cce Scalar_BOOLEAN 0 VBU0513_CM_boolean_cnt 0.0 1.0 /end CHARACTERISTIC
/begin CHARACTERISTIC DCH_flgBRMBatSfwrVer2Ovrd_C "" VALUE 0x70020ccf Scalar_BOOLEAN 0 VBU0513_CM_boolean_cnt 0.0 1.0 /end CHARACTERISTIC
/begin CHARACTERISTIC DCH_flgBRMBatSupOvrd_C "" VALUE 0x70020cd0 Scalar_BOOLEAN 0 VBU0513_CM_boolean_cnt 0.0 1.0 /end CHARACTERISTIC
/begin CHARACTERISTIC DCH_flgBRMResevedOvrd_C "" VALUE 0x70020cd1 Scalar_BOOLEAN 0 VBU0513_CM_boolean_cnt 0.0 1.0 /end CHARACTERISTIC
/begin CHARACTERISTIC DCH_flgBRMVin1Ovrd_C "" VALUE 0x70020cd2 Scalar_BOOLEAN 0 VBU0513_CM_boolean_cnt 0.0 1.0 /end CHARACTERISTIC
/begin CHARACTERISTIC DCH_flgBRMVin2Ovrd_C "" VALUE 0x70020cd3 Scalar_BOOLEAN 0 VBU0513_CM_boolean_cnt 0.0 1.0 /end CHARACTERISTIC
/begin CHARACTERISTIC DCH_flgBRMVin3Ovrd_C "" VALUE 0x70020cd4 Scalar_BOOLEAN 0 VBU0513_CM_boolean_cnt 0.0 1.0 /end CHARACTERISTIC
/begin CHARACTERISTIC DCH_flgBROBattChRdyOvrd_C "" VALUE 0x70020cd5 Scalar_BOOLEAN 0 VBU0513_CM_boolean_cnt 0.0 1.0 /end CHARACTERISTIC
/begin CHARACTERISTIC DCH_flgBSDChEndSocOvrd_C "" VALUE 0x70020cd6 Scalar_BOOLEAN 0 VBU0513_CM_boolean_cnt 0.0 1.0 /end CHARACTERISTIC
/begin CHARACTERISTIC DCH_flgBSDMaxCellTempOvrd_C "" VALUE 0x70020cd7 Scalar_BOOLEAN 0 VBU0513_CM_boolean_cnt 0.0 1.0 /end CHARACTERISTIC
/begin CHARACTERISTIC DCH_flgBSDMaxCellVltgOvrd_C "" VALUE 0x70020cd8 Scalar_BOOLEAN 0 VBU0513_CM_boolean_cnt 0.0 1.0 /end CHARACTERISTIC
/begin CHARACTERISTIC DCH_flgBSDMinCellTempOvrd_C "" VALUE 0x70020cd9 Scalar_BOOLEAN 0 VBU0513_CM_boolean_cnt 0.0 1.0 /end CHARACTERISTIC
/begin CHARACTERISTIC DCH_flgBSDMinCellVltgOvrd_C "" VALUE 0x70020cda Scalar_BOOLEAN 0 VBU0513_CM_boolean_cnt 0.0 1.0 /end CHARACTERISTIC
/begin CHARACTERISTIC DCH_flgBSMBattOutConnStOvrdVal_C "" VALUE 0x70020cdb Scalar_BOOLEAN 0 VBU0513_CM_boolean_cnt 0.0 1.0 /end CHARACTERISTIC
/begin CHARACTERISTIC DCH_flgBSMBattOutConnStOvrd_C "" VALUE 0x70020cdc Scalar_BOOLEAN 0 VBU0513_CM_boolean_cnt 0.0 1.0 /end CHARACTERISTIC
/begin CHARACTERISTIC DCH_flgBSMCellVltgOverUndOvrdVal_C "" VALUE 0x70020cdd Scalar_BOOLEAN 0 VBU0513_CM_boolean_cnt 0.0 1.0 /end CHARACTERISTIC
/begin CHARACTERISTIC DCH_flgBSMCellVltgOverUndOvrd_C "" VALUE 0x70020cde Scalar_BOOLEAN 0 VBU0513_CM_boolean_cnt 0.0 1.0 /end CHARACTERISTIC
/begin CHARACTERISTIC DCH_flgBSMChCurrOverOvrdVal_C "" VALUE 0x70020cdf Scalar_BOOLEAN 0 VBU0513_CM_boolean_cnt 0.0 1.0 /end CHARACTERISTIC
/begin CHARACTERISTIC DCH_flgBSMChCurrOverOvrd_C "" VALUE 0x70020ce0 Scalar_BOOLEAN 0 VBU0513_CM_boolean_cnt 0.0 1.0 /end CHARACTERISTIC
/begin CHARACTERISTIC DCH_flgBSMChPermitOvrdVal_C "" VALUE 0x70020ce1 Scalar_BOOLEAN 0 VBU0513_CM_boolean_cnt 0.0 1.0 /end CHARACTERISTIC
/begin CHARACTERISTIC DCH_flgBSMChPermitOvrd_C "" VALUE 0x70020ce2 Scalar_BOOLEAN 0 VBU0513_CM_boolean_cnt 0.0 1.0 /end CHARACTERISTIC
/begin CHARACTERISTIC DCH_flgBSMIsoStOvrdVal_C "" VALUE 0x70020ce3 Scalar_BOOLEAN 0 VBU0513_CM_boolean_cnt 0.0 1.0 /end CHARACTERISTIC
/begin CHARACTERISTIC DCH_flgBSMIsoStOvrd_C "" VALUE 0x70020ce4 Scalar_BOOLEAN 0 VBU0513_CM_boolean_cnt 0.0 1.0 /end CHARACTERISTIC
/begin CHARACTERISTIC DCH_flgBSMMaxCellTempNumOvrd_C "" VALUE 0x70020ce5 Scalar_BOOLEAN 0 VBU0513_CM_boolean_cnt 0.0 1.0 /end CHARACTERISTIC
/begin CHARACTERISTIC DCH_flgBSMMaxCellTempOvrd_C "" VALUE 0x70020ce6 Scalar_BOOLEAN 0 VBU0513_CM_boolean_cnt 0.0 1.0 /end CHARACTERISTIC
/begin CHARACTERISTIC DCH_flgBSMMaxCellVltgNumOvrd_C "" VALUE 0x70020ce7 Scalar_BOOLEAN 0 VBU0513_CM_boolean_cnt 0.0 1.0 /end CHARACTERISTIC
/begin CHARACTERISTIC DCH_flgBSMMinCellTempNumOvrd_C "" VALUE 0x70020ce8 Scalar_BOOLEAN 0 VBU0513_CM_boolean_cnt 0.0 1.0 /end CHARACTERISTIC
/begin CHARACTERISTIC DCH_flgBSMMinCellTempOvrd_C "" VALUE 0x70020ce9 Scalar_BOOLEAN 0 VBU0513_CM_boolean_cnt 0.0 1.0 /end CHARACTERISTIC
/begin CHARACTERISTIC DCH_flgBSMSocOverUndOvrdVal_C "" VALUE 0x70020cea Scalar_BOOLEAN 0 VBU0513_CM_boolean_cnt 0.0 1.0 /end CHARACTERISTIC
/begin CHARACTERISTIC DCH_flgBSMSocOverUndOvrd_C "" VALUE 0x70020ceb Scalar_BOOLEAN 0 VBU0513_CM_boolean_cnt 0.0 1.0 /end CHARACTERISTIC
/begin CHARACTERISTIC DCH_flgBSMTempOverOvrdVal_C "" VALUE 0x70020cec Scalar_BOOLEAN 0 VBU0513_CM_boolean_cnt 0.0 1.0 /end CHARACTERISTIC
/begin CHARACTERISTIC DCH_flgBSMTempOverOvrd_C "" VALUE 0x70020ced Scalar_BOOLEAN 0 VBU0513_CM_boolean_cnt 0.0 1.0 /end CHARACTERISTIC
/begin CHARACTERISTIC DCH_flgBSTChStopForBMSConnOverTempOvrdVal_C "" VALUE 0x70020cee Scalar_BOOLEAN 0 VBU0513_CM_boolean_cnt 0.0 1.0 /end CHARACTERISTIC
/begin CHARACTERISTIC DCH_flgBSTChStopForBMSConnOverTempOvrd_C "" VALUE 0x70020cef Scalar_BOOLEAN 0 VBU0513_CM_boolean_cnt 0.0 1.0 /end CHARACTERISTIC
/begin CHARACTERISTIC DCH_flgBSTChStopForBattOverTempOvrdVal_C "" VALUE 0x70020cf0 Scalar_BOOLEAN 0 VBU0513_CM_boolean_cnt 0.0 1.0 /end CHARACTERISTIC
/begin CHARACTERISTIC DCH_flgBSTChStopForBattOverTempOvrd_C "" VALUE 0x70020cf1 Scalar_BOOLEAN 0 VBU0513_CM_boolean_cnt 0.0 1.0 /end CHARACTERISTIC
/begin CHARACTERISTIC DCH_flgBSTChStopForCCToVltgFaultOvrdVal_C "" VALUE 0x70020cf2 Scalar_BOOLEAN 0 VBU0513_CM_boolean_cnt 0.0 1.0 /end CHARACTERISTIC
/begin CHARACTERISTIC DCH_flgBSTChStopForCCToVltgFaultOvrd_C "" VALUE 0x70020cf3 Scalar_BOOLEAN 0 VBU0513_CM_boolean_cnt 0.0 1.0 /end CHARACTERISTIC
/begin CHARACTERISTIC DCH_flgBSTChStopForCellVltgOvrdVal_C "" VALUE 0x70020cf4 Scalar_BOOLEAN 0 VBU0513_CM_boolean_cnt 0.0 1.0 /end CHARACTERISTIC
/begin CHARACTERISTIC DCH_flgBSTChStopForCellVltgOvrd_C "" VALUE 0x70020cf5 Scalar_BOOLEAN 0 VBU0513_CM_boolean_cnt 0.0 1.0 /end CHARACTERISTIC
/begin CHARACTERISTIC DCH_flgBSTChStopForChgrReqStopOvrdVal_C "" VALUE 0x70020cf6 Scalar_BOOLEAN 0 VBU0513_CM_boolean_cnt 0.0 1.0 /end CHARACTERISTIC
/begin CHARACTERISTIC DCH_flgBSTChStopForChgrReqStopOvrd_C "" VALUE 0x70020cf7 Scalar_BOOLEAN 0 VBU0513_CM_boolean_cnt 0.0 1.0 /end CHARACTERISTIC
/begin CHARACTERISTIC DCH_flgBSTChStopForConnFaultOvrdVal_C "" VALUE 0x70020cf8 Scalar_BOOLEAN 0 VBU0513_CM_boolean_cnt 0.0 1.0 /end CHARACTERISTIC
/begin CHARACTERISTIC DCH_flgBSTChStopForConnFaultOvrd_C "" VALUE 0x70020cf9 Scalar_BOOLEAN 0 VBU0513_CM_boolean_cnt 0.0 1.0 /end CHARACTERISTIC
/begin CHARACTERISTIC DCH_flgBSTChStopForConnOverTempOvrdVal_C "" VALUE 0x70020cfa Scalar_BOOLEAN 0 VBU0513_CM_boolean_cnt 0.0 1.0 /end CHARACTERISTIC
/begin CHARACTERISTIC DCH_flgBSTChStopForConnOverTempOvrd_C "" VALUE 0x70020cfb Scalar_BOOLEAN 0 VBU0513_CM_boolean_cnt 0.0 1.0 /end CHARACTERISTIC
/begin CHARACTERISTIC DCH_flgBSTChStopForHvRlyFaultOvrdVal_C "" VALUE 0x70020cfc Scalar_BOOLEAN 0 VBU0513_CM_boolean_cnt 0.0 1.0 /end CHARACTERISTIC
/begin CHARACTERISTIC DCH_flgBSTChStopForHvRlyFaultOvrd_C "" VALUE 0x70020cfd Scalar_BOOLEAN 0 VBU0513_CM_boolean_cnt 0.0 1.0 /end CHARACTERISTIC
/begin CHARACTERISTIC DCH_flgBSTChStopForIsoFaultOvrdVal_C "" VALUE 0x70020cfe Scalar_BOOLEAN 0 VBU0513_CM_boolean_cnt 0.0 1.0 /end CHARACTERISTIC
/begin CHARACTERISTIC DCH_flgBSTChStopForIsoFaultOvrd_C "" VALUE 0x70020cff Scalar_BOOLEAN 0 VBU0513_CM_boolean_cnt 0.0 1.0 /end CHARACTERISTIC
/begin CHARACTERISTIC DCH_flgBSTChStopForOtherFaultOvrdVal_C "" VALUE 0x70020d00 Scalar_BOOLEAN 0 VBU0513_CM_boolean_cnt 0.0 1.0 /end CHARACTERISTIC
/begin CHARACTERISTIC DCH_flgBSTChStopForOtherFaultOvrd_C "" VALUE 0x70020d01 Scalar_BOOLEAN 0 VBU0513_CM_boolean_cnt 0.0 1.0 /end CHARACTERISTIC
/begin CHARACTERISTIC DCH_flgBSTChStopForOverCurrOvrdVal_C "" VALUE 0x70020d02 Scalar_BOOLEAN 0 VBU0513_CM_boolean_cnt 0.0 1.0 /end CHARACTERISTIC
/begin CHARACTERISTIC DCH_flgBSTChStopForOverCurrOvrd_C "" VALUE 0x70020d03 Scalar_BOOLEAN 0 VBU0513_CM_boolean_cnt 0.0 1.0 /end CHARACTERISTIC
/begin CHARACTERISTIC DCH_flgBSTChStopForSocOvrdVal_C "" VALUE 0x70020d04 Scalar_BOOLEAN 0 VBU0513_CM_boolean_cnt 0.0 1.0 /end CHARACTERISTIC
/begin CHARACTERISTIC DCH_flgBSTChStopForSocOvrd_C "" VALUE 0x70020d05 Scalar_BOOLEAN 0 VBU0513_CM_boolean_cnt 0.0 1.0 /end CHARACTERISTIC
/begin CHARACTERISTIC DCH_flgBSTChStopForTotalVltgOvrdVal_C "" VALUE 0x70020d06 Scalar_BOOLEAN 0 VBU0513_CM_boolean_cnt 0.0 1.0 /end CHARACTERISTIC
/begin CHARACTERISTIC DCH_flgBSTChStopForTotalVltgOvrd_C "" VALUE 0x70020d07 Scalar_BOOLEAN 0 VBU0513_CM_boolean_cnt 0.0 1.0 /end CHARACTERISTIC
/begin CHARACTERISTIC DCH_flgBSTChStopForVltgAbNrmOvrdVal_C "" VALUE 0x70020d08 Scalar_BOOLEAN 0 VBU0513_CM_boolean_cnt 0.0 1.0 /end CHARACTERISTIC
/begin CHARACTERISTIC DCH_flgBSTChStopForVltgAbNrmOvrd_C "" VALUE 0x70020d09 Scalar_BOOLEAN 0 VBU0513_CM_boolean_cnt 0.0 1.0 /end CHARACTERISTIC
/begin CHARACTERISTIC DCH_flgDCChRlyClose_SY "" VALUE 0x70020d0c Scalar_BOOLEAN 0 VBU0513_CM_boolean_cnt 0.0 1.0 /end CHARACTERISTIC
/begin CHARACTERISTIC DCH_flgDCChRlyOpen_SY "" VALUE 0x70020d0d Scalar_BOOLEAN 0 VBU0513_CM_boolean_cnt 0.0 1.0 /end CHARACTERISTIC
/begin CHARACTERISTIC DCH_flgHvRlyClose_SY "" VALUE 0x70020d0f Scalar_BOOLEAN 0 VBU0513_CM_boolean_cnt 0.0 1.0 /end CHARACTERISTIC
/begin CHARACTERISTIC DCH_flgHvRlyOpen_SY "" VALUE 0x70020d10 Scalar_BOOLEAN 0 VBU0513_CM_boolean_cnt 0.0 1.0 /end CHARACTERISTIC
/begin CHARACTERISTIC DCH_flgOvrdReceiveCCS_C "" VALUE 0x70020d11 Scalar_BOOLEAN 0 VBU0513_CM_boolean_cnt 0.0 1.0 /end CHARACTERISTIC
/begin CHARACTERISTIC DCH_flgOvrdReceiveCEM_C "" VALUE 0x70020d12 Scalar_BOOLEAN 0 VBU0513_CM_boolean_cnt 0.0 1.0 /end CHARACTERISTIC
/begin CHARACTERISTIC DCH_flgOvrdReceiveCHM_C "" VALUE 0x70020d13 Scalar_BOOLEAN 0 VBU0513_CM_boolean_cnt 0.0 1.0 /end CHARACTERISTIC
/begin CHARACTERISTIC DCH_flgOvrdReceiveCML_C "" VALUE 0x70020d14 Scalar_BOOLEAN 0 VBU0513_CM_boolean_cnt 0.0 1.0 /end CHARACTERISTIC
/begin CHARACTERISTIC DCH_flgOvrdReceiveCRM_C "" VALUE 0x70020d15 Scalar_BOOLEAN 0 VBU0513_CM_boolean_cnt 0.0 1.0 /end CHARACTERISTIC
/begin CHARACTERISTIC DCH_flgOvrdReceiveCRO_C "" VALUE 0x70020d16 Scalar_BOOLEAN 0 VBU0513_CM_boolean_cnt 0.0 1.0 /end CHARACTERISTIC
/begin CHARACTERISTIC DCH_flgOvrdReceiveCSD_C "" VALUE 0x70020d17 Scalar_BOOLEAN 0 VBU0513_CM_boolean_cnt 0.0 1.0 /end CHARACTERISTIC
/begin CHARACTERISTIC DCH_flgOvrdReceiveCST_C "" VALUE 0x70020d18 Scalar_BOOLEAN 0 VBU0513_CM_boolean_cnt 0.0 1.0 /end CHARACTERISTIC
/begin CHARACTERISTIC DCH_flgOvrdValReceiveCCS_C "" VALUE 0x70020d19 Scalar_BOOLEAN 0 VBU0513_CM_boolean_cnt 0.0 1.0 /end CHARACTERISTIC
/begin CHARACTERISTIC DCH_flgOvrdValReceiveCEM_C "" VALUE 0x70020d1a Scalar_BOOLEAN 0 VBU0513_CM_boolean_cnt 0.0 1.0 /end CHARACTERISTIC
/begin CHARACTERISTIC DCH_flgOvrdValReceiveCHM_C "" VALUE 0x70020d1b Scalar_BOOLEAN 0 VBU0513_CM_boolean_cnt 0.0 1.0 /end CHARACTERISTIC
/begin CHARACTERISTIC DCH_flgOvrdValReceiveCML_C "" VALUE 0x70020d1c Scalar_BOOLEAN 0 VBU0513_CM_boolean_cnt 0.0 1.0 /end CHARACTERISTIC
/begin CHARACTERISTIC DCH_flgOvrdValReceiveCRM_C "" VALUE 0x70020d1d Scalar_BOOLEAN 0 VBU0513_CM_boolean_cnt 0.0 1.0 /end CHARACTERISTIC
/begin CHARACTERISTIC DCH_flgOvrdValReceiveCRO_C "" VALUE 0x70020d1e Scalar_BOOLEAN 0 VBU0513_CM_boolean_cnt 0.0 1.0 /end CHARACTERISTIC
/begin CHARACTERISTIC DCH_flgOvrdValReceiveCSD_C "" VALUE 0x70020d1f Scalar_BOOLEAN 0 VBU0513_CM_boolean_cnt 0.0 1.0 /end CHARACTERISTIC
/begin CHARACTERISTIC DCH_flgOvrdValReceiveCST_C "" VALUE 0x70020d20 Scalar_BOOLEAN 0 VBU0513_CM_boolean_cnt 0.0 1.0 /end CHARACTERISTIC
/begin CHARACTERISTIC EPB_flgMsg080ChksmDisbl_C "" VALUE 0x70020dbf Scalar_BOOLEAN 0 VBU0513_CM_boolean_flg 0.0 1.0 /end CHARACTERISTIC
/begin CHARACTERISTIC EPB_flgMsg080RollCntDisbl_C "" VALUE 0x70020dc0 Scalar_BOOLEAN 0 VBU0513_CM_boolean_flg 0.0 1.0 /end CHARACTERISTIC
/begin CHARACTERISTIC EPS_flgMsg070ChksmDisbl_C "" VALUE 0x70020dc3 Scalar_BOOLEAN 0 VBU0513_CM_boolean_flg 0.0 1.0 /end CHARACTERISTIC
/begin CHARACTERISTIC EPS_flgMsg070RollCntDisbl_C "" VALUE 0x70020dc4 Scalar_BOOLEAN 0 VBU0513_CM_boolean_flg 0.0 1.0 /end CHARACTERISTIC
/begin CHARACTERISTIC IC_flgMsg401ChksmDisbl_C "" VALUE 0x70020e1a Scalar_BOOLEAN 0 VBU0513_CM_boolean_flg 0.0 1.0 /end CHARACTERISTIC
/begin CHARACTERISTIC IC_flgMsg401RollCntDisbl_C "" VALUE 0x70020e1b Scalar_BOOLEAN 0 VBU0513_CM_boolean_flg 0.0 1.0 /end CHARACTERISTIC
/begin CHARACTERISTIC MCU_flgMsg205ChksmDisbl_C "" VALUE 0x70020e5a Scalar_BOOLEAN 0 VBU0513_CM_boolean_flg 0.0 1.0 /end CHARACTERISTIC
/begin CHARACTERISTIC MCU_flgMsg205RollCntDisbl_C "" VALUE 0x70020e5b Scalar_BOOLEAN 0 VBU0513_CM_boolean_flg 0.0 1.0 /end CHARACTERISTIC
/begin CHARACTERISTIC MCU_flgMsg405ChksmDisbl_C "" VALUE 0x70020e5c Scalar_BOOLEAN 0 VBU0513_CM_boolean_flg 0.0 1.0 /end CHARACTERISTIC
/begin CHARACTERISTIC MCU_flgMsg405RollCntDisbl_C "" VALUE 0x70020e5d Scalar_BOOLEAN 0 VBU0513_CM_boolean_flg 0.0 1.0 /end CHARACTERISTIC
/begin CHARACTERISTIC NVM_READ_SUCCESS "" VALUE 0x70020e71 Scalar_BOOLEAN 0 VBU0513_CM_boolean_cnt 0.0 1.0 /end CHARACTERISTIC
/begin CHARACTERISTIC PEUR_flgMsg305ChksmDisbl_C "" VALUE 0x70020e74 Scalar_BOOLEAN 0 VBU0513_CM_boolean_flg 0.0 1.0 /end CHARACTERISTIC
/begin CHARACTERISTIC PEUR_flgMsg305RollCntDisbl_C "" VALUE 0x70020e75 Scalar_BOOLEAN 0 VBU0513_CM_boolean_flg 0.0 1.0 /end CHARACTERISTIC
/begin CHARACTERISTIC PEUR_flgMsg505ChksmDisbl_C "" VALUE 0x70020e76 Scalar_BOOLEAN 0 VBU0513_CM_boolean_flg 0.0 1.0 /end CHARACTERISTIC
/begin CHARACTERISTIC PEUR_flgMsg505RollCntDisbl_C "" VALUE 0x70020e77 Scalar_BOOLEAN 0 VBU0513_CM_boolean_flg 0.0 1.0 /end CHARACTERISTIC
/begin CHARACTERISTIC SOC_flgOCVCorrection_C "" VALUE 0x70020ec9 Scalar_BOOLEAN 0 VBU0513_CM_boolean 0 1 /end CHARACTERISTIC
/begin CHARACTERISTIC SOC_flgOCValidOvrd_C "" VALUE 0x70020eca Scalar_BOOLEAN 0 VBU0513_CM_boolean 0 1 /end CHARACTERISTIC
/begin CHARACTERISTIC VCT_CHARGE_STATE_CHARGING "" VALUE 0x70020f0c Scalar_BOOLEAN 0 VBU0513_CM_boolean_cnt 0.0 1.0 /end CHARACTERISTIC
/begin CHARACTERISTIC VCT_CHARGE_STATE_CHARGING_FAULT "" VALUE 0x70020f0d Scalar_BOOLEAN 0 VBU0513_CM_boolean_cnt 0.0 1.0 /end CHARACTERISTIC
/begin CHARACTERISTIC VCT_CHARGE_STATE_NOT_CHARGING "" VALUE 0x70020f0f Scalar_BOOLEAN 0 VBU0513_CM_boolean_cnt 0.0 1.0 /end CHARACTERISTIC
/begin CHARACTERISTIC CcSOC_BatterySocHighFaultFIC_n "" VALUE 0x70020c3f Scalar_BYTE 0 VBU0513_CM_int8_cnt -128.0 127.0 /end CHARACTERISTIC
/begin CHARACTERISTIC CcSOC_BatterySocHighFaultPIC_n "" VALUE 0x70020c40 Scalar_BYTE 0 VBU0513_CM_int8_cnt -128.0 127.0 /end CHARACTERISTIC
/begin CHARACTERISTIC CcSOC_BatterySocLowFaultFIC_n "" VALUE 0x70020c41 Scalar_BYTE 0 VBU0513_CM_int8_cnt -128.0 127.0 /end CHARACTERISTIC
/begin CHARACTERISTIC CcSOC_BatterySocLowFaultPIC_n "" VALUE 0x70020c42 Scalar_BYTE 0 VBU0513_CM_int8_cnt -128.0 127.0 /end CHARACTERISTIC
/begin CHARACTERISTIC CcSOF_ChargePowerLimitViolationFIC_n "" VALUE 0x70020c46 Scalar_BYTE 0 VBU0513_CM_int8_cnt -128.0 127.0 /end CHARACTERISTIC
/begin CHARACTERISTIC CcSOF_ChargePowerLimitViolationPIC_n "" VALUE 0x70020c47 Scalar_BYTE 0 VBU0513_CM_int8_cnt -128.0 127.0 /end CHARACTERISTIC
/begin CHARACTERISTIC CcSOF_DischargePowerLimitViolationFIC_n "" VALUE 0x70020c49 Scalar_BYTE 0 VBU0513_CM_int8_cnt -128.0 127.0 /end CHARACTERISTIC
/begin CHARACTERISTIC CcSOF_DischargePowerLimitViolationPIC_n "" VALUE 0x70020c4a Scalar_BYTE 0 VBU0513_CM_int8_cnt -128.0 127.0 /end CHARACTERISTIC
/begin CHARACTERISTIC CcTHM_InletCoolantSensorOorHighFIC_n "" VALUE 0x70020c59 Scalar_BYTE 0 VBU0513_CM_int8_cnt -128.0 127.0 /end CHARACTERISTIC
/begin CHARACTERISTIC CcTHM_InletCoolantSensorOorHighPIC_n "" VALUE 0x70020c5a Scalar_BYTE 0 VBU0513_CM_int8_cnt -128.0 127.0 /end CHARACTERISTIC
/begin CHARACTERISTIC CcTHM_InletCoolantSensorOorLowFIC_n "" VALUE 0x70020c5b Scalar_BYTE 0 VBU0513_CM_int8_cnt -128.0 127.0 /end CHARACTERISTIC
/begin CHARACTERISTIC CcTHM_InletCoolantSensorOorLowPIC_n "" VALUE 0x70020c5c Scalar_BYTE 0 VBU0513_CM_int8_cnt -128.0 127.0 /end CHARACTERISTIC
/begin CHARACTERISTIC CcTHM_InletOutletTempDeltaFIC_n "" VALUE 0x70020c5d Scalar_BYTE 0 VBU0513_CM_int8_cnt -128.0 127.0 /end CHARACTERISTIC
/begin CHARACTERISTIC CcTHM_InletOutletTempDeltaPIC_n "" VALUE 0x70020c5e Scalar_BYTE 0 VBU0513_CM_int8_cnt -128.0 127.0 /end CHARACTERISTIC
/begin CHARACTERISTIC CcTHM_OutletCoolantSensorOorHighFIC_n "" VALUE 0x70020c5f Scalar_BYTE 0 VBU0513_CM_int8_cnt -128.0 127.0 /end CHARACTERISTIC
/begin CHARACTERISTIC CcTHM_OutletCoolantSensorOorHighPIC_n "" VALUE 0x70020c60 Scalar_BYTE 0 VBU0513_CM_int8_cnt -128.0 127.0 /end CHARACTERISTIC
/begin CHARACTERISTIC CcTHM_OutletCoolantSensorOorLowFIC_n "" VALUE 0x70020c61 Scalar_BYTE 0 VBU0513_CM_int8_cnt -128.0 127.0 /end CHARACTERISTIC
/begin CHARACTERISTIC CcTHM_OutletCoolantSensorOorLowPIC_n "" VALUE 0x70020c62 Scalar_BYTE 0 VBU0513_CM_int8_cnt -128.0 127.0 /end CHARACTERISTIC
/begin CHARACTERISTIC CbSYS_AbnormalResetRecoverEnable_flg "" VALUE 0x70020b2b Scalar_UBYTE 0 VBU0513_CM_uint8_cnt 0.0 255.0 /end CHARACTERISTIC
/begin CHARACTERISTIC CcSYS_NoOfInvalidCellTemps_n "" VALUE 0x70020c55 Scalar_UBYTE 0 VBU0513_CM_uint8_cnt 0.0 255.0 /end CHARACTERISTIC
/begin CHARACTERISTIC CeVCT_BMSBatteryType_enum "" VALUE 0x70020c73 Scalar_UBYTE 0 VBU0513_CM_uint8_enum 0.0 255.0 /end CHARACTERISTIC
/begin CHARACTERISTIC DCH_numBRMBatDateDayOvrdVal_C "" VALUE 0x70020d26 Scalar_UBYTE 0 VBU0513_CM_uint8_cnt 0.0 255.0 /end CHARACTERISTIC
/begin CHARACTERISTIC DCH_numBRMBatDateMonthOvrdVal_C "" VALUE 0x70020d27 Scalar_UBYTE 0 VBU0513_CM_uint8_cnt 0.0 255.0 /end CHARACTERISTIC
/begin CHARACTERISTIC DCH_numBRMBatDateYearOvrdVal_C "" VALUE 0x70020d28 Scalar_UBYTE 0 VBU0513_CM_uint8_cnt 0.0 255.0 /end CHARACTERISTIC
/begin CHARACTERISTIC DCH_numBRMBatIdentifyOvrdVal_C "" VALUE 0x70020d29 Scalar_UBYTE 0 VBU0513_CM_uint8_cnt 0.0 255.0 /end CHARACTERISTIC
/begin CHARACTERISTIC DCH_numBRMBatIdentify_C "" VALUE 0x70020d2a Scalar_UBYTE 0 VBU0513_CM_uint8_cnt 0.0 255.0 /end CHARACTERISTIC
/begin CHARACTERISTIC DCH_numBRMResevedOvrdVal_C "" VALUE 0x70020d2f Scalar_UBYTE 0 VBU0513_CM_uint8_cnt 0.0 255.0 /end CHARACTERISTIC
/begin CHARACTERISTIC DCH_numBRMReseved_C "" VALUE 0x70020d30 Scalar_UBYTE 0 VBU0513_CM_uint8_cnt 0.0 255.0 /end CHARACTERISTIC
/begin CHARACTERISTIC DCH_numInitialBRMBatDateDay_C "" VALUE 0x70020d31 Scalar_UBYTE 0 VBU0513_CM_uint8_cnt 0.0 255.0 /end CHARACTERISTIC
/begin CHARACTERISTIC DCH_numInitialBRMBatDateMonth_C "" VALUE 0x70020d32 Scalar_UBYTE 0 VBU0513_CM_uint8_cnt 0.0 255.0 /end CHARACTERISTIC
/begin CHARACTERISTIC DCH_numInitialBRMBatDateYear_C "" VALUE 0x70020d33 Scalar_UBYTE 0 VBU0513_CM_uint8_cnt 0.0 255.0 /end CHARACTERISTIC
/begin CHARACTERISTIC DCH_stBCLChModeReqOvrdVal_C "" VALUE 0x70020d36 Scalar_UBYTE 0 VBU0513_CM_uint8_cnt 0.0 15.0 /end CHARACTERISTIC
/begin CHARACTERISTIC DCH_stBCLConstantCurrMode_C "" VALUE 0x70020d37 Scalar_UBYTE 0 VBU0513_CM_uint8_cnt 0.0 15.0 /end CHARACTERISTIC
/begin CHARACTERISTIC DCH_stBCLConstantVltgMode_C "" VALUE 0x70020d38 Scalar_UBYTE 0 VBU0513_CM_uint8_cnt 0.0 15.0 /end CHARACTERISTIC
/begin CHARACTERISTIC DCH_stBCLMode_SY "" VALUE 0x70020d39 Scalar_UBYTE 0 VBU0513_CM_uint8_cnt 0.0 255.0 /end CHARACTERISTIC
/begin CHARACTERISTIC DCH_stBCPMode_SY "" VALUE 0x70020d3a Scalar_UBYTE 0 VBU0513_CM_uint8_cnt 0.0 255.0 /end CHARACTERISTIC
/begin CHARACTERISTIC DCH_stBEMChCapTOutOvrdVal_C "" VALUE 0x70020d3e Scalar_UBYTE 0 VBU0513_CM_uint8_cnt 0.0 15.0 /end CHARACTERISTIC
/begin CHARACTERISTIC DCH_stBEMChRdyTOutOvrdVal_C "" VALUE 0x70020d40 Scalar_UBYTE 0 VBU0513_CM_uint8_cnt 0.0 15.0 /end CHARACTERISTIC
/begin CHARACTERISTIC DCH_stBEMChStTOutOvrdVal_C "" VALUE 0x70020d42 Scalar_UBYTE 0 VBU0513_CM_uint8_cnt 0.0 15.0 /end CHARACTERISTIC
/begin CHARACTERISTIC DCH_stBEMChgrStopTOutOvrdVal_C "" VALUE 0x70020d44 Scalar_UBYTE 0 VBU0513_CM_uint8_cnt 0.0 15.0 /end CHARACTERISTIC
/begin CHARACTERISTIC DCH_stBEMId00TOutOvrdVal_C "" VALUE 0x70020d45 Scalar_UBYTE 0 VBU0513_CM_uint8_cnt 0.0 15.0 /end CHARACTERISTIC
/begin CHARACTERISTIC DCH_stBEMIdAATOutOvrdVal_C "" VALUE 0x70020d46 Scalar_UBYTE 0 VBU0513_CM_uint8_cnt 0.0 15.0 /end CHARACTERISTIC
/begin CHARACTERISTIC DCH_stBEMStatsDataTOutOvrdVal_C "" VALUE 0x70020d48 Scalar_UBYTE 0 VBU0513_CM_uint8_cnt 0.0 15.0 /end CHARACTERISTIC
/begin CHARACTERISTIC DCH_stBRMMode_SY "" VALUE 0x70020d4b Scalar_UBYTE 0 VBU0513_CM_uint8_cnt 0.0 255.0 /end CHARACTERISTIC
/begin CHARACTERISTIC DCH_stBROBattChRdyOvrdVal_C "" VALUE 0x70020d4c Scalar_UBYTE 0 VBU0513_CM_uint8_cnt 0.0 15.0 /end CHARACTERISTIC
/begin CHARACTERISTIC DCH_stBRONoRdyMode_SY "" VALUE 0x70020d4d Scalar_UBYTE 0 VBU0513_CM_uint8_cnt 0.0 255.0 /end CHARACTERISTIC
/begin CHARACTERISTIC DCH_stBRORdyMode_SY "" VALUE 0x70020d4e Scalar_UBYTE 0 VBU0513_CM_uint8_cnt 0.0 255.0 /end CHARACTERISTIC
/begin CHARACTERISTIC DCH_stBSTForNrmMode_SY "" VALUE 0x70020d4f Scalar_UBYTE 0 VBU0513_CM_uint8_cnt 0.0 255.0 /end CHARACTERISTIC
/begin CHARACTERISTIC DCH_stCC2AplusConnect_SY "" VALUE 0x70020d50 Scalar_UBYTE 0 VBU0513_CM_uint8_cnt 0.0 255.0 /end CHARACTERISTIC
/begin CHARACTERISTIC DCH_stChStopChgrErr_SY "" VALUE 0x70020d52 Scalar_UBYTE 0 VBU0513_CM_uint8_cnt 0.0 255.0 /end CHARACTERISTIC
/begin CHARACTERISTIC DCH_stChStopChgrManual_SY "" VALUE 0x70020d53 Scalar_UBYTE 0 VBU0513_CM_uint8_cnt 0.0 255.0 /end CHARACTERISTIC
/begin CHARACTERISTIC DCH_stChStopIso_SY "" VALUE 0x70020d54 Scalar_UBYTE 0 VBU0513_CM_uint8_cnt 0.0 255.0 /end CHARACTERISTIC
/begin CHARACTERISTIC DCH_stChStopVehCmpt_SY "" VALUE 0x70020d55 Scalar_UBYTE 0 VBU0513_CM_uint8_cnt 0.0 255.0 /end CHARACTERISTIC
/begin CHARACTERISTIC DCH_stChStopVehErr_SY "" VALUE 0x70020d56 Scalar_UBYTE 0 VBU0513_CM_uint8_cnt 0.0 255.0 /end CHARACTERISTIC
/begin CHARACTERISTIC DCH_stChargeFinishMode_SY "" VALUE 0x70020d57 Scalar_UBYTE 0 VBU0513_CM_uint8_cnt 0.0 255.0 /end CHARACTERISTIC
/begin CHARACTERISTIC DCH_stCharging_SY "" VALUE 0x70020d58 Scalar_UBYTE 0 VBU0513_CM_uint8_cnt 0.0 255.0 /end CHARACTERISTIC
/begin CHARACTERISTIC DCH_stChrgPortSnglSnsr_SY "" VALUE 0x70020d59 Scalar_UBYTE 0 VBU0513_CM_uint8_cnt 0.0 255.0 /end CHARACTERISTIC
/begin CHARACTERISTIC DCH_stChrgPortSnsrConfig_C "" VALUE 0x70020d5a Scalar_UBYTE 0 VBU0513_CM_uint8_cnt 0.0 15.0 /end CHARACTERISTIC
/begin CHARACTERISTIC DCH_stClDCChRlyMode_SY "" VALUE 0x70020d5b Scalar_UBYTE 0 VBU0513_CM_uint8_cnt 0.0 255.0 /end CHARACTERISTIC
/begin CHARACTERISTIC DCH_stComTOut_SY "" VALUE 0x70020d5c Scalar_UBYTE 0 VBU0513_CM_uint8_cnt 0.0 255.0 /end CHARACTERISTIC
/begin CHARACTERISTIC DCH_stHandshake_SY "" VALUE 0x70020d62 Scalar_UBYTE 0 VBU0513_CM_uint8_cnt 0.0 255.0 /end CHARACTERISTIC
/begin CHARACTERISTIC DCH_stHvRlyMode_SY "" VALUE 0x70020d63 Scalar_UBYTE 0 VBU0513_CM_uint8_cnt 0.0 255.0 /end CHARACTERISTIC
/begin CHARACTERISTIC DCH_stInitMode_SY "" VALUE 0x70020d64 Scalar_UBYTE 0 VBU0513_CM_uint8_cnt 0.0 255.0 /end CHARACTERISTIC
/begin CHARACTERISTIC DCH_stInit_SY "" VALUE 0x70020d65 Scalar_UBYTE 0 VBU0513_CM_uint8_cnt 0.0 255.0 /end CHARACTERISTIC
/begin CHARACTERISTIC DCH_stLvShutDownForNrmMode_SY "" VALUE 0x70020d67 Scalar_UBYTE 0 VBU0513_CM_uint8_cnt 0.0 255.0 /end CHARACTERISTIC
/begin CHARACTERISTIC DCH_stOpenDCRlyForBMSTOutMode_SY "" VALUE 0x70020d69 Scalar_UBYTE 0 VBU0513_CM_uint8_cnt 0.0 255.0 /end CHARACTERISTIC
/begin CHARACTERISTIC DCH_stOpenDCRlyForNrmMode_SY "" VALUE 0x70020d6a Scalar_UBYTE 0 VBU0513_CM_uint8_cnt 0.0 255.0 /end CHARACTERISTIC
/begin CHARACTERISTIC DCH_stOpenHvForBMSTOutMode_SY "" VALUE 0x70020d6b Scalar_UBYTE 0 VBU0513_CM_uint8_cnt 0.0 255.0 /end CHARACTERISTIC
/begin CHARACTERISTIC DCH_stParConfig_SY "" VALUE 0x70020d6e Scalar_UBYTE 0 VBU0513_CM_uint8_cnt 0.0 255.0 /end CHARACTERISTIC
/begin CHARACTERISTIC DCH_stPreOpenDCRly_SY "" VALUE 0x70020d6f Scalar_UBYTE 0 VBU0513_CM_uint8_cnt 0.0 255.0 /end CHARACTERISTIC
/begin CHARACTERISTIC DCH_stReConnectChProcessMode_SY "" VALUE 0x70020d70 Scalar_UBYTE 0 VBU0513_CM_uint8_cnt 0.0 255.0 /end CHARACTERISTIC
/begin CHARACTERISTIC DCH_stStopBMS_SY "" VALUE 0x70020d76 Scalar_UBYTE 0 VBU0513_CM_uint8_cnt 0.0 255.0 /end CHARACTERISTIC
/begin CHARACTERISTIC DCH_stStopCC2ConnErr_SY "" VALUE 0x70020d77 Scalar_UBYTE 0 VBU0513_CM_uint8_cnt 0.0 255.0 /end CHARACTERISTIC
/begin CHARACTERISTIC DCH_stStopChAvlErr_SY "" VALUE 0x70020d78 Scalar_UBYTE 0 VBU0513_CM_uint8_cnt 0.0 255.0 /end CHARACTERISTIC
/begin CHARACTERISTIC DCH_stStopChRdyTout_SY "" VALUE 0x70020d79 Scalar_UBYTE 0 VBU0513_CM_uint8_cnt 0.0 255.0 /end CHARACTERISTIC
/begin CHARACTERISTIC DCH_stStopChgrAvl_SY "" VALUE 0x70020d7a Scalar_UBYTE 0 VBU0513_CM_uint8_cnt 0.0 255.0 /end CHARACTERISTIC
/begin CHARACTERISTIC DCH_stStopChgrErr_SY "" VALUE 0x70020d7b Scalar_UBYTE 0 VBU0513_CM_uint8_cnt 0.0 255.0 /end CHARACTERISTIC
/begin CHARACTERISTIC DCH_stStopCrntLrgErr_SY "" VALUE 0x70020d7c Scalar_UBYTE 0 VBU0513_CM_uint8_cnt 0.0 255.0 /end CHARACTERISTIC
/begin CHARACTERISTIC DCH_stStopCrntOvr_SY "" VALUE 0x70020d7d Scalar_UBYTE 0 VBU0513_CM_uint8_cnt 0.0 255.0 /end CHARACTERISTIC
/begin CHARACTERISTIC DCH_stStopDCRlyClTout_SY "" VALUE 0x70020d7e Scalar_UBYTE 0 VBU0513_CM_uint8_cnt 0.0 255.0 /end CHARACTERISTIC
/begin CHARACTERISTIC DCH_stStopDCRlyOpErr_SY "" VALUE 0x70020d7f Scalar_UBYTE 0 VBU0513_CM_uint8_cnt 0.0 255.0 /end CHARACTERISTIC
/begin CHARACTERISTIC DCH_stStopFidErr_SY "" VALUE 0x70020d80 Scalar_UBYTE 0 VBU0513_CM_uint8_cnt 0.0 255.0 /end CHARACTERISTIC
/begin CHARACTERISTIC DCH_stStopHVRlyOpErr_SY "" VALUE 0x70020d81 Scalar_UBYTE 0 VBU0513_CM_uint8_cnt 0.0 255.0 /end CHARACTERISTIC
/begin CHARACTERISTIC DCH_stStopHlfConnErr_SY "" VALUE 0x70020d82 Scalar_UBYTE 0 VBU0513_CM_uint8_cnt 0.0 255.0 /end CHARACTERISTIC
/begin CHARACTERISTIC DCH_stStopIso_SY "" VALUE 0x70020d83 Scalar_UBYTE 0 VBU0513_CM_uint8_cnt 0.0 255.0 /end CHARACTERISTIC
/begin CHARACTERISTIC DCH_stStopManual_SY "" VALUE 0x70020d84 Scalar_UBYTE 0 VBU0513_CM_uint8_cnt 0.0 255.0 /end CHARACTERISTIC
/begin CHARACTERISTIC DCH_stStopToutOvr3_SY "" VALUE 0x70020d85 Scalar_UBYTE 0 VBU0513_CM_uint8_cnt 0.0 255.0 /end CHARACTERISTIC
/begin CHARACTERISTIC DCH_stStopZeroCrnt_SY "" VALUE 0x70020d86 Scalar_UBYTE 0 VBU0513_CM_uint8_cnt 0.0 255.0 /end CHARACTERISTIC
/begin CHARACTERISTIC DCH_stTimeOutInTimeOut_SY "" VALUE 0x70020d88 Scalar_UBYTE 0 VBU0513_CM_uint8_cnt 0.0 255.0 /end CHARACTERISTIC
/begin CHARACTERISTIC DCH_stWaitCHMMode_SY "" VALUE 0x70020d8c Scalar_UBYTE 0 VBU0513_CM_uint8_cnt 0.0 255.0 /end CHARACTERISTIC
/begin CHARACTERISTIC DCH_stWaitCRMMode_SY "" VALUE 0x70020d8d Scalar_UBYTE 0 VBU0513_CM_uint8_cnt 0.0 255.0 /end CHARACTERISTIC
/begin CHARACTERISTIC DCH_stWaitCSDForNrmMode_SY "" VALUE 0x70020d8e Scalar_UBYTE 0 VBU0513_CM_uint8_cnt 0.0 255.0 /end CHARACTERISTIC
/begin CHARACTERISTIC NUMBER_OF_PARALLEL_CELLS_PER_MODULE "" VALUE 0x70020e6a Scalar_UBYTE 0 VBU0513_CM_uint8_cnt 0.0 255.0 /end CHARACTERISTIC
/begin CHARACTERISTIC NUMBER_OF_PARALLEL_MODULES "" VALUE 0x70020e6b Scalar_UBYTE 0 VBU0513_CM_uint8_cnt 0.0 255.0 /end CHARACTERISTIC
/begin CHARACTERISTIC SOF_DISCHARGE_OVER_POWER_FAULT "" VALUE 0x70020ecb Scalar_UBYTE 0 VBU0513_CM_uint8_cnt 0.0 255.0 /end CHARACTERISTIC
/begin CHARACTERISTIC VCT_CHARGE_STATE_CHARGING_FULL "" VALUE 0x70020f0e Scalar_UBYTE 0 VBU0513_CM_uint8_cnt 0.0 255.0 /end CHARACTERISTIC
/begin MEASUREMENT SOC_numLoadDefaultSOCCnt "" ULONG VBU0513_CM_uint32 0 0 0 4294967295 ECU_ADDRESS 0x90001e32 /end MEASUREMENT
/begin MEASUREMENT OCV_tisRelaxationElapsedTime "" ULONG VBU0513_CM_uint32 0 0 0 4294967295 ECU_ADDRESS 0x9000245e /end MEASUREMENT
/begin MEASUREMENT INP_fBattPresFrq "" FLOAT32_IEEE VBU0513_CM_single 0 0 -3.4E+38 3.4E+38 ECU_ADDRESS 0x90002446 /end MEASUREMENT
/begin MEASUREMENT INP_pctBattPresDty "" FLOAT32_IEEE VBU0513_CM_single 0 0 -3.4E+38 3.4E+38 ECU_ADDRESS 0x9000244a /end MEASUREMENT
/begin MEASUREMENT INP_pctHVILDty "" FLOAT32_IEEE VBU0513_CM_single 0 0 0.0 100.0 ECU_ADDRESS 0x90001ef2 /end MEASUREMENT
/begin MEASUREMENT INP_fHVILFrq "" FLOAT32_IEEE VBU0513_CM_single 0 0 -3.4E+38 3.4E+38 ECU_ADDRESS 0x90001eee /end MEASUREMENT
/begin MEASUREMENT INP_uDCCHCC2 "" FLOAT32_IEEE VBU0513_CM_single 0 0 0.0 30.0 ECU_ADDRESS 0x900022ce /end MEASUREMENT
/begin MEASUREMENT INP_tEDSInletCoolTemp "" FLOAT32_IEEE VBU0513_CM_single 0 0 -100.0 200.0 ECU_ADDRESS 0x9000217e /end MEASUREMENT
/begin MEASUREMENT INP_tDCChPortNegTemp "" FLOAT32_IEEE VBU0513_CM_single 0 0 -100.0 200.0 ECU_ADDRESS 0x90002176 /end MEASUREMENT
/begin MEASUREMENT INP_tDCChPortPosTemp "" FLOAT32_IEEE VBU0513_CM_single 0 0 -100.0 200.0 ECU_ADDRESS 0x9000217a /end MEASUREMENT
/begin MEASUREMENT INP_uAccPed2 "" FLOAT32_IEEE VBU0513_CM_single 0 0 0.0 5000.0 ECU_ADDRESS 0x90002186 /end MEASUREMENT
/begin MEASUREMENT INP_uAccPed1 "" FLOAT32_IEEE VBU0513_CM_single 0 0 0.0 5000.0 ECU_ADDRESS 0x90002182 /end MEASUREMENT
/begin MEASUREMENT INP_pVacPres "" FLOAT32_IEEE VBU0513_CM_single 0 0 0.0 5000.0 ECU_ADDRESS 0x90002172 /end MEASUREMENT
/begin MEASUREMENT INP_uBrkPres "" FLOAT32_IEEE VBU0513_CM_single 0 0 0.0 5000.0 ECU_ADDRESS 0x9000218a /end MEASUREMENT
/begin MEASUREMENT DCH_iBMSDCChReqLim "" FLOAT32_IEEE VBU0513_CM_single 0 0 -3.4E+38 3.4E+38 ECU_ADDRESS 0x90001e52 /end MEASUREMENT
/begin MEASUREMENT OP_fLsACPump "" FLOAT32_IEEE VBU0513_CM_single 0 0 -3.4E+38 3.4E+38 ECU_ADDRESS 0x90001f0e /end MEASUREMENT
/begin MEASUREMENT OP_pctLsACPump "" FLOAT32_IEEE VBU0513_CM_single 0 0 -3.4E+38 3.4E+38 ECU_ADDRESS 0x90001f12 /end MEASUREMENT
/begin MEASUREMENT EDIS_pwrDrvPwrLimDrvMode "" FLOAT32_IEEE VBU0513_CM_single 0 0 -3.4E+38 3.4E+38 ECU_ADDRESS 0x90002146 /end MEASUREMENT
/begin MEASUREMENT DCDC_pwrLVOut "" FLOAT32_IEEE VBU0513_CM_single 0 0 -3.4E+38 3.4E+38 ECU_ADDRESS 0x90002402 /end MEASUREMENT
/begin MEASUREMENT DCDC_pwrHVInput "" FLOAT32_IEEE VBU0513_CM_single 0 0 -3.4E+38 3.4E+38 ECU_ADDRESS 0x900023fe /end MEASUREMENT
/begin MEASUREMENT PEUR_trqMaxLimit "" FLOAT32_IEEE VBU0513_CM_single 0 0 -3.4E+38 3.4E+38 ECU_ADDRESS 0x90002462 /end MEASUREMENT
/begin MEASUREMENT PEUR_trqAct "" FLOAT32_IEEE VBU0513_CM_single 0 0 -3.4E+38 3.4E+38 ECU_ADDRESS 0x900022fa /end MEASUREMENT
/begin MEASUREMENT THM_tInletTempRequest "" FLOAT32_IEEE VBU0513_CM_single 0 0 -3.4E+38 3.4E+38 ECU_ADDRESS 0x9000230e /end MEASUREMENT
/begin MEASUREMENT SOE_pctCellSocEndPredict "" FLOAT32_IEEE VBU0513_CM_single 0 0 -3.4E+38 3.4E+38 ECU_ADDRESS 0x900021aa /end MEASUREMENT
/begin MEASUREMENT SOE_kwhPackRemainingEnergy "" FLOAT32_IEEE VBU0513_CM_single 0 0 -3.4E+38 3.4E+38 ECU_ADDRESS 0x900021a2 /end MEASUREMENT
/begin MEASUREMENT SOF_kwsChargePowerLimitDeltaTotal "" FLOAT32_IEEE VBU0513_CM_single 0 0 -3.4E+38 3.4E+38 ECU_ADDRESS 0x90001fc2 /end MEASUREMENT
/begin MEASUREMENT SOF_kwDischargePowerShortPulseRated "" FLOAT32_IEEE VBU0513_CM_single 0 0 -3.4E+38 3.4E+38 ECU_ADDRESS 0x900024d2 /end MEASUREMENT
/begin MEASUREMENT SOF_kwDischargePowerContinuousRated "" FLOAT32_IEEE VBU0513_CM_single 0 0 -3.4E+38 3.4E+38 ECU_ADDRESS 0x900024c6 /end MEASUREMENT
/begin MEASUREMENT SOF_kwDischargePowerLimitRated "" FLOAT32_IEEE VBU0513_CM_single 0 0 -3.4E+38 3.4E+38 ECU_ADDRESS 0x900024ce /end MEASUREMENT
/begin MEASUREMENT SOF_kwChargePowerShortPulseRated "" FLOAT32_IEEE VBU0513_CM_single 0 0 -3.4E+38 3.4E+38 ECU_ADDRESS 0x900024be /end MEASUREMENT
/begin MEASUREMENT SOF_kwChargePowerContinuousRated "" FLOAT32_IEEE VBU0513_CM_single 0 0 -3.4E+38 3.4E+38 ECU_ADDRESS 0x900024b2 /end MEASUREMENT
/begin MEASUREMENT SOF_kwChargePowerLimitRated "" FLOAT32_IEEE VBU0513_CM_single 0 0 -3.4E+38 3.4E+38 ECU_ADDRESS 0x900024ba /end MEASUREMENT
/begin MEASUREMENT SOF_iAShortPulseDischargeCurrentRatedLimit "" FLOAT32_IEEE VBU0513_CM_single 0 0 -3.4E+38 3.4E+38 ECU_ADDRESS 0x900024aa /end MEASUREMENT
/begin MEASUREMENT SOF_iAContinuousDischargeCurrentRatedLimit "" FLOAT32_IEEE VBU0513_CM_single 0 0 -3.4E+38 3.4E+38 ECU_ADDRESS 0x9000249e /end MEASUREMENT
/begin MEASUREMENT SOF_iAShortPulseChargeCurrentRatedLimit "" FLOAT32_IEEE VBU0513_CM_single 0 0 -3.4E+38 3.4E+38 ECU_ADDRESS 0x900024a6 /end MEASUREMENT
/begin MEASUREMENT SOF_iAChargeContinuousCurrentRatedLimit "" FLOAT32_IEEE VBU0513_CM_single 0 0 -3.4E+38 3.4E+38 ECU_ADDRESS 0x90002492 /end MEASUREMENT
/begin MEASUREMENT SOF_iADischargeCurrentRatedLimit "" FLOAT32_IEEE VBU0513_CM_single 0 0 -3.4E+38 3.4E+38 ECU_ADDRESS 0x900024a2 /end MEASUREMENT
/begin MEASUREMENT SOF_iAChargeCurrentRatedLimit "" FLOAT32_IEEE VBU0513_CM_single 0 0 -3.4E+38 3.4E+38 ECU_ADDRESS 0x90002496 /end MEASUREMENT
/begin MEASUREMENT SOF_kwContinuousDischargePowerLimitBefoTarget "" FLOAT32_IEEE VBU0513_CM_single 0 0 -3.4E+38 3.4E+38 ECU_ADDRESS 0x90001faa /end MEASUREMENT
/begin MEASUREMENT SOF_kwDischargePowerLimitBefoTarget "" FLOAT32_IEEE VBU0513_CM_single 0 0 -3.4E+38 3.4E+38 ECU_ADDRESS 0x90001fb2 /end MEASUREMENT
/begin MEASUREMENT SOF_kwShortPulseDischargePowerLimitTarget "" FLOAT32_IEEE VBU0513_CM_single 0 0 -3.4E+38 3.4E+38 ECU_ADDRESS 0x90001fbe /end MEASUREMENT
/begin MEASUREMENT SOF_kwShortPulseChargePowerLimitTarget "" FLOAT32_IEEE VBU0513_CM_single 0 0 -3.4E+38 3.4E+38 ECU_ADDRESS 0x90001fba /end MEASUREMENT
/begin MEASUREMENT SOF_kwContinuousChargePowerLimitTarget "" FLOAT32_IEEE VBU0513_CM_single 0 0 -3.4E+38 3.4E+38 ECU_ADDRESS 0x90001fa6 /end MEASUREMENT
/begin MEASUREMENT SOF_kwChargePowerLimitTarget "" FLOAT32_IEEE VBU0513_CM_single 0 0 -3.4E+38 3.4E+38 ECU_ADDRESS 0x90001fa2 /end MEASUREMENT
/begin MEASUREMENT SOF_kwChargePowerActual "" FLOAT32_IEEE VBU0513_CM_single 0 0 -3.4E+38 3.4E+38 ECU_ADDRESS 0x900024ae /end MEASUREMENT
/begin MEASUREMENT SOF_kwChargePowerLimitDelta "" FLOAT32_IEEE VBU0513_CM_single 0 0 -3.4E+38 3.4E+38 ECU_ADDRESS 0x900024b6 /end MEASUREMENT
/begin MEASUREMENT SOF_kwDischargePowerActual "" FLOAT32_IEEE VBU0513_CM_single 0 0 -3.4E+38 3.4E+38 ECU_ADDRESS 0x900024c2 /end MEASUREMENT
/begin MEASUREMENT SOF_kwDischargePowerLimitDelta "" FLOAT32_IEEE VBU0513_CM_single 0 0 -3.4E+38 3.4E+38 ECU_ADDRESS 0x900024ca /end MEASUREMENT
/begin MEASUREMENT LaSOC_pctCellSocOcvShortTimeCorrection "" FLOAT32_IEEE VBU0513_CM_single 0 0 0.0 100.0 ARRAY_SIZE 198 ECU_ADDRESS 0x90000040 /end MEASUREMENT
/begin MEASUREMENT SOC_pctCellSocMin "" FLOAT32_IEEE VBU0513_CM_single 0 0 -3.4E+38 3.4E+38 ECU_ADDRESS 0x90002306 /end MEASUREMENT
/begin MEASUREMENT SOC_pctCellSocMax "" FLOAT32_IEEE VBU0513_CM_single 0 0 -3.4E+38 3.4E+38 ECU_ADDRESS 0x90001f22 /end MEASUREMENT
/begin MEASUREMENT SOC_pctCellSocAve "" FLOAT32_IEEE VBU0513_CM_single 0 0 -3.4E+38 3.4E+38 ECU_ADDRESS 0x90001f1e /end MEASUREMENT
/begin MEASUREMENT GaSOC_pctCellSoc "" FLOAT32_IEEE VBU0513_CM_single 0 0 -3.4E+38 3.4E+38 ARRAY_SIZE 198 ECU_ADDRESS 0x6003b07e /end MEASUREMENT
/begin MEASUREMENT LaSOC_pctCellSocInitial "" FLOAT32_IEEE VBU0513_CM_single 0 0 0.0 100.0 ARRAY_SIZE 198 ECU_ADDRESS 0x6003bcde /end MEASUREMENT
/begin MEASUREMENT SOC_pctNoJumpBatterySoc "" FLOAT32_IEEE VBU0513_CM_single 0 0 0.0 100.0 ECU_ADDRESS 0x90001f26 /end MEASUREMENT
/begin MEASUREMENT SOC_pctBatteryDisplaySoc "" FLOAT32_IEEE VBU0513_CM_single 0 0 -3.4E+38 3.4E+38 ECU_ADDRESS 0x9000219e /end MEASUREMENT
/begin MEASUREMENT SOC_pctBatterySoc "" FLOAT32_IEEE VBU0513_CM_single 0 0 -3.4E+38 3.4E+38 ECU_ADDRESS 0x90002302 /end MEASUREMENT
/begin MEASUREMENT SOC_pctBatteryUsableSoc "" FLOAT32_IEEE VBU0513_CM_single 0 0 0.0 100.0 ECU_ADDRESS 0x90001f1a /end MEASUREMENT
/begin MEASUREMENT OP_fLsFan "" UWORD VBU0513_CM_uint16 0 0 0 65535 ECU_ADDRESS 0x90003764 /end MEASUREMENT
/begin MEASUREMENT OP_pctLsFan "" UWORD VBU0513_CM_uint16 0 0 0 65535 ECU_ADDRESS 0x9000376a /end MEASUREMENT
/begin MEASUREMENT OP_fLsHVIL1 "" UWORD VBU0513_CM_uint16 0 0 0 65535 ECU_ADDRESS 0x900039e2 /end MEASUREMENT
/begin MEASUREMENT OP_pctLsHVIL1 "" UWORD VBU0513_CM_uint16 0 0 0 65535 ECU_ADDRESS 0x900039e4 /end MEASUREMENT
/begin MEASUREMENT OP_fLsWaterPump1 "" UWORD VBU0513_CM_uint16 0 0 0 65535 ECU_ADDRESS 0x90003766 /end MEASUREMENT
/begin MEASUREMENT OP_pctLsWaterPump1 "" UWORD VBU0513_CM_uint16 0 0 0 65535 ECU_ADDRESS 0x9000376c /end MEASUREMENT
/begin MEASUREMENT OP_fLsWaterPump2 "" UWORD VBU0513_CM_uint16 0 0 0 65535 ECU_ADDRESS 0x90003768 /end MEASUREMENT
/begin MEASUREMENT OP_pctLsWaterPump2 "" UWORD VBU0513_CM_uint16 0 0 0 65535 ECU_ADDRESS 0x9000376e /end MEASUREMENT
/begin MEASUREMENT DCH_stChStopReason "" UWORD VBU0513_CM_uint16 0 0 0 65535 ECU_ADDRESS 0x90002f9a /end MEASUREMENT
/begin MEASUREMENT THM_ftInletCoolantSensorOorHigh "" UWORD VBU0513_CM_uint16 0 0 0 65535 ECU_ADDRESS 0x90003992 /end MEASUREMENT
/begin MEASUREMENT THM_ftInletCoolantSensorOorLow "" UWORD VBU0513_CM_uint16 0 0 0 65535 ECU_ADDRESS 0x90003994 /end MEASUREMENT
/begin MEASUREMENT THM_ftInletOutletTempDelta "" UWORD VBU0513_CM_uint16 0 0 0 65535 ECU_ADDRESS 0x90003996 /end MEASUREMENT
/begin MEASUREMENT THM_ftOutletCoolantSensorOorHigh "" UWORD VBU0513_CM_uint16 0 0 0 65535 ECU_ADDRESS 0x90003998 /end MEASUREMENT
/begin MEASUREMENT THM_ftOutletCoolantSensorOorLow "" UWORD VBU0513_CM_uint16 0 0 0 65535 ECU_ADDRESS 0x9000399a /end MEASUREMENT
/begin MEASUREMENT SOF_stDischargePowerLimitViolationFault "" UWORD VBU0513_CM_uint16 0 0 0 65535 ECU_ADDRESS 0x900039e8 /end MEASUREMENT
/begin MEASUREMENT SOF_stChargePowerLimitViolationFault "" UWORD VBU0513_CM_uint16 0 0 0 65535 ECU_ADDRESS 0x900039e6 /end MEASUREMENT
/begin MEASUREMENT SOC_numCellSocMaxID "" UWORD VBU0513_CM_uint16 0 0 0 65535 ECU_ADDRESS 0x90002fa2 /end MEASUREMENT
/begin MEASUREMENT INP_stBattPresFrq "" UBYTE VBU0513_CM_uint8 0 0 0 255 ECU_ADDRESS 0x900042ab /end MEASUREMENT
/begin MEASUREMENT INP_stBattPresDty "" UBYTE VBU0513_CM_uint8 0 0 0 255 ECU_ADDRESS 0x900042aa /end MEASUREMENT
/begin MEASUREMENT INP_stHVILDty "" UBYTE VBU0513_CM_INP_stHVILDty 0 0 0.0 255.0 ECU_ADDRESS 0x90004052 /end MEASUREMENT
/begin MEASUREMENT INP_stHVILFrq "" UBYTE VBU0513_CM_INP_stHVILFrq 0 0 0.0 255.0 ECU_ADDRESS 0x90004053 /end MEASUREMENT
/begin MEASUREMENT DCH_stBEMChCapTOut "" UBYTE VBU0513_CM_uint8 0 0 0 255 ECU_ADDRESS 0x9000401a /end MEASUREMENT
/begin MEASUREMENT DCH_stBEMChRdyTOut "" UBYTE VBU0513_CM_uint8 0 0 0 255 ECU_ADDRESS 0x9000401b /end MEASUREMENT
/begin MEASUREMENT DCH_stBEMChStTOut "" UBYTE VBU0513_CM_uint8 0 0 0 255 ECU_ADDRESS 0x9000401c /end MEASUREMENT
/begin MEASUREMENT DCH_stBEMChgrStopTOut "" UBYTE VBU0513_CM_uint8 0 0 0 255 ECU_ADDRESS 0x9000401d /end MEASUREMENT
/begin MEASUREMENT DCH_stBEMId00TOut "" UBYTE VBU0513_CM_uint8 0 0 0 255 ECU_ADDRESS 0x9000401e /end MEASUREMENT
/begin MEASUREMENT DCH_stBEMIdAATOut "" UBYTE VBU0513_CM_uint8 0 0 0 255 ECU_ADDRESS 0x9000401f /end MEASUREMENT
/begin MEASUREMENT DCH_stBEMStatsDataTOut "" UBYTE VBU0513_CM_uint8 0 0 0 255 ECU_ADDRESS 0x90004020 /end MEASUREMENT
/begin MEASUREMENT DCH_stBROBattChRdy "" UBYTE VBU0513_CM_uint8 0 0 0 255 ECU_ADDRESS 0x90004021 /end MEASUREMENT
/begin MEASUREMENT DCH_stSup "" UBYTE VBU0513_CM_uint8 0 0 0 255 ECU_ADDRESS 0x90004023 /end MEASUREMENT
/begin MEASUREMENT DCH_stChStateGen "" UBYTE VBU0513_CM_uint8 0 0 0 255 ECU_ADDRESS 0x90004022 /end MEASUREMENT
/begin MEASUREMENT SOH_stSohMonitor "" UBYTE VBU0513_CM_uint8 0 0 0 255 ECU_ADDRESS 0x900042b9 /end MEASUREMENT
/begin MEASUREMENT SOH_stResistanceIncRatio "" UBYTE VBU0513_CM_uint8 0 0 0 255 ECU_ADDRESS 0x900042b8 /end MEASUREMENT
/begin MEASUREMENT SOC_numCellSocMinID "" UBYTE VBU0513_CM_uint8 0 0 0 255 ECU_ADDRESS 0x9000428c /end MEASUREMENT
/begin MEASUREMENT ISO_stIsolationEVM "" UBYTE VBU0513_CM_uint8 0 0 0.0 15.0 ECU_ADDRESS 0x90004055 /end MEASUREMENT
/begin MEASUREMENT ISO_stIsolationLevel "" UBYTE VBU0513_CM_uint8 0 0 0.0 15.0 ECU_ADDRESS 0x90004056 /end MEASUREMENT
/begin MEASUREMENT INP_flgCrankConfirm "" UBYTE VBU0513_CM_boolean 0 0 0 1 ECU_ADDRESS 0x900042a9 /end MEASUREMENT
/begin MEASUREMENT INP_flgACMidPresSwitch "" UBYTE VBU0513_CM_boolean 0 0 0.0 1.0 ECU_ADDRESS 0x90004049 /end MEASUREMENT
/begin MEASUREMENT INP_flgDriverACOn "" UBYTE VBU0513_CM_boolean 0 0 0.0 1.0 ECU_ADDRESS 0x9000404d /end MEASUREMENT
/begin MEASUREMENT INP_flgGearH3 "" UBYTE VBU0513_CM_boolean 0 0 0.0 1.0 ECU_ADDRESS 0x90004050 /end MEASUREMENT
/begin MEASUREMENT INP_flgGearH2 "" UBYTE VBU0513_CM_boolean 0 0 0.0 1.0 ECU_ADDRESS 0x9000404f /end MEASUREMENT
/begin MEASUREMENT INP_flgGearH1 "" UBYTE VBU0513_CM_boolean 0 0 0.0 1.0 ECU_ADDRESS 0x9000404e /end MEASUREMENT
/begin MEASUREMENT INP_flgBrkLmpSwt "" UBYTE VBU0513_CM_boolean 0 0 0.0 1.0 ECU_ADDRESS 0x9000404a /end MEASUREMENT
/begin MEASUREMENT DCH_flgReceiveCEM "" UBYTE VBU0513_CM_boolean 0 0 0.0 1.0 ECU_ADDRESS 0x9000400e /end MEASUREMENT
/begin MEASUREMENT DCH_flgReceiveCHM "" UBYTE VBU0513_CM_boolean 0 0 0.0 1.0 ECU_ADDRESS 0x9000400f /end MEASUREMENT
/begin MEASUREMENT DCH_flgReceiveCML "" UBYTE VBU0513_CM_boolean 0 0 0.0 1.0 ECU_ADDRESS 0x90004010 /end MEASUREMENT
/begin MEASUREMENT DCH_flgReceiveCRM "" UBYTE VBU0513_CM_boolean 0 0 0.0 1.0 ECU_ADDRESS 0x90004011 /end MEASUREMENT
/begin MEASUREMENT DCH_flgReceiveCRO "" UBYTE VBU0513_CM_boolean 0 0 0.0 1.0 ECU_ADDRESS 0x90004012 /end MEASUREMENT
/begin MEASUREMENT DCH_flgReceiveCSD "" UBYTE VBU0513_CM_boolean 0 0 0.0 1.0 ECU_ADDRESS 0x90004013 /end MEASUREMENT
/begin MEASUREMENT DCH_flgReceiveCCS "" UBYTE VBU0513_CM_boolean 0 0 0.0 1.0 ECU_ADDRESS 0x9000400d /end MEASUREMENT
/begin MEASUREMENT DCH_flgReceiveCST "" UBYTE VBU0513_CM_boolean 0 0 0.0 1.0 ECU_ADDRESS 0x90004014 /end MEASUREMENT
/begin MEASUREMENT OD_LsMainRly "" UBYTE VBU0513_CM_boolean 0 0 0 1 ECU_ADDRESS 0x90003fd9 /end MEASUREMENT
/begin MEASUREMENT OD_flgVBUSleepEnable "" UBYTE VBU0513_CM_boolean 0 0 0 1 ECU_ADDRESS 0x900042b1 /end MEASUREMENT
/begin MEASUREMENT OD_HsWakeUp1 "" UBYTE VBU0513_CM_boolean 0 0 0 1 ECU_ADDRESS 0x900042af /end MEASUREMENT
/begin MEASUREMENT DCH_flgReceiveCTS "" UBYTE VBU0513_CM_boolean 0 0 0.0 1.0 ECU_ADDRESS 0x90004015 /end MEASUREMENT
/begin MEASUREMENT DCH_flgBEMTxEna "" UBYTE VBU0513_CM_boolean 0 0 0.0 1.0 ECU_ADDRESS 0x90003fef /end MEASUREMENT
/begin MEASUREMENT DCH_flgBSTTxEna "" UBYTE VBU0513_CM_boolean 0 0 0.0 1.0 ECU_ADDRESS 0x90003ff6 /end MEASUREMENT
/begin MEASUREMENT DCH_flgBHMTxEna "" UBYTE VBU0513_CM_boolean 0 0 0.0 1.0 ECU_ADDRESS 0x90003ff0 /end MEASUREMENT
/begin MEASUREMENT DCH_flgBRMTxEna "" UBYTE VBU0513_CM_boolean 0 0 0.0 1.0 ECU_ADDRESS 0x90003ff2 /end MEASUREMENT
/begin MEASUREMENT DCH_flgBCPTxEna "" UBYTE VBU0513_CM_boolean 0 0 0.0 1.0 ECU_ADDRESS 0x90003fed /end MEASUREMENT
/begin MEASUREMENT DCH_flgBROTxEna "" UBYTE VBU0513_CM_boolean 0 0 0.0 1.0 ECU_ADDRESS 0x90003ff3 /end MEASUREMENT
/begin MEASUREMENT DCH_flgBCLTxEna "" UBYTE VBU0513_CM_boolean 0 0 0.0 1.0 ECU_ADDRESS 0x90003fec /end MEASUREMENT
/begin MEASUREMENT DCH_flgBCSTxEna "" UBYTE VBU0513_CM_boolean 0 0 0.0 1.0 ECU_ADDRESS 0x90003fee /end MEASUREMENT
/begin MEASUREMENT DCH_flgBSMTxEna "" UBYTE VBU0513_CM_boolean 0 0 0.0 1.0 ECU_ADDRESS 0x90003ff5 /end MEASUREMENT
/begin MEASUREMENT DCH_flgBSDTxEna "" UBYTE VBU0513_CM_boolean 0 0 0.0 1.0 ECU_ADDRESS 0x90003ff4 /end MEASUREMENT
/begin MEASUREMENT DCH_flgHvRlyReq "" UBYTE VBU0513_CM_boolean 0 0 0.0 1.0 ECU_ADDRESS 0x90004008 /end MEASUREMENT
/begin MEASUREMENT DCH_flgDCChWakeUp "" UBYTE VBU0513_CM_boolean 0 0 0.0 1.0 ECU_ADDRESS 0x90004002 /end MEASUREMENT
/begin MEASUREMENT DCH_flgNwOldCNReg "" UBYTE VBU0513_CM_boolean 0 0 0.0 1.0 ECU_ADDRESS 0x9000400b /end MEASUREMENT
/begin MEASUREMENT DCH_flgOffLoadTOut "" UBYTE VBU0513_CM_boolean 0 0 0.0 1.0 ECU_ADDRESS 0x9000400c /end MEASUREMENT
/begin MEASUREMENT DCH_flgDftDCChZeroCrntDlyEna "" UBYTE VBU0513_CM_boolean 0 0 0.0 1.0 ECU_ADDRESS 0x90004005 /end MEASUREMENT
/begin MEASUREMENT DCH_flgDCChRlyReq "" UBYTE VBU0513_CM_boolean 0 0 0.0 1.0 ECU_ADDRESS 0x90004001 /end MEASUREMENT
/begin MEASUREMENT PEUR_flgMotrSpdVld "" UBYTE VBU0513_CM_boolean 0 0 0.0 1.0 ECU_ADDRESS 0x90004061 /end MEASUREMENT
/begin MEASUREMENT THM_flgTempRequestValid "" UBYTE VBU0513_CM_boolean 0 0 0 1 ECU_ADDRESS 0x900041d2 /end MEASUREMENT
/begin MEASUREMENT SOC_flgOcvShortTimeCorrectionComplete "" UBYTE VBU0513_CM_boolean 0 0 0.0 1.0 ECU_ADDRESS 0x90004068 /end MEASUREMENT
/begin MEASUREMENT SOC_flgOcvShortTimeDisChDiff "" UBYTE VBU0513_CM_boolean 0 0 0.0 1.0 ECU_ADDRESS 0x9000406a /end MEASUREMENT
/begin MEASUREMENT SOC_flgOcvShortTimeCorrection "" UBYTE VBU0513_CM_boolean 0 0 0.0 1.0 ECU_ADDRESS 0x90004067 /end MEASUREMENT
/begin MEASUREMENT SOC_flgOcvShortTimeVolDirection "" UBYTE VBU0513_CM_boolean 0 0 0.0 1.0 ECU_ADDRESS 0x9000406b /end MEASUREMENT
/begin MEASUREMENT SOC_flgStartupFilterDelay "" UBYTE VBU0513_CM_boolean 0 0 0.0 1.0 ECU_ADDRESS 0x90004070 /end MEASUREMENT
/begin MEASUREMENT SOC_flgSocInitializationDelay "" UBYTE VBU0513_CM_boolean 0 0 0.0 1.0 ECU_ADDRESS 0x9000406e /end MEASUREMENT
/begin MEASUREMENT SOC_flgCellSocCorrectionFinished "" UBYTE VBU0513_CM_boolean 0 0 0.0 1.0 ECU_ADDRESS 0x90004065 /end MEASUREMENT
/begin MEASUREMENT SOC_flgSocInitializeComplete "" UBYTE VBU0513_CM_boolean 0 0 0.0 1.0 ECU_ADDRESS 0x9000406f /end MEASUREMENT
/begin MEASUREMENT SOC_flgOcvCorrection "" UBYTE VBU0513_CM_boolean 0 0 0.0 1.0 ECU_ADDRESS 0x90004066 /end MEASUREMENT
/begin MEASUREMENT SOC_flgCellDataValid "" UBYTE VBU0513_CM_boolean 0 0 0.0 1.0 ECU_ADDRESS 0x9000428b /end MEASUREMENT
/begin MEASUREMENT OCV_flgOcvValid "" UBYTE VBU0513_CM_boolean 0 0 0 1 ECU_ADDRESS 0x9000405d /end MEASUREMENT
/begin MEASUREMENT OCV_flgQuasiOcvValid "" UBYTE VBU0513_CM_boolean 0 0 0 1 ECU_ADDRESS 0x9000405f /end MEASUREMENT
/begin MEASUREMENT OCV_flgOcvShortTimeValid "" UBYTE VBU0513_CM_boolean 0 0 0.0 1.0 ECU_ADDRESS 0x9000426b /end MEASUREMENT
/begin MEASUREMENT NVM_flgActualTimeInit "" UBYTE VBU0513_CM_boolean 0 0 0 1 ECU_ADDRESS 0x90004059 /end MEASUREMENT
/begin MEASUREMENT NVM_flgNVMRestoreRequest "" UBYTE VBU0513_CM_boolean 0 0 0.0 1.0 ECU_ADDRESS 0x9000405a /end MEASUREMENT
/begin MEASUREMENT NVM_flgNVMReadComplete "" UBYTE VBU0513_CM_boolean 0 0 0 1 ECU_ADDRESS 0x900041b7 /end MEASUREMENT
/begin MEASUREMENT ISO_flgIsolationStatus "" UBYTE VBU0513_CM_boolean 0 0 0.0 1.0 ECU_ADDRESS 0x90004054 /end MEASUREMENT
/begin MEASUREMENT EcOCV_RelaxationStartTime_s "" ULONG VBU0513_CM_uint32 0 0 0 4294967295 ECU_ADDRESS 0x90001ece /end MEASUREMENT
/begin MEASUREMENT DCH_numTOutCnt "" FLOAT32_IEEE VBU0513_CM_single 0 0 -3.4E+38 3.4E+38 ECU_ADDRESS 0x90001e5a /end MEASUREMENT
/begin MEASUREMENT DCH_tiDurInChStop "" FLOAT32_IEEE VBU0513_CM_single 0 0 -3.4E+38 3.4E+38 ECU_ADDRESS 0x90001e5e /end MEASUREMENT
/begin MEASUREMENT DCH_tiDurTBRO0xAA "" FLOAT32_IEEE VBU0513_CM_single 0 0 -3.4E+38 3.4E+38 ECU_ADDRESS 0x90001e62 /end MEASUREMENT
/begin MEASUREMENT DCH_tiDurTBROCloseDCRly "" FLOAT32_IEEE VBU0513_CM_single 0 0 -3.4E+38 3.4E+38 ECU_ADDRESS 0x90001e66 /end MEASUREMENT
/begin MEASUREMENT DCH_tiDurTBROCloseHVRly "" FLOAT32_IEEE VBU0513_CM_single 0 0 -3.4E+38 3.4E+38 ECU_ADDRESS 0x90001e6a /end MEASUREMENT
/begin MEASUREMENT DCH_tiDurTBRONotReady "" FLOAT32_IEEE VBU0513_CM_single 0 0 -3.4E+38 3.4E+38 ECU_ADDRESS 0x90001e6e /end MEASUREMENT
/begin MEASUREMENT DCH_tiDurTHandshake "" FLOAT32_IEEE VBU0513_CM_single 0 0 -3.4E+38 3.4E+38 ECU_ADDRESS 0x90001e72 /end MEASUREMENT
/begin MEASUREMENT DCH_tiDurTOpenDCRly "" FLOAT32_IEEE VBU0513_CM_single 0 0 -3.4E+38 3.4E+38 ECU_ADDRESS 0x90001e76 /end MEASUREMENT
/begin MEASUREMENT DCH_tiDurTOpenHVRly "" FLOAT32_IEEE VBU0513_CM_single 0 0 -3.4E+38 3.4E+38 ECU_ADDRESS 0x90001e7a /end MEASUREMENT
/begin MEASUREMENT DCH_tiDurTWaitCCS "" FLOAT32_IEEE VBU0513_CM_single 0 0 -3.4E+38 3.4E+38 ECU_ADDRESS 0x90001e7e /end MEASUREMENT
/begin MEASUREMENT DCH_tiDurTWaitCHM "" FLOAT32_IEEE VBU0513_CM_single 0 0 -3.4E+38 3.4E+38 ECU_ADDRESS 0x90001e82 /end MEASUREMENT
/begin MEASUREMENT DCH_tiDurTWaitCML "" FLOAT32_IEEE VBU0513_CM_single 0 0 -3.4E+38 3.4E+38 ECU_ADDRESS 0x90001e86 /end MEASUREMENT
/begin MEASUREMENT DCH_tiDurTWaitCRM "" FLOAT32_IEEE VBU0513_CM_single 0 0 -3.4E+38 3.4E+38 ECU_ADDRESS 0x90001e8a /end MEASUREMENT
/begin MEASUREMENT DCH_tiDurTWaitCRM0xAA "" FLOAT32_IEEE VBU0513_CM_single 0 0 -3.4E+38 3.4E+38 ECU_ADDRESS 0x90001e8e /end MEASUREMENT
/begin MEASUREMENT DCH_tiDurTWaitCRO0xAA "" FLOAT32_IEEE VBU0513_CM_single 0 0 -3.4E+38 3.4E+38 ECU_ADDRESS 0x90001e92 /end MEASUREMENT
/begin MEASUREMENT DCH_tiDurTWaitCST "" FLOAT32_IEEE VBU0513_CM_single 0 0 -3.4E+38 3.4E+38 ECU_ADDRESS 0x90001e96 /end MEASUREMENT
/begin MEASUREMENT DCH_tiDurTWaitDCRlyOff "" FLOAT32_IEEE VBU0513_CM_single 0 0 -3.4E+38 3.4E+38 ECU_ADDRESS 0x90001e9a /end MEASUREMENT
/begin MEASUREMENT DCH_tiDurTZeroCrnt "" FLOAT32_IEEE VBU0513_CM_single 0 0 -3.4E+38 3.4E+38 ECU_ADDRESS 0x90001e9e /end MEASUREMENT
/begin MEASUREMENT DCH_tiDurTimeOut "" FLOAT32_IEEE VBU0513_CM_single 0 0 -3.4E+38 3.4E+38 ECU_ADDRESS 0x90001ea2 /end MEASUREMENT
/begin MEASUREMENT DCH_numChErrCnt "" FLOAT32_IEEE VBU0513_CM_single 0 0 -3.4E+38 3.4E+38 ECU_ADDRESS 0x90001e56 /end MEASUREMENT
/begin MEASUREMENT DCH_flgChgrAvlTOut "" UBYTE VBU0513_CM_boolean 0 0 0.0 1.0 ECU_ADDRESS 0x90003ffc /end MEASUREMENT
/begin MEASUREMENT DCH_flgDCChRlyCloseTOut "" UBYTE VBU0513_CM_boolean 0 0 0.0 1.0 ECU_ADDRESS 0x90004000 /end MEASUREMENT
/begin MEASUREMENT DCH_flgVehChRdyTOut "" UBYTE VBU0513_CM_boolean 0 0 0.0 1.0 ECU_ADDRESS 0x90004019 /end MEASUREMENT
/begin MEASUREMENT DCH_flgRlyAccidentOpn "" UBYTE VBU0513_CM_boolean 0 0 0.0 1.0 ECU_ADDRESS 0x90004016 /end MEASUREMENT
/begin COMPU_METHOD VBU0513_CM_single_cnt "Q = V" RAT_FUNC "%8.6" "cnt" COEFFS 0 1 0 0 0 1 /end COMPU_METHOD
/begin COMPU_METHOD VBU0513_CM_uint16_cnt "Q = V" RAT_FUNC "%5.0" "cnt" COEFFS 0 1 0 0 0 1 /end COMPU_METHOD
/begin COMPU_METHOD VBU0513_CM_single_pct "Q = V" RAT_FUNC "%8.6" "pct" COEFFS 0 1 0 0 0 1 /end COMPU_METHOD
/begin COMPU_METHOD VBU0513_CM_uint8 "Q = V" RAT_FUNC "%3.0" "" COEFFS 0 1 0 0 0 1 /end COMPU_METHOD
/begin COMPU_METHOD VBU0513_CM_single_V "Q = V" RAT_FUNC "%8.6" "V" COEFFS 0 1 0 0 0 1 /end COMPU_METHOD
/begin COMPU_METHOD VBU0513_CM_uint16 "Q = V" RAT_FUNC "%5.0" "" COEFFS 0 1 0 0 0 1 /end COMPU_METHOD
/begin COMPU_METHOD VBU0513_CM_single "Q = V" RAT_FUNC "%8.6" "" COEFFS 0 1 0 0 0 1 /end COMPU_METHOD
/begin COMPU_METHOD VBU0513_CM_single_single "Q = V" RAT_FUNC "%8.6" "single" COEFFS 0 1 0 0 0 1 /end COMPU_METHOD
/begin COMPU_METHOD VBU0513_CM_single_Ah "Q = V" RAT_FUNC "%8.6" "Ah" COEFFS 0 1 0 0 0 1 /end COMPU_METHOD
/begin COMPU_METHOD VBU0513_CM_single_ms "Q = V" RAT_FUNC "%8.6" "ms" COEFFS 0 1 0 0 0 1 /end COMPU_METHOD
/begin COMPU_METHOD VBU0513_CM_uint32_cnt "Q = V" RAT_FUNC "%10.0" "cnt" COEFFS 0 1 0 0 0 1 /end COMPU_METHOD
/begin COMPU_METHOD VBU0513_CM_uint32 "Q = V" RAT_FUNC "%10.0" "" COEFFS 0 1 0 0 0 1 /end COMPU_METHOD
/begin COMPU_METHOD VBU0513_CM_uint32_n "Q = V" RAT_FUNC "%10.0" "n" COEFFS 0 1 0 0 0 1 /end COMPU_METHOD
/begin COMPU_METHOD VBU0513_CM_uint16_ms "Q = V" RAT_FUNC "%5.0" "ms" COEFFS 0 1 0 0 0 1 /end COMPU_METHOD
/begin COMPU_METHOD VBU0513_CM_uint16_mV "Q = V" RAT_FUNC "%5.0" "mV" COEFFS 0 1 0 0 0 1 /end COMPU_METHOD
/begin COMPU_METHOD VBU0513_CM_boolean_flg "Q = V" RAT_FUNC "%1.0" "flg" COEFFS 0 1 0 0 0 1 /end COMPU_METHOD
/begin COMPU_METHOD VBU0513_CM_boolean_cnt "Q = V" RAT_FUNC "%1.0" "cnt" COEFFS 0 1 0 0 0 1 /end COMPU_METHOD
/begin COMPU_METHOD VBU0513_CM_boolean "Q = V" RAT_FUNC "%1.0" "" COEFFS 0 1 0 0 0 1 /end COMPU_METHOD
/begin COMPU_METHOD VBU0513_CM_int8_cnt "Q = V" RAT_FUNC "%3.0" "cnt" COEFFS 0 1 0 0 0 1 /end COMPU_METHOD
/begin COMPU_METHOD VBU0513_CM_uint8_cnt "Q = V" RAT_FUNC "%3.0" "cnt" COEFFS 0 1 0 0 0 1 /end COMPU_METHOD
/begin COMPU_METHOD VBU0513_CM_uint8_enum "Q = V" RAT_FUNC "%3.0" "enum" COEFFS 0 1 0 0 0 1 /end COMPU_METHOD
/begin COMPU_METHOD VBU0513_CM_INP_stHVILDty "" TAB_VERB "%0.6" "" /* Conversion Table */ COMPU_TAB_REF VTAB_FOR_VBU0513_CM_INP_stHVILDty /end COMPU_METHOD
/begin COMPU_VTAB /* Name of Table */ VTAB_FOR_VBU0513_CM_INP_stHVILDty "" TAB_VERB /* Number of Elements */ 4 0 "NoError" 1 "NotConfirmError" 2 "ConfirmError" 3 "MonitorInhibit" /end COMPU_VTAB
/begin COMPU_METHOD VBU0513_CM_INP_stHVILFrq "" TAB_VERB "%0.6" "" /* Conversion Table */ COMPU_TAB_REF VTAB_FOR_VBU0513_CM_INP_stHVILFrq /end COMPU_METHOD
/begin COMPU_VTAB /* Name of Table */ VTAB_FOR_VBU0513_CM_INP_stHVILFrq "" TAB_VERB /* Number of Elements */ 4 0 "NoError" 1 "NotConfirmError" 2 "ConfirmError" 3 "MonitorInhibit" /end COMPU_VTAB
/begin GROUP S741_MapingSOC "VBU0513/VBUSystem/BMS/FCC /FCC/Subsystem/MapingSOC" /begin REF_CHARACTERISTIC CcSYS_CellSOCLockedMax_pct CcSYS_CellSOCLockedMin_pct /end REF_CHARACTERISTIC /end GROUP
/begin GROUP S871_Determine_EVMandStatus "VBU0513/VBUSystem/BMS/ISO/Determine_FaultDetection_Check/Status_Process/Determine_EVMandStatus" /begin REF_MEASUREMENT ISO_flgIsolationStatus ISO_stIsolationEVM /end REF_MEASUREMENT /end GROUP
/begin GROUP S871_Determine_IsolationLevel "VBU0513/VBUSystem/BMS/ISO/Determine_FaultDetection_Check/Status_Process/Determine_IsolationLevel" /begin REF_CHARACTERISTIC CcISO_DCStationFaultDelayTime_ms /end REF_CHARACTERISTIC /begin REF_MEASUREMENT ISO_stIsolationLevel /end REF_MEASUREMENT /end GROUP
/begin GROUP S904_Check_First_Run "VBU0513/VBUSystem/BMS/NVM /Subsystem3/Read_NVM_Data/Check_First_Run" /begin REF_CHARACTERISTIC CbNVM_FirstRun_flg /end REF_CHARACTERISTIC /begin REF_MEASUREMENT NVM_flgActualTimeInit NVM_flgNVMRestoreRequest /end REF_MEASUREMENT /end GROUP
/begin GROUP S904_Check_NVM_Read "VBU0513/VBUSystem/BMS/NVM /Subsystem3/Read_NVM_Data/Check_NVM_Read" /begin REF_CHARACTERISTIC NVM_READ_SUCCESS /end REF_CHARACTERISTIC /begin REF_MEASUREMENT NVM_flgNVMReadComplete /end REF_MEASUREMENT /end GROUP
/begin GROUP S923_Determine_Criteria "VBU0513/VBUSystem/BMS/OCV/OCV/Subsystem/Determine_Criteria" /begin SUB_GROUP S924_Determine_OCV_Criteria S924_Determine_QOCV_Criteria /end SUB_GROUP /end GROUP
/begin GROUP S923_Determine_Relax_ElapsedTime "VBU0513/VBUSystem/BMS/OCV/OCV/Subsystem/Determine_Relax_ElapsedTime" /begin REF_MEASUREMENT EcOCV_RelaxationStartTime_s OCV_tisRelaxationElapsedTime /end REF_MEASUREMENT /end GROUP
/begin GROUP S923_Determine_Relax_MinTime "VBU0513/VBUSystem/BMS/OCV/OCV/Subsystem/Determine_Relax_MinTime"
 /begin REF_CHARACTERISTIC CaOCV_RelaxaShortTimeCurveY_s CaOCV_RelaxationTimeCurveY_s CcOCV_RelaxationMinRequiredTime_s CcOCV_RelaxationRequiredShortTime_s CcSYS_NoOfInvalidCellTemps_n /end REF_CHARACTERISTIC
/end GROUP
/begin GROUP S923_OCV_Valid_Check "VBU0513/VBUSystem/BMS/OCV/OCV/Subsystem/OCV_Valid_Check"
 /begin REF_MEASUREMENT OCV_flgOcvShortTimeValid OCV_flgOcvValid OCV_flgQuasiOcvValid /end REF_MEASUREMENT
/end GROUP
/begin GROUP S932_Initialize_Actual_Time "VBU0513/VBUSystem/BMS/RTC/RTC/Calculate_Actual_Time/Initialize_Actual_Time" /begin REF_CHARACTERISTIC CbRTC_flgActualTimeCheckEnable /end REF_CHARACTERISTIC /end GROUP
/begin GROUP S934_Calculate_Time_Deviation "VBU0513/VBUSystem/BMS/RTC/RTC/Determine_VCU_ActualTime/Calculate_Time_Deviation"
 /begin REF_CHARACTERISTIC CcRTC_ActualTimeDeviationThreshold_s CcRTC_EnableVCURtcCrection_flg /end REF_CHARACTERISTIC
/end GROUP
/begin GROUP S959_Battery_SoC_Diagnostic "VBU0513/VBUSystem/BMS/SOC/Subsystem5/Subsystem/Battery_SoC_Diagnostic"
 /begin REF_CHARACTERISTIC CbSOC_BatterySocHighFaultEnable_flg CbSOC_BatterySocLowFaultEnable_flg CcSOC_BDMOutputDelayTime_ms CcSOC_BatteryCapacity10Cycles_n CcSOC_BatteryCapacity70Cycles_n CcSOC_BatterySocHighFault10Cycles_pct CcSOC_BatterySocHighFault70Cycles_pct CcSOC_BatterySocHighFaultFIC_n CcSOC_BatterySocHighFaultPIC_n CcSOC_BatterySocHighFault_pct CcSOC_BatterySocLowFault10Cycles_pct CcSOC_BatterySocLowFault70Cycles_pct CcSOC_BatterySocLowFaultFIC_n CcSOC_BatterySocLowFaultPIC_n CcSOC_BatterySocLowFault_pct SOC_BATTERY_SOC_HIGH_FAULT SOC_BATTERY_SOC_LOW_FAULT /end REF_CHARACTERISTIC
/end GROUP
/begin GROUP S959_Determine_AhIntegral_SoC "VBU0513/VBUSystem/BMS/SOC/Subsystem5/Subsystem/Determine_AhIntegral_SoC"
 /begin SUB_GROUP S961_Determine_AhIntegral_Capacity S961_Determine_AhIntegral_SOC S961_Determine_Module_Current /end SUB_GROUP
/end GROUP
/begin GROUP S959_Determine_Battery_SOC "VBU0513/VBUSystem/BMS/SOC/Subsystem5/Subsystem/Determine_Battery_SOC"
 /begin REF_CHARACTERISTIC CaSOC_SOCPLowY_pct CbSYS_HomoTestEnable_flg CcSOC_BatteryCapacity10Cycles_n CcSOC_BatteryCapacity70Cycles_n CcSOC_BatterySocLowerLimit_pct CcSOC_BatterySocUpperLimit_pct CcSOC_BatteryUsableSocLowerLimit10Cycles_pct CcSOC_BatteryUsableSocLowerLimit70Cycles_pct CcSOC_BatteryUsableSocLowerLimitHomo_pct CcSOC_BatteryUsableSocLowerLimit_pct CcSOC_BatteryUsableSocUpperLimit10Cycles_pct CcSOC_BatteryUsableSocUpperLimit70Cycles_pct CcSOC_BatteryUsableSocUpperLimitHomo_pct CcSOC_BatteryUsableSocUpperLimit_pct CcSOC_SOCPEnable_flg CcSYS_CellSOCLockedMax_pct CcSYS_CellSOCLockedMin_pct /end REF_CHARACTERISTIC
 /begin REF_MEASUREMENT SOC_pctBatterySoc SOC_pctBatteryUsableSoc /end REF_MEASUREMENT
/end GROUP
/begin GROUP S959_Determine_CellData_Validation "VBU0513/VBUSystem/BMS/SOC/Subsystem5/Subsystem/Determine_CellData_Validation" /begin REF_MEASUREMENT SOC_flgCellDataValid /end REF_MEASUREMENT /end GROUP
/begin GROUP S959_Determine_Cell_SOC "VBU0513/VBUSystem/BMS/SOC/Subsystem5/Subsystem/Determine_Cell_SOC"
 /begin REF_CHARACTERISTIC CbSOC_CellArraySOCOvrdFlg_flg CcSOC_CellArraySOCOvrdVal_pct CcSOC_CellSocLowerLimit_pct CcSOC_CellSocUpperLimit_pct /end REF_CHARACTERISTIC
 /begin REF_MEASUREMENT GaSOC_pctCellSoc SOC_numCellSocMaxID SOC_numCellSocMinID SOC_pctCellSocAve SOC_pctCellSocMax SOC_pctCellSocMin /end REF_MEASUREMENT
/end GROUP
/begin GROUP S959_Determine_Correction_Condition "VBU0513/VBUSystem/BMS/SOC/Subsystem5/Subsystem/Determine_Correction_Condition"
 /begin REF_CHARACTERISTIC CcSOC_OcvCorrectionIntervalTime_s SOC_flgOCVCorrection_C SOC_flgOCValidOvrd_C /end REF_CHARACTERISTIC
 /begin REF_MEASUREMENT SOC_flgOcvCorrection /end REF_MEASUREMENT
/end GROUP
/begin GROUP S959_Determine_Display_SOC "VBU0513/VBUSystem/BMS/SOC/Subsystem5/Subsystem/Determine_Display_SOC"
 /begin SUB_GROUP S966_Determine_BatterySOC_ChangeRate S966_DisplaySOC_Driving_Calculation S966_DisplaySOC_Startup_Calculation S966_NoJumpSOC_Driving_Calculation S966_NoJumpSOC_Startup_Calculation /end SUB_GROUP
 /begin REF_CHARACTERISTIC CcSOC_BatterySocLowerLimit_pct CcSOC_BatterySocUpperLimit_pct CcSYS_CellSOCLockedMax_pct CcSYS_CellSOCLockedMin_pct /end REF_CHARACTERISTIC
 /begin REF_MEASUREMENT SOC_pctBatteryDisplaySoc SOC_pctNoJumpBatterySoc /end REF_MEASUREMENT
/end GROUP
/begin GROUP S959_Determine_FastChargeCorrection_Soc "VBU0513/VBUSystem/BMS/SOC/Subsystem5/Subsystem/Determine_FastChargeCorrection_Soc"
 /begin SUB_GROUP S967_Determine_FastChargeCorrectionEnable S967_Determine_InternalResistanceCausedDevCellVoltage S967_FastCharge_DynamicCorrection S967_FastCharge_PreCorrection S967_FastCharge_TopofChargeCorrection /end SUB_GROUP
/end GROUP
/begin GROUP S959_Determine_Initial_SoC "VBU0513/VBUSystem/BMS/SOC/Subsystem5/Subsystem/Determine_Initial_SoC"
 /begin SUB_GROUP S968_CellSOC_Startup_AbnormalPoweroff S968_CellSOC_Startup_AbnormalReset S968_CellSOC_Startup_EolFlashing S968_CellSOC_Startup_Normal S968_Determine_EOL_Flashing S968_Determine_Soc_Jump /end SUB_GROUP
 /begin REF_CHARACTERISTIC CbSYS_AbnormalResetRecoverEnable_flg /end REF_CHARACTERISTIC
 /begin REF_MEASUREMENT LaSOC_pctCellSocInitial SOC_flgCellSocCorrectionFinished SOC_flgSocInitializeComplete SOC_numLoadDefaultSOCCnt /end REF_MEASUREMENT
/end GROUP
/begin GROUP S959_Determine_Initialization_Condition "VBU0513/VBUSystem/BMS/SOC/Subsystem5/Subsystem/Determine_Initialization_Condition"
 /begin REF_CHARACTERISTIC CcSOC_SocInitializationDelayTime_ms CcSOC_SocInitializationMaxTime_ms /end REF_CHARACTERISTIC
 /begin REF_MEASUREMENT SOC_flgSocInitializationDelay SOC_flgStartupFilterDelay /end REF_MEASUREMENT
/end GROUP
/begin GROUP S959_Determine_OcvSoc "VBU0513/VBUSystem/BMS/SOC/Subsystem5/Subsystem/Determine_OcvSoc"
 /begin SUB_GROUP S970_Replace_Invalid_CellTemperature S970_Replace_Invalid_CellVoltage /end SUB_GROUP
/end GROUP
/begin GROUP S959_Determine_ShortTimeCorrection_Condition "VBU0513/VBUSystem/BMS/SOC/Subsystem5/Subsystem/Determine_ShortTimeCorrection_Condition" /begin SUB_GROUP S971_Current_Limit_Condition /end SUB_GROUP
 /begin REF_CHARACTERISTIC CcSOC_OcvShortTimeCorrIntervalTime_s CcSOC_OcvShortTimeDisChDiff_n CcSOC_OcvShortTimeVolDiffCh_mV CcSOC_OcvShortTimeVolDiffDis_mV CcSOC_OcvShortTimeVolDiffThreshold_mV /end REF_CHARACTERISTIC
 /begin REF_MEASUREMENT SOC_flgOcvShortTimeCorrection SOC_flgOcvShortTimeDisChDiff SOC_flgOcvShortTimeVolDirection /end REF_MEASUREMENT
/end GROUP
/begin GROUP S959_Ocv_ShortTimeCorrection "VBU0513/VBUSystem/BMS/SOC/Subsystem5/Subsystem/Ocv_ShortTimeCorrection"
 /begin REF_CHARACTERISTIC CaSOC_OcvShortTimeChMapDimension_n CaSOC_OcvShortTimeChargeSocZ_pct CaSOC_OcvShortTimeDisMapDimension_n CaSOC_OcvShortTimeDischargeSocZ_pct CaSOC_OcvShortTimeSocErrorCurveY_pct CbSOC_OcvShortTime_flg CcSOC_OcvShortTimeSocErrorThreshold_pct CcSOC_OcvShortTimeVolThreshold_mV CcSYS_NoOfInvalidCellTemps_n /end REF_CHARACTERISTIC
 /begin REF_MEASUREMENT LaSOC_pctCellSocOcvShortTimeCorrection SOC_flgOcvShortTimeCorrectionComplete /end REF_MEASUREMENT
/end GROUP
/begin GROUP S959_Soc_Data_Storage "VBU0513/VBUSystem/BMS/SOC/Subsystem5/Subsystem/Soc_Data_Storage" /begin SUB_GROUP S974_Data_Storage /end SUB_GROUP /end GROUP
/begin GROUP S1136_Calculate_History_Average_Current "VBU0513/VBUSystem/BMS/SOE/Subsystem2/Subsystem/Calculate_History_Average_Current" /begin SUB_GROUP S1137_Determine_History_Current_Data S1137_Time_Counter /end SUB_GROUP /end GROUP
/begin GROUP S1136_Calculate_Pack_Remaining_Energy "VBU0513/VBUSystem/BMS/SOE/Subsystem2/Subsystem/Calculate_Pack_Remaining_Energy" /begin SUB_GROUP S1138_Charge_and_Idle_Mode S1138_Discharge_Mode /end SUB_GROUP /begin REF_MEASUREMENT SOE_kwhPackRemainingEnergy SOE_pctCellSocEndPredict /end REF_MEASUREMENT /end GROUP
/begin GROUP S1136_Calculate_Pack_Remaining_Energy_SOC "VBU0513/VBUSystem/BMS/SOE/Subsystem2/Subsystem/Calculate_Pack_Remaining_Energy_SOC"
 /begin REF_CHARACTERISTIC CaSOE_DispalySocFactorMapY_pct CcSOE_DischargeCutOffSoc_pct CcSYS_BatteryRatedVoltage_V CcSYS_CellSOCLockedMax_pct CcSYS_CellSOCLockedMin_pct CcSYS_FullChargeSoc_pct WATS_PER_KILOWAT /end REF_CHARACTERISTIC
/end GROUP
/begin GROUP S1136_Rate_Limit_and_Output "VBU0513/VBUSystem/BMS/SOE/Subsystem2/Subsystem/Rate_Limit_and_Output"
 /begin REF_CHARACTERISTIC CcSOE_EnergyDecRate_Kwh CcSOE_EnergyIncRate_Kwh CcSOE_SocInitializationMaxTime_ms /end REF_CHARACTERISTIC
/end GROUP
/begin GROUP S1136_Rate_Limit_and_Output_SOC "VBU0513/VBUSystem/BMS/SOE/Subsystem2/Subsystem/Rate_Limit_and_Output_SOC" /begin SUB_GROUP S1141_Rate_Limiter_Reset1 /end SUB_GROUP
 /begin REF_CHARACTERISTIC CcSOE_EnergyDecRate_Kwh CcSOE_EnergyIncRate_Kwh CcSOE_SocInitializationMaxTime_ms /end REF_CHARACTERISTIC
/end GROUP
/begin GROUP S1188_Calculate_ActualPower "VBU0513/VBUSystem/BMS/SOF/Subsystem6/Subsystem/Calculate_ActualPower" /begin REF_CHARACTERISTIC WATS_PER_KILOWAT /end REF_CHARACTERISTIC
 /begin REF_MEASUREMENT SOF_kwChargePowerActual SOF_kwChargePowerLimitDelta SOF_kwDischargePowerActual SOF_kwDischargePowerLimitDelta /end REF_MEASUREMENT
/end GROUP
/begin GROUP S1188_Calculate_PowerLimit "VBU0513/VBUSystem/BMS/SOF/Subsystem6/Subsystem/Calculate_PowerLimit"
 /begin SUB_GROUP S1190_Calculate_Pack_OCV S1190_Determine_Capacity_Cycle_PowerLimit S1190_Determine_SOCP_PowerLimit /end SUB_GROUP
 /begin REF_CHARACTERISTIC WATS_PER_KILOWAT /end REF_CHARACTERISTIC
 /begin REF_MEASUREMENT SOF_kwChargePowerLimitTarget SOF_kwContinuousChargePowerLimitTarget SOF_kwContinuousDischargePowerLimitBefoTarget SOF_kwDischargePowerLimitBefoTarget SOF_kwShortPulseChargePowerLimitTarget SOF_kwShortPulseDischargePowerLimitTarget /end REF_MEASUREMENT
/end GROUP
/begin GROUP S1188_Count_LowTempOverCurrent "VBU0513/VBUSystem/BMS/SOF/Subsystem6/Subsystem/Count_LowTempOverCurrent"
 /begin REF_CHARACTERISTIC CcSOF_LowTempOverCurrentBufferEmpty_As CcSOF_LowTempOverCurrentCount_C CcSOF_LowTempOverCurrent_A /end REF_CHARACTERISTIC
/end GROUP
/begin GROUP S1188_Determine_Currentlimit_Target "VBU0513/VBUSystem/BMS/SOF/Subsystem6/Subsystem/Determine_Currentlimit_Target"
 /begin SUB_GROUP S1192_Calculate_CurrentLimit_Target S1192_Determine_CurrentLimitTarget_Enable /end SUB_GROUP
/end GROUP
/begin GROUP S1188_Rate_CurrentLimit "VBU0513/VBUSystem/BMS/SOF/Subsystem6/Subsystem/Rate_CurrentLimit" /begin SUB_GROUP S1193_FCC_CHARGE_MODE1 /end SUB_GROUP
 /begin REF_CHARACTERISTIC CbSOF_CurrentLimitFastChargeCheckEnable_flg CcSOF_CapacityScalingFactor_n CcSOF_ChargeCurrentSlopeFccMode_A CcSOF_ChargeCurrentSlope_A CcSOF_DischargeCurrentSlope_A /end REF_CHARACTERISTIC
 /begin REF_MEASUREMENT SOF_iAChargeContinuousCurrentRatedLimit SOF_iAChargeCurrentRatedLimit SOF_iAContinuousDischargeCurrentRatedLimit SOF_iADischargeCurrentRatedLimit SOF_iAShortPulseChargeCurrentRatedLimit SOF_iAShortPulseDischargeCurrentRatedLimit /end REF_MEASUREMENT
/end GROUP
/begin GROUP S1188_Rate_PowerLimit "VBU0513/VBUSystem/BMS/SOF/Subsystem6/Subsystem/Rate_PowerLimit"
 /begin REF_CHARACTERISTIC CaSOF_ChargePowerSlopeSocTempMapDimension_n CaSOF_ChargePowerSlopeSocTempMapZ_Kw CaSOF_DischargePowerSlopeSocTempMapDimension_n CaSOF_DischargePowerSlopeSocTempMapZ_Kw /end REF_CHARACTERISTIC
 /begin REF_MEASUREMENT SOF_kwChargePowerContinuousRated SOF_kwChargePowerLimitRated SOF_kwChargePowerShortPulseRated SOF_kwDischargePowerContinuousRated SOF_kwDischargePowerLimitRated SOF_kwDischargePowerShortPulseRated /end REF_MEASUREMENT
/end GROUP
/begin GROUP S1188_SOF_Diagnostic "VBU0513/VBUSystem/BMS/SOF/Subsystem6/Subsystem/SOF_Diagnostic"
 /begin REF_CHARACTERISTIC CbSOF_ChargePowerLimitViolationFaultEnable_flg CbSOF_DischargePowerLimitViolationFaultEnable_flg CcSOF_ChargePowerLimitViolationFIC_n CcSOF_ChargePowerLimitViolationPIC_n CcSOF_ChargePowerLimitViolationThreshold_Kws CcSOF_ChargePowerViolationCurrentDelay_s CcSOF_DischargePowerLimitViolationFIC_n CcSOF_DischargePowerLimitViolationPIC_n CcSOF_DischargePowerLimitViolationThreshold_Kws CcSYS_TrickleChargeCurrent_A SOF_DISCHARGE_OVER_POWER_FAULT /end REF_CHARACTERISTIC
 /begin REF_MEASUREMENT SOF_kwsChargePowerLimitDeltaTotal SOF_stChargePowerLimitViolationFault SOF_stDischargePowerLimitViolationFault /end REF_MEASUREMENT
/end GROUP
/begin GROUP S1415_Calculate_Capacity "VBU0513/VBUSystem/BMS/SOH/Subsystem4/Subsystem1/Calculate_Capacity"
 /begin SUB_GROUP S1416_Calculate_CellCapacity S1416_Calculate_CellCapacity_SlowCharge S1416_Calculate_MinCellCapacity274_SlowCharge S1416_Determine_CalculateCellCapacity_Condition /end SUB_GROUP
/end GROUP
/begin GROUP S1415_Calculate_Resistance "VBU0513/VBUSystem/BMS/SOH/Subsystem4/Subsystem1/Calculate_Resistance"
 /begin SUB_GROUP S1417_BasicCellResistance_Calculation_Check S1417_Caculate_CellResistance S1417_Calculate_ModuleCurrent S1417_Calculate_Relaxation_Average_CurrentVoltage S1417_Compute_Resistance_Request S1417_Determine_Condition_Calculate_Pulse_Average_CurrentVoltage /end SUB_GROUP
/end GROUP
/begin GROUP S1415_Monitor_SOH "VBU0513/VBUSystem/BMS/SOH/Subsystem4/Subsystem1/Monitor_SOH" /begin REF_MEASUREMENT SOH_stResistanceIncRatio SOH_stSohMonitor /end REF_MEASUREMENT /end GROUP
/begin GROUP S1415_SOH_Diagnositic "VBU0513/VBUSystem/BMS/SOH/Subsystem4/Subsystem1/SOH_Diagnositic"
 /begin SUB_GROUP S1420_CellCapacity_Diagnostic S1420_CellResistanceIncRto_Diagnostic S1420_Monitor_SOH_Performance /end SUB_GROUP
/end GROUP
/begin GROUP S1415_Subsystem "VBU0513/VBUSystem/BMS/SOH/Subsystem4/Subsystem1/Subsystem"
 /begin REF_CHARACTERISTIC VCT_CHARGE_STATE_CHARGING VCT_CHARGE_STATE_CHARGING_FAULT VCT_CHARGE_STATE_CHARGING_FULL VCT_CHARGE_STATE_NOT_CHARGING /end REF_CHARACTERISTIC
/end GROUP
/begin GROUP S1546_Calculate_PipeTemperature "VBU0513/VBUSystem/BMS/THM/Subsystem/Subsystem/Calculate_PipeTemperature" /begin SUB_GROUP S1547_Determine_CoolantSensorTemp_Validation /end SUB_GROUP /end GROUP
/begin GROUP S1546_Charge_Mode_Temp_Request "VBU0513/VBUSystem/BMS/THM/Subsystem/Subsystem/Charge_Mode_Temp_Request"
 /begin SUB_GROUP S1548_FCC_Temp_Request S1548_Invaild_Temp_Request S1548_OBC_Temp_Request /end SUB_GROUP
 /begin REF_MEASUREMENT THM_tInletTempRequest /end REF_MEASUREMENT
/end GROUP
/begin GROUP S1546_Cooling_Request_Respond_Check "VBU0513/VBUSystem/BMS/THM/Subsystem/Subsystem/Cooling_Request_Respond_Check"
 /begin REF_CHARACTERISTIC CcTHM_CoolingReponseCellTemp_C CcTHM_CoolingReponseInletTemp_C CcTHM_CoolingResponseDelay_s CcTHM_InletResponseDebounce_s SAMPLE_TIME_TASK_E /end REF_CHARACTERISTIC
/end GROUP
/begin GROUP S1546_Diagnose_InletCoolingHighTemperture_Fault "VBU0513/VBUSystem/BMS/THM/Subsystem/Subsystem/Diagnose_InletCoolingHighTemperture_Fault"
 /begin REF_CHARACTERISTIC CbTHM_InletCoolantSensorOorHighFaultEnable_flg CcTHM_CoolantSensorOorHigh_C CcTHM_InletCoolantSensorOorHighFIC_n CcTHM_InletCoolantSensorOorHighPIC_n THM_INLET_COOLANT_SENSOR_OOR_HIGH_FAULT /end REF_CHARACTERISTIC
 /begin REF_MEASUREMENT THM_ftInletCoolantSensorOorHigh /end REF_MEASUREMENT
/end GROUP
/begin GROUP S1546_Diagnose_InletCoolingLowTemperture_Fault "VBU0513/VBUSystem/BMS/THM/Subsystem/Subsystem/Diagnose_InletCoolingLowTemperture_Fault"
 /begin REF_CHARACTERISTIC CbTHM_InletCoolantSensorOorLowFaultEnable_flg CcTHM_CoolantSensorOorLow_C CcTHM_InletCoolantSensorOorLowFIC_n CcTHM_InletCoolantSensorOorLowPIC_n THM_INLET_COOLANT_SENSOR_OOR_LOW_FAULT /end REF_CHARACTERISTIC
 /begin REF_MEASUREMENT THM_ftInletCoolantSensorOorLow /end REF_MEASUREMENT
/end GROUP
/begin GROUP S1546_Diagnose_InletOutletTempDelta_Fault "VBU0513/VBUSystem/BMS/THM/Subsystem/Subsystem/Diagnose_InletOutletTempDelta_Fault"
 /begin REF_CHARACTERISTIC CbTHM_InletOutletTempDeltaFaultEnable_flg CcTHM_InletOutletTempDeltaFIC_n CcTHM_InletOutletTempDeltaPIC_n CcTHM_InletOutletTempDeltaThreshold_C THM_INLET_OUTLET_TEMP_DELTA_FAULT /end REF_CHARACTERISTIC
 /begin REF_MEASUREMENT THM_ftInletOutletTempDelta /end REF_MEASUREMENT
/end GROUP
/begin GROUP S1546_Diagnose_OutletCoolingHighTemperture_Fault "VBU0513/VBUSystem/BMS/THM/Subsystem/Subsystem/Diagnose_OutletCoolingHighTemperture_Fault"
 /begin REF_CHARACTERISTIC CbTHM_OutletCoolantSensorOorHighFaultEnable_flg CcTHM_CoolantSensorOorHigh_C CcTHM_OutletCoolantSensorOorHighFIC_n CcTHM_OutletCoolantSensorOorHighPIC_n THM_OUTLET_COOLANT_SENSOR_OOR_HIGH_FAULT /end REF_CHARACTERISTIC
 /begin REF_MEASUREMENT THM_ftOutletCoolantSensorOorHigh /end REF_MEASUREMENT
/end GROUP
/begin GROUP S1546_Diagnose_OutletCoolingLowTemperture_Fault "VBU0513/VBUSystem/BMS/THM/Subsystem/Subsystem/Diagnose_OutletCoolingLowTemperture_Fault"
 /begin REF_CHARACTERISTIC CbTHM_OutletCoolantSensorOorLowFaultEnable_flg CcTHM_CoolantSensorOorLow_C CcTHM_OutletCoolantSensorOorLowFIC_n CcTHM_OutletCoolantSensorOorLowPIC_n THM_OUTLET_COOLANT_SENSOR_OOR_LOW_FAULT /end REF_CHARACTERISTIC
 /begin REF_MEASUREMENT THM_ftOutletCoolantSensorOorLow /end REF_MEASUREMENT
/end GROUP
/begin GROUP S1546_Thermal_System_Damage_Judgement "VBU0513/VBUSystem/BMS/THM/Subsystem/Subsystem/Thermal_System_Damage_Judgement" /begin SUB_GROUP S1555_Delay_FallingEdge /end SUB_GROUP
 /begin REF_CHARACTERISTIC CaTHM_OutletCoolantTempMapZ_C CcTHM_BdmDelay_s CcTHM_CoolingReponseCellTemp_C CcTHM_InletCoolingTempDeviation_C SAMPLE_TIME_TASK_E /end REF_CHARACTERISTIC
/end GROUP
/begin GROUP S1546_Valid_Condition_Determination "VBU0513/VBUSystem/BMS/THM/Subsystem/Subsystem/Valid_Condition_Determination" /begin SUB_GROUP S1556_FCC_Temp_Valid S1556_OBC_Temp_Valid /end SUB_GROUP /begin REF_CHARACTERISTIC CcTHM_BatteryCapacityCycle_n CcTHM_TempRequestEnable_flg /end REF_CHARACTERISTIC /begin REF_MEASUREMENT THM_flgTempRequestValid /end REF_MEASUREMENT /end GROUP
/begin GROUP S1620_Determine_BMS_VCU_267 "VBU0513/VBUSystem/BMS/VCT/Subsystem/Subsystem/Determine_BMS_VCU_267" /begin SUB_GROUP S1621_FCC_CHARGE_MODE1 S1621_Override /end SUB_GROUP /end GROUP
/begin GROUP S1620_Determine_BMS_VCU_268 "VBU0513/VBUSystem/BMS/VCT/Subsystem/Subsystem/Determine_BMS_VCU_268" /begin SUB_GROUP S1622_Override /end SUB_GROUP /end GROUP
/begin GROUP S1620_Determine_BMS_VCU_269 "VBU0513/VBUSystem/BMS/VCT/Subsystem/Subsystem/Determine_BMS_VCU_269" /begin SUB_GROUP S1623_Override /end SUB_GROUP /end GROUP
/begin GROUP S1620_Determine_BMS_VCU_26A "VBU0513/VBUSystem/BMS/VCT/Subsystem/Subsystem/Determine_BMS_VCU_26A" /begin SUB_GROUP S1624_Override /end SUB_GROUP /end GROUP
/begin GROUP S1620_Determine_BMS_VCU_26F "VBU0513/VBUSystem/BMS/VCT/Subsystem/Subsystem/Determine_BMS_VCU_26F" /begin SUB_GROUP S1625_Override /end SUB_GROUP
 /begin REF_CHARACTERISTIC CcSYS_CellVoltageMaxLimit_mV CcVCT_BMSProtocalVersion_n CcVCT_NominalCellCapacity_Ah CeVCT_BMSBatteryType_enum MILIVOLTAGES_PER_VOLTAGE /end REF_CHARACTERISTIC
/end GROUP
/begin GROUP S1620_Determine_BMS_VCU_270 "VBU0513/VBUSystem/BMS/VCT/Subsystem/Subsystem/Determine_BMS_VCU_270" /begin SUB_GROUP S1626_Override /end SUB_GROUP /begin REF_CHARACTERISTIC CcVCT_BatteryRatedVoltage_V /end REF_CHARACTERISTIC /end GROUP
/begin GROUP S1620_Determine_BMS_VCU_271 "VBU0513/VBUSystem/BMS/VCT/Subsystem/Subsystem/Determine_BMS_VCU_271" /begin SUB_GROUP S1627_Override /end SUB_GROUP /begin REF_CHARACTERISTIC CcSYS_FullChargeSoc_pct /end REF_CHARACTERISTIC /end GROUP
/begin GROUP S1620_Determine_BMS_VCU_272 "VBU0513/VBUSystem/BMS/VCT/Subsystem/Subsystem/Determine_BMS_VCU_272" /begin SUB_GROUP S1628_Override /end SUB_GROUP
 /begin REF_CHARACTERISTIC CcVCT_SOCJumpSOCLow_pct CcVCT_SOCJumpThreshold_pct CcVCT_SocInitializationMaxTime_ms /end REF_CHARACTERISTIC
/end GROUP
/begin GROUP S1620_Determine_BMS_VCU_273 "VBU0513/VBUSystem/BMS/VCT/Subsystem/Subsystem/Determine_BMS_VCU_273" /begin SUB_GROUP S1629_Override /end SUB_GROUP /end GROUP
/begin GROUP S1620_Determine_BMS_VCU_34 "VBU0513/VBUSystem/BMS/VCT/Subsystem/Subsystem/Determine_BMS_VCU_34"
 /begin SUB_GROUP S1630_CONTACTOR_STATUS_CLOSED1 S1630_CONTACTOR_STATUS_CLOSED2 S1630_CONTACTOR_STATUS_CLOSED3 S1630_CONTACTOR_STATUS_CLOSED4 S1630_CONTACTOR_STATUS_OPENED2 S1630_Override /end SUB_GROUP
/end GROUP
/begin GROUP S1620_Determine_BMS_VCU_372 "VBU0513/VBUSystem/BMS/VCT/Subsystem/Subsystem/Determine_BMS_VCU_372" /begin SUB_GROUP S1631_Override /end SUB_GROUP
 /begin REF_CHARACTERISTIC CcSYS_BatteryChargeCurrentMax_A CcSYS_CellVoltageMaxLimit_mV CcSYS_NoChargeHighTemp_C CcVCT_BatteryRatedVoltage_V CcVCT_NominalCellCapacity_Ah MILIVOLTAGES_PER_VOLTAGE NUMBER_OF_PARALLEL_CELLS_PER_MODULE NUMBER_OF_PARALLEL_MODULES WATS_PER_KILOWAT /end REF_CHARACTERISTIC
/end GROUP
/begin GROUP S1620_Determine_BMS_VCU_373 "VBU0513/VBUSystem/BMS/VCT/Subsystem/Subsystem/Determine_BMS_VCU_373" /begin SUB_GROUP S1632_Override /end SUB_GROUP /end GROUP
/begin GROUP S1620_Determine_BMS_VCU_AC "VBU0513/VBUSystem/BMS/VCT/Subsystem/Subsystem/Determine_BMS_VCU_AC" /begin SUB_GROUP S1633_FCC_CHARGE_MODE1 S1633_Override /end SUB_GROUP
 /begin REF_CHARACTERISTIC CcVCT_SOCLowWarningThreshold1_pct CcVCT_SOCLowWarningThreshold2_pct /end REF_CHARACTERISTIC
/end GROUP
/begin GROUP S1620_Determine_BMS_VCU_AD "VBU0513/VBUSystem/BMS/VCT/Subsystem/Subsystem/Determine_BMS_VCU_AD" /begin SUB_GROUP S1634_OBC_ChargeState_Mapping S1634_Override /end SUB_GROUP
 /begin REF_CHARACTERISTIC CcVCT_BatteryVoltageLimitMax_V CcVCT_BatteryVoltageLimitMin_V /end REF_CHARACTERISTIC
/end GROUP
/begin GROUP S1620_Determine_BMS_VCU_AE "VBU0513/VBUSystem/BMS/VCT/Subsystem/Subsystem/Determine_BMS_VCU_AE" /begin SUB_GROUP S1635_Override /end SUB_GROUP /begin REF_CHARACTERISTIC CcSYS_CellVoltageMaxLimit_mV MILIVOLTAGES_PER_VOLTAGE /end REF_CHARACTERISTIC /end GROUP
/begin GROUP S1863_override_signal_Status "VBU0513/VBUSystem/HALIn/HW/Subsystem/Input_HW_Signal_Range_Check2/override_signal_Status" /begin REF_MEASUREMENT INP_uAccPed1 /end REF_MEASUREMENT /end GROUP
/begin GROUP S1864_override_signal_Status "VBU0513/VBUSystem/HALIn/HW/Subsystem/Input_HW_Signal_Range_Check3/override_signal_Status" /begin REF_MEASUREMENT INP_uBrkPres /end REF_MEASUREMENT /end GROUP
/begin GROUP S1865_override_signal_Status "VBU0513/VBUSystem/HALIn/HW/Subsystem/Input_HW_Signal_Range_Check4/override_signal_Status" /begin REF_MEASUREMENT INP_uAccPed2 /end REF_MEASUREMENT /end GROUP
/begin GROUP S1866_override_signal_Status "VBU0513/VBUSystem/HALIn/HW/Subsystem/Input_HW_Signal_Range_Check6/override_signal_Status" /begin REF_MEASUREMENT INP_uDCCHCC2 /end REF_MEASUREMENT /end GROUP
/begin GROUP S1867_override_signal_Status "VBU0513/VBUSystem/HALIn/HW/Subsystem/Input_HW_Signal_Range_Check_Table1/override_signal_Status" /begin REF_MEASUREMENT INP_pVacPres /end REF_MEASUREMENT /end GROUP
/begin GROUP S1868_override_signal_Status "VBU0513/VBUSystem/HALIn/HW/Subsystem/Input_HW_Signal_Range_Check_Table2/override_signal_Status" /begin REF_MEASUREMENT INP_tDCChPortPosTemp /end REF_MEASUREMENT /end GROUP
/begin GROUP S1869_override_signal_Status "VBU0513/VBUSystem/HALIn/HW/Subsystem/Input_HW_Signal_Range_Check_Table4/override_signal_Status" /begin REF_MEASUREMENT INP_tDCChPortNegTemp /end REF_MEASUREMENT /end GROUP
/begin GROUP S1870_override_signal_Status "VBU0513/VBUSystem/HALIn/HW/Subsystem/Input_HW_Signal_Range_Check_Table5/override_signal_Status" /begin REF_MEASUREMENT INP_tEDSInletCoolTemp /end REF_MEASUREMENT /end GROUP
/begin GROUP S1943_override_signal "VBU0513/VBUSystem/HALIn/HW/Subsystem1/BrkLmpSwtConfirm/override_signal" /begin REF_MEASUREMENT INP_flgBrkLmpSwt /end REF_MEASUREMENT /end GROUP
/begin GROUP S1944_override_signal "VBU0513/VBUSystem/HALIn/HW/Subsystem1/INP_flgGearH1Confirm/override_signal" /begin REF_MEASUREMENT INP_flgGearH1 /end REF_MEASUREMENT /end GROUP
/begin GROUP S1945_override_signal "VBU0513/VBUSystem/HALIn/HW/Subsystem1/INP_flgGearH2Confirm/override_signal" /begin REF_MEASUREMENT INP_flgGearH2 /end REF_MEASUREMENT /end GROUP
/begin GROUP S1946_override_signal "VBU0513/VBUSystem/HALIn/HW/Subsystem1/INP_flgGearH3Confirm/override_signal" /begin REF_MEASUREMENT INP_flgGearH3 /end REF_MEASUREMENT /end GROUP
/begin GROUP S1947_override_signal "VBU0513/VBUSystem/HALIn/HW/Subsystem1/IN_ACMidPreConfirm/override_signal" /begin REF_MEASUREMENT INP_flgACMidPresSwitch /end REF_MEASUREMENT /end GROUP
/begin GROUP S1948_override_signal "VBU0513/VBUSystem/HALIn/HW/Subsystem1/IN_CrankConfirm/override_signal" /begin REF_MEASUREMENT INP_flgCrankConfirm /end REF_MEASUREMENT /end GROUP
/begin GROUP S1949_override_signal "VBU0513/VBUSystem/HALIn/HW/Subsystem1/IN_DriverACOnConfirm/override_signal" /begin REF_MEASUREMENT INP_flgDriverACOn /end REF_MEASUREMENT /end GROUP
/begin GROUP S1964_override_signal_Status "VBU0513/VBUSystem/HALIn/HW/Subsystem2/Input_HW_Signal_Range_Check1/override_signal_Status" /begin REF_MEASUREMENT INP_pctHVILDty INP_stHVILDty /end REF_MEASUREMENT /end GROUP
/begin GROUP S1965_override_signal_Status "VBU0513/VBUSystem/HALIn/HW/Subsystem2/Input_HW_Signal_Range_Check2/override_signal_Status" /begin REF_MEASUREMENT INP_pctBattPresDty INP_stBattPresDty /end REF_MEASUREMENT /end GROUP
/begin GROUP S1966_override_signal_Status "VBU0513/VBUSystem/HALIn/HW/Subsystem2/Input_HW_Signal_Range_Check3/override_signal_Status" /begin REF_MEASUREMENT INP_fBattPresFrq INP_stBattPresFrq /end REF_MEASUREMENT /end GROUP
/begin GROUP S1967_override_signal_Status "VBU0513/VBUSystem/HALIn/HW/Subsystem2/Input_HW_Signal_Range_Check7/override_signal_Status" /begin REF_MEASUREMENT INP_fHVILFrq INP_stHVILFrq /end REF_MEASUREMENT /end GROUP
/begin GROUP S2011_ABS_0x068 "VBU0513/VBUSystem/HALIn/PTCAN/Subsystem/20ms/ABS_0x068"
 /begin SUB_GROUP S2020_Input_CAN_Signal_No_Range_Check S2020_Input_CAN_Signal_No_Range_Check1 S2020_Input_CAN_Signal_No_Range_Check2 S2020_Input_CAN_Signal_No_Range_Check3 S2020_Input_CAN_Signal_No_Range_Check4 S2020_Input_CAN_Signal_No_Range_Check5 /end SUB_GROUP
 /begin REF_CHARACTERISTIC ABS_flgMsg068ChksmDisbl_C ABS_flgMsg068RollCntDisbl_C /end REF_CHARACTERISTIC
/end GROUP
/begin GROUP S2011_ABS_0x115 "VBU0513/VBUSystem/HALIn/PTCAN/Subsystem/20ms/ABS_0x115"
 /begin SUB_GROUP S2021_Input_CAN_Signal_No_Range_Check S2021_Input_CAN_Signal_No_Range_Check1 S2021_Input_CAN_Signal_No_Range_Check2 S2021_Input_CAN_Signal_No_Range_Check3 S2021_Input_CAN_Signal_No_Range_Check4 S2021_Input_CAN_Signal_No_Range_Check5 S2021_Input_CAN_Signal_No_Range_Check6 S2021_Input_CAN_Signal_No_Range_Check7 /end SUB_GROUP
 /begin REF_CHARACTERISTIC ABS_flgMsg115ChksmDisbl_C ABS_flgMsg115RollCntDisbl_C /end REF_CHARACTERISTIC
/end GROUP
/begin GROUP S2011_ABS_0x75 "VBU0513/VBUSystem/HALIn/PTCAN/Subsystem/20ms/ABS_0x75"
 /begin SUB_GROUP S2022_Input_CAN_Signal_No_Range_Check S2022_Input_CAN_Signal_No_Range_Check1 S2022_Input_CAN_Signal_No_Range_Check2 S2022_Input_CAN_Signal_No_Range_Check3 /end SUB_GROUP
 /begin REF_CHARACTERISTIC ABS_flgMsg075ChksmDisbl_C ABS_flgMsg075RollCntDisbl_C /end REF_CHARACTERISTIC
/end GROUP
/begin GROUP S2011_ABS_0x79 "VBU0513/VBUSystem/HALIn/PTCAN/Subsystem/20ms/ABS_0x79"
 /begin SUB_GROUP S2023_Input_CAN_Signal_No_Range_Check S2023_Input_CAN_Signal_No_Range_Check1 S2023_Input_CAN_Signal_No_Range_Check2 S2023_Input_CAN_Signal_No_Range_Check3 /end SUB_GROUP
 /begin REF_CHARACTERISTIC ABS_flgMsg079ChksmDisbl_C ABS_flgMsg079RollCntDisbl_C /end REF_CHARACTERISTIC
/end GROUP
/begin GROUP S2011_EPB_0x80 "VBU0513/VBUSystem/HALIn/PTCAN/Subsystem/20ms/EPB_0x80"
 /begin SUB_GROUP S2024_Input_CAN_Signal_No_Range_Check1 S2024_Input_CAN_Signal_No_Range_Check10 S2024_Input_CAN_Signal_No_Range_Check2 S2024_Input_CAN_Signal_No_Range_Check3 S2024_Input_CAN_Signal_No_Range_Check4 S2024_Input_CAN_Signal_No_Range_Check5 S2024_Input_CAN_Signal_No_Range_Check6 S2024_Input_CAN_Signal_No_Range_Check7 S2024_Input_CAN_Signal_No_Range_Check9 /end SUB_GROUP
 /begin REF_CHARACTERISTIC EPB_flgMsg080ChksmDisbl_C EPB_flgMsg080RollCntDisbl_C /end REF_CHARACTERISTIC
/end GROUP
/begin GROUP S2011_EPS_0x70 "VBU0513/VBUSystem/HALIn/PTCAN/Subsystem/20ms/EPS_0x70"
 /begin SUB_GROUP S2025_Input_CAN_Signal_No_Range_Check1 S2025_Input_CAN_Signal_No_Range_Check2 S2025_Input_CAN_Signal_No_Range_Check3 S2025_Input_CAN_Signal_No_Range_Check4 S2025_Input_CAN_Signal_No_Range_Check5 S2025_Input_CAN_Signal_No_Range_Check6 /end SUB_GROUP
 /begin REF_CHARACTERISTIC EPS_flgMsg070ChksmDisbl_C EPS_flgMsg070RollCntDisbl_C /end REF_CHARACTERISTIC
/end GROUP
/begin GROUP S2011_MCU_205 "VBU0513/VBUSystem/HALIn/PTCAN/Subsystem/20ms/MCU_205"
 /begin SUB_GROUP S2026_Input_CAN_Signal_No_Range_Check1 S2026_Input_CAN_Signal_No_Range_Check2 S2026_Input_CAN_Signal_No_Range_Check3 S2026_Input_CAN_Signal_No_Range_Check4 S2026_Input_CAN_Signal_No_Range_Check5 S2026_Input_CAN_Signal_No_Range_Check6 S2026_Input_CAN_Signal_No_Range_Check7 /end SUB_GROUP
 /begin REF_CHARACTERISTIC MCU_flgMsg205ChksmDisbl_C MCU_flgMsg205RollCntDisbl_C /end REF_CHARACTERISTIC
 /begin REF_MEASUREMENT PEUR_flgMotrSpdVld PEUR_trqAct /end REF_MEASUREMENT
/end GROUP
/begin GROUP S2012_BCM_0x18FE0121 "VBU0513/VBUSystem/HALIn/PTCAN/Subsystem/50ms/BCM_0x18FE0121"
 /begin SUB_GROUP S2214_Input_CAN_Signal_No_Range_Check S2214_Input_CAN_Signal_No_Range_Check1 S2214_Input_CAN_Signal_No_Range_Check10 S2214_Input_CAN_Signal_No_Range_Check11 S2214_Input_CAN_Signal_No_Range_Check12 S2214_Input_CAN_Signal_No_Range_Check13 S2214_Input_CAN_Signal_No_Range_Check14 S2214_Input_CAN_Signal_No_Range_Check15 S2214_Input_CAN_Signal_No_Range_Check16 S2214_Input_CAN_Signal_No_Range_Check17 S2214_Input_CAN_Signal_No_Range_Check18 S2214_Input_CAN_Signal_No_Range_Check2 S2214_Input_CAN_Signal_No_Range_Check3 S2214_Input_CAN_Signal_No_Range_Check4 S2214_Input_CAN_Signal_No_Range_Check5 S2214_Input_CAN_Signal_No_Range_Check6 S2214_Input_CAN_Signal_No_Range_Check7 S2214_Input_CAN_Signal_No_Range_Check8 S2214_Input_CAN_Signal_No_Range_Check9 /end SUB_GROUP
 /begin REF_CHARACTERISTIC BCM_flgMsg18FE0121ChksmDisbl_C BCM_flgMsg18FE0121RollCntDisbl_C /end REF_CHARACTERISTIC
/end GROUP
/begin GROUP S2012_MCU_305 "VBU0513/VBUSystem/HALIn/PTCAN/Subsystem/50ms/MCU_305"
 /begin SUB_GROUP S2215_Input_CAN_Signal_No_Range_Check S2215_Input_CAN_Signal_No_Range_Check1 S2215_Input_CAN_Signal_No_Range_Check2 /end SUB_GROUP
 /begin REF_CHARACTERISTIC PEUR_flgMsg305ChksmDisbl_C PEUR_flgMsg305RollCntDisbl_C /end REF_CHARACTERISTIC
 /begin REF_MEASUREMENT PEUR_trqMaxLimit /end REF_MEASUREMENT
/end GROUP
/begin GROUP S2015_MsgRxData_Unpack1 "VBU0513/VBUSystem/HALIn/PTCAN/Subsystem/CanMsgUnpack/MsgRxData_Unpack1" /begin SUB_GROUP S2398_CanRxData_Unpack /end SUB_GROUP /end GROUP
/begin GROUP S2015_MsgRxData_Unpack10 "VBU0513/VBUSystem/HALIn/PTCAN/Subsystem/CanMsgUnpack/MsgRxData_Unpack10" /begin SUB_GROUP S2399_CanRxData_Unpack /end SUB_GROUP /end GROUP
/begin GROUP S2015_MsgRxData_Unpack11 "VBU0513/VBUSystem/HALIn/PTCAN/Subsystem/CanMsgUnpack/MsgRxData_Unpack11" /begin SUB_GROUP S2400_CanRxData_Unpack /end SUB_GROUP /end GROUP
/begin GROUP S2015_MsgRxData_Unpack12 "VBU0513/VBUSystem/HALIn/PTCAN/Subsystem/CanMsgUnpack/MsgRxData_Unpack12" /begin SUB_GROUP S2401_CanRxData_Unpack /end SUB_GROUP /end GROUP
/begin GROUP S2015_MsgRxData_Unpack13 "VBU0513/VBUSystem/HALIn/PTCAN/Subsystem/CanMsgUnpack/MsgRxData_Unpack13" /begin SUB_GROUP S2402_CanRxData_Unpack /end SUB_GROUP /end GROUP
/begin GROUP S2015_MsgRxData_Unpack14 "VBU0513/VBUSystem/HALIn/PTCAN/Subsystem/CanMsgUnpack/MsgRxData_Unpack14" /begin SUB_GROUP S2403_CanRxData_Unpack /end SUB_GROUP /end GROUP
/begin GROUP S2015_MsgRxData_Unpack15 "VBU0513/VBUSystem/HALIn/PTCAN/Subsystem/CanMsgUnpack/MsgRxData_Unpack15" /begin SUB_GROUP S2404_CanRxData_Unpack /end SUB_GROUP /end GROUP
/begin GROUP S2015_MsgRxData_Unpack16 "VBU0513/VBUSystem/HALIn/PTCAN/Subsystem/CanMsgUnpack/MsgRxData_Unpack16" /begin SUB_GROUP S2405_CanRxData_Unpack /end SUB_GROUP /end GROUP
/begin GROUP S2015_MsgRxData_Unpack17 "VBU0513/VBUSystem/HALIn/PTCAN/Subsystem/CanMsgUnpack/MsgRxData_Unpack17" /begin SUB_GROUP S2406_CanRxData_Unpack /end SUB_GROUP /end GROUP
/begin GROUP S2015_MsgRxData_Unpack18 "VBU0513/VBUSystem/HALIn/PTCAN/Subsystem/CanMsgUnpack/MsgRxData_Unpack18" /begin SUB_GROUP S2407_CanRxData_Unpack /end SUB_GROUP /end GROUP
/begin GROUP S2015_MsgRxData_Unpack19 "VBU0513/VBUSystem/HALIn/PTCAN/Subsystem/CanMsgUnpack/MsgRxData_Unpack19" /begin SUB_GROUP S2408_CanRxData_Unpack /end SUB_GROUP /end GROUP
/begin GROUP S2015_MsgRxData_Unpack2 "VBU0513/VBUSystem/HALIn/PTCAN/Subsystem/CanMsgUnpack/MsgRxData_Unpack2" /begin SUB_GROUP S2409_CanRxData_Unpack /end SUB_GROUP /end GROUP
/begin GROUP S2015_MsgRxData_Unpack20 "VBU0513/VBUSystem/HALIn/PTCAN/Subsystem/CanMsgUnpack/MsgRxData_Unpack20" /begin SUB_GROUP S2410_CanRxData_Unpack /end SUB_GROUP /end GROUP
/begin GROUP S2015_MsgRxData_Unpack3 "VBU0513/VBUSystem/HALIn/PTCAN/Subsystem/CanMsgUnpack/MsgRxData_Unpack3" /begin SUB_GROUP S2411_CanRxData_Unpack /end SUB_GROUP /end GROUP
/begin GROUP S2015_MsgRxData_Unpack4 "VBU0513/VBUSystem/HALIn/PTCAN/Subsystem/CanMsgUnpack/MsgRxData_Unpack4" /begin SUB_GROUP S2412_CanRxData_Unpack /end SUB_GROUP /end GROUP
/begin GROUP S2015_MsgRxData_Unpack5 "VBU0513/VBUSystem/HALIn/PTCAN/Subsystem/CanMsgUnpack/MsgRxData_Unpack5" /begin SUB_GROUP S2413_CanRxData_Unpack /end SUB_GROUP /end GROUP
/begin GROUP S2015_MsgRxData_Unpack6 "VBU0513/VBUSystem/HALIn/PTCAN/Subsystem/CanMsgUnpack/MsgRxData_Unpack6" /begin SUB_GROUP S2414_CanRxData_Unpack /end SUB_GROUP /end GROUP
/begin GROUP S2015_MsgRxData_Unpack7 "VBU0513/VBUSystem/HALIn/PTCAN/Subsystem/CanMsgUnpack/MsgRxData_Unpack7" /begin SUB_GROUP S2415_CanRxData_Unpack /end SUB_GROUP /end GROUP
/begin GROUP S2015_MsgRxData_Unpack8 "VBU0513/VBUSystem/HALIn/PTCAN/Subsystem/CanMsgUnpack/MsgRxData_Unpack8" /begin SUB_GROUP S2416_CanRxData_Unpack /end SUB_GROUP /end GROUP
/begin GROUP S2015_MsgRxData_Unpack9 "VBU0513/VBUSystem/HALIn/PTCAN/Subsystem/CanMsgUnpack/MsgRxData_Unpack9" /begin SUB_GROUP S2417_CanRxData_Unpack /end SUB_GROUP /end GROUP
/begin GROUP S2017_AVAS_1801D0D3 "VBU0513/VBUSystem/HALIn/PTCAN/Subsystem/Subsystem2/AVAS_1801D0D3"
 /begin SUB_GROUP S2458_Input_CAN_Signal_No_Range_Check S2458_Input_CAN_Signal_No_Range_Check1 S2458_Input_CAN_Signal_No_Range_Check2 /end SUB_GROUP
 /begin REF_CHARACTERISTIC AVAS_flgMsg1801D0D3ChksmDisbl_C AVAS_flgMsg1801D0D3RollCntDisbl_C /end REF_CHARACTERISTIC
/end GROUP
/begin GROUP S2017_IC_401 "VBU0513/VBUSystem/HALIn/PTCAN/Subsystem/Subsystem2/IC_401"
 /begin SUB_GROUP S2459_Input_CAN_Signal_No_Range_Check S2459_Input_CAN_Signal_No_Range_Check1 S2459_Input_CAN_Signal_No_Range_Check2 S2459_Input_CAN_Signal_No_Range_Check3 /end SUB_GROUP
 /begin REF_CHARACTERISTIC IC_flgMsg401ChksmDisbl_C IC_flgMsg401RollCntDisbl_C /end REF_CHARACTERISTIC
/end GROUP
/begin GROUP S2017_MCU_505 "VBU0513/VBUSystem/HALIn/PTCAN/Subsystem/Subsystem2/MCU_505"
 /begin SUB_GROUP S2460_Input_CAN_Signal_No_Range_Check S2460_Input_CAN_Signal_No_Range_Check1 S2460_Input_CAN_Signal_No_Range_Check10 S2460_Input_CAN_Signal_No_Range_Check11 S2460_Input_CAN_Signal_No_Range_Check12 S2460_Input_CAN_Signal_No_Range_Check13 S2460_Input_CAN_Signal_No_Range_Check14 S2460_Input_CAN_Signal_No_Range_Check15 S2460_Input_CAN_Signal_No_Range_Check16 S2460_Input_CAN_Signal_No_Range_Check17 S2460_Input_CAN_Signal_No_Range_Check18 S2460_Input_CAN_Signal_No_Range_Check19 S2460_Input_CAN_Signal_No_Range_Check2 S2460_Input_CAN_Signal_No_Range_Check20 S2460_Input_CAN_Signal_No_Range_Check3 S2460_Input_CAN_Signal_No_Range_Check4 S2460_Input_CAN_Signal_No_Range_Check5 S2460_Input_CAN_Signal_No_Range_Check6 S2460_Input_CAN_Signal_No_Range_Check7 S2460_Input_CAN_Signal_No_Range_Check8 S2460_Input_CAN_Signal_No_Range_Check9 /end SUB_GROUP
 /begin REF_CHARACTERISTIC PEUR_flgMsg505ChksmDisbl_C PEUR_flgMsg505RollCntDisbl_C /end REF_CHARACTERISTIC
/end GROUP
/begin GROUP S2018_DCDC_509 "VBU0513/VBUSystem/HALIn/PTCAN/Subsystem/Subsystem3/DCDC_509"
 /begin SUB_GROUP S2566_Input_CAN_Signal_No_Range_Check S2566_Input_CAN_Signal_No_Range_Check1 S2566_Input_CAN_Signal_No_Range_Check2 S2566_Input_CAN_Signal_No_Range_Check3 S2566_Input_CAN_Signal_No_Range_Check4 S2566_Input_CAN_Signal_No_Range_Check5 S2566_Input_CAN_Signal_No_Range_Check6 S2566_Input_CAN_Signal_No_Range_Check7 S2566_Input_CAN_Signal_No_Range_Check8 /end SUB_GROUP
 /begin REF_CHARACTERISTIC DCDC_flgMsg509ChksmDisbl_C DCDC_flgMsg509RollCntDisbl_C /end REF_CHARACTERISTIC
/end GROUP
/begin GROUP S2019_AC_248 "VBU0513/VBUSystem/HALIn/PTCAN/Subsystem/Subsystem4/AC_248"
 /begin SUB_GROUP S2601_Input_CAN_Signal_No_Range_Check S2601_Input_CAN_Signal_No_Range_Check1 S2601_Input_CAN_Signal_No_Range_Check10 S2601_Input_CAN_Signal_No_Range_Check11 S2601_Input_CAN_Signal_No_Range_Check2 S2601_Input_CAN_Signal_No_Range_Check3 S2601_Input_CAN_Signal_No_Range_Check4 S2601_Input_CAN_Signal_No_Range_Check5 S2601_Input_CAN_Signal_No_Range_Check6 S2601_Input_CAN_Signal_No_Range_Check7 S2601_Input_CAN_Signal_No_Range_Check8 S2601_Input_CAN_Signal_No_Range_Check9 /end SUB_GROUP
 /begin REF_CHARACTERISTIC CCU_flgMsg248ChksmDisbl_C CCU_flgMsg248RollCntDisbl_C /end REF_CHARACTERISTIC
/end GROUP
/begin GROUP S2019_CDC_220 "VBU0513/VBUSystem/HALIn/PTCAN/Subsystem/Subsystem4/CDC_220"
 /begin SUB_GROUP S2602_Input_CAN_Signal_No_Range_Check S2602_Input_CAN_Signal_No_Range_Check1 S2602_Input_CAN_Signal_No_Range_Check2 S2602_Input_CAN_Signal_No_Range_Check3 S2602_Input_CAN_Signal_No_Range_Check4 /end SUB_GROUP
 /begin REF_CHARACTERISTIC CDC_flgMsg220ChksmDisbl_C CDC_flgMsg220RollCntDisbl_C /end REF_CHARACTERISTIC
/end GROUP
/begin GROUP S2019_DCDC_303 "VBU0513/VBUSystem/HALIn/PTCAN/Subsystem/Subsystem4/DCDC_303"
 /begin SUB_GROUP S2603_Input_CAN_Signal_No_Range_Check S2603_Input_CAN_Signal_No_Range_Check1 S2603_Input_CAN_Signal_No_Range_Check2 S2603_Input_CAN_Signal_No_Range_Check3 S2603_Input_CAN_Signal_No_Range_Check4 S2603_Input_CAN_Signal_No_Range_Check5 /end SUB_GROUP
 /begin REF_CHARACTERISTIC DCDC_flgMsg303ChksmDisbl_C DCDC_flgMsg303RollCntDisbl_C /end REF_CHARACTERISTIC
 /begin REF_MEASUREMENT DCDC_pwrHVInput DCDC_pwrLVOut /end REF_MEASUREMENT
/end GROUP
/begin GROUP S2019_MCU_405 "VBU0513/VBUSystem/HALIn/PTCAN/Subsystem/Subsystem4/MCU_405"
 /begin SUB_GROUP S2604_Input_CAN_Signal_No_Range_Check S2604_Input_CAN_Signal_No_Range_Check1 S2604_Input_CAN_Signal_No_Range_Check2 S2604_Input_CAN_Signal_No_Range_Check3 /end SUB_GROUP
 /begin REF_CHARACTERISTIC MCU_flgMsg405ChksmDisbl_C MCU_flgMsg405RollCntDisbl_C /end REF_CHARACTERISTIC
/end GROUP
/begin GROUP S2716_CanRxData_Unpack "VBU0513/VBUSystem/HALIn/PrivateCAN/CanMsgUnpack1/MsgRxData_Unpack1/CanRxData_Unpack" /begin SUB_GROUP S2794_HCUCellTemp_1 /end SUB_GROUP /end GROUP
/begin GROUP S2717_CanRxData_Unpack "VBU0513/VBUSystem/HALIn/PrivateCAN/CanMsgUnpack1/MsgRxData_Unpack10/CanRxData_Unpack" /begin SUB_GROUP S2796_HCU_Message_5 /end SUB_GROUP /end GROUP
/begin GROUP S2718_CanRxData_Unpack "VBU0513/VBUSystem/HALIn/PrivateCAN/CanMsgUnpack1/MsgRxData_Unpack11/CanRxData_Unpack" /begin SUB_GROUP S2798_HCU_Message_6 /end SUB_GROUP /end GROUP
/begin GROUP S2719_CanRxData_Unpack "VBU0513/VBUSystem/HALIn/PrivateCAN/CanMsgUnpack1/MsgRxData_Unpack12/CanRxData_Unpack" /begin SUB_GROUP S2800_HCU_Message_7_PWM /end SUB_GROUP /end GROUP
/begin GROUP S2720_CanRxData_Unpack "VBU0513/VBUSystem/HALIn/PrivateCAN/CanMsgUnpack1/MsgRxData_Unpack13/CanRxData_Unpack" /begin SUB_GROUP S2802_HCU_Statistics_State1 /end SUB_GROUP /end GROUP
/begin GROUP S2721_CanRxData_Unpack "VBU0513/VBUSystem/HALIn/PrivateCAN/CanMsgUnpack1/MsgRxData_Unpack14/CanRxData_Unpack" /begin SUB_GROUP S2804_HCU_Statistics_State10 /end SUB_GROUP /end GROUP
/begin GROUP S2722_CanRxData_Unpack "VBU0513/VBUSystem/HALIn/PrivateCAN/CanMsgUnpack1/MsgRxData_Unpack15/CanRxData_Unpack" /begin SUB_GROUP S2806_HCU_Statistics_State11 /end SUB_GROUP /end GROUP
/begin GROUP S2723_CanRxData_Unpack "VBU0513/VBUSystem/HALIn/PrivateCAN/CanMsgUnpack1/MsgRxData_Unpack16/CanRxData_Unpack" /begin SUB_GROUP S2808_HCU_Statistics_State12 /end SUB_GROUP /end GROUP
/begin GROUP S2724_CanRxData_Unpack "VBU0513/VBUSystem/HALIn/PrivateCAN/CanMsgUnpack1/MsgRxData_Unpack17/CanRxData_Unpack" /begin SUB_GROUP S2810_HCU_Statistics_State13 /end SUB_GROUP /end GROUP
/begin GROUP S2725_CanRxData_Unpack "VBU0513/VBUSystem/HALIn/PrivateCAN/CanMsgUnpack1/MsgRxData_Unpack18/CanRxData_Unpack" /begin SUB_GROUP S2812_HCU_Statistics_State2 /end SUB_GROUP /end GROUP
/begin GROUP S2726_CanRxData_Unpack "VBU0513/VBUSystem/HALIn/PrivateCAN/CanMsgUnpack1/MsgRxData_Unpack19/CanRxData_Unpack" /begin SUB_GROUP S2814_HCU_Statistics_State3 /end SUB_GROUP /end GROUP
/begin GROUP S2727_CanRxData_Unpack "VBU0513/VBUSystem/HALIn/PrivateCAN/CanMsgUnpack1/MsgRxData_Unpack2/CanRxData_Unpack" /begin SUB_GROUP S2816_HCUCellTemp_2 /end SUB_GROUP /end GROUP
/begin GROUP S2728_CanRxData_Unpack "VBU0513/VBUSystem/HALIn/PrivateCAN/CanMsgUnpack1/MsgRxData_Unpack20/CanRxData_Unpack" /begin SUB_GROUP S2818_HCU_Statistics_State4 /end SUB_GROUP /end GROUP
/begin GROUP S2729_CanRxData_Unpack "VBU0513/VBUSystem/HALIn/PrivateCAN/CanMsgUnpack1/MsgRxData_Unpack21/CanRxData_Unpack" /begin SUB_GROUP S2820_HCU_Statistics_State5 /end SUB_GROUP /end GROUP
/begin GROUP S2730_CanRxData_Unpack "VBU0513/VBUSystem/HALIn/PrivateCAN/CanMsgUnpack1/MsgRxData_Unpack22/CanRxData_Unpack" /begin SUB_GROUP S2822_HCU_Statistics_State6 /end SUB_GROUP /end GROUP
/begin GROUP S2731_CanRxData_Unpack "VBU0513/VBUSystem/HALIn/PrivateCAN/CanMsgUnpack1/MsgRxData_Unpack23/CanRxData_Unpack" /begin SUB_GROUP S2824_HCU_Statistics_State7 /end SUB_GROUP /end GROUP
/begin GROUP S2732_CanRxData_Unpack "VBU0513/VBUSystem/HALIn/PrivateCAN/CanMsgUnpack1/MsgRxData_Unpack24/CanRxData_Unpack" /begin SUB_GROUP S2826_HCU_Statistics_State8 /end SUB_GROUP /end GROUP
/begin GROUP S2733_CanRxData_Unpack "VBU0513/VBUSystem/HALIn/PrivateCAN/CanMsgUnpack1/MsgRxData_Unpack25/CanRxData_Unpack" /begin SUB_GROUP S2828_HCU_Statistics_State9 /end SUB_GROUP /end GROUP
/begin GROUP S2734_CanRxData_Unpack "VBU0513/VBUSystem/HALIn/PrivateCAN/CanMsgUnpack1/MsgRxData_Unpack26/CanRxData_Unpack" /begin SUB_GROUP S2830_HCU_Temp /end SUB_GROUP /end GROUP
/begin GROUP S2735_CanRxData_Unpack "VBU0513/VBUSystem/HALIn/PrivateCAN/CanMsgUnpack1/MsgRxData_Unpack27/CanRxData_Unpack" /begin SUB_GROUP S2832_HCU_Total_Cell_Num /end SUB_GROUP /end GROUP
/begin GROUP S2736_CanRxData_Unpack "VBU0513/VBUSystem/HALIn/PrivateCAN/CanMsgUnpack1/MsgRxData_Unpack28/CanRxData_Unpack" /begin SUB_GROUP S2834_LEM_CurrentSensor_3C2 /end SUB_GROUP /end GROUP
/begin GROUP S2737_CanRxData_Unpack "VBU0513/VBUSystem/HALIn/PrivateCAN/CanMsgUnpack1/MsgRxData_Unpack29/CanRxData_Unpack" /begin SUB_GROUP S2836_HCUCellVolt1 /end SUB_GROUP /end GROUP
/begin GROUP S2738_CanRxData_Unpack "VBU0513/VBUSystem/HALIn/PrivateCAN/CanMsgUnpack1/MsgRxData_Unpack3/CanRxData_Unpack" /begin SUB_GROUP S2838_HCUCellTemp_3 /end SUB_GROUP /end GROUP
/begin GROUP S2739_CanRxData_Unpack "VBU0513/VBUSystem/HALIn/PrivateCAN/CanMsgUnpack1/MsgRxData_Unpack30/CanRxData_Unpack" /begin SUB_GROUP S2840_HCUCellVolt10 /end SUB_GROUP /end GROUP
/begin GROUP S2740_CanRxData_Unpack "VBU0513/VBUSystem/HALIn/PrivateCAN/CanMsgUnpack1/MsgRxData_Unpack31/CanRxData_Unpack" /begin SUB_GROUP S2842_HCUCellVolt11 /end SUB_GROUP /end GROUP
/begin GROUP S2741_CanRxData_Unpack "VBU0513/VBUSystem/HALIn/PrivateCAN/CanMsgUnpack1/MsgRxData_Unpack32/CanRxData_Unpack" /begin SUB_GROUP S2844_HCUCellVolt12 /end SUB_GROUP /end GROUP
/begin GROUP S2742_CanRxData_Unpack "VBU0513/VBUSystem/HALIn/PrivateCAN/CanMsgUnpack1/MsgRxData_Unpack33/CanRxData_Unpack" /begin SUB_GROUP S2846_HCUCellVolt13 /end SUB_GROUP /end GROUP
/begin GROUP S2743_CanRxData_Unpack "VBU0513/VBUSystem/HALIn/PrivateCAN/CanMsgUnpack1/MsgRxData_Unpack34/CanRxData_Unpack" /begin SUB_GROUP S2848_HCUCellVolt14 /end SUB_GROUP /end GROUP
/begin GROUP S2744_CanRxData_Unpack "VBU0513/VBUSystem/HALIn/PrivateCAN/CanMsgUnpack1/MsgRxData_Unpack35/CanRxData_Unpack" /begin SUB_GROUP S2850_HCUCellVolt15 /end SUB_GROUP /end GROUP
/begin GROUP S2745_CanRxData_Unpack "VBU0513/VBUSystem/HALIn/PrivateCAN/CanMsgUnpack1/MsgRxData_Unpack36/CanRxData_Unpack" /begin SUB_GROUP S2852_HCUCellVolt16 /end SUB_GROUP /end GROUP
/begin GROUP S2746_CanRxData_Unpack "VBU0513/VBUSystem/HALIn/PrivateCAN/CanMsgUnpack1/MsgRxData_Unpack37/CanRxData_Unpack" /begin SUB_GROUP S2854_HCUCellVolt17 /end SUB_GROUP /end GROUP
/begin GROUP S2747_CanRxData_Unpack "VBU0513/VBUSystem/HALIn/PrivateCAN/CanMsgUnpack1/MsgRxData_Unpack38/CanRxData_Unpack" /begin SUB_GROUP S2856_HCUCellVolt18 /end SUB_GROUP /end GROUP
/begin GROUP S2748_CanRxData_Unpack "VBU0513/VBUSystem/HALIn/PrivateCAN/CanMsgUnpack1/MsgRxData_Unpack39/CanRxData_Unpack" /begin SUB_GROUP S2858_HCUCellVolt19 /end SUB_GROUP /end GROUP
/begin GROUP S2749_CanRxData_Unpack "VBU0513/VBUSystem/HALIn/PrivateCAN/CanMsgUnpack1/MsgRxData_Unpack4/CanRxData_Unpack" /begin SUB_GROUP S2860_HCUCellTemp_4 /end SUB_GROUP /end GROUP
/begin GROUP S2750_CanRxData_Unpack "VBU0513/VBUSystem/HALIn/PrivateCAN/CanMsgUnpack1/MsgRxData_Unpack40/CanRxData_Unpack" /begin SUB_GROUP S2862_HCUCellVolt2 /end SUB_GROUP /end GROUP
/begin GROUP S2751_CanRxData_Unpack "VBU0513/VBUSystem/HALIn/PrivateCAN/CanMsgUnpack1/MsgRxData_Unpack41/CanRxData_Unpack" /begin SUB_GROUP S2864_HCUCellVolt20 /end SUB_GROUP /end GROUP
/begin GROUP S2752_CanRxData_Unpack "VBU0513/VBUSystem/HALIn/PrivateCAN/CanMsgUnpack1/MsgRxData_Unpack42/CanRxData_Unpack" /begin SUB_GROUP S2866_HCUCellVolt21 /end SUB_GROUP /end GROUP
/begin GROUP S2753_CanRxData_Unpack "VBU0513/VBUSystem/HALIn/PrivateCAN/CanMsgUnpack1/MsgRxData_Unpack43/CanRxData_Unpack" /begin SUB_GROUP S2868_HCUCellVolt22 /end SUB_GROUP /end GROUP
/begin GROUP S2754_CanRxData_Unpack "VBU0513/VBUSystem/HALIn/PrivateCAN/CanMsgUnpack1/MsgRxData_Unpack44/CanRxData_Unpack" /begin SUB_GROUP S2870_HCUCellVolt23 /end SUB_GROUP /end GROUP
/begin GROUP S2755_CanRxData_Unpack "VBU0513/VBUSystem/HALIn/PrivateCAN/CanMsgUnpack1/MsgRxData_Unpack45/CanRxData_Unpack" /begin SUB_GROUP S2872_HCUCellVolt24 /end SUB_GROUP /end GROUP
/begin GROUP S2756_CanRxData_Unpack "VBU0513/VBUSystem/HALIn/PrivateCAN/CanMsgUnpack1/MsgRxData_Unpack46/CanRxData_Unpack" /begin SUB_GROUP S2874_HCUCellVolt25 /end SUB_GROUP /end GROUP
/begin GROUP S2757_CanRxData_Unpack "VBU0513/VBUSystem/HALIn/PrivateCAN/CanMsgUnpack1/MsgRxData_Unpack47/CanRxData_Unpack" /begin SUB_GROUP S2876_HCUCellVolt26 /end SUB_GROUP /end GROUP
/begin GROUP S2758_CanRxData_Unpack "VBU0513/VBUSystem/HALIn/PrivateCAN/CanMsgUnpack1/MsgRxData_Unpack48/CanRxData_Unpack" /begin SUB_GROUP S2878_HCUCellVolt27 /end SUB_GROUP /end GROUP
/begin GROUP S2759_CanRxData_Unpack "VBU0513/VBUSystem/HALIn/PrivateCAN/CanMsgUnpack1/MsgRxData_Unpack49/CanRxData_Unpack" /begin SUB_GROUP S2880_HCUCellVolt28 /end SUB_GROUP /end GROUP
/begin GROUP S2760_CanRxData_Unpack "VBU0513/VBUSystem/HALIn/PrivateCAN/CanMsgUnpack1/MsgRxData_Unpack5/CanRxData_Unpack" /begin SUB_GROUP S2882_HCUCellTemp_5 /end SUB_GROUP /end GROUP
/begin GROUP S2761_CanRxData_Unpack "VBU0513/VBUSystem/HALIn/PrivateCAN/CanMsgUnpack1/MsgRxData_Unpack50/CanRxData_Unpack" /begin SUB_GROUP S2884_HCUCellVolt29 /end SUB_GROUP /end GROUP
/begin GROUP S2762_CanRxData_Unpack "VBU0513/VBUSystem/HALIn/PrivateCAN/CanMsgUnpack1/MsgRxData_Unpack51/CanRxData_Unpack" /begin SUB_GROUP S2886_HCUCellVolt3 /end SUB_GROUP /end GROUP
/begin GROUP S2763_CanRxData_Unpack "VBU0513/VBUSystem/HALIn/PrivateCAN/CanMsgUnpack1/MsgRxData_Unpack52/CanRxData_Unpack" /begin SUB_GROUP S2888_HCUCellVolt30 /end SUB_GROUP /end GROUP
/begin GROUP S2764_CanRxData_Unpack "VBU0513/VBUSystem/HALIn/PrivateCAN/CanMsgUnpack1/MsgRxData_Unpack53/CanRxData_Unpack" /begin SUB_GROUP S2890_HCUCellVolt31 /end SUB_GROUP /end GROUP
/begin GROUP S2765_CanRxData_Unpack "VBU0513/VBUSystem/HALIn/PrivateCAN/CanMsgUnpack1/MsgRxData_Unpack54/CanRxData_Unpack" /begin SUB_GROUP S2892_HCUCellVolt32 /end SUB_GROUP /end GROUP
/begin GROUP S2766_CanRxData_Unpack "VBU0513/VBUSystem/HALIn/PrivateCAN/CanMsgUnpack1/MsgRxData_Unpack55/CanRxData_Unpack" /begin SUB_GROUP S2894_HCUCellVolt33 /end SUB_GROUP /end GROUP
/begin GROUP S2767_CanRxData_Unpack "VBU0513/VBUSystem/HALIn/PrivateCAN/CanMsgUnpack1/MsgRxData_Unpack56/CanRxData_Unpack" /begin SUB_GROUP S2896_HCUCellVolt34 /end SUB_GROUP /end GROUP
/begin GROUP S2768_CanRxData_Unpack "VBU0513/VBUSystem/HALIn/PrivateCAN/CanMsgUnpack1/MsgRxData_Unpack57/CanRxData_Unpack" /begin SUB_GROUP S2898_HCUCellVolt35 /end SUB_GROUP /end GROUP
/begin GROUP S2769_CanRxData_Unpack "VBU0513/VBUSystem/HALIn/PrivateCAN/CanMsgUnpack1/MsgRxData_Unpack58/CanRxData_Unpack" /begin SUB_GROUP S2900_HCUCellVolt36 /end SUB_GROUP /end GROUP
/begin GROUP S2770_CanRxData_Unpack "VBU0513/VBUSystem/HALIn/PrivateCAN/CanMsgUnpack1/MsgRxData_Unpack59/CanRxData_Unpack" /begin SUB_GROUP S2902_HCUCellVolt37 /end SUB_GROUP /end GROUP
/begin GROUP S2771_CanRxData_Unpack "VBU0513/VBUSystem/HALIn/PrivateCAN/CanMsgUnpack1/MsgRxData_Unpack6/CanRxData_Unpack" /begin SUB_GROUP S2904_HCU_Message_1_RelayStatus /end SUB_GROUP /end GROUP
/begin GROUP S2772_CanRxData_Unpack "VBU0513/VBUSystem/HALIn/PrivateCAN/CanMsgUnpack1/MsgRxData_Unpack60/CanRxData_Unpack" /begin SUB_GROUP S2906_HCUCellVolt38 /end SUB_GROUP /end GROUP
/begin GROUP S2773_CanRxData_Unpack "VBU0513/VBUSystem/HALIn/PrivateCAN/CanMsgUnpack1/MsgRxData_Unpack61/CanRxData_Unpack" /begin SUB_GROUP S2908_HCUCellVolt39 /end SUB_GROUP /end GROUP
/begin GROUP S2774_CanRxData_Unpack "VBU0513/VBUSystem/HALIn/PrivateCAN/CanMsgUnpack1/MsgRxData_Unpack62/CanRxData_Unpack" /begin SUB_GROUP S2910_HCUCellVolt4 /end SUB_GROUP /end GROUP
/begin GROUP S2775_CanRxData_Unpack "VBU0513/VBUSystem/HALIn/PrivateCAN/CanMsgUnpack1/MsgRxData_Unpack63/CanRxData_Unpack" /begin SUB_GROUP S2912_HCUCellVolt40 /end SUB_GROUP /end GROUP
/begin GROUP S2776_CanRxData_Unpack "VBU0513/VBUSystem/HALIn/PrivateCAN/CanMsgUnpack1/MsgRxData_Unpack64/CanRxData_Unpack" /begin SUB_GROUP S2914_HCUCellVolt41 /end SUB_GROUP /end GROUP
/begin GROUP S2777_CanRxData_Unpack "VBU0513/VBUSystem/HALIn/PrivateCAN/CanMsgUnpack1/MsgRxData_Unpack65/CanRxData_Unpack" /begin SUB_GROUP S2916_HCUCellVolt42 /end SUB_GROUP /end GROUP
/begin GROUP S2778_CanRxData_Unpack "VBU0513/VBUSystem/HALIn/PrivateCAN/CanMsgUnpack1/MsgRxData_Unpack66/CanRxData_Unpack" /begin SUB_GROUP S2918_HCUCellVolt43 /end SUB_GROUP /end GROUP
/begin GROUP S2779_CanRxData_Unpack "VBU0513/VBUSystem/HALIn/PrivateCAN/CanMsgUnpack1/MsgRxData_Unpack67/CanRxData_Unpack" /begin SUB_GROUP S2920_HCUCellVolt44 /end SUB_GROUP /end GROUP
/begin GROUP S2780_CanRxData_Unpack "VBU0513/VBUSystem/HALIn/PrivateCAN/CanMsgUnpack1/MsgRxData_Unpack68/CanRxData_Unpack" /begin SUB_GROUP S2922_HCUCellVolt45 /end SUB_GROUP /end GROUP
/begin GROUP S2781_CanRxData_Unpack "VBU0513/VBUSystem/HALIn/PrivateCAN/CanMsgUnpack1/MsgRxData_Unpack69/CanRxData_Unpack" /begin SUB_GROUP S2924_HCUCellVolt46 /end SUB_GROUP /end GROUP
/begin GROUP S2782_CanRxData_Unpack "VBU0513/VBUSystem/HALIn/PrivateCAN/CanMsgUnpack1/MsgRxData_Unpack7/CanRxData_Unpack" /begin SUB_GROUP S2926_HCU_Message_2_AD1 /end SUB_GROUP /end GROUP
/begin GROUP S2783_CanRxData_Unpack "VBU0513/VBUSystem/HALIn/PrivateCAN/CanMsgUnpack1/MsgRxData_Unpack70/CanRxData_Unpack" /begin SUB_GROUP S2928_HCUCellVolt47 /end SUB_GROUP /end GROUP
/begin GROUP S2784_CanRxData_Unpack "VBU0513/VBUSystem/HALIn/PrivateCAN/CanMsgUnpack1/MsgRxData_Unpack71/CanRxData_Unpack" /begin SUB_GROUP S2930_HCUCellVolt48 /end SUB_GROUP /end GROUP
/begin GROUP S2785_CanRxData_Unpack "VBU0513/VBUSystem/HALIn/PrivateCAN/CanMsgUnpack1/MsgRxData_Unpack72/CanRxData_Unpack" /begin SUB_GROUP S2932_HCUCellVolt49 /end SUB_GROUP /end GROUP
/begin GROUP S2786_CanRxData_Unpack "VBU0513/VBUSystem/HALIn/PrivateCAN/CanMsgUnpack1/MsgRxData_Unpack73/CanRxData_Unpack" /begin SUB_GROUP S2934_HCUCellVolt5 /end SUB_GROUP /end GROUP
/begin GROUP S2787_CanRxData_Unpack "VBU0513/VBUSystem/HALIn/PrivateCAN/CanMsgUnpack1/MsgRxData_Unpack74/CanRxData_Unpack" /begin SUB_GROUP S2936_HCUCellVolt50 /end SUB_GROUP /end GROUP
/begin GROUP S2788_CanRxData_Unpack "VBU0513/VBUSystem/HALIn/PrivateCAN/CanMsgUnpack1/MsgRxData_Unpack75/CanRxData_Unpack" /begin SUB_GROUP S2938_HCUCellVolt6 /end SUB_GROUP /end GROUP
/begin GROUP S2789_CanRxData_Unpack "VBU0513/VBUSystem/HALIn/PrivateCAN/CanMsgUnpack1/MsgRxData_Unpack76/CanRxData_Unpack" /begin SUB_GROUP S2940_HCUCellVolt7 /end SUB_GROUP /end GROUP
/begin GROUP S2790_CanRxData_Unpack "VBU0513/VBUSystem/HALIn/PrivateCAN/CanMsgUnpack1/MsgRxData_Unpack77/CanRxData_Unpack" /begin SUB_GROUP S2942_HCUCellVolt8 /end SUB_GROUP /end GROUP
/begin GROUP S2791_CanRxData_Unpack "VBU0513/VBUSystem/HALIn/PrivateCAN/CanMsgUnpack1/MsgRxData_Unpack78/CanRxData_Unpack" /begin SUB_GROUP S2944_HCUCellVolt9 /end SUB_GROUP /end GROUP
/begin GROUP S2792_CanRxData_Unpack "VBU0513/VBUSystem/HALIn/PrivateCAN/CanMsgUnpack1/MsgRxData_Unpack8/CanRxData_Unpack" /begin SUB_GROUP S2946_HCU_Message_3_AD2 /end SUB_GROUP /end GROUP
/begin GROUP S2793_CanRxData_Unpack "VBU0513/VBUSystem/HALIn/PrivateCAN/CanMsgUnpack1/MsgRxData_Unpack9/CanRxData_Unpack" /begin SUB_GROUP S2948_HCU_Message_4_AD3 /end SUB_GROUP /end GROUP
/begin GROUP S3218_PropertyConfirm "VBU0513/VBUSystem/VCU /APO2HAL/Subsystem2/Subsystem/PropertyConfirm" /begin REF_MEASUREMENT OD_LsMainRly /end REF_MEASUREMENT /end GROUP
/begin GROUP S3218_PropertyConfirm1 "VBU0513/VBUSystem/VCU /APO2HAL/Subsystem2/Subsystem/PropertyConfirm1" /begin REF_MEASUREMENT OD_HsWakeUp1 /end REF_MEASUREMENT /end GROUP
/begin GROUP S3218_PropertyConfirm10 "VBU0513/VBUSystem/VCU /APO2HAL/Subsystem2/Subsystem/PropertyConfirm10" /begin REF_MEASUREMENT OP_fLsWaterPump1 /end REF_MEASUREMENT /end GROUP
/begin GROUP S3218_PropertyConfirm11 "VBU0513/VBUSystem/VCU /APO2HAL/Subsystem2/Subsystem/PropertyConfirm11" /begin REF_MEASUREMENT OP_pctLsWaterPump1 /end REF_MEASUREMENT /end GROUP
/begin GROUP S3218_PropertyConfirm12 "VBU0513/VBUSystem/VCU /APO2HAL/Subsystem2/Subsystem/PropertyConfirm12" /begin REF_MEASUREMENT OP_fLsWaterPump2 /end REF_MEASUREMENT /end GROUP
/begin GROUP S3218_PropertyConfirm13 "VBU0513/VBUSystem/VCU /APO2HAL/Subsystem2/Subsystem/PropertyConfirm13" /begin REF_MEASUREMENT OP_pctLsWaterPump2 /end REF_MEASUREMENT /end GROUP
/begin GROUP S3218_PropertyConfirm14 "VBU0513/VBUSystem/VCU /APO2HAL/Subsystem2/Subsystem/PropertyConfirm14" /begin REF_MEASUREMENT OP_fLsACPump /end REF_MEASUREMENT /end GROUP
/begin GROUP S3218_PropertyConfirm15 "VBU0513/VBUSystem/VCU /APO2HAL/Subsystem2/Subsystem/PropertyConfirm15" /begin REF_MEASUREMENT OP_pctLsACPump /end REF_MEASUREMENT /end GROUP
/begin GROUP S3218_PropertyConfirm4 "VBU0513/VBUSystem/VCU /APO2HAL/Subsystem2/Subsystem/PropertyConfirm4" /begin REF_MEASUREMENT OP_fLsHVIL1 /end REF_MEASUREMENT /end GROUP
/begin GROUP S3218_PropertyConfirm5 "VBU0513/VBUSystem/VCU /APO2HAL/Subsystem2/Subsystem/PropertyConfirm5" /begin REF_MEASUREMENT OD_flgVBUSleepEnable /end REF_MEASUREMENT /end GROUP
/begin GROUP S3218_PropertyConfirm6 "VBU0513/VBUSystem/VCU /APO2HAL/Subsystem2/Subsystem/PropertyConfirm6" /begin REF_MEASUREMENT OP_pctLsHVIL1 /end REF_MEASUREMENT /end GROUP
/begin GROUP S3218_PropertyConfirm8 "VBU0513/VBUSystem/VCU /APO2HAL/Subsystem2/Subsystem/PropertyConfirm8" /begin REF_MEASUREMENT OP_fLsFan /end REF_MEASUREMENT /end GROUP
/begin GROUP S3218_PropertyConfirm9 "VBU0513/VBUSystem/VCU /APO2HAL/Subsystem2/Subsystem/PropertyConfirm9" /begin REF_MEASUREMENT OP_pctLsFan /end REF_MEASUREMENT /end GROUP
/begin GROUP S3237_DCH_BMSChgrReq "VBU0513/VBUSystem/VCU /DCH/DCH_Overall/DCH_DCChargeCtrlOverall/DCH_BMSChgrReq" /begin SUB_GROUP S3240_Turn_On_Delay_Time S3240_Turn_On_Delay_Time1 /end SUB_GROUP
 /begin REF_CHARACTERISTIC DCH_facLimitChrCrnntLvl0V_C DCH_facLimitChrCrnntLvl1V_C DCH_facLimitChrCrnntLvl2V_C DCH_facLimitChrCrnntLvl3V_C DCH_facOneTmpSnsrInvldLmt_C DCH_iCMLMinChCurr_C DCH_iDCChOneSnsrInvldCrntLmt_C DCH_iDCChPortFailureChCurr_C DCH_iDCChReqLowLim_C DCH_iDCChReqUpLim_C DCH_iStatnLackCrnntThres_C DCH_stBCLMode_SY DCH_stChrgPortSnglSnsr_SY DCH_stChrgPortSnsrConfig_C DCH_stWaitCHMMode_SY DCH_tLimitChrCrnntLvl1L_C DCH_tLimitChrCrnntLvl1R_C DCH_tLimitChrCrnntLvl2L_C DCH_tLimitChrCrnntLvl2R_C DCH_tLimitChrCrnntLvl3L_C DCH_tLimitChrCrnntLvl3R_C DCH_tiSmplT_SY DCH_tiStatnLackCrnntThres_C /end REF_CHARACTERISTIC
 /begin REF_MEASUREMENT DCH_iBMSDCChReqLim /end REF_MEASUREMENT
/end GROUP
/begin GROUP S3237_DCH_DCChargeCtrlStateflow "VBU0513/VBUSystem/VCU /DCH/DCH_Overall/DCH_DCChargeCtrlOverall/DCH_DCChargeCtrlStateflow"
 /begin SUB_GROUP S3241_DCH_CtrlStateflowPostProcess S3241_DCH_InputSignalPreProcess S3241_DCH_SignalPreProcessForStateflow /end SUB_GROUP
 /begin REF_CHARACTERISTIC DCH_flgDCChRlyClose_SY DCH_flgDCChRlyOpen_SY DCH_flgHvRlyClose_SY DCH_flgHvRlyOpen_SY DCH_numMaxChErrReconn_C DCH_numTOutCnt_C DCH_stBCLMode_SY DCH_stBCPMode_SY DCH_stBRMMode_SY DCH_stBRONoRdyMode_SY DCH_stBRORdyMode_SY DCH_stBSTForNrmMode_SY DCH_stCC2AplusConnect_SY DCH_stChStopChgrErr_SY DCH_stChStopChgrManual_SY DCH_stChStopIso_SY DCH_stChStopVehCmpt_SY DCH_stChStopVehErr_SY DCH_stChargeFinishMode_SY DCH_stCharging_SY DCH_stClDCChRlyMode_SY DCH_stComTOut_SY DCH_stHandshake_SY DCH_stHvRlyMode_SY DCH_stInitMode_SY DCH_stInit_SY DCH_stLvShutDownForNrmMode_SY DCH_stOpenDCRlyForBMSTOutMode_SY DCH_stOpenDCRlyForNrmMode_SY DCH_stOpenHvForBMSTOutMode_SY DCH_stParConfig_SY DCH_stPreOpenDCRly_SY DCH_stReConnectChProcessMode_SY DCH_stStopBMS_SY DCH_stStopCC2ConnErr_SY DCH_stStopChAvlErr_SY DCH_stStopChRdyTout_SY DCH_stStopChgrAvl_SY DCH_stStopChgrErr_SY DCH_stStopCrntLrgErr_SY DCH_stStopCrntOvr_SY DCH_stStopDCRlyClTout_SY DCH_stStopDCRlyOpErr_SY DCH_stStopFidErr_SY DCH_stStopHVRlyOpErr_SY DCH_stStopHlfConnErr_SY DCH_stStopIso_SY DCH_stStopManual_SY DCH_stStopToutOvr3_SY DCH_stStopZeroCrnt_SY DCH_stTimeOutInTimeOut_SY DCH_stWaitCHMMode_SY DCH_stWaitCRMMode_SY DCH_stWaitCSDForNrmMode_SY DCH_tiCCSTOut_C DCH_tiCHMtoCRMTOut_C DCH_tiCRM00TOutStrtFrmCHM_C DCH_tiCRM00TOut_C DCH_tiCRMAATOut_C DCH_tiCROAATOutStrtFrmBRO_C DCH_tiCROAATOut_C DCH_tiCSTTOut_C DCH_tiChCap_C DCH_tiChRdy_C DCH_tiChgrAvl_C DCH_tiDCChRly_C DCH_tiDCRlyDiagDly_C DCH_tiDlyCCSnotChging_C DCH_tiOpenHvRly_C DCH_tiReStartChProcess_C DCH_tiSmplT_SY DCH_tisinceBEMCEMTOut_C DCH_tisinceBSTSentOutTOut_C /end REF_CHARACTERISTIC
 /begin REF_MEASUREMENT DCH_flgBCLTxEna DCH_flgBCPTxEna DCH_flgBCSTxEna DCH_flgBEMTxEna DCH_flgBHMTxEna DCH_flgBRMTxEna DCH_flgBROTxEna DCH_flgBSDTxEna DCH_flgBSMTxEna DCH_flgBSTTxEna DCH_flgChgrAvlTOut DCH_flgDCChRlyCloseTOut DCH_flgDCChRlyReq DCH_flgDCChWakeUp DCH_flgDftDCChZeroCrntDlyEna DCH_flgHvRlyReq DCH_flgNwOldCNReg DCH_flgOffLoadTOut DCH_flgRlyAccidentOpn DCH_flgVehChRdyTOut DCH_numChErrCnt DCH_numTOutCnt DCH_stBEMChCapTOut DCH_stBEMChRdyTOut DCH_stBEMChStTOut DCH_stBEMChgrStopTOut DCH_stBEMId00TOut DCH_stBEMIdAATOut DCH_stBEMStatsDataTOut DCH_stBROBattChRdy DCH_stChStateGen DCH_stChStopReason DCH_stSup DCH_tiDurInChStop DCH_tiDurTBRO0xAA DCH_tiDurTBROCloseDCRly DCH_tiDurTBROCloseHVRly DCH_tiDurTBRONotReady DCH_tiDurTHandshake DCH_tiDurTOpenDCRly DCH_tiDurTOpenHVRly DCH_tiDurTWaitCCS DCH_tiDurTWaitCHM DCH_tiDurTWaitCML DCH_tiDurTWaitCRM DCH_tiDurTWaitCRM0xAA DCH_tiDurTWaitCRO0xAA DCH_tiDurTWaitCST DCH_tiDurTWaitDCRlyOff DCH_tiDurTZeroCrnt DCH_tiDurTimeOut /end REF_MEASUREMENT
/end GROUP
/begin GROUP S3237_DCH_Diagnose "VBU0513/VBUSystem/VCU /DCH/DCH_Overall/DCH_DCChargeCtrlOverall/DCH_Diagnose"
 /begin SUB_GROUP S3242_DCH_BmsVoltagCurrentDiagnose S3242_DCH_ChargeErrDetect S3242_DCH_DCRelayDiag S3242_DCH_VehErrDetect /end SUB_GROUP
/end GROUP
/begin GROUP S3237_DCH_EepromStore "VBU0513/VBUSystem/VCU /DCH/DCH_Overall/DCH_DCChargeCtrlOverall/DCH_EepromStore"
 /begin SUB_GROUP S3243_DCH_ChargeStopErrDiagnose S3243_DCH_ChargeTimeOutDiagnose S3243_DataConvertandCSTEEPROM /end SUB_GROUP
/end GROUP
/begin GROUP S3237_DSPLLight "VBU0513/VBUSystem/VCU /DCH/DCH_Overall/DCH_DCChargeCtrlOverall/DSPLLight"
 /begin REF_CHARACTERISTIC DCH_stChStopChgrErr_SY DCH_stChStopChgrManual_SY DCH_stChStopIso_SY DCH_stChStopVehCmpt_SY DCH_stChStopVehErr_SY DCH_stChargeFinishMode_SY DCH_stInit_SY DCH_stWaitCHMMode_SY /end REF_CHARACTERISTIC
/end GROUP
/begin GROUP S3238_DCH_J1939ReceiveProcess "VBU0513/VBUSystem/VCU /DCH/DCH_Overall/DCH_J1939InputProcess/DCH_J1939ReceiveProcess"
 /begin REF_CHARACTERISTIC DCH_flgOvrdReceiveCCS_C DCH_flgOvrdReceiveCEM_C DCH_flgOvrdReceiveCHM_C DCH_flgOvrdReceiveCML_C DCH_flgOvrdReceiveCRM_C DCH_flgOvrdReceiveCRO_C DCH_flgOvrdReceiveCSD_C DCH_flgOvrdReceiveCST_C DCH_flgOvrdValReceiveCCS_C DCH_flgOvrdValReceiveCEM_C DCH_flgOvrdValReceiveCHM_C DCH_flgOvrdValReceiveCML_C DCH_flgOvrdValReceiveCRM_C DCH_flgOvrdValReceiveCRO_C DCH_flgOvrdValReceiveCSD_C DCH_flgOvrdValReceiveCST_C /end REF_CHARACTERISTIC
 /begin REF_MEASUREMENT DCH_flgReceiveCCS DCH_flgReceiveCEM DCH_flgReceiveCHM DCH_flgReceiveCML DCH_flgReceiveCRM DCH_flgReceiveCRO DCH_flgReceiveCSD DCH_flgReceiveCST DCH_flgReceiveCTS /end REF_MEASUREMENT
/end GROUP
/begin GROUP S3239_DCH_J1939OutputProcessBCL "VBU0513/VBUSystem/VCU /DCH/DCH_Overall/DCH_J1939OutputSignalProcess/DCH_J1939OutputProcessBCL"
 /begin REF_CHARACTERISTIC DCH_flgBCLChModeReqOvrd_C DCH_flgBCLCurrReqOvrd_C DCH_flgBCLVltgReqOvrd_C DCH_iBCLCurrReqOvrdVal_C DCH_stBCLChModeReqOvrdVal_C DCH_stBCLConstantCurrMode_C DCH_stBCLConstantVltgMode_C DCH_uBCLVltgReqOvrdVal_C DCH_uDCChReqLowLim_C DCH_uDCChReqUpLim_C /end REF_CHARACTERISTIC
/end GROUP
/begin GROUP S3239_DCH_J1939OutputProcessBCP "VBU0513/VBUSystem/VCU /DCH/DCH_Overall/DCH_J1939OutputSignalProcess/DCH_J1939OutputProcessBCP"
 /begin REF_CHARACTERISTIC DCH_flgBCPBattVltgOvrd_C DCH_flgBCPMaxCellVltgForChOvrd_C DCH_flgBCPMaxChCurrOvrd_C DCH_flgBCPMaxPermitTempOvrd_C DCH_flgBCPMaxVltgForChOvrd_C DCH_flgBCPNrmCapOvrd_C DCH_flgBCPSocOvrd_C DCH_tBCPMaxPermitTempLowLim_C DCH_tBCPMaxPermitTempUpLim_C /end REF_CHARACTERISTIC
/end GROUP
/begin GROUP S3239_DCH_J1939OutputProcessBCS "VBU0513/VBUSystem/VCU /DCH/DCH_Overall/DCH_J1939OutputSignalProcess/DCH_J1939OutputProcessBCS"
 /begin REF_CHARACTERISTIC DCH_flgBCSChCurrMeasureOvrd_C DCH_flgBCSChNeedTOvrd_C DCH_flgBCSChVltgMeasureOvrd_C DCH_flgBCSCurrSocOvrd_C DCH_flgBCSMaxCellVltgNumOvrd_C DCH_flgBCSMaxCellVltgOvrd_C DCH_numBCSMaxCellNumLowLim_C DCH_numBCSMaxCellNumUpLim_C DCH_tiBCSEstChTiLowLim_C DCH_tiBCSEstChTiUpLim_C /end REF_CHARACTERISTIC
/end GROUP
/begin GROUP S3239_DCH_J1939OutputProcessBEM "VBU0513/VBUSystem/VCU /DCH/DCH_Overall/DCH_J1939OutputSignalProcess/DCH_J1939OutputProcessBEM"
 /begin REF_CHARACTERISTIC DCH_flgBEMChCapTOutOvrd_C DCH_flgBEMChRdyTOutOvrd_C DCH_flgBEMChStTOutOvrd_C DCH_flgBEMChgrStopTOutOvrd_C DCH_flgBEMId00TOutOvrd_C DCH_flgBEMIdAATOutOvrd_C DCH_flgBEMStatsDataTOutOvrd_C DCH_stBEMChCapTOutOvrdVal_C DCH_stBEMChRdyTOutOvrdVal_C DCH_stBEMChStTOutOvrdVal_C DCH_stBEMChgrStopTOutOvrdVal_C DCH_stBEMId00TOutOvrdVal_C DCH_stBEMIdAATOutOvrdVal_C DCH_stBEMStatsDataTOutOvrdVal_C /end REF_CHARACTERISTIC
/end GROUP
/begin GROUP S3239_DCH_J1939OutputProcessBRM "VBU0513/VBUSystem/VCU /DCH/DCH_Overall/DCH_J1939OutputSignalProcess/DCH_J1939OutputProcessBRM"
 /begin REF_CHARACTERISTIC DCH_flgBRMBatChgTOvrd_C DCH_flgBRMBatDateDayOvrd_C DCH_flgBRMBatDateMonthOvrd_C DCH_flgBRMBatDateYearOvrd_C DCH_flgBRMBatGrpOvrd_C DCH_flgBRMBatIdentifyOvrd_C DCH_flgBRMBatSfwrVer1Ovrd_C DCH_flgBRMBatSfwrVer2Ovrd_C DCH_flgBRMBatSupOvrd_C DCH_flgBRMResevedOvrd_C DCH_flgBRMVin1Ovrd_C DCH_flgBRMVin2Ovrd_C DCH_flgBRMVin3Ovrd_C DCH_numBRMBatChgTOvrdVal_C DCH_numBRMBatDateDayOvrdVal_C DCH_numBRMBatDateMonthOvrdVal_C DCH_numBRMBatDateYearOvrdVal_C DCH_numBRMBatGrpOvrdVal_C DCH_numBRMBatIdentifyOvrdVal_C DCH_numBRMBatIdentify_C DCH_numBRMBatProtcVerNew_C DCH_numBRMBatProtcVerOld_C DCH_numBRMBatSfwrVer1OvrdVal_C DCH_numBRMBatSfwrVer1_C DCH_numBRMBatSfwrVer2OvrdVal_C DCH_numBRMBatSfwrVer2_C DCH_numBRMBatSupOvrdVal_C DCH_numBRMResevedOvrdVal_C DCH_numBRMReseved_C DCH_numBRMVin1OvrdVal_C DCH_numBRMVin1_C DCH_numBRMVin2OvrdVal_C DCH_numBRMVin2_C DCH_numBRMVin3OvrdVal_C DCH_numBRMVin3_C DCH_numInitialBRMBatChgT_C DCH_numInitialBRMBatDateDay_C DCH_numInitialBRMBatDateMonth_C DCH_numInitialBRMBatDateYear_C DCH_numInitialBRMBatGrp_C DCH_numInitialBRMBatSup_C /end REF_CHARACTERISTIC
/end GROUP
/begin GROUP S3239_DCH_J1939OutputProcessBRO "VBU0513/VBUSystem/VCU /DCH/DCH_Overall/DCH_J1939OutputSignalProcess/DCH_J1939OutputProcessBRO" /begin REF_CHARACTERISTIC DCH_flgBROBattChRdyOvrd_C DCH_stBROBattChRdyOvrdVal_C /end REF_CHARACTERISTIC /end GROUP
/begin GROUP S3239_DCH_J1939OutputProcessBSD "VBU0513/VBUSystem/VCU /DCH/DCH_Overall/DCH_J1939OutputSignalProcess/DCH_J1939OutputProcessBSD"
 /begin REF_CHARACTERISTIC DCH_flgBSDChEndSocOvrd_C DCH_flgBSDMaxCellTempOvrd_C DCH_flgBSDMaxCellVltgOvrd_C DCH_flgBSDMinCellTempOvrd_C DCH_flgBSDMinCellVltgOvrd_C DCH_pctBSDChEndSocOvrdVal_C DCH_tBSDMaxCellTempOvrdVal_C DCH_tBSDMinCellTempOvrdVal_C DCH_uBSDMaxCellVltgOvrdVal_C DCH_uBSDMinCellVltgOvrdVal_C /end REF_CHARACTERISTIC
/end GROUP
/begin GROUP S3239_DCH_J1939OutputProcessBSM "VBU0513/VBUSystem/VCU /DCH/DCH_Overall/DCH_J1939OutputSignalProcess/DCH_J1939OutputProcessBSM"
 /begin REF_CHARACTERISTIC DCH_flgBSMBattOutConnStOvrdVal_C DCH_flgBSMBattOutConnStOvrd_C DCH_flgBSMCellVltgOverUndOvrdVal_C DCH_flgBSMCellVltgOverUndOvrd_C DCH_flgBSMChCurrOverOvrdVal_C DCH_flgBSMChCurrOverOvrd_C DCH_flgBSMChPermitOvrdVal_C DCH_flgBSMChPermitOvrd_C DCH_flgBSMIsoStOvrdVal_C DCH_flgBSMIsoStOvrd_C DCH_flgBSMMaxCellTempNumOvrd_C DCH_flgBSMMaxCellTempOvrd_C DCH_flgBSMMaxCellVltgNumOvrd_C DCH_flgBSMMinCellTempNumOvrd_C DCH_flgBSMMinCellTempOvrd_C DCH_flgBSMSocOverUndOvrdVal_C DCH_flgBSMSocOverUndOvrd_C DCH_flgBSMTempOverOvrdVal_C DCH_flgBSMTempOverOvrd_C DCH_numBSMMaxCellTempNumOvrdVal_C DCH_numBSMMaxCellVltgNumOvrdVal_C DCH_numBSMMinCellTempNumOvrdVal_C DCH_tBSMMaxCellTempOvrdVal_C DCH_tBSMMinCellTempOvrdVal_C /end REF_CHARACTERISTIC
/end GROUP
/begin GROUP S3239_DCH_J1939OutputProcessBST "VBU0513/VBUSystem/VCU /DCH/DCH_Overall/DCH_J1939OutputSignalProcess/DCH_J1939OutputProcessBST"
 /begin REF_CHARACTERISTIC DCH_flgBSTChStopForBMSConnOverTempOvrdVal_C DCH_flgBSTChStopForBMSConnOverTempOvrd_C DCH_flgBSTChStopForBattOverTempOvrdVal_C DCH_flgBSTChStopForBattOverTempOvrd_C DCH_flgBSTChStopForCCToVltgFaultOvrdVal_C DCH_flgBSTChStopForCCToVltgFaultOvrd_C DCH_flgBSTChStopForCellVltgOvrdVal_C DCH_flgBSTChStopForCellVltgOvrd_C DCH_flgBSTChStopForChgrReqStopOvrdVal_C DCH_flgBSTChStopForChgrReqStopOvrd_C DCH_flgBSTChStopForConnFaultOvrdVal_C DCH_flgBSTChStopForConnFaultOvrd_C DCH_flgBSTChStopForConnOverTempOvrdVal_C DCH_flgBSTChStopForConnOverTempOvrd_C DCH_flgBSTChStopForHvRlyFaultOvrdVal_C DCH_flgBSTChStopForHvRlyFaultOvrd_C DCH_flgBSTChStopForIsoFaultOvrdVal_C DCH_flgBSTChStopForIsoFaultOvrd_C DCH_flgBSTChStopForOtherFaultOvrdVal_C DCH_flgBSTChStopForOtherFaultOvrd_C DCH_flgBSTChStopForOverCurrOvrdVal_C DCH_flgBSTChStopForOverCurrOvrd_C DCH_flgBSTChStopForSocOvrdVal_C DCH_flgBSTChStopForSocOvrd_C DCH_flgBSTChStopForTotalVltgOvrdVal_C DCH_flgBSTChStopForTotalVltgOvrd_C DCH_flgBSTChStopForVltgAbNrmOvrdVal_C DCH_flgBSTChStopForVltgAbNrmOvrd_C DCH_stWaitCHMMode_SY /end REF_CHARACTERISTIC
/end GROUP
/begin GROUP S3361_DSPL_Consumption "VBU0513/VBUSystem/VCU /DSPL /DSPL/DriveRange/DSPL_Consumption"
 /begin SUB_GROUP S3364_DSPL_EnergySelfLearn S3364_Range10kmConsumption S3364_Range50kmConsumption /end SUB_GROUP
/end GROUP
/begin GROUP S3361_RemainingRange "VBU0513/VBUSystem/VCU /DSPL /DSPL/DriveRange/RemainingRange"
 /begin SUB_GROUP S3365_ChargeConditon S3365_ChargeTemp S3365_DriveTemp S3365_FullRangeAndSocDeclineFactor S3365_RangeTempSelect S3365_SelectDisplayRange /end SUB_GROUP
/end GROUP
/begin GROUP S3504_Drive_Mode_Power_Calculate "VBU0513/VBUSystem/VCU /EDIS/EDIS_Ctrl/BatDis_Power_Lim_Calc/Drive_Mode_Power_Calculate" /begin REF_CHARACTERISTIC EDIS_pwrDrvRstn_C /end REF_CHARACTERISTIC /begin REF_MEASUREMENT EDIS_pwrDrvPwrLimDrvMode /end REF_MEASUREMENT /end GROUP
/begin GROUP S3504_Power_Arbitration "VBU0513/VBUSystem/VCU /EDIS/EDIS_Ctrl/BatDis_Power_Lim_Calc/Power_Arbitration"
 /begin SUB_GROUP S3508_accessory_power_limit_Calculate S3508_drive_power_limit_calculate /end SUB_GROUP
/end GROUP
/begin GROUP S288_DetermineSOCBalance_EnableCondition "VBU0513/VBUSystem/BMS/CBL/Subsystem8/Subsystem/Balance_EnableCondition/DetermineSOCBalance_EnableCondition" /begin REF_CHARACTERISTIC SAMPLE_TIME_TASK_E /end REF_CHARACTERISTIC /end GROUP
/begin GROUP S288_DetermineVoltaageBalance_EnableCondition "VBU0513/VBUSystem/BMS/CBL/Subsystem8/Subsystem/Balance_EnableCondition/DetermineVoltaageBalance_EnableCondition" /begin REF_CHARACTERISTIC SAMPLE_TIME_TASK_E /end REF_CHARACTERISTIC /end GROUP
/begin GROUP S621_Cell_DataValid_Check "VBU0513/VBUSystem/BMS/CTS/CTS/Subsystem/DeterminePrechargeConditions/Cell_DataValid_Check" /begin REF_CHARACTERISTIC CcSYS_NoOfInvalidCellTemps_n /end REF_CHARACTERISTIC /end GROUP
/begin GROUP S742_SOC_Mapping "VBU0513/VBUSystem/BMS/FCC /FCC/Subsystem/Calculate_Fastcharge_Time/SOC_Mapping" /begin REF_CHARACTERISTIC CcSYS_CellSOCLockedMax_pct CcSYS_CellSOCLockedMin_pct /end REF_CHARACTERISTIC /end GROUP
/begin GROUP S743_Charge_Request_Protection "VBU0513/VBUSystem/BMS/FCC /FCC/Subsystem/Determine_Fastcharge_Request/Charge_Request_Protection" /begin REF_CHARACTERISTIC CcSYS_CellVoltageMaxLimit_mV /end REF_CHARACTERISTIC /end GROUP
/begin GROUP S743_Determine_DiagnosedAndLimitedChargeRequestCurrent "VBU0513/VBUSystem/BMS/FCC /FCC/Subsystem/Determine_Fastcharge_Request/Determine_DiagnosedAndLimitedChargeRequestCurrent" /begin REF_CHARACTERISTIC WATS_PER_KILOWAT /end REF_CHARACTERISTIC /end GROUP
/begin GROUP S966_Determine_BatterySOC_ChangeRate "VBU0513/VBUSystem/BMS/SOC/Subsystem5/Subsystem/Determine_Display_SOC/Determine_BatterySOC_ChangeRate"
 /begin REF_CHARACTERISTIC CcSOC_BatteryUsableSocLowerLimit_pct CcSOC_BatteryUsableSocUpperLimit_pct CcSYS_CellSOCLockedMax_pct CcSYS_CellSOCLockedMin_pct /end REF_CHARACTERISTIC
/end GROUP
/begin GROUP S966_DisplaySOC_Driving_Calculation "VBU0513/VBUSystem/BMS/SOC/Subsystem5/Subsystem/Determine_Display_SOC/DisplaySOC_Driving_Calculation" /begin REF_CHARACTERISTIC CbSOC_CellArraySOCOvrdFlg_flg /end REF_CHARACTERISTIC /end GROUP
/begin GROUP S967_FastCharge_TopofChargeCorrection "VBU0513/VBUSystem/BMS/SOC/Subsystem5/Subsystem/Determine_FastChargeCorrection_Soc/FastCharge_TopofChargeCorrection" /begin REF_CHARACTERISTIC CcSOC_CellSocUpperLimit_pct /end REF_CHARACTERISTIC /end GROUP
/begin GROUP S1137_Time_Counter "VBU0513/VBUSystem/BMS/SOE/Subsystem2/Subsystem/Calculate_History_Average_Current/Time_Counter" /begin REF_CHARACTERISTIC NUMBER_OF_PARALLEL_MODULES /end REF_CHARACTERISTIC /end GROUP
/begin GROUP S1138_Charge_and_Idle_Mode "VBU0513/VBUSystem/BMS/SOE/Subsystem2/Subsystem/Calculate_Pack_Remaining_Energy/Charge_and_Idle_Mode"
 /begin REF_CHARACTERISTIC CcSOE_DischargeCutOffSoc_pct CcSYS_CellSOCLockedMax_pct CcSYS_CellSOCLockedMin_pct /end REF_CHARACTERISTIC
/end GROUP
/begin GROUP S1138_Discharge_Mode "VBU0513/VBUSystem/BMS/SOE/Subsystem2/Subsystem/Calculate_Pack_Remaining_Energy/Discharge_Mode"
 /begin REF_CHARACTERISTIC CcSOE_DischargeCutOffSoc_pct CcSYS_CellSOCLockedMax_pct CcSYS_CellSOCLockedMin_pct /end REF_CHARACTERISTIC
/end GROUP
/begin GROUP S1190_Calculate_Pack_OCV "VBU0513/VBUSystem/BMS/SOF/Subsystem6/Subsystem/Calculate_PowerLimit/Calculate_Pack_OCV" /begin REF_CHARACTERISTIC NUMBER_OF_PARALLEL_MODULES /end REF_CHARACTERISTIC /end GROUP
/begin GROUP S1192_Determine_CurrentLimitTarget_Enable "VBU0513/VBUSystem/BMS/SOF/Subsystem6/Subsystem/Determine_Currentlimit_Target/Determine_CurrentLimitTarget_Enable" /begin REF_CHARACTERISTIC CcSYS_NoOfInvalidCellTemps_n /end REF_CHARACTERISTIC /end GROUP
/begin GROUP S1634_OBC_ChargeState_Mapping "VBU0513/VBUSystem/BMS/VCT/Subsystem/Subsystem/Determine_BMS_VCU_AD/OBC_ChargeState_Mapping"
 /begin REF_CHARACTERISTIC VCT_CHARGE_STATE_CHARGING VCT_CHARGE_STATE_CHARGING_FAULT VCT_CHARGE_STATE_CHARGING_FULL VCT_CHARGE_STATE_NOT_CHARGING /end REF_CHARACTERISTIC
/end GROUP
/begin GROUP S3241_DCH_CtrlStateflowPostProcess "VBU0513/VBUSystem/VCU /DCH/DCH_Overall/DCH_DCChargeCtrlOverall/DCH_DCChargeCtrlStateflow/DCH_CtrlStateflowPostProcess"
 /begin REF_CHARACTERISTIC DCH_stChStopChgrErr_SY DCH_stChStopChgrManual_SY DCH_tiSmplT_SY /end REF_CHARACTERISTIC
/end GROUP
/begin GROUP S3242_DCH_ChargeErrDetect "VBU0513/VBUSystem/VCU /DCH/DCH_Overall/DCH_DCChargeCtrlOverall/DCH_Diagnose/DCH_ChargeErrDetect" /begin REF_CHARACTERISTIC DCH_tiSmplT_SY /end REF_CHARACTERISTIC /end GROUP
/begin GROUP S3242_DCH_VehErrDetect "VBU0513/VBUSystem/VCU /DCH/DCH_Overall/DCH_DCChargeCtrlOverall/DCH_Diagnose/DCH_VehErrDetect" /begin REF_CHARACTERISTIC DCH_stChrgPortSnglSnsr_SY DCH_stChrgPortSnsrConfig_C /end REF_CHARACTERISTIC /end GROUP
/begin GROUP S322_Balance_Fault_Diagnostic1 "VBU0513/VBUSystem/BMS/CBL/Subsystem8/Subsystem/Determine_CSCCellBalanceRequest/Subsystem/Balance_Fault_Diagnostic1" /begin REF_CHARACTERISTIC SAMPLE_TIME_TASK_E /end REF_CHARACTERISTIC /end GROUP
/begin GROUP S798_Override_Voltage_Request "VBU0513/VBUSystem/BMS/FCC /FCC/Subsystem/Determine_Fastcharge_Request/Charge_Request_Protection/Override_Voltage_Request" /begin REF_CHARACTERISTIC CcSYS_CellVoltageMaxLimit_mV MILIVOLTAGES_PER_VOLTAGE /end REF_CHARACTERISTIC /end GROUP
/begin GROUP S799_Determine_ComputeResistancePulseRequest "VBU0513/VBUSystem/BMS/FCC /FCC/Subsystem/Determine_Fastcharge_Request/DetermineComputeResistancePulseCurrent/Determine_ComputeResistancePulseRequest" /begin REF_CHARACTERISTIC WATS_PER_KILOWAT /end REF_CHARACTERISTIC /end GROUP
/begin GROUP S800_Request_At_Charging "VBU0513/VBUSystem/BMS/FCC /FCC/Subsystem/Determine_Fastcharge_Request/Determine_Base_ChargeRequest/Request_At_Charging"
 /begin REF_CHARACTERISTIC CcSYS_CellVoltageMaxLimit_mV MILIVOLTAGES_PER_VOLTAGE WATS_PER_KILOWAT /end REF_CHARACTERISTIC
/end GROUP
/begin GROUP S800_Request_At_NoCharging "VBU0513/VBUSystem/BMS/FCC /FCC/Subsystem/Determine_Fastcharge_Request/Determine_Base_ChargeRequest/Request_At_NoCharging"
 /begin REF_CHARACTERISTIC CcSYS_CellVoltageMaxLimit_mV MILIVOLTAGES_PER_VOLTAGE WATS_PER_KILOWAT /end REF_CHARACTERISTIC
/end GROUP
/begin GROUP S832_Voltage_Protection "VBU0513/VBUSystem/BMS/FCC /FCC/Subsystem/Fastcharge_Conditions_Check/Condition_Categorize/Voltage_Protection" /begin REF_CHARACTERISTIC CcSYS_CellVoltageMaxLimit_mV MILIVOLTAGES_PER_VOLTAGE /end REF_CHARACTERISTIC /end GROUP
/begin GROUP S1047_FastCharge_TOCAdjustAllSOC "VBU0513/VBUSystem/BMS/SOC/Subsystem5/Subsystem/Determine_FastChargeCorrection_Soc/FastCharge_TopofChargeCorrection/FastCharge_TOCAdjustAllSOC" /begin REF_CHARACTERISTIC CcSOC_CellSocUpperLimit_pct /end REF_CHARACTERISTIC /end GROUP
/begin GROUP S1082_Battery_SOC_Calculation "VBU0513/VBUSystem/BMS/SOC/Subsystem5/Subsystem/Determine_Initial_SoC/CellSOC_Startup_AbnormalReset/Battery_SOC_Calculation"
 /begin REF_CHARACTERISTIC CcSOC_BatterySocLowerLimit_pct CcSOC_BatterySocUpperLimit_pct /end REF_CHARACTERISTIC
/end GROUP
/begin GROUP S1084_Battery_SOC_Calculation "VBU0513/VBUSystem/BMS/SOC/Subsystem5/Subsystem/Determine_Initial_SoC/CellSOC_Startup_Normal/Battery SOC Calculation"
 /begin REF_CHARACTERISTIC CcSOC_BatterySocLowerLimit_pct CcSOC_BatterySocUpperLimit_pct /end REF_CHARACTERISTIC
/end GROUP
/begin GROUP S1149_Predict_SOC_End "VBU0513/VBUSystem/BMS/SOE/Subsystem2/Subsystem/Calculate_Pack_Remaining_Energy/Discharge_Mode/Predict_SOC_End"
 /begin REF_CHARACTERISTIC CcSOE_DischargeCutOffSoc_pct CcSYS_CellSOCLockedMax_pct CcSYS_CellSOCLockedMin_pct /end REF_CHARACTERISTIC
/end GROUP
/begin GROUP S1196_Calculate_Locked_SOC "VBU0513/VBUSystem/BMS/SOF/Subsystem6/Subsystem/Calculate_PowerLimit/Calculate_Pack_OCV/Calculate_Locked_SOC" /begin REF_CHARACTERISTIC CcSYS_CellSOCLockedMax_pct CcSYS_CellSOCLockedMin_pct /end REF_CHARACTERISTIC /end GROUP
/begin GROUP S1198_Calculate_Locked_SOC "VBU0513/VBUSystem/BMS/SOF/Subsystem6/Subsystem/Calculate_PowerLimit/Determine_SOCP_PowerLimit/Calculate_Locked_SOC" /begin REF_CHARACTERISTIC CcSYS_CellSOCLockedMax_pct CcSYS_CellSOCLockedMin_pct /end REF_CHARACTERISTIC /end GROUP
/begin GROUP S1425_Determine_SlowCharge "VBU0513/VBUSystem/BMS/SOH/Subsystem4/Subsystem1/Calculate_Capacity/Determine_CalculateCellCapacity_Condition/Determine_SlowCharge" /begin REF_CHARACTERISTIC CcSYS_NoOfInvalidCellTemps_n VCT_CHARGE_STATE_CHARGING /end REF_CHARACTERISTIC /end GROUP
/begin GROUP S1425_Determine_SlowChargeEnd "VBU0513/VBUSystem/BMS/SOH/Subsystem4/Subsystem1/Calculate_Capacity/Determine_CalculateCellCapacity_Condition/Determine_SlowChargeEnd" /begin REF_CHARACTERISTIC CcSYS_NoOfInvalidCellTemps_n VCT_CHARGE_STATE_CHARGING /end REF_CHARACTERISTIC /end GROUP
/begin GROUP S1425_Determine_SlowChargeStart "VBU0513/VBUSystem/BMS/SOH/Subsystem4/Subsystem1/Calculate_Capacity/Determine_CalculateCellCapacity_Condition/Determine_SlowChargeStart" /begin REF_CHARACTERISTIC CcSYS_NoOfInvalidCellTemps_n VCT_CHARGE_STATE_CHARGING /end REF_CHARACTERISTIC /end GROUP
/begin GROUP S1491_ResistanceCalc_Check "VBU0513/VBUSystem/BMS/SOH/Subsystem4/Subsystem1/Calculate_Resistance/BasicCellResistance_Calculation_Check/ResistanceCalc_Check" /begin REF_CHARACTERISTIC CcSYS_NoOfInvalidCellTemps_n VCT_CHARGE_STATE_CHARGING /end REF_CHARACTERISTIC /end GROUP
/begin GROUP S1557_Determine_InletTemp_Validation "VBU0513/VBUSystem/BMS/THM/Subsystem/Subsystem/Calculate_PipeTemperature/Determine_CoolantSensorTemp_Validation/Determine_InletTemp_Validation" /begin REF_CHARACTERISTIC SAMPLE_TIME_TASK_E /end REF_CHARACTERISTIC /end GROUP
/begin GROUP S1557_Determine_OutletTemp_Validation "VBU0513/VBUSystem/BMS/THM/Subsystem/Subsystem/Calculate_PipeTemperature/Determine_CoolantSensorTemp_Validation/Determine_OutletTemp_Validation" /begin REF_CHARACTERISTIC SAMPLE_TIME_TASK_E /end REF_CHARACTERISTIC /end GROUP
/begin GROUP S3256_DCH_BMSChAvlDebounce "VBU0513/VBUSystem/VCU /DCH/DCH_Overall/DCH_DCChargeCtrlOverall/DCH_DCChargeCtrlStateflow/DCH_InputSignalPreProcess/DCH_BMSChAvlDebounce" /begin REF_CHARACTERISTIC DCH_tiSmplT_SY /end REF_CHARACTERISTIC /end GROUP
/begin GROUP S3256_DCH_DCRelayCloseDiagnose "VBU0513/VBUSystem/VCU /DCH/DCH_Overall/DCH_DCChargeCtrlOverall/DCH_DCChargeCtrlStateflow/DCH_InputSignalPreProcess/DCH_DCRelayCloseDiagnose" /begin REF_CHARACTERISTIC DCH_tiSmplT_SY /end REF_CHARACTERISTIC /end GROUP
/begin GROUP S3256_DCH_VehStateAnalyze "VBU0513/VBUSystem/VCU /DCH/DCH_Overall/DCH_DCChargeCtrlOverall/DCH_DCChargeCtrlStateflow/DCH_InputSignalPreProcess/DCH_VehStateAnalyze" /begin REF_CHARACTERISTIC DCH_tiSmplT_SY /end REF_CHARACTERISTIC /end GROUP
/begin GROUP S3257_DCH_OpenPDURelayValid "VBU0513/VBUSystem/VCU /DCH/DCH_Overall/DCH_DCChargeCtrlOverall/DCH_DCChargeCtrlStateflow/DCH_SignalPreProcessForStateflow/DCH_OpenPDURelayValid" /begin REF_CHARACTERISTIC DCH_tiSmplT_SY /end REF_CHARACTERISTIC /end GROUP
/begin GROUP S3300_DCH_BSTOrCSTTrigger "VBU0513/VBUSystem/VCU /DCH/DCH_Overall/DCH_DCChargeCtrlOverall/DCH_EepromStore/DCH_ChargeStopErrDiagnose/DCH_BSTOrCSTTrigger" /begin REF_CHARACTERISTIC DCH_tiSmplT_SY /end REF_CHARACTERISTIC /end GROUP
/begin GROUP S3302_CSTTrigDly "VBU0513/VBUSystem/VCU /DCH/DCH_Overall/DCH_DCChargeCtrlOverall/DCH_EepromStore/DataConvertandCSTEEPROM/CSTTrigDly" /begin REF_CHARACTERISTIC DCH_tiSmplT_SY /end REF_CHARACTERISTIC /end GROUP
/begin GROUP S841_FullCharge_criteria2 "VBU0513/VBUSystem/BMS/FCC /FCC/Subsystem/Fastcharge_Conditions_Check/Condition_Categorize/Full_Charge_Determination/FullCharge_criteria2"
 /begin REF_CHARACTERISTIC MILIVOLTAGES_PER_VOLTAGE NUMBER_OF_PARALLEL_CELLS_PER_MODULE NUMBER_OF_PARALLEL_MODULES /end REF_CHARACTERISTIC
/end GROUP
/begin GROUP S841_FullCharge_criteria4 "VBU0513/VBUSystem/BMS/FCC /FCC/Subsystem/Fastcharge_Conditions_Check/Condition_Categorize/Full_Charge_Determination/FullCharge_criteria4" /begin REF_CHARACTERISTIC CbSYS_HomoTestEnable_flg /end REF_CHARACTERISTIC /end GROUP
/begin GROUP S1230_Calculate_ContinuousChargeCurrent "VBU0513/VBUSystem/BMS/SOF/Subsystem6/Subsystem/Determine_Currentlimit_Target/Calculate_CurrentLimit_Target/Calculate_CurrentLimit_Base/Calculate_ContinuousChargeCurrent" /begin REF_CHARACTERISTIC CbSYS_HomoTestEnable_flg /end REF_CHARACTERISTIC /end GROUP
/begin GROUP S1232_SegmentChargeCheck "VBU0513/VBUSystem/BMS/SOF/Subsystem6/Subsystem/Determine_Currentlimit_Target/Calculate_CurrentLimit_Target/CurrentLimit_FastCharge_Check/SegmentChargeCheck" /begin REF_CHARACTERISTIC CbSOF_CurrentLimitFastChargeCheckEnable_flg /end REF_CHARACTERISTIC /end GROUP
/begin GROUP S1461_Determine_Module_Current "VBU0513/VBUSystem/BMS/SOH/Subsystem4/Subsystem1/Calculate_Capacity/Calculate_CellCapacity_SlowCharge/Determine_AhIntegral_DeltaQ/Determine_Module_Current" /begin REF_CHARACTERISTIC NUMBER_OF_PARALLEL_MODULES /end REF_CHARACTERISTIC /end GROUP
/begin GROUP S1516_Determine_FCCPulseCurrent_Condition "VBU0513/VBUSystem/BMS/SOH/Subsystem4/Subsystem1/Calculate_Resistance/Determine_Condition_Calculate_Pulse_Average_CurrentVoltage/Determine_Condition/Determine_FCCPulseCurrent_Condition" /begin REF_CHARACTERISTIC NUMBER_OF_PARALLEL_MODULES /end REF_CHARACTERISTIC /end GROUP
/begin GROUP S1558_Determinate_InletTempValidationDelay "VBU0513/VBUSystem/BMS/THM/Subsystem/Subsystem/Calculate_PipeTemperature/Determine_CoolantSensorTemp_Validation/Determine_InletTemp_Validation/Determinate_InletTempValidationDelay" /begin REF_CHARACTERISTIC SAMPLE_TIME_TASK_E /end REF_CHARACTERISTIC /end GROUP
/begin GROUP S1559_Determinate_OutletTempValidationDelay "VBU0513/VBUSystem/BMS/THM/Subsystem/Subsystem/Calculate_PipeTemperature/Determine_CoolantSensorTemp_Validation/Determine_OutletTemp_Validation/Determinate_OutletTempValidationDelay" /begin REF_CHARACTERISTIC SAMPLE_TIME_TASK_E /end REF_CHARACTERISTIC /end GROUP
/begin GROUP S1235_Calculate_Locked_SOC "VBU0513/VBUSystem/BMS/SOF/Subsystem6/Subsystem/Determine_Currentlimit_Target/Calculate_CurrentLimit_Target/Calculate_CurrentLimit_Base/Calculate_ContinuousChargeCurrent/Calculate_Locked_SOC" /begin REF_CHARACTERISTIC CcSYS_CellSOCLockedMax_pct CcSYS_CellSOCLockedMin_pct /end REF_CHARACTERISTIC /end GROUP
/begin GROUP S1235_Calculate_Locked_SOC1 "VBU0513/VBUSystem/BMS/SOF/Subsystem6/Subsystem/Determine_Currentlimit_Target/Calculate_CurrentLimit_Target/Calculate_CurrentLimit_Base/Calculate_ContinuousChargeCurrent/Calculate_Locked_SOC1" /begin REF_CHARACTERISTIC CcSYS_CellSOCLockedMax_pct CcSYS_CellSOCLockedMin_pct /end REF_CHARACTERISTIC /end GROUP
/begin GROUP S1235_Calculate_Locked_SOC2 "VBU0513/VBUSystem/BMS/SOF/Subsystem6/Subsystem/Determine_Currentlimit_Target/Calculate_CurrentLimit_Target/Calculate_CurrentLimit_Base/Calculate_ContinuousChargeCurrent/Calculate_Locked_SOC2" /begin REF_CHARACTERISTIC CcSYS_CellSOCLockedMax_pct CcSYS_CellSOCLockedMin_pct /end REF_CHARACTERISTIC /end GROUP
/begin GROUP S1236_Calculate_Locked_SOC "VBU0513/VBUSystem/BMS/SOF/Subsystem6/Subsystem/Determine_Currentlimit_Target/Calculate_CurrentLimit_Target/Calculate_CurrentLimit_Base/Calculate_ContinuousDischargeCurrent/Calculate_Locked_SOC" /begin REF_CHARACTERISTIC CcSYS_CellSOCLockedMax_pct CcSYS_CellSOCLockedMin_pct /end REF_CHARACTERISTIC /end GROUP
/begin GROUP S1236_Calculate_Locked_SOC1 "VBU0513/VBUSystem/BMS/SOF/Subsystem6/Subsystem/Determine_Currentlimit_Target/Calculate_CurrentLimit_Target/Calculate_CurrentLimit_Base/Calculate_ContinuousDischargeCurrent/Calculate_Locked_SOC1" /begin REF_CHARACTERISTIC CcSYS_CellSOCLockedMax_pct CcSYS_CellSOCLockedMin_pct /end REF_CHARACTERISTIC /end GROUP
/begin GROUP S1237_Calculate_Locked_SOC "VBU0513/VBUSystem/BMS/SOF/Subsystem6/Subsystem/Determine_Currentlimit_Target/Calculate_CurrentLimit_Target/Calculate_CurrentLimit_Base/Calculate_ShortPulseChargeCurrent/Calculate_Locked_SOC" /begin REF_CHARACTERISTIC CcSYS_CellSOCLockedMax_pct CcSYS_CellSOCLockedMin_pct /end REF_CHARACTERISTIC /end GROUP
/begin GROUP S1237_Calculate_Locked_SOC1 "VBU0513/VBUSystem/BMS/SOF/Subsystem6/Subsystem/Determine_Currentlimit_Target/Calculate_CurrentLimit_Target/Calculate_CurrentLimit_Base/Calculate_ShortPulseChargeCurrent/Calculate_Locked_SOC1" /begin REF_CHARACTERISTIC CcSYS_CellSOCLockedMax_pct CcSYS_CellSOCLockedMin_pct /end REF_CHARACTERISTIC /end GROUP
/begin GROUP S1238_Calculate_Locked_SOC "VBU0513/VBUSystem/BMS/SOF/Subsystem6/Subsystem/Determine_Currentlimit_Target/Calculate_CurrentLimit_Target/Calculate_CurrentLimit_Base/Calculate_ShortPulseDischargeCurrent/Calculate_Locked_SOC" /begin REF_CHARACTERISTIC CcSYS_CellSOCLockedMax_pct CcSYS_CellSOCLockedMin_pct /end REF_CHARACTERISTIC /end GROUP
/begin GROUP S1238_Calculate_Locked_SOC1 "VBU0513/VBUSystem/BMS/SOF/Subsystem6/Subsystem/Determine_Currentlimit_Target/Calculate_CurrentLimit_Target/Calculate_CurrentLimit_Base/Calculate_ShortPulseDischargeCurrent/Calculate_Locked_SOC1" /begin REF_CHARACTERISTIC CcSYS_CellSOCLockedMax_pct CcSYS_CellSOCLockedMin_pct /end REF_CHARACTERISTIC /end GROUP
/begin GROUP S1337_Calculate_CurrentLimit "VBU0513/VBUSystem/BMS/SOF/Subsystem6/Subsystem/Determine_Currentlimit_Target/Calculate_CurrentLimit_Target/CurrentLimit_Voltage_Correct/Correct_CurrentLimit/Calculate_CurrentLimit" /begin REF_CHARACTERISTIC MILIVOLTAGES_PER_VOLTAGE /end REF_CHARACTERISTIC /end GROUP
/begin GROUP S1339_BatteryVoltageAveCalculate "VBU0513/VBUSystem/BMS/SOF/Subsystem6/Subsystem/Determine_Currentlimit_Target/Calculate_CurrentLimit_Target/CurrentLimit_Voltage_Correct/Correct_CurrentLimit/Calculate_CurrentLimit/BatteryVoltageAveCalculate" /begin REF_CHARACTERISTIC MILIVOLTAGES_PER_VOLTAGE /end REF_CHARACTERISTIC /end GROUP
/end MODULE
/end PROJECT
