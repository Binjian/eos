ASAP2_VERSION 1 31
/begin PROJECT ProjectName "Project Comment Goes Here"
/begin HEADER "Header Comments go here" /end HEADER
/begin MODULE ModuleName "Module Comment Goes Here"
/begin MOD_COMMON "Mod Common Comment Here" BYTE_ORDER MSB_LAST /end MOD_COMMON
/begin RECORD_LAYOUT Scalar_BOOLEAN FNC_VALUES 1 UBYTE COLUMN_DIR DIRECT /end RECORD_LAYOUT
/begin RECORD_LAYOUT Scalar_UBYTE FNC_VALUES 1 UBYTE COLUMN_DIR DIRECT /end RECORD_LAYOUT
/begin RECORD_LAYOUT Scalar_BYTE FNC_VALUES 1 SBYTE COLUMN_DIR DIRECT /end RECORD_LAYOUT
/begin RECORD_LAYOUT Scalar_UWORD FNC_VALUES 1 UWORD COLUMN_DIR DIRECT /end RECORD_LAYOUT
/begin RECORD_LAYOUT Scalar_ULONG FNC_VALUES 1 ULONG COLUMN_DIR DIRECT /end RECORD_LAYOUT
/begin RECORD_LAYOUT Scalar_FLOAT32_IEEE FNC_VALUES 1 FLOAT32_IEEE COLUMN_DIR DIRECT /end RECORD_LAYOUT
/begin RECORD_LAYOUT Lookup1D_FLOAT32_IEEE FNC_VALUES 1 FLOAT32_IEEE COLUMN_DIR DIRECT /end RECORD_LAYOUT
/begin RECORD_LAYOUT Lookup1D_X_FLOAT32_IEEE AXIS_PTS_X 1 FLOAT32_IEEE INDEX_INCR DIRECT /end RECORD_LAYOUT
/begin RECORD_LAYOUT Lookup1D_X_FLOAT64_IEEE AXIS_PTS_X 1 FLOAT64_IEEE INDEX_INCR DIRECT /end RECORD_LAYOUT
/begin RECORD_LAYOUT Lookup2D_BYTE FNC_VALUES 1 SBYTE COLUMN_DIR DIRECT /end RECORD_LAYOUT
/begin RECORD_LAYOUT Lookup2D_X_BYTE AXIS_PTS_X 1 SBYTE INDEX_INCR DIRECT /end RECORD_LAYOUT
/begin RECORD_LAYOUT Lookup2D_UWORD FNC_VALUES 1 UWORD COLUMN_DIR DIRECT /end RECORD_LAYOUT
/begin RECORD_LAYOUT Lookup2D_X_UWORD AXIS_PTS_X 1 UWORD INDEX_INCR DIRECT /end RECORD_LAYOUT
/begin RECORD_LAYOUT Lookup2D_WORD FNC_VALUES 1 SWORD COLUMN_DIR DIRECT /end RECORD_LAYOUT
/begin RECORD_LAYOUT Lookup2D_FLOAT32_IEEE FNC_VALUES 1 FLOAT32_IEEE COLUMN_DIR DIRECT /end RECORD_LAYOUT
/begin RECORD_LAYOUT Lookup2D_X_FLOAT32_IEEE AXIS_PTS_X 1 FLOAT32_IEEE INDEX_INCR DIRECT /end RECORD_LAYOUT
/begin AXIS_PTS TQD_vSgndSpd_CUR_x "" 0x70014872 TQD_vVehSpd Lookup1D_X_FLOAT32_IEEE 0 VBU0428Test_CM_single_kph 21 -250.0 250.0 /end AXIS_PTS
/begin AXIS_PTS CaTHM_PackSohMapX_pct "" 0x70011f2e NO_INPUT_QUANTITY Lookup1D_X_FLOAT32_IEEE 0 VBU0428Test_CM_single_cnt 5 0.0 100.0 /end AXIS_PTS
/begin AXIS_PTS CaTHM_CellTempMaxMapX_C "" 0x70012192 CTM_tCellTempMax Lookup2D_X_FLOAT32_IEEE 0 VBU0428Test_CM_single_cnt 6 -40.0 80.0 /end AXIS_PTS
/begin AXIS_PTS CaTHM_CellSocMaxMapY_pct "" 0x70011ede SOC_pctCellSocMax Lookup2D_X_FLOAT32_IEEE 0 VBU0428Test_CM_single_cnt 5 0.0 100.0 /end AXIS_PTS
/begin CHARACTERISTIC SPD_pctSlope_CUR_v "" CURVE 0x70012222 Lookup1D_FLOAT32_IEEE 0 VBU0428Test_CM_single_cnt -3.4028234663852886E+38 3.4028234663852886E+38
 /begin AXIS_DESCR COM_AXIS SPD_aXSlope VBU0428Test_CM_single_cnt 6 -3.4028234663852886E+38 3.4028234663852886E+38 AXIS_PTS_REF SPD_aXSlope_CUR_x /end AXIS_DESCR
/end CHARACTERISTIC
/begin AXIS_PTS SPD_aXSlope_CUR_x "" 0x7001220a SPD_aXSlope Lookup1D_X_FLOAT32_IEEE 0 VBU0428Test_CM_single_cnt 6 -3.4028234663852886E+38 3.4028234663852886E+38 /end AXIS_PTS
/begin CHARACTERISTIC TQD_pctCrpCtrlBrkPctS_CUR_v "" CURVE 0x7001261e Lookup1D_FLOAT32_IEEE 0 VBU0428Test_CM_single_fac 0.0 2.0
 /begin AXIS_DESCR COM_AXIS BPD_pctBrkPos VBU0428Test_CM_single_cnt 8 0.0 100.0 AXIS_PTS_REF TQD_rCrpCtrlBrkPct_CUR_x /end AXIS_DESCR
/end CHARACTERISTIC
/begin AXIS_PTS TQD_rCrpCtrlBrkPct_CUR_x "" 0x7001267e BPD_pctBrkPos Lookup1D_X_FLOAT32_IEEE 0 VBU0428Test_CM_single_cnt 8 0.0 100.0 /end AXIS_PTS
/begin CHARACTERISTIC TQD_pctCrpCtrlBrkPct_MAP_v "" MAP 0x7001535a Lookup2D_FLOAT32_IEEE 0 VBU0428Test_CM_single_pct 0.0 1.0
 /begin AXIS_DESCR COM_AXIS BPD_pctBrkPos VBU0428Test_CM_single_pct 8 0.0 25.0 AXIS_PTS_REF TQD_pctCrpCtrlBrkPct_MAP_y /end AXIS_DESCR
 /begin AXIS_DESCR COM_AXIS SPD_pctSlope VBU0428Test_CM_single_fac 6 -5.0 20.0 AXIS_PTS_REF TQD_rCrpCtrlBrkPct_MAP_x /end AXIS_DESCR
/end CHARACTERISTIC
/begin AXIS_PTS TQD_rCrpCtrlBrkPct_MAP_x "" 0x700122ca SPD_pctSlope Lookup2D_X_FLOAT32_IEEE 0 VBU0428Test_CM_single_fac 6 -5.0 20.0 /end AXIS_PTS
/begin AXIS_PTS TQD_pctCrpCtrlBrkPct_MAP_y "" 0x7001263e BPD_pctBrkPos Lookup2D_X_FLOAT32_IEEE 0 VBU0428Test_CM_single_pct 8 0.0 25.0 /end AXIS_PTS
/begin CHARACTERISTIC TQD_pctCrpCtrlBrkPresS_CUR_v "" CURVE 0x7001265e Lookup1D_FLOAT32_IEEE 0 VBU0428Test_CM_single_p 0.0 2.0
 /begin AXIS_DESCR COM_AXIS TQD_pBrkPress VBU0428Test_CM_single_p 8 0.0 20.0 AXIS_PTS_REF TQD_pCrpCtrlBrkPres_CUR_x /end AXIS_DESCR
/end CHARACTERISTIC
/begin AXIS_PTS TQD_pCrpCtrlBrkPres_CUR_x "" 0x700125de TQD_pBrkPress Lookup1D_X_FLOAT32_IEEE 0 VBU0428Test_CM_single_p 8 0.0 20.0 /end AXIS_PTS
/begin CHARACTERISTIC TQD_pctCrpCtrlBrkPres_MAP_v "" MAP 0x7001541a Lookup2D_FLOAT32_IEEE 0 VBU0428Test_CM_single_pct 0.0 1.0
 /begin AXIS_DESCR COM_AXIS TQD_pBrkPress VBU0428Test_CM_single_pct 8 0.0 100.0 AXIS_PTS_REF TQD_pCrpCtrlBrkPres_MAP_y /end AXIS_DESCR
 /begin AXIS_DESCR COM_AXIS SPD_pctSlope VBU0428Test_CM_single_fac 6 -5.0 20.0 AXIS_PTS_REF TQD_rCrpCtrlBrkPct_MAP_x /end AXIS_DESCR
/end CHARACTERISTIC
/begin AXIS_PTS TQD_pCrpCtrlBrkPres_MAP_y "" 0x700125fe TQD_pBrkPress Lookup2D_X_FLOAT32_IEEE 0 VBU0428Test_CM_single_pct 8 0.0 100.0 /end AXIS_PTS
/begin CHARACTERISTIC TQD_trqCrpCtrlSlp_MAP_v "" MAP 0x70016104 Lookup2D_FLOAT32_IEEE 0 VBU0428Test_CM_single_Nm -10000.0 10000.0
 /begin AXIS_DESCR COM_AXIS TQD_vVehSpd VBU0428Test_CM_single_kph 9 -250.0 250.0 AXIS_PTS_REF TQD_vCrpCtrlSlp_MAP_y /end AXIS_DESCR
 /begin AXIS_DESCR COM_AXIS NO_INPUT_QUANTITY VBU0428Test_CM_single_phi 11 0.0 360.0 AXIS_PTS_REF TQD_phiCrpCtrlSlp_MAP_x /end AXIS_DESCR
/end CHARACTERISTIC
/begin AXIS_PTS TQD_phiCrpCtrlSlp_MAP_x "" 0x70012e56 NO_INPUT_QUANTITY Lookup2D_X_FLOAT32_IEEE 0 VBU0428Test_CM_single_phi 11 0.0 360.0 /end AXIS_PTS
/begin AXIS_PTS TQD_vCrpCtrlSlp_MAP_y "" 0x700128de TQD_vVehSpd Lookup2D_X_FLOAT32_IEEE 0 VBU0428Test_CM_single_kph 9 -250.0 250.0 /end AXIS_PTS
/begin CHARACTERISTIC TQD_trqCrpCstModeA_CUR_v "" CURVE 0x700146ce Lookup1D_FLOAT32_IEEE 0 VBU0428Test_CM_single_Nm -10000.0 10000.0
 /begin AXIS_DESCR COM_AXIS TQD_vVehSpd VBU0428Test_CM_single_kph 21 -250.0 250.0 AXIS_PTS_REF TQD_vSgndSpd_CUR_x /end AXIS_DESCR
/end CHARACTERISTIC
/begin CHARACTERISTIC TQD_trqCrpCstModeB_CUR_v "" CURVE 0x70014722 Lookup1D_FLOAT32_IEEE 0 VBU0428Test_CM_single_Nm -10000.0 10000.0
 /begin AXIS_DESCR COM_AXIS TQD_vVehSpd VBU0428Test_CM_single_kph 21 -250.0 250.0 AXIS_PTS_REF TQD_vSgndSpd_CUR_x /end AXIS_DESCR
/end CHARACTERISTIC
/begin CHARACTERISTIC TQD_trqCrpCstModeC_CUR_v "" CURVE 0x70014776 Lookup1D_FLOAT32_IEEE 0 VBU0428Test_CM_single_Nm -10000.0 10000.0
 /begin AXIS_DESCR COM_AXIS TQD_vVehSpd VBU0428Test_CM_single_kph 21 -250.0 250.0 AXIS_PTS_REF TQD_vSgndSpd_CUR_x /end AXIS_DESCR
/end CHARACTERISTIC
/begin CHARACTERISTIC TQD_trqCrpCstModeD_CUR_v "" CURVE 0x700147ca Lookup1D_FLOAT32_IEEE 0 VBU0428Test_CM_single_Nm -10000.0 10000.0
 /begin AXIS_DESCR COM_AXIS TQD_vVehSpd VBU0428Test_CM_single_kph 21 -250.0 250.0 AXIS_PTS_REF TQD_vSgndSpd_CUR_x /end AXIS_DESCR
/end CHARACTERISTIC
/begin CHARACTERISTIC MTQL_trqVehSpdLimNormRMot_MAP_v "" MAP 0x70014f5e Lookup2D_FLOAT32_IEEE 0 VBU0428Test_CM_single_cnt -3.4028234663852886E+38 3.4028234663852886E+38
 /begin AXIS_DESCR COM_AXIS NO_INPUT_QUANTITY VBU0428Test_CM_single_cnt 9 -3.4028234663852886E+38 3.4028234663852886E+38 AXIS_PTS_REF MTQL_stVehSpdLim_MAP_y /end AXIS_DESCR
 /begin AXIS_DESCR FIX_AXIS NO_INPUT_QUANTITY VBU0428Test_CM_uint8 4 0 3 FIX_AXIS_PAR_DIST 0 1 4 /end AXIS_DESCR
/end CHARACTERISTIC
/begin AXIS_PTS MTQL_stVehSpdLim_MAP_y "" 0x7001282a NO_INPUT_QUANTITY Lookup2D_X_FLOAT32_IEEE 0 VBU0428Test_CM_single_cnt 9 -3.4028234663852886E+38 3.4028234663852886E+38 /end AXIS_PTS
/begin CHARACTERISTIC MTQL_trqWhlRLim_CUR_v "" CURVE 0x70012872 Lookup1D_FLOAT32_IEEE 0 VBU0428Test_CM_single_cnt -3.4028234663852886E+38 3.4028234663852886E+38
 /begin AXIS_DESCR COM_AXIS NO_INPUT_QUANTITY VBU0428Test_CM_single_cnt 9 -3.4028234663852886E+38 3.4028234663852886E+38 AXIS_PTS_REF MTQL_dnWhlRLim_CUR_x /end AXIS_DESCR
/end CHARACTERISTIC
/begin AXIS_PTS MTQL_dnWhlRLim_CUR_x "" 0x700127e2 NO_INPUT_QUANTITY Lookup1D_X_FLOAT32_IEEE 0 VBU0428Test_CM_single_cnt 9 -3.4028234663852886E+38 3.4028234663852886E+38 /end AXIS_PTS
/begin CHARACTERISTIC VTQA_facMtrDrvPwrUpLim_MAP_v "" MAP 0x700165d0 Lookup2D_FLOAT32_IEEE 0 VBU0428Test_CM_single_cnt -3.4028234663852886E+38 3.4028234663852886E+38
 /begin AXIS_DESCR COM_AXIS NO_INPUT_QUANTITY VBU0428Test_CM_single_cnt 9 -3.4028234663852886E+38 3.4028234663852886E+38 AXIS_PTS_REF VTQA_nMtrDrvPwrUpLim_MAP_y /end AXIS_DESCR
 /begin AXIS_DESCR COM_AXIS NO_INPUT_QUANTITY VBU0428Test_CM_single_cnt 12 -3.4028234663852886E+38 3.4028234663852886E+38 AXIS_PTS_REF VTQA_pwrMtrDrvPwrUpLim_MAP_x /end AXIS_DESCR
/end CHARACTERISTIC
/begin AXIS_PTS VTQA_pwrMtrDrvPwrUpLim_MAP_x "" 0x70013276 NO_INPUT_QUANTITY Lookup2D_X_FLOAT32_IEEE 0 VBU0428Test_CM_single_cnt 12 -3.4028234663852886E+38 3.4028234663852886E+38 /end AXIS_PTS
/begin AXIS_PTS VTQA_nMtrDrvPwrUpLim_MAP_y "" 0x70012926 NO_INPUT_QUANTITY Lookup2D_X_FLOAT32_IEEE 0 VBU0428Test_CM_single_cnt 9 -3.4028234663852886E+38 3.4028234663852886E+38 /end AXIS_PTS
/begin CHARACTERISTIC VTQA_pwrRMtrRgnPwrLoss_MAP_v "" MAP 0x70016930 Lookup2D_FLOAT32_IEEE 0 VBU0428Test_CM_single_cnt -3.4028234663852886E+38 3.4028234663852886E+38
 /begin AXIS_DESCR COM_AXIS NO_INPUT_QUANTITY VBU0428Test_CM_single_cnt 9 -3.4028234663852886E+38 3.4028234663852886E+38 AXIS_PTS_REF VTQA_nRMtrRgnPwrLoss_MAP_y /end AXIS_DESCR
 /begin AXIS_DESCR COM_AXIS VTQA_trqRMotrNeg VBU0428Test_CM_single_cnt 12 -3.4028234663852886E+38 3.4028234663852886E+38 AXIS_PTS_REF VTQA_trqRMtrRgnPwrLoss_MAP_x /end AXIS_DESCR
/end CHARACTERISTIC
/begin AXIS_PTS VTQA_trqRMtrRgnPwrLoss_MAP_x "" 0x700132d6 VTQA_trqRMotrNeg Lookup2D_X_FLOAT32_IEEE 0 VBU0428Test_CM_single_cnt 12 -3.4028234663852886E+38 3.4028234663852886E+38 /end AXIS_PTS
/begin AXIS_PTS VTQA_nRMtrRgnPwrLoss_MAP_y "" 0x7001296e NO_INPUT_QUANTITY Lookup2D_X_FLOAT32_IEEE 0 VBU0428Test_CM_single_cnt 9 -3.4028234663852886E+38 3.4028234663852886E+38 /end AXIS_PTS
/begin CHARACTERISTIC VTQA_pwrRMtrDrvPwrLoss_MAP_v "" MAP 0x70016780 Lookup2D_FLOAT32_IEEE 0 VBU0428Test_CM_single_cnt -3.4028234663852886E+38 3.4028234663852886E+38
 /begin AXIS_DESCR COM_AXIS NO_INPUT_QUANTITY VBU0428Test_CM_single_cnt 9 -3.4028234663852886E+38 3.4028234663852886E+38 AXIS_PTS_REF VTQA_nRMtrDrvPwrLoss_MAP_y /end AXIS_DESCR
 /begin AXIS_DESCR COM_AXIS VTQA_trqRMotrPos VBU0428Test_CM_single_cnt 12 -3.4028234663852886E+38 3.4028234663852886E+38 AXIS_PTS_REF VTQA_trqRMtrDrvPwrLoss_MAP_x /end AXIS_DESCR
/end CHARACTERISTIC
/begin AXIS_PTS VTQA_trqRMtrDrvPwrLoss_MAP_x "" 0x700132a6 VTQA_trqRMotrPos Lookup2D_X_FLOAT32_IEEE 0 VBU0428Test_CM_single_cnt 12 -3.4028234663852886E+38 3.4028234663852886E+38 /end AXIS_PTS
/begin AXIS_PTS VTQA_nRMtrDrvPwrLoss_MAP_y "" 0x7001294a NO_INPUT_QUANTITY Lookup2D_X_FLOAT32_IEEE 0 VBU0428Test_CM_single_cnt 9 -3.4028234663852886E+38 3.4028234663852886E+38 /end AXIS_PTS
/begin CHARACTERISTIC VTQA_trqAxleMax_CUR_v "" CURVE 0x70012eda Lookup1D_FLOAT32_IEEE 0 VBU0428Test_CM_single_cnt -3.4028234663852886E+38 3.4028234663852886E+38
 /begin AXIS_DESCR COM_AXIS SPD_vVehSpd VBU0428Test_CM_single_cnt 11 -3.4028234663852886E+38 3.4028234663852886E+38 AXIS_PTS_REF VTQA_vAxleMax_CUR_x /end AXIS_DESCR
/end CHARACTERISTIC
/begin AXIS_PTS VTQA_vAxleMax_CUR_x "" 0x70012f5e SPD_vVehSpd Lookup1D_X_FLOAT32_IEEE 0 VBU0428Test_CM_single_cnt 11 -3.4028234663852886E+38 3.4028234663852886E+38 /end AXIS_PTS
/begin CHARACTERISTIC VTQA_trqLimpModeMax_CUR_v "" CURVE 0x70012f32 Lookup1D_FLOAT32_IEEE 0 VBU0428Test_CM_single_cnt -3.4028234663852886E+38 3.4028234663852886E+38
 /begin AXIS_DESCR COM_AXIS SPD_vVehSpd VBU0428Test_CM_single_cnt 11 -3.4028234663852886E+38 3.4028234663852886E+38 AXIS_PTS_REF VTQA_vAxleMax_CUR_x /end AXIS_DESCR
/end CHARACTERISTIC
/begin CHARACTERISTIC VTQA_trqLimpModeByPmpMax_CUR_v "" CURVE 0x70012f06 Lookup1D_FLOAT32_IEEE 0 VBU0428Test_CM_single_cnt -3.4028234663852886E+38 3.4028234663852886E+38
 /begin AXIS_DESCR COM_AXIS SPD_vVehSpd VBU0428Test_CM_single_cnt 11 -3.4028234663852886E+38 3.4028234663852886E+38 AXIS_PTS_REF VTQA_vLimpModeByPmpMax_CUR_x /end AXIS_DESCR
/end CHARACTERISTIC
/begin AXIS_PTS VTQA_vLimpModeByPmpMax_CUR_x "" 0x70012fb6 SPD_vVehSpd Lookup1D_X_FLOAT32_IEEE 0 VBU0428Test_CM_single_cnt 11 -3.4028234663852886E+38 3.4028234663852886E+38 /end AXIS_PTS
/begin CHARACTERISTIC VTQA_trqBrk_MAP_v "" MAP 0x70017024 Lookup2D_FLOAT32_IEEE 0 VBU0428Test_CM_single_cnt -3.4028234663852886E+38 3.4028234663852886E+38
 /begin AXIS_DESCR COM_AXIS SPD_vVehSpd VBU0428Test_CM_single_cnt 11 -3.4028234663852886E+38 3.4028234663852886E+38 AXIS_PTS_REF VTQA_vBrk_MAP_y /end AXIS_DESCR
 /begin AXIS_DESCR COM_AXIS BPD_pctBrkPos VBU0428Test_CM_single_cnt 11 -3.4028234663852886E+38 3.4028234663852886E+38 AXIS_PTS_REF VTQA_pctBrk_MAP_x /end AXIS_DESCR
/end CHARACTERISTIC
/begin AXIS_PTS VTQA_pctBrk_MAP_x "" 0x70012eae BPD_pctBrkPos Lookup2D_X_FLOAT32_IEEE 0 VBU0428Test_CM_single_cnt 11 -3.4028234663852886E+38 3.4028234663852886E+38 /end AXIS_PTS
/begin AXIS_PTS VTQA_vBrk_MAP_y "" 0x70012f8a SPD_vVehSpd Lookup2D_X_FLOAT32_IEEE 0 VBU0428Test_CM_single_cnt 11 -3.4028234663852886E+38 3.4028234663852886E+38 /end AXIS_PTS
/begin CHARACTERISTIC APD_uThdDiff12_CUR_v "" CURVE 0x70013c86 Lookup1D_FLOAT32_IEEE 0 VBU0428Test_CM_single_cnt -3.4028234663852886E+38 3.4028234663852886E+38
 /begin AXIS_DESCR COM_AXIS NO_INPUT_QUANTITY VBU0428Test_CM_single_cnt 16 -3.4028234663852886E+38 3.4028234663852886E+38 AXIS_PTS_REF APD_uThdDiff12_CUR_x /end AXIS_DESCR
/end CHARACTERISTIC
/begin AXIS_PTS APD_uThdDiff12_CUR_x "" 0x70013cc6 NO_INPUT_QUANTITY Lookup1D_X_FLOAT32_IEEE 0 VBU0428Test_CM_single_cnt 16 -3.4028234663852886E+38 3.4028234663852886E+38 /end AXIS_PTS
/begin CHARACTERISTIC Veh_tDCPortTempPlausibility_CUR_v "" CURVE 0x70012fe2 Lookup1D_FLOAT32_IEEE 0 VBU0428Test_CM_single_cnt -3.4028234663852886E+38 3.4028234663852886E+38
 /begin AXIS_DESCR COM_AXIS NO_INPUT_QUANTITY VBU0428Test_CM_single_cnt 11 -3.4028234663852886E+38 3.4028234663852886E+38 AXIS_PTS_REF Veh_tDCPortTempPlausibility_CUR_x /end AXIS_DESCR
/end CHARACTERISTIC
/begin AXIS_PTS Veh_tDCPortTempPlausibility_CUR_x "" 0x7001300e NO_INPUT_QUANTITY Lookup1D_X_FLOAT32_IEEE 0 VBU0428Test_CM_single_cnt 11 -3.4028234663852886E+38 3.4028234663852886E+38 /end AXIS_PTS
/begin CHARACTERISTIC BPD_pctBrkPress_CUR_v "" CURVE 0x700124be Lookup1D_FLOAT32_IEEE 0 VBU0428Test_CM_single_cnt -3.4028234663852886E+38 3.4028234663852886E+38
 /begin AXIS_DESCR COM_AXIS BPD_pBrkPress VBU0428Test_CM_double_cnt 8 -3.4028234663852886E+38 3.4028234663852886E+38 AXIS_PTS_REF BPD_pBrkPress_CUR_x /end AXIS_DESCR
/end CHARACTERISTIC
/begin AXIS_PTS BPD_pBrkPress_CUR_x "" 0x7001249e BPD_pBrkPress Lookup1D_X_FLOAT64_IEEE 0 VBU0428Test_CM_double_cnt 8 -3.4028234663852886E+38 3.4028234663852886E+38 /end AXIS_PTS
/begin CHARACTERISTIC BCU_pBrkPres "" CURVE 0x70011dda Lookup1D_FLOAT32_IEEE 0 VBU0428Test_CM_single_MPa 0.0 1000.0
 /begin AXIS_DESCR COM_AXIS NO_INPUT_QUANTITY VBU0428Test_CM_single_V 5 0.0 100.0 AXIS_PTS_REF INP_uBrkPresFlt /end AXIS_DESCR
/end CHARACTERISTIC
/begin AXIS_PTS INP_uBrkPresFlt "" 0x7001200a NO_INPUT_QUANTITY Lookup1D_X_FLOAT32_IEEE 0 VBU0428Test_CM_single_V 5 0.0 100.0 /end AXIS_PTS
/begin CHARACTERISTIC CaFCC_VCRVCUAuxPowerFactorVoltageTempMapZ_nbr "" MAP 0x70013096 Lookup2D_FLOAT32_IEEE 0 VBU0428Test_CM_single_cnt -3.4028234663852886E+38 3.4028234663852886E+38
 /begin AXIS_DESCR COM_AXIS CVT_mvCellVoltageMin VBU0428Test_CM_uint16_cnt 3 0.0 65535.0 AXIS_PTS_REF CaFCC_VCRVCUAuxPowerFactorVoltageTempMapY_mV /end AXIS_DESCR
 /begin AXIS_DESCR COM_AXIS CTM_tCellTempMin VBU0428Test_CM_single_cnt 4 -3.4028234663852886E+38 3.4028234663852886E+38 AXIS_PTS_REF CaFCC_VCRVCUAuxPowerFactorVoltageTempMapX_C /end AXIS_DESCR
/end CHARACTERISTIC
/begin AXIS_PTS CaFCC_VCRVCUAuxPowerFactorVoltageTempMapX_C "" 0x70011c6a CTM_tCellTempMin Lookup2D_X_FLOAT32_IEEE 0 VBU0428Test_CM_single_cnt 4 -3.4028234663852886E+38 3.4028234663852886E+38 /end AXIS_PTS
/begin AXIS_PTS CaFCC_VCRVCUAuxPowerFactorVoltageTempMapY_mV "" 0x70011a34 CVT_mvCellVoltageMin Lookup2D_X_UWORD 0 VBU0428Test_CM_uint16_cnt 3 0.0 65535.0 /end AXIS_PTS
/begin CHARACTERISTIC CaSOC_BatteryDisplaySocDischargeDecRateY_n "" CURVE 0x70011e02 Lookup1D_FLOAT32_IEEE 0 VBU0428Test_CM_single_cnt -3.4028234663852886E+38 3.4028234663852886E+38
 /begin AXIS_DESCR COM_AXIS SOC_pctBatterySoc VBU0428Test_CM_single_cnt 5 -3.4028234663852886E+38 3.4028234663852886E+38 AXIS_PTS_REF CaSOC_BatteryDisplaySocDischargeDecRateX_pct /end AXIS_DESCR
/end CHARACTERISTIC
/begin AXIS_PTS CaSOC_BatteryDisplaySocDischargeDecRateX_pct "" 0x70011dee SOC_pctBatterySoc Lookup1D_X_FLOAT32_IEEE 0 VBU0428Test_CM_single_cnt 5 -3.4028234663852886E+38 3.4028234663852886E+38 /end AXIS_PTS
/begin CHARACTERISTIC CaSOC_BatteryDisplaySocDischargeIncRateY_n "" CURVE 0x70011e2a Lookup1D_FLOAT32_IEEE 0 VBU0428Test_CM_single_cnt -3.4028234663852886E+38 3.4028234663852886E+38
 /begin AXIS_DESCR COM_AXIS SOC_pctBatterySoc VBU0428Test_CM_single_cnt 5 -3.4028234663852886E+38 3.4028234663852886E+38 AXIS_PTS_REF CaSOC_BatteryDisplaySocDischargeIncRateX_pct /end AXIS_DESCR
/end CHARACTERISTIC
/begin AXIS_PTS CaSOC_BatteryDisplaySocDischargeIncRateX_pct "" 0x70011e16 SOC_pctBatterySoc Lookup1D_X_FLOAT32_IEEE 0 VBU0428Test_CM_single_cnt 5 -3.4028234663852886E+38 3.4028234663852886E+38 /end AXIS_PTS
/begin CHARACTERISTIC CaSOC_SOCDisChargeIncOffsetY_n "" CURVE 0x70012162 Lookup1D_FLOAT32_IEEE 0 VBU0428Test_CM_single_cnt -3.4028234663852886E+38 3.4028234663852886E+38
 /begin AXIS_DESCR COM_AXIS SOC_pctBatterySoc VBU0428Test_CM_single_cnt 6 -3.4028234663852886E+38 3.4028234663852886E+38 AXIS_PTS_REF CaSOC_SOCDisChargeIncOffsetX_pct /end AXIS_DESCR
/end CHARACTERISTIC
/begin AXIS_PTS CaSOC_SOCDisChargeIncOffsetX_pct "" 0x7001214a SOC_pctBatterySoc Lookup1D_X_FLOAT32_IEEE 0 VBU0428Test_CM_single_cnt 6 -3.4028234663852886E+38 3.4028234663852886E+38 /end AXIS_PTS
/begin CHARACTERISTIC CaSOC_SOCDisChargeDecOffsetY_n "" CURVE 0x70012132 Lookup1D_FLOAT32_IEEE 0 VBU0428Test_CM_single_cnt -3.4028234663852886E+38 3.4028234663852886E+38
 /begin AXIS_DESCR COM_AXIS SOC_pctBatterySoc VBU0428Test_CM_single_cnt 6 -3.4028234663852886E+38 3.4028234663852886E+38 AXIS_PTS_REF CaSOC_SOCDisChargeDecOffsetX_pct /end AXIS_DESCR
/end CHARACTERISTIC
/begin AXIS_PTS CaSOC_SOCDisChargeDecOffsetX_pct "" 0x7001211a SOC_pctBatterySoc Lookup1D_X_FLOAT32_IEEE 0 VBU0428Test_CM_single_cnt 6 -3.4028234663852886E+38 3.4028234663852886E+38 /end AXIS_PTS
/begin CHARACTERISTIC CaSOC_FastChargeCCCorrectionBOLVoltThd1Z_mV "" MAP 0x700154da Lookup2D_UWORD 0 VBU0428Test_CM_uint16_cnt 0.0 65535.0
 /begin AXIS_DESCR COM_AXIS NO_INPUT_QUANTITY VBU0428Test_CM_single_cnt 11 -3.4028234663852886E+38 3.4028234663852886E+38 AXIS_PTS_REF CaSOC_FastChargeCCRateY_n /end AXIS_DESCR
 /begin AXIS_DESCR COM_AXIS NO_INPUT_QUANTITY VBU0428Test_CM_single_cnt 9 -3.4028234663852886E+38 3.4028234663852886E+38 AXIS_PTS_REF CaSOC_FastChargeCCTempX_C /end AXIS_DESCR
/end CHARACTERISTIC
/begin AXIS_PTS CaSOC_FastChargeCCTempX_C "" 0x7001269e NO_INPUT_QUANTITY Lookup2D_X_FLOAT32_IEEE 0 VBU0428Test_CM_single_cnt 9 -3.4028234663852886E+38 3.4028234663852886E+38 /end AXIS_PTS
/begin AXIS_PTS CaSOC_FastChargeCCRateY_n "" 0x70012c1a NO_INPUT_QUANTITY Lookup2D_X_FLOAT32_IEEE 0 VBU0428Test_CM_single_cnt 11 -3.4028234663852886E+38 3.4028234663852886E+38 /end AXIS_PTS
/begin CHARACTERISTIC CaSOC_FastChargeCCCorrectionSoc1Z_pct "" MAP 0x70015ad4 Lookup2D_FLOAT32_IEEE 0 VBU0428Test_CM_single_cnt -3.4028234663852886E+38 3.4028234663852886E+38
 /begin AXIS_DESCR COM_AXIS NO_INPUT_QUANTITY VBU0428Test_CM_single_cnt 11 -3.4028234663852886E+38 3.4028234663852886E+38 AXIS_PTS_REF CaSOC_FastChargeCCRateY_n /end AXIS_DESCR
 /begin AXIS_DESCR COM_AXIS NO_INPUT_QUANTITY VBU0428Test_CM_single_cnt 9 -3.4028234663852886E+38 3.4028234663852886E+38 AXIS_PTS_REF CaSOC_FastChargeCCTempX_C /end AXIS_DESCR
/end CHARACTERISTIC
/begin CHARACTERISTIC CaSOC_FastChargeCCCorrectionVoltThd2Z_mV "" MAP 0x70015666 Lookup2D_UWORD 0 VBU0428Test_CM_uint16_cnt 0.0 65535.0
 /begin AXIS_DESCR COM_AXIS NO_INPUT_QUANTITY VBU0428Test_CM_single_cnt 11 -3.4028234663852886E+38 3.4028234663852886E+38 AXIS_PTS_REF CaSOC_FastChargeCCRateY_n /end AXIS_DESCR
 /begin AXIS_DESCR COM_AXIS NO_INPUT_QUANTITY VBU0428Test_CM_single_cnt 9 -3.4028234663852886E+38 3.4028234663852886E+38 AXIS_PTS_REF CaSOC_FastChargeCCTempX_C /end AXIS_DESCR
/end CHARACTERISTIC
/begin CHARACTERISTIC CaSOC_FastChargeCCCorrectionSoc2Z_pct "" MAP 0x70015c60 Lookup2D_FLOAT32_IEEE 0 VBU0428Test_CM_single_cnt -3.4028234663852886E+38 3.4028234663852886E+38
 /begin AXIS_DESCR COM_AXIS NO_INPUT_QUANTITY VBU0428Test_CM_single_cnt 11 -3.4028234663852886E+38 3.4028234663852886E+38 AXIS_PTS_REF CaSOC_FastChargeCCRateY_n /end AXIS_DESCR
 /begin AXIS_DESCR COM_AXIS NO_INPUT_QUANTITY VBU0428Test_CM_single_cnt 9 -3.4028234663852886E+38 3.4028234663852886E+38 AXIS_PTS_REF CaSOC_FastChargeCCTempX_C /end AXIS_DESCR
/end CHARACTERISTIC
/begin CHARACTERISTIC CaSOC_FastChargeCCCorrectionEOLVoltThd1Z_mV "" MAP 0x700155a0 Lookup2D_UWORD 0 VBU0428Test_CM_uint16_cnt 0.0 65535.0
 /begin AXIS_DESCR COM_AXIS NO_INPUT_QUANTITY VBU0428Test_CM_single_cnt 11 -3.4028234663852886E+38 3.4028234663852886E+38 AXIS_PTS_REF CaSOC_FastChargeCCRateY_n /end AXIS_DESCR
 /begin AXIS_DESCR COM_AXIS NO_INPUT_QUANTITY VBU0428Test_CM_single_cnt 9 -3.4028234663852886E+38 3.4028234663852886E+38 AXIS_PTS_REF CaSOC_FastChargeCCTempX_C /end AXIS_DESCR
/end CHARACTERISTIC
/begin CHARACTERISTIC CaSOE_SocOcvMapZ_mV "" MAP 0x70015dec Lookup2D_FLOAT32_IEEE 0 VBU0428Test_CM_single_cnt 2500.0 3800.0
 /begin AXIS_DESCR COM_AXIS NO_INPUT_QUANTITY VBU0428Test_CM_single_cnt 11 0.0 100.0 AXIS_PTS_REF CaSOE_SocOcvMapY_pct /end AXIS_DESCR
 /begin AXIS_DESCR COM_AXIS CTM_tCellTempAve VBU0428Test_CM_single_cnt 9 -40.0 80.0 AXIS_PTS_REF CaSOE_SocOcvMapX_C /end AXIS_DESCR
/end CHARACTERISTIC
/begin AXIS_PTS CaSOE_SocOcvMapX_C "" 0x700126e6 CTM_tCellTempAve Lookup2D_X_FLOAT32_IEEE 0 VBU0428Test_CM_single_cnt 9 -40.0 80.0 /end AXIS_PTS
/begin AXIS_PTS CaSOE_SocOcvMapY_pct "" 0x70012c46 NO_INPUT_QUANTITY Lookup2D_X_FLOAT32_IEEE 0 VBU0428Test_CM_single_cnt 11 0.0 100.0 /end AXIS_PTS
/begin CHARACTERISTIC CaSOE_SocResistanceLongMapZ_mohm "" MAP 0x70015f78 Lookup2D_FLOAT32_IEEE 0 VBU0428Test_CM_single_cnt -3.4028234663852886E+38 3.4028234663852886E+38
 /begin AXIS_DESCR COM_AXIS NO_INPUT_QUANTITY VBU0428Test_CM_single_cnt 11 -3.4028234663852886E+38 3.4028234663852886E+38 AXIS_PTS_REF CaSOE_SocResistanceLongMapY_pct /end AXIS_DESCR
 /begin AXIS_DESCR COM_AXIS CTM_tCellTempAve VBU0428Test_CM_single_cnt 9 -3.4028234663852886E+38 3.4028234663852886E+38 AXIS_PTS_REF CaSOE_SocResistanceLongMapX_C /end AXIS_DESCR
/end CHARACTERISTIC
/begin AXIS_PTS CaSOE_SocResistanceLongMapX_C "" 0x7001270a CTM_tCellTempAve Lookup2D_X_FLOAT32_IEEE 0 VBU0428Test_CM_single_cnt 9 -3.4028234663852886E+38 3.4028234663852886E+38 /end AXIS_PTS
/begin AXIS_PTS CaSOE_SocResistanceLongMapY_pct "" 0x70012c72 NO_INPUT_QUANTITY Lookup2D_X_FLOAT32_IEEE 0 VBU0428Test_CM_single_cnt 11 -3.4028234663852886E+38 3.4028234663852886E+38 /end AXIS_PTS
/begin CHARACTERISTIC CaSOH_CellCapacity_Ah "" CURVE 0x70013646 Lookup1D_FLOAT32_IEEE 0 VBU0428Test_CM_single_cnt -3.4028234663852886E+38 3.4028234663852886E+38
 /begin AXIS_DESCR COM_AXIS NO_INPUT_QUANTITY VBU0428Test_CM_single_cnt 13 -3.4028234663852886E+38 3.4028234663852886E+38 AXIS_PTS_REF CaSOH_LifeTimeDischarge_Ah /end AXIS_DESCR
/end CHARACTERISTIC
/begin AXIS_PTS CaSOH_LifeTimeDischarge_Ah "" 0x700136ae NO_INPUT_QUANTITY Lookup1D_X_FLOAT32_IEEE 0 VBU0428Test_CM_single_cnt 13 -3.4028234663852886E+38 3.4028234663852886E+38 /end AXIS_PTS
/begin CHARACTERISTIC CaSOH_LifeTimeDischargeLookUp_Ah "" CURVE 0x7001367a Lookup1D_FLOAT32_IEEE 0 VBU0428Test_CM_single_cnt -3.4028234663852886E+38 3.4028234663852886E+38
 /begin AXIS_DESCR COM_AXIS NO_INPUT_QUANTITY VBU0428Test_CM_single_cnt 13 -3.4028234663852886E+38 3.4028234663852886E+38 AXIS_PTS_REF CaSOH_CellCapacityLookUp_Ah /end AXIS_DESCR
/end CHARACTERISTIC
/begin AXIS_PTS CaSOH_CellCapacityLookUp_Ah "" 0x70013612 NO_INPUT_QUANTITY Lookup1D_X_FLOAT32_IEEE 0 VBU0428Test_CM_single_cnt 13 -3.4028234663852886E+38 3.4028234663852886E+38 /end AXIS_PTS
/begin CHARACTERISTIC CaTHM_ObcSohFactorMapY_n "" CURVE 0x70011f1a Lookup1D_FLOAT32_IEEE 0 VBU0428Test_CM_single_cnt 0.0 1.0
 /begin AXIS_DESCR COM_AXIS NO_INPUT_QUANTITY VBU0428Test_CM_single_cnt 5 0.0 100.0 AXIS_PTS_REF CaTHM_PackSohMapX_pct /end AXIS_DESCR
/end CHARACTERISTIC
/begin CHARACTERISTIC CaTHM_ObcHighSocRequestTempMapZ_C "" MAP 0x70014dde Lookup2D_FLOAT32_IEEE 0 VBU0428Test_CM_single_cnt -40.0 80.0
 /begin AXIS_DESCR COM_AXIS SOC_pctCellSocMax VBU0428Test_CM_single_cnt 5 0.0 100.0 AXIS_PTS_REF CaTHM_CellSocMaxMapY_pct /end AXIS_DESCR
 /begin AXIS_DESCR COM_AXIS CTM_tCellTempMax VBU0428Test_CM_single_cnt 6 -40.0 80.0 AXIS_PTS_REF CaTHM_CellTempMaxMapX_C /end AXIS_DESCR
/end CHARACTERISTIC
/begin CHARACTERISTIC APD_numPlausibilityDec_C "" VALUE 0x70010148 Scalar_FLOAT32_IEEE 0 VBU0428Test_CM_single_cnt -3.4028234663852886E+38 3.4028234663852886E+38 /end CHARACTERISTIC
/begin CHARACTERISTIC APD_numPlausibilityInc_C "" VALUE 0x7001014c Scalar_FLOAT32_IEEE 0 VBU0428Test_CM_single_cnt -3.4028234663852886E+38 3.4028234663852886E+38 /end CHARACTERISTIC
/begin CHARACTERISTIC APD_numPlausibilityLim_C "" VALUE 0x70010150 Scalar_FLOAT32_IEEE 0 VBU0428Test_CM_single_cnt -3.4028234663852886E+38 3.4028234663852886E+38 /end CHARACTERISTIC
/begin CHARACTERISTIC APD_pctAccPedPosLimit_C "" VALUE 0x70010154 Scalar_FLOAT32_IEEE 0 VBU0428Test_CM_single_cnt -3.4028234663852886E+38 3.4028234663852886E+38 /end CHARACTERISTIC
/begin CHARACTERISTIC APD_pctAccPedPosOverrideVal_C "" VALUE 0x70010158 Scalar_FLOAT32_IEEE 0 VBU0428Test_CM_single_cnt -3.4028234663852886E+38 3.4028234663852886E+38 /end CHARACTERISTIC
/begin CHARACTERISTIC APD_pctAccPedPosOverride_C "" VALUE 0x7001015c Scalar_FLOAT32_IEEE 0 VBU0428Test_CM_single_cnt -3.4028234663852886E+38 3.4028234663852886E+38 /end CHARACTERISTIC
/begin CHARACTERISTIC APD_uJitterFil1_C "" VALUE 0x7001018c Scalar_FLOAT32_IEEE 0 VBU0428Test_CM_single_cnt -3.4028234663852886E+38 3.4028234663852886E+38 /end CHARACTERISTIC
/begin CHARACTERISTIC APD_uJitterFil2_C "" VALUE 0x70010190 Scalar_FLOAT32_IEEE 0 VBU0428Test_CM_single_cnt -3.4028234663852886E+38 3.4028234663852886E+38 /end CHARACTERISTIC
/begin CHARACTERISTIC APD_uSetPoint1Max_C "" VALUE 0x70010194 Scalar_FLOAT32_IEEE 0 VBU0428Test_CM_single_cnt -3.4028234663852886E+38 3.4028234663852886E+38 /end CHARACTERISTIC
/begin CHARACTERISTIC APD_uSetPoint1Min_C "" VALUE 0x70010198 Scalar_FLOAT32_IEEE 0 VBU0428Test_CM_single_cnt -3.4028234663852886E+38 3.4028234663852886E+38 /end CHARACTERISTIC
/begin CHARACTERISTIC APD_uSetPoint2Max_C "" VALUE 0x7001019c Scalar_FLOAT32_IEEE 0 VBU0428Test_CM_single_cnt -3.4028234663852886E+38 3.4028234663852886E+38 /end CHARACTERISTIC
/begin CHARACTERISTIC APD_uSetPoint2Min_C "" VALUE 0x700101a0 Scalar_FLOAT32_IEEE 0 VBU0428Test_CM_single_cnt -3.4028234663852886E+38 3.4028234663852886E+38 /end CHARACTERISTIC
/begin CHARACTERISTIC BPD_facBrkPresVoltFilt_C "" VALUE 0x700103d4 Scalar_FLOAT32_IEEE 0 VBU0428Test_CM_single -3.4E+38 3.4E+38 /end CHARACTERISTIC
/begin CHARACTERISTIC BPD_pctBrkPedalDownStep_C "" VALUE 0x700103d8 Scalar_FLOAT32_IEEE 0 VBU0428Test_CM_single_cnt -3.4028234663852886E+38 3.4028234663852886E+38 /end CHARACTERISTIC
/begin CHARACTERISTIC BPD_pctBrkPedalPressedZero_C "" VALUE 0x700103dc Scalar_FLOAT32_IEEE 0 VBU0428Test_CM_single_cnt -3.4028234663852886E+38 3.4028234663852886E+38 /end CHARACTERISTIC
/begin CHARACTERISTIC BPD_pctBrkPedalPressed_C "" VALUE 0x700103e0 Scalar_FLOAT32_IEEE 0 VBU0428Test_CM_single_cnt -3.4028234663852886E+38 3.4028234663852886E+38 /end CHARACTERISTIC
/begin CHARACTERISTIC BPD_pctBrkPressDiag_C "" VALUE 0x700103e8 Scalar_FLOAT32_IEEE 0 VBU0428Test_CM_single_cnt -3.4028234663852886E+38 3.4028234663852886E+38 /end CHARACTERISTIC
/begin CHARACTERISTIC BPD_pctBrkReleaseDiag_C "" VALUE 0x700103ec Scalar_FLOAT32_IEEE 0 VBU0428Test_CM_single_cnt -3.4028234663852886E+38 3.4028234663852886E+38 /end CHARACTERISTIC
/begin CHARACTERISTIC BPD_tiDftBrkPosSwtPress_C "" VALUE 0x700103f0 Scalar_FLOAT32_IEEE 0 VBU0428Test_CM_single_cnt -3.4028234663852886E+38 3.4028234663852886E+38 /end CHARACTERISTIC
/begin CHARACTERISTIC BPD_tiDftBrkPosSwtRelease_C "" VALUE 0x700103f4 Scalar_FLOAT32_IEEE 0 VBU0428Test_CM_single_cnt -3.4028234663852886E+38 3.4028234663852886E+38 /end CHARACTERISTIC
/begin CHARACTERISTIC BPD_tiSampleTime_C "" VALUE 0x700103f8 Scalar_FLOAT32_IEEE 0 VBU0428Test_CM_single_cnt -3.4028234663852886E+38 3.4028234663852886E+38 /end CHARACTERISTIC
/begin CHARACTERISTIC CaSOH_CellCapacityWrite_Ah "" VAL_BLK 0x7001a694 Scalar_FLOAT32_IEEE 0 VBU0428Test_CM_single_cnt -3.4028234663852886E+38 3.4028234663852886E+38 NUMBER 198 /end CHARACTERISTIC
/begin CHARACTERISTIC CaSOH_InvalidCellCapacity_Ah "" VAL_BLK 0x7001a9ac Scalar_FLOAT32_IEEE 0 VBU0428Test_CM_single_cnt -3.4028234663852886E+38 3.4028234663852886E+38 NUMBER 198 /end CHARACTERISTIC
/begin CHARACTERISTIC CaSOH_InvalidHistoryCurrentData_A "" VAL_BLK 0x70011eca Scalar_FLOAT32_IEEE 0 VBU0428Test_CM_single_cnt -3.4028234663852886E+38 3.4028234663852886E+38 NUMBER 5 /end CHARACTERISTIC
/begin CHARACTERISTIC CcBCV_BdmBatteryBusVoltageMismatchFaultDelta_V "" VALUE 0x700104d4 Scalar_FLOAT32_IEEE 0 VBU0428Test_CM_single_cnt -3.4028234663852886E+38 3.4028234663852886E+38 /end CHARACTERISTIC
/begin CHARACTERISTIC CcBCV_BdmBatteryBusVoltageMismatchFault_V "" VALUE 0x700104d8 Scalar_FLOAT32_IEEE 0 VBU0428Test_CM_single_cnt -3.4028234663852886E+38 3.4028234663852886E+38 /end CHARACTERISTIC
/begin CHARACTERISTIC CcBCV_BdmBatteryCurrentOoR_A "" VALUE 0x700104dc Scalar_FLOAT32_IEEE 0 VBU0428Test_CM_single_cnt -3.4028234663852886E+38 3.4028234663852886E+38 /end CHARACTERISTIC
/begin CHARACTERISTIC CcBCV_BdmBatteryOverCurrent_A "" VALUE 0x700104e0 Scalar_FLOAT32_IEEE 0 VBU0428Test_CM_single_cnt -3.4028234663852886E+38 3.4028234663852886E+38 /end CHARACTERISTIC
/begin CHARACTERISTIC CcBCV_BdmBatteryOverVoltage_V "" VALUE 0x700104e4 Scalar_FLOAT32_IEEE 0 VBU0428Test_CM_single_cnt -3.4028234663852886E+38 3.4028234663852886E+38 /end CHARACTERISTIC
/begin CHARACTERISTIC CcBCV_BdmBatteryUnderVoltage1_V "" VALUE 0x700104e8 Scalar_FLOAT32_IEEE 0 VBU0428Test_CM_single_cnt -3.4028234663852886E+38 3.4028234663852886E+38 /end CHARACTERISTIC
/begin CHARACTERISTIC CcBCV_BdmBatteryUnderVoltage2_V "" VALUE 0x700104ec Scalar_FLOAT32_IEEE 0 VBU0428Test_CM_single_cnt -3.4028234663852886E+38 3.4028234663852886E+38 /end CHARACTERISTIC
/begin CHARACTERISTIC CcBCV_BdmBatteryUnderVoltageTemp_C "" VALUE 0x700104f0 Scalar_FLOAT32_IEEE 0 VBU0428Test_CM_single_cnt -3.4028234663852886E+38 3.4028234663852886E+38 /end CHARACTERISTIC
/begin CHARACTERISTIC CcBCV_BdmBatteryVoltageOoRHigh_V "" VALUE 0x700104f4 Scalar_FLOAT32_IEEE 0 VBU0428Test_CM_single_cnt -3.4028234663852886E+38 3.4028234663852886E+38 /end CHARACTERISTIC
/begin CHARACTERISTIC CcBCV_BdmBatteryVoltageOoRLow_V "" VALUE 0x700104f8 Scalar_FLOAT32_IEEE 0 VBU0428Test_CM_single_cnt -3.4028234663852886E+38 3.4028234663852886E+38 /end CHARACTERISTIC
/begin CHARACTERISTIC CcCTD_MNCStuckOpenCurrentMax_A "" VALUE 0x700105c0 Scalar_FLOAT32_IEEE 0 VBU0428Test_CM_single_cnt -3.4028234663852886E+38 3.4028234663852886E+38 /end CHARACTERISTIC
/begin CHARACTERISTIC CcCTD_MaxJouleHeat_J "" VALUE 0x700105cc Scalar_FLOAT32_IEEE 0 VBU0428Test_CM_single_cnt -3.4028234663852886E+38 3.4028234663852886E+38 /end CHARACTERISTIC
/begin CHARACTERISTIC CcCTD_MinHeatDissipation_J "" VALUE 0x700105d4 Scalar_FLOAT32_IEEE 0 VBU0428Test_CM_single_cnt -3.4028234663852886E+38 3.4028234663852886E+38 /end CHARACTERISTIC
/begin CHARACTERISTIC CcCTD_MnNegContactorOpenDeltaVoltage_V "" VALUE 0x700105dc Scalar_FLOAT32_IEEE 0 VBU0428Test_CM_single_cnt -3.4028234663852886E+38 3.4028234663852886E+38 /end CHARACTERISTIC
/begin CHARACTERISTIC CcCTD_MnPosContactorOpenDeltaVoltage_V "" VALUE 0x700105e4 Scalar_FLOAT32_IEEE 0 VBU0428Test_CM_single_cnt -3.4028234663852886E+38 3.4028234663852886E+38 /end CHARACTERISTIC
/begin CHARACTERISTIC CcCTD_OnePrechargeHeat_J "" VALUE 0x700105e8 Scalar_FLOAT32_IEEE 0 VBU0428Test_CM_single_cnt -3.4028234663852886E+38 3.4028234663852886E+38 /end CHARACTERISTIC
/begin CHARACTERISTIC CcCTD_PrechargeOverEnergy_J "" VALUE 0x70010600 Scalar_FLOAT32_IEEE 0 VBU0428Test_CM_single_cnt -3.4028234663852886E+38 3.4028234663852886E+38 /end CHARACTERISTIC
/begin CHARACTERISTIC CcCTD_PrechargeResistance_ohm "" VALUE 0x7001060c Scalar_FLOAT32_IEEE 0 VBU0428Test_CM_single_cnt -3.4028234663852886E+38 3.4028234663852886E+38 /end CHARACTERISTIC
/begin CHARACTERISTIC CcCTD_RnMNCStuckOpenCurrentMax_A "" VALUE 0x70010618 Scalar_FLOAT32_IEEE 0 VBU0428Test_CM_single_cnt -3.4028234663852886E+38 3.4028234663852886E+38 /end CHARACTERISTIC
/begin CHARACTERISTIC CcCTD_RnMnNegContactorOpenDeltaVoltage_V "" VALUE 0x7001061c Scalar_FLOAT32_IEEE 0 VBU0428Test_CM_single_cnt -3.4028234663852886E+38 3.4028234663852886E+38 /end CHARACTERISTIC
/begin CHARACTERISTIC CcCTD_RnMnPosContactorOpenDeltaVoltage_V "" VALUE 0x70010620 Scalar_FLOAT32_IEEE 0 VBU0428Test_CM_single_cnt -3.4028234663852886E+38 3.4028234663852886E+38 /end CHARACTERISTIC
/begin CHARACTERISTIC CcCTM_CellThermalRunawayRatePerSecond_C "" VALUE 0x70010654 Scalar_FLOAT32_IEEE 0 VBU0428Test_CM_single_cnt -3.4028234663852886E+38 3.4028234663852886E+38 /end CHARACTERISTIC
/begin CHARACTERISTIC CcFCC_ChargeCurrentDerateSocDelta_pct "" VALUE 0x700106e4 Scalar_FLOAT32_IEEE 0 VBU0428Test_CM_single_cnt -3.4028234663852886E+38 3.4028234663852886E+38 /end CHARACTERISTIC
/begin CHARACTERISTIC CcFCC_ChargeCurrentDerateSoc_pct "" VALUE 0x700106e8 Scalar_FLOAT32_IEEE 0 VBU0428Test_CM_single_cnt -3.4028234663852886E+38 3.4028234663852886E+38 /end CHARACTERISTIC
/begin CHARACTERISTIC CcFCC_ChargeCurrentOvRValue_A "" VALUE 0x700106ec Scalar_FLOAT32_IEEE 0 VBU0428Test_CM_single_cnt -3.4028234663852886E+38 3.4028234663852886E+38 /end CHARACTERISTIC
/begin CHARACTERISTIC CcFCC_ChargeCurrentOverDelay_s "" VALUE 0x700106f0 Scalar_FLOAT32_IEEE 0 VBU0428Test_CM_single_cnt -3.4028234663852886E+38 3.4028234663852886E+38 /end CHARACTERISTIC
/begin CHARACTERISTIC CcFCC_ChargeCurrentRequestDec_A "" VALUE 0x700106fc Scalar_FLOAT32_IEEE 0 VBU0428Test_CM_single_cnt -3.4028234663852886E+38 3.4028234663852886E+38 /end CHARACTERISTIC
/begin CHARACTERISTIC CcFCC_ChargeVoltageDelta_V "" VALUE 0x70010714 Scalar_FLOAT32_IEEE 0 VBU0428Test_CM_single_cnt -3.4028234663852886E+38 3.4028234663852886E+38 /end CHARACTERISTIC
/begin CHARACTERISTIC CcFCC_ComputeResistanceTempMax_C "" VALUE 0x70010728 Scalar_FLOAT32_IEEE 0 VBU0428Test_CM_single_C -40.0 200.0 /end CHARACTERISTIC
/begin CHARACTERISTIC CcFCC_ComputeResistanceTempMin_C "" VALUE 0x7001072c Scalar_FLOAT32_IEEE 0 VBU0428Test_CM_single_C -40.0 200.0 /end CHARACTERISTIC
/begin CHARACTERISTIC CcSOC_BatteryDisplaySocChargeDecRate_n "" VALUE 0x700107c0 Scalar_FLOAT32_IEEE 0 VBU0428Test_CM_single_cnt -3.4028234663852886E+38 3.4028234663852886E+38 /end CHARACTERISTIC
/begin CHARACTERISTIC CcSOC_BatteryDisplaySocChargeIncRate_n "" VALUE 0x700107c4 Scalar_FLOAT32_IEEE 0 VBU0428Test_CM_single_cnt -3.4028234663852886E+38 3.4028234663852886E+38 /end CHARACTERISTIC
/begin CHARACTERISTIC CcSOC_iAOcvShortTimeCurrentLimit "" VALUE 0x70010870 Scalar_FLOAT32_IEEE 0 VBU0428Test_CM_single_cnt -3.4028234663852886E+38 3.4028234663852886E+38 /end CHARACTERISTIC
/begin CHARACTERISTIC CcSOE_CellVoltageLowerLimit_mV "" VALUE 0x70010880 Scalar_FLOAT32_IEEE 0 VBU0428Test_CM_single_cnt -3.4028234663852886E+38 3.4028234663852886E+38 /end CHARACTERISTIC
/begin CHARACTERISTIC CcSOF_DischargeLowOCVStepSlope_V "" VALUE 0x70010918 Scalar_FLOAT32_IEEE 0 VBU0428Test_CM_single_cnt -3.4028234663852886E+38 3.4028234663852886E+38 /end CHARACTERISTIC
/begin CHARACTERISTIC CcSOF_LowVoltageChargeCurrentMax_A "" VALUE 0x70010988 Scalar_FLOAT32_IEEE 0 VBU0428Test_CM_single_cnt -3.4028234663852886E+38 3.4028234663852886E+38 /end CHARACTERISTIC
/begin CHARACTERISTIC CcSOF_LowVoltageChargeCurrentSlopeDec_A "" VALUE 0x7001098c Scalar_FLOAT32_IEEE 0 VBU0428Test_CM_single_cnt -3.4028234663852886E+38 3.4028234663852886E+38 /end CHARACTERISTIC
/begin CHARACTERISTIC CcSOF_LowVoltageChargeCurrentSlopeInc_A "" VALUE 0x70010990 Scalar_FLOAT32_IEEE 0 VBU0428Test_CM_single_cnt -3.4028234663852886E+38 3.4028234663852886E+38 /end CHARACTERISTIC
/begin CHARACTERISTIC CcSOF_SocpDischargePowerMin_Kw "" VALUE 0x700109c0 Scalar_FLOAT32_IEEE 0 VBU0428Test_CM_single_cnt -3.4028234663852886E+38 3.4028234663852886E+38 /end CHARACTERISTIC
/begin CHARACTERISTIC CcSOF_SocpDischargePowerSlope_Kw "" VALUE 0x700109c4 Scalar_FLOAT32_IEEE 0 VBU0428Test_CM_single_cnt -3.4028234663852886E+38 3.4028234663852886E+38 /end CHARACTERISTIC
/begin CHARACTERISTIC CcSOH_CellCapacityLowThershold_Ah "" VALUE 0x70010a28 Scalar_FLOAT32_IEEE 0 VBU0428Test_CM_single_cnt -3.4028234663852886E+38 3.4028234663852886E+38 /end CHARACTERISTIC
/begin CHARACTERISTIC CcSOH_ComResisTempLowerLimit_C "" VALUE 0x70010a3c Scalar_FLOAT32_IEEE 0 VBU0428Test_CM_single_cnt -3.4028234663852886E+38 3.4028234663852886E+38 /end CHARACTERISTIC
/begin CHARACTERISTIC CcSOH_ComResisTempUpperLimit_C "" VALUE 0x70010a40 Scalar_FLOAT32_IEEE 0 VBU0428Test_CM_single_cnt -3.4028234663852886E+38 3.4028234663852886E+38 /end CHARACTERISTIC
/begin CHARACTERISTIC CcSOH_DeltaModuleCurrent_A "" VALUE 0x70010a44 Scalar_FLOAT32_IEEE 0 VBU0428Test_CM_single_cnt -3.4028234663852886E+38 3.4028234663852886E+38 /end CHARACTERISTIC
/begin CHARACTERISTIC CcSOH_DeltaSocLowerLimit_pct "" VALUE 0x70010a48 Scalar_FLOAT32_IEEE 0 VBU0428Test_CM_single_cnt -3.4028234663852886E+38 3.4028234663852886E+38 /end CHARACTERISTIC
/begin CHARACTERISTIC CcSOH_DeltaSocThreshold_pct "" VALUE 0x70010a4c Scalar_FLOAT32_IEEE 0 VBU0428Test_CM_single_cnt -3.4028234663852886E+38 3.4028234663852886E+38 /end CHARACTERISTIC
/begin CHARACTERISTIC CcSOH_DeltaSocUpperLimit_pct "" VALUE 0x70010a50 Scalar_FLOAT32_IEEE 0 VBU0428Test_CM_single_cnt -3.4028234663852886E+38 3.4028234663852886E+38 /end CHARACTERISTIC
/begin CHARACTERISTIC CcSOH_DeltaTemThreshold_C "" VALUE 0x70010a54 Scalar_FLOAT32_IEEE 0 VBU0428Test_CM_single_cnt -3.4028234663852886E+38 3.4028234663852886E+38 /end CHARACTERISTIC
/begin CHARACTERISTIC CcSOH_LowTemThreshold_C "" VALUE 0x70010a60 Scalar_FLOAT32_IEEE 0 VBU0428Test_CM_single_cnt -3.4028234663852886E+38 3.4028234663852886E+38 /end CHARACTERISTIC
/begin CHARACTERISTIC CcSOH_UdSocInvalidLowerLimit_pct "" VALUE 0x70010a80 Scalar_FLOAT32_IEEE 0 VBU0428Test_CM_single_cnt -3.4028234663852886E+38 3.4028234663852886E+38 /end CHARACTERISTIC
/begin CHARACTERISTIC CcSOH_UdSocInvalidUpperLimit_pct "" VALUE 0x70010a84 Scalar_FLOAT32_IEEE 0 VBU0428Test_CM_single_cnt -3.4028234663852886E+38 3.4028234663852886E+38 /end CHARACTERISTIC
/begin CHARACTERISTIC CcSYS_ResisCalFCCPulseCurrent_A "" VALUE 0x70010aa8 Scalar_FLOAT32_IEEE 0 VBU0428Test_CM_single_cnt 0.0 1.0E+23 /end CHARACTERISTIC
/begin CHARACTERISTIC CcSYS_ResisCalPulseCurrentDurationTime_ms "" VALUE 0x70010aac Scalar_FLOAT32_IEEE 0 VBU0428Test_CM_single_cnt 0.0 1.0E+23 /end CHARACTERISTIC
/begin CHARACTERISTIC CcSYS_ResisCalRelaxationCurrent_A "" VALUE 0x70010ab0 Scalar_FLOAT32_IEEE 0 VBU0428Test_CM_single_cnt -3.4028234663852886E+38 3.4028234663852886E+38 /end CHARACTERISTIC
/begin CHARACTERISTIC CcTHM_CoolantSensorGradient_C "" VALUE 0x70010ac0 Scalar_FLOAT32_IEEE 0 VBU0428Test_CM_single_cnt -3.4028234663852886E+38 3.4028234663852886E+38 /end CHARACTERISTIC
/begin CHARACTERISTIC CcTHM_FccCellTempHighThreshold_C "" VALUE 0x70010ad4 Scalar_FLOAT32_IEEE 0 VBU0428Test_CM_single_cnt -3.4028234663852886E+38 3.4028234663852886E+38 /end CHARACTERISTIC
/begin CHARACTERISTIC CcTHM_FccChargeHysterSOC_pct "" VALUE 0x70010ad8 Scalar_FLOAT32_IEEE 0 VBU0428Test_CM_single_cnt -3.4028234663852886E+38 3.4028234663852886E+38 /end CHARACTERISTIC
/begin CHARACTERISTIC CcTHM_FccChargeTempRequestHysterTemp_C "" VALUE 0x70010adc Scalar_FLOAT32_IEEE 0 VBU0428Test_CM_single_cnt -3.4028234663852886E+38 3.4028234663852886E+38 /end CHARACTERISTIC
/begin CHARACTERISTIC CcTHM_FccSocHighThreshold_pct "" VALUE 0x70010ae4 Scalar_FLOAT32_IEEE 0 VBU0428Test_CM_single_cnt -3.4028234663852886E+38 3.4028234663852886E+38 /end CHARACTERISTIC
/begin CHARACTERISTIC CcTHM_ObcCellTempHighThreshold_C "" VALUE 0x70010af8 Scalar_FLOAT32_IEEE 0 VBU0428Test_CM_single_cnt -3.4028234663852886E+38 3.4028234663852886E+38 /end CHARACTERISTIC
/begin CHARACTERISTIC CcTHM_ObcChargeHysterSOC_pct "" VALUE 0x70010afc Scalar_FLOAT32_IEEE 0 VBU0428Test_CM_single_cnt -3.4028234663852886E+38 3.4028234663852886E+38 /end CHARACTERISTIC
/begin CHARACTERISTIC CcTHM_ObcChargeTempRequestHysterTemp_C "" VALUE 0x70010b00 Scalar_FLOAT32_IEEE 0 VBU0428Test_CM_single_cnt -3.4028234663852886E+38 3.4028234663852886E+38 /end CHARACTERISTIC
/begin CHARACTERISTIC CcTHM_ObcChargeTempRequestLowThreshold_C "" VALUE 0x70010b04 Scalar_FLOAT32_IEEE 0 VBU0428Test_CM_single_cnt -3.4028234663852886E+38 3.4028234663852886E+38 /end CHARACTERISTIC
/begin CHARACTERISTIC CcTHM_ObcSocHighThreshold_pct "" VALUE 0x70010b08 Scalar_FLOAT32_IEEE 0 VBU0428Test_CM_single_cnt -3.4028234663852886E+38 3.4028234663852886E+38 /end CHARACTERISTIC
/begin CHARACTERISTIC CcTHM_ObcSohTempLowThreshold_C "" VALUE 0x70010b0c Scalar_FLOAT32_IEEE 0 VBU0428Test_CM_single_cnt -3.4028234663852886E+38 3.4028234663852886E+38 /end CHARACTERISTIC
/begin CHARACTERISTIC Gear_pctBrkPosPressed_C "" VALUE 0x70011244 Scalar_FLOAT32_IEEE 0 VBU0428Test_CM_single_cnt -3.4028234663852886E+38 3.4028234663852886E+38 /end CHARACTERISTIC
/begin CHARACTERISTIC Gear_tiGearDebounceCnt_C "" VALUE 0x70011254 Scalar_FLOAT32_IEEE 0 VBU0428Test_CM_single_cnt -3.4028234663852886E+38 3.4028234663852886E+38 /end CHARACTERISTIC
/begin CHARACTERISTIC Gear_tiGearPSwitchDebounceCnt_C "" VALUE 0x70011268 Scalar_FLOAT32_IEEE 0 VBU0428Test_CM_single_cnt -3.4028234663852886E+38 3.4028234663852886E+38 /end CHARACTERISTIC
/begin CHARACTERISTIC Gear_tiSampleTime_C "" VALUE 0x70011284 Scalar_FLOAT32_IEEE 0 VBU0428Test_CM_single_cnt -3.4028234663852886E+38 3.4028234663852886E+38 /end CHARACTERISTIC
/begin CHARACTERISTIC Gear_tiShiftEnableCnt_C "" VALUE 0x70011288 Scalar_FLOAT32_IEEE 0 VBU0428Test_CM_single_cnt -3.4028234663852886E+38 3.4028234663852886E+38 /end CHARACTERISTIC
/begin CHARACTERISTIC Gear_trqShiftDriveEnableLe_C "" VALUE 0x70011290 Scalar_FLOAT32_IEEE 0 VBU0428Test_CM_single_cnt -3.4028234663852886E+38 3.4028234663852886E+38 /end CHARACTERISTIC
/begin CHARACTERISTIC Gear_trqShiftDriveEnableRi_C "" VALUE 0x70011294 Scalar_FLOAT32_IEEE 0 VBU0428Test_CM_single_cnt -3.4028234663852886E+38 3.4028234663852886E+38 /end CHARACTERISTIC
/begin CHARACTERISTIC Gear_vForce2NThreshold_C "" VALUE 0x70011298 Scalar_FLOAT32_IEEE 0 VBU0428Test_CM_single_cnt -3.4028234663852886E+38 3.4028234663852886E+38 /end CHARACTERISTIC
/begin CHARACTERISTIC Gear_vGearDLowThreshold_C "" VALUE 0x7001129c Scalar_FLOAT32_IEEE 0 VBU0428Test_CM_single_cnt -3.4028234663852886E+38 3.4028234663852886E+38 /end CHARACTERISTIC
/begin CHARACTERISTIC Gear_vGearDMiThreshold_C "" VALUE 0x700112a0 Scalar_FLOAT32_IEEE 0 VBU0428Test_CM_single_cnt -3.4028234663852886E+38 3.4028234663852886E+38 /end CHARACTERISTIC
/begin CHARACTERISTIC Gear_vGearPThreshold_C "" VALUE 0x700112a4 Scalar_FLOAT32_IEEE 0 VBU0428Test_CM_single_cnt -3.4028234663852886E+38 3.4028234663852886E+38 /end CHARACTERISTIC
/begin CHARACTERISTIC Gear_vTowThreshold_C "" VALUE 0x700112a8 Scalar_FLOAT32_IEEE 0 VBU0428Test_CM_single_cnt -3.4028234663852886E+38 3.4028234663852886E+38 /end CHARACTERISTIC
/begin CHARACTERISTIC MILIAMPERES_PER_AMPERE "" VALUE 0x700113cc Scalar_FLOAT32_IEEE 0 VBU0428Test_CM_single_cnt -3.4028234663852886E+38 3.4028234663852886E+38 /end CHARACTERISTIC
/begin CHARACTERISTIC MTQL_trqPEURFidByTempLim_C "" VALUE 0x0000 Scalar_FLOAT32_IEEE 0 VBU0428Test_CM_single_cnt -10000.0 10000.0 /end CHARACTERISTIC
/begin CHARACTERISTIC MTQL_trqPEURFidLim_C "" VALUE 0x0000 Scalar_FLOAT32_IEEE 0 VBU0428Test_CM_single_cnt -10000.0 10000.0 /end CHARACTERISTIC
/begin CHARACTERISTIC SPD_facSpdFlt_C "" VALUE 0x700115e8 Scalar_FLOAT32_IEEE 0 VBU0428Test_CM_single_cnt -3.4028234663852886E+38 3.4028234663852886E+38 /end CHARACTERISTIC
/begin CHARACTERISTIC SPD_nMotrDrvRvsThd_C "" VALUE 0x700115ec Scalar_FLOAT32_IEEE 0 VBU0428Test_CM_single_cnt -3.4028234663852886E+38 3.4028234663852886E+38 /end CHARACTERISTIC
/begin CHARACTERISTIC SPD_tiSample10ms_SY "" VALUE 0x700115f8 Scalar_FLOAT32_IEEE 0 VBU0428Test_CM_single_cnt -3.4028234663852886E+38 3.4028234663852886E+38 /end CHARACTERISTIC
/begin CHARACTERISTIC SPD_tiSlopeFilter_C "" VALUE 0x700115fc Scalar_FLOAT32_IEEE 0 VBU0428Test_CM_single_cnt -3.4028234663852886E+38 3.4028234663852886E+38 /end CHARACTERISTIC
/begin CHARACTERISTIC SPD_tiSpdFil_C "" VALUE 0x70011600 Scalar_FLOAT32_IEEE 0 VBU0428Test_CM_single_cnt -3.4028234663852886E+38 3.4028234663852886E+38 /end CHARACTERISTIC
/begin CHARACTERISTIC SPD_trqRvsRst_C "" VALUE 0x70011604 Scalar_FLOAT32_IEEE 0 VBU0428Test_CM_single_cnt -3.4028234663852886E+38 3.4028234663852886E+38 /end CHARACTERISTIC
/begin CHARACTERISTIC SPD_vGoThd_C "" VALUE 0x70011608 Scalar_FLOAT32_IEEE 0 VBU0428Test_CM_single_cnt -3.4028234663852886E+38 3.4028234663852886E+38 /end CHARACTERISTIC
/begin CHARACTERISTIC SPD_vVehOvrdFlg_C "" VALUE 0x7001160c Scalar_FLOAT32_IEEE 0 VBU0428Test_CM_single_cnt -3.4028234663852886E+38 3.4028234663852886E+38 /end CHARACTERISTIC
/begin CHARACTERISTIC SPD_vVehOvrdVal_C "" VALUE 0x70011610 Scalar_FLOAT32_IEEE 0 VBU0428Test_CM_single_cnt -3.4028234663852886E+38 3.4028234663852886E+38 /end CHARACTERISTIC
/begin CHARACTERISTIC SPD_vVehRvsRst_C "" VALUE 0x70011614 Scalar_FLOAT32_IEEE 0 VBU0428Test_CM_single_cnt -3.4028234663852886E+38 3.4028234663852886E+38 /end CHARACTERISTIC
/begin CHARACTERISTIC SPD_vVehRvsThd_C "" VALUE 0x70011618 Scalar_FLOAT32_IEEE 0 VBU0428Test_CM_single_cnt -3.4028234663852886E+38 3.4028234663852886E+38 /end CHARACTERISTIC
/begin CHARACTERISTIC SYS_facGearRatioR_SY "" VALUE 0x70011638 Scalar_FLOAT32_IEEE 0 VBU0428Test_CM_single_cnt -3.4028234663852886E+38 3.4028234663852886E+38 /end CHARACTERISTIC
/begin CHARACTERISTIC TQDIS_tiForFacCal_C "" VALUE 0x700117b8 Scalar_FLOAT32_IEEE 0 VBU0428Test_CM_single_cnt -3.4028234663852886E+38 3.4028234663852886E+38 /end CHARACTERISTIC
/begin CHARACTERISTIC TQDIS_trqDecForFacCal_C "" VALUE 0x700117cc Scalar_FLOAT32_IEEE 0 VBU0428Test_CM_single_cnt -3.4028234663852886E+38 3.4028234663852886E+38 /end CHARACTERISTIC
/begin CHARACTERISTIC TQDIS_trqIncForFacCal_C "" VALUE 0x700117d8 Scalar_FLOAT32_IEEE 0 VBU0428Test_CM_single_cnt -3.4028234663852886E+38 3.4028234663852886E+38 /end CHARACTERISTIC
/begin CHARACTERISTIC TQDMP_vVehEnaMax_C "" VALUE 0x7001187c Scalar_FLOAT32_IEEE 0 VBU0428Test_CM_single -3.4E+38 3.4E+38 /end CHARACTERISTIC
/begin CHARACTERISTIC TQDMP_vVehEnaMin_C "" VALUE 0x70011880 Scalar_FLOAT32_IEEE 0 VBU0428Test_CM_single -3.4E+38 3.4E+38 /end CHARACTERISTIC
/begin CHARACTERISTIC TQD_trqModeChngDecGrad_C "" VALUE 0x700118f4 Scalar_FLOAT32_IEEE 0 VBU0428Test_CM_single_cnt -3.4028234663852886E+38 3.4028234663852886E+38 /end CHARACTERISTIC
/begin CHARACTERISTIC TQD_trqModeChngIncGrad_C "" VALUE 0x700118f8 Scalar_FLOAT32_IEEE 0 VBU0428Test_CM_single_cnt -3.4028234663852886E+38 3.4028234663852886E+38 /end CHARACTERISTIC
/begin CHARACTERISTIC TQD_trqNrmDecGrad_C "" VALUE 0x700118fc Scalar_FLOAT32_IEEE 0 VBU0428Test_CM_single_cnt -3.4028234663852886E+38 3.4028234663852886E+38 /end CHARACTERISTIC
/begin CHARACTERISTIC TQD_trqNrmIncGrad_C "" VALUE 0x70011900 Scalar_FLOAT32_IEEE 0 VBU0428Test_CM_single_cnt -3.4028234663852886E+38 3.4028234663852886E+38 /end CHARACTERISTIC
/begin CHARACTERISTIC TQD_trqRateLimThres_C "" VALUE 0x70011904 Scalar_FLOAT32_IEEE 0 VBU0428Test_CM_single_cnt -3.4028234663852886E+38 3.4028234663852886E+38 /end CHARACTERISTIC
/begin CHARACTERISTIC TQO_pctSlopeShft_C "" VALUE 0x70011910 Scalar_FLOAT32_IEEE 0 VBU0428Test_CM_single_cnt -3.4028234663852886E+38 3.4028234663852886E+38 /end CHARACTERISTIC
/begin CHARACTERISTIC TQO_tiShftDR_C "" VALUE 0x70011918 Scalar_FLOAT32_IEEE 0 VBU0428Test_CM_single_cnt -3.4028234663852886E+38 3.4028234663852886E+38 /end CHARACTERISTIC
/begin CHARACTERISTIC TQO_tiShftOut_C "" VALUE 0x7001191c Scalar_FLOAT32_IEEE 0 VBU0428Test_CM_single_cnt -3.4028234663852886E+38 3.4028234663852886E+38 /end CHARACTERISTIC
/begin CHARACTERISTIC VTQA_facActDrvPwrFltr_C "" VALUE 0x70011998 Scalar_FLOAT32_IEEE 0 VBU0428Test_CM_single_cnt 0.0 1.0 /end CHARACTERISTIC
/begin CHARACTERISTIC VTQA_facActRgnPwrFltr_C "" VALUE 0x7001199c Scalar_FLOAT32_IEEE 0 VBU0428Test_CM_single_cnt 0.0 1.0 /end CHARACTERISTIC
/begin CHARACTERISTIC VTQA_facMotorAvgFltr_C "" VALUE 0x700119a0 Scalar_FLOAT32_IEEE 0 VBU0428Test_CM_single_cnt 0.0 1.0 /end CHARACTERISTIC
/begin CHARACTERISTIC VTQA_facVehSpd2MotSpd_C "" VALUE 0x700119a4 Scalar_FLOAT32_IEEE 0 VBU0428Test_CM_single_cnt 0.0 1000.0 /end CHARACTERISTIC
/begin CHARACTERISTIC VTQA_trqABSFailMin_C "" VALUE 0x700119a8 Scalar_FLOAT32_IEEE 0 VBU0428Test_CM_single_cnt -10000.0 10000.0 /end CHARACTERISTIC
/begin CHARACTERISTIC VTQA_trqActDrvLoLim_C "" VALUE 0x700119ac Scalar_FLOAT32_IEEE 0 VBU0428Test_CM_single_cnt -10000.0 10000.0 /end CHARACTERISTIC
/begin CHARACTERISTIC VTQA_trqActDrvTrqLimORV "" VALUE 0x700119b0 Scalar_FLOAT32_IEEE 0 VBU0428Test_CM_single -3.4E+38 3.4E+38 /end CHARACTERISTIC
/begin CHARACTERISTIC VTQA_trqActDrvUpLim_C "" VALUE 0x700119b4 Scalar_FLOAT32_IEEE 0 VBU0428Test_CM_single_cnt -10000.0 10000.0 /end CHARACTERISTIC
/begin CHARACTERISTIC VTQA_trqActRgnLoLim_C "" VALUE 0x700119b8 Scalar_FLOAT32_IEEE 0 VBU0428Test_CM_single_cnt -10000.0 10000.0 /end CHARACTERISTIC
/begin CHARACTERISTIC VTQA_trqActRgnTrqLimORV "" VALUE 0x700119bc Scalar_FLOAT32_IEEE 0 VBU0428Test_CM_single -3.4E+38 3.4E+38 /end CHARACTERISTIC
/begin CHARACTERISTIC VTQA_trqActRgnUpLim_C "" VALUE 0x700119c0 Scalar_FLOAT32_IEEE 0 VBU0428Test_CM_single_cnt -10000.0 10000.0 /end CHARACTERISTIC
/begin CHARACTERISTIC VTQA_trqAxleMaxLimit_C "" VALUE 0x700119c4 Scalar_FLOAT32_IEEE 0 VBU0428Test_CM_single -3.4E+38 3.4E+38 /end CHARACTERISTIC
/begin CHARACTERISTIC VTQA_trqAxleMaxORV "" VALUE 0x700119c8 Scalar_FLOAT32_IEEE 0 VBU0428Test_CM_single -3.4E+38 3.4E+38 /end CHARACTERISTIC
/begin CHARACTERISTIC VTQA_trqAxleMinORV "" VALUE 0x700119cc Scalar_FLOAT32_IEEE 0 VBU0428Test_CM_single -3.4E+38 3.4E+38 /end CHARACTERISTIC
/begin CHARACTERISTIC VTQA_trqAxleMin_C "" VALUE 0x700119d0 Scalar_FLOAT32_IEEE 0 VBU0428Test_CM_single_cnt -10000.0 10000.0 /end CHARACTERISTIC
/begin CHARACTERISTIC VTQA_trqBrkSwtTrqLim_C "" VALUE 0x700119d4 Scalar_FLOAT32_IEEE 0 VBU0428Test_CM_single_cnt -10000.0 10000.0 /end CHARACTERISTIC
/begin CHARACTERISTIC VTQA_trqLimphomeMin_C "" VALUE 0x0000 Scalar_FLOAT32_IEEE 0 VBU0428Test_CM_single_cnt -10000.0 10000.0 /end CHARACTERISTIC
/begin CHARACTERISTIC Veh_tDCPortNegativeTempCheckEn_C "" VALUE 0x70011a00 Scalar_FLOAT32_IEEE 0 VBU0428Test_CM_single_cnt -3.4028234663852886E+38 3.4028234663852886E+38 /end CHARACTERISTIC
/begin CHARACTERISTIC Veh_tiDCPortPlausibilityConfirm_C "" VALUE 0x70011a04 Scalar_FLOAT32_IEEE 0 VBU0428Test_CM_single_cnt -3.4028234663852886E+38 3.4028234663852886E+38 /end CHARACTERISTIC
/begin CHARACTERISTIC Veh_tiModeDebTime_C "" VALUE 0x70011a10 Scalar_FLOAT32_IEEE 0 VBU0428Test_CM_single_cnt -3.4028234663852886E+38 3.4028234663852886E+38 /end CHARACTERISTIC
/begin CHARACTERISTIC Veh_tiModeSampleTime_C "" VALUE 0x70011a14 Scalar_FLOAT32_IEEE 0 VBU0428Test_CM_single_cnt -3.4028234663852886E+38 3.4028234663852886E+38 /end CHARACTERISTIC
/begin CHARACTERISTIC CaSOC_CCCorrectionMapDimension_n "" VAL_BLK 0x70011a42 Scalar_ULONG 0 VBU0428Test_CM_uint32_cnt 0.0 4.294967295E+9 NUMBER 2 /end CHARACTERISTIC
/begin CHARACTERISTIC CcFCC_ComputeResistanceRelaxationTime_ms "" VALUE 0x70010724 Scalar_ULONG 0 VBU0428Test_CM_uint32_cnt 0.0 4.294967295E+9 /end CHARACTERISTIC
/begin CHARACTERISTIC CcSOH_AfertSlowChargeEndTime_ms "" VALUE 0x70010a14 Scalar_ULONG 0 VBU0428Test_CM_uint32_cnt 0.0 4.294967295E+9 /end CHARACTERISTIC
/begin CHARACTERISTIC CcSOH_AfertSlowChargeStartTime_ms "" VALUE 0x70010a18 Scalar_ULONG 0 VBU0428Test_CM_uint32_cnt 0.0 4.294967295E+9 /end CHARACTERISTIC
/begin CHARACTERISTIC BPD_numHWBrkSwtDebounce_C "" VALUE 0x70010006 Scalar_UWORD 0 VBU0428Test_CM_uint16_cnt 0.0 65535.0 /end CHARACTERISTIC
/begin CHARACTERISTIC CcCBL_CellBalanceRespMismatchReqtTimeLmt_ms "" VALUE 0x70010054 Scalar_UWORD 0 VBU0428Test_CM_uint16_cnt 0.0 65535.0 /end CHARACTERISTIC
/begin CHARACTERISTIC CcFCC_BatteryVoltageMaxLimitDebounceTime_s "" VALUE 0x70010096 Scalar_UWORD 0 VBU0428Test_CM_uint16_cnt 0.0 65535.0 /end CHARACTERISTIC
/begin CHARACTERISTIC CcFCC_CellVoltageMaxLimitDebounceTime_s "" VALUE 0x70010098 Scalar_UWORD 0 VBU0428Test_CM_uint16_cnt 0.0 65535.0 /end CHARACTERISTIC
/begin CHARACTERISTIC CcFCC_ComputeResistanceDelayTime_ms "" VALUE 0x7001009c Scalar_UWORD 0 VBU0428Test_CM_uint16_cnt 0.0 65535.0 /end CHARACTERISTIC
/begin CHARACTERISTIC CcFCC_ComputeResistanceEndVoltage_mV "" VALUE 0x7001009e Scalar_UWORD 0 VBU0428Test_CM_uint16_cnt 0.0 65535.0 /end CHARACTERISTIC
/begin CHARACTERISTIC CcFCC_ComputeResistanceStartVoltage_mV "" VALUE 0x700100a0 Scalar_UWORD 0 VBU0428Test_CM_uint16_cnt 0.0 65535.0 /end CHARACTERISTIC
/begin CHARACTERISTIC CcFCC_HighTempDebounceTime_s "" VALUE 0x700100aa Scalar_UWORD 0 VBU0428Test_CM_uint16_cnt 0.0 65535.0 /end CHARACTERISTIC
/begin CHARACTERISTIC CcSOF_LowVoltChgCurtSloDelay_ms "" VALUE 0x700100ee Scalar_UWORD 0 VBU0428Test_CM_uint16_cnt 0.0 65535.0 /end CHARACTERISTIC
/begin CHARACTERISTIC CcSOF_LowVoltagePowerOnDelay_ms "" VALUE 0x700100f2 Scalar_UWORD 0 VBU0428Test_CM_uint16_cnt 0.0 65535.0 /end CHARACTERISTIC
/begin CHARACTERISTIC CcSOH_HistoryDataDimension_n "" VALUE 0x70010108 Scalar_UWORD 0 VBU0428Test_CM_uint16_cnt 0.0 65535.0 /end CHARACTERISTIC
/begin CHARACTERISTIC CcSYS_BalanceResistance_ohm "" VALUE 0x7001010a Scalar_UWORD 0 VBU0428Test_CM_uint16_cnt 0.0 65535.0 /end CHARACTERISTIC
/begin CHARACTERISTIC CcSYS_CellBalanceDutyCycle_pct "" VALUE 0x7001010c Scalar_UWORD 0 VBU0428Test_CM_uint16_cnt 0.0 65535.0 /end CHARACTERISTIC
/begin CHARACTERISTIC CcTHM_CoolantTempOorDebounceTime_s "" VALUE 0x70010118 Scalar_UWORD 0 VBU0428Test_CM_uint16_cnt 0.0 65535.0 /end CHARACTERISTIC
/begin CHARACTERISTIC APD_efAccPedPos_C "" VALUE 0x70021f00 Scalar_BOOLEAN 0 VBU0428Test_CM_boolean_cnt 0.0 1.0 /end CHARACTERISTIC
/begin CHARACTERISTIC APD_flgAccPedPosPctVld_C "" VALUE 0x70021f01 Scalar_BOOLEAN 0 VBU0428Test_CM_boolean_cnt 0.0 1.0 /end CHARACTERISTIC
/begin CHARACTERISTIC CGW_flgVehAccrModeCaliOvrd_C "" VALUE 0x70021fa4 Scalar_BOOLEAN 0 VBU0428Test_CM_boolean_cnt 0.0 1.0 /end CHARACTERISTIC
/begin CHARACTERISTIC CGW_flgVehCreepModeCaliOvrd_C "" VALUE 0x70021fa5 Scalar_BOOLEAN 0 VBU0428Test_CM_boolean_cnt 0.0 1.0 /end CHARACTERISTIC
/begin CHARACTERISTIC CGW_flgVehDrvModeCaliOvrd_C "" VALUE 0x70021fa6 Scalar_BOOLEAN 0 VBU0428Test_CM_boolean_cnt 0.0 1.0 /end CHARACTERISTIC
/begin CHARACTERISTIC CGW_flgVehRgnModeCaliOvrd_C "" VALUE 0x70021fa8 Scalar_BOOLEAN 0 VBU0428Test_CM_boolean_cnt 0.0 1.0 /end CHARACTERISTIC
/begin CHARACTERISTIC CbBCV_BdmBatteryBusVoltageMismatch_flg "" VALUE 0x70022000 Scalar_BOOLEAN 0 VBU0428Test_CM_boolean_cnt 0.0 1.0 /end CHARACTERISTIC
/begin CHARACTERISTIC CbBCV_BdmBatteryCurrentOoR_flg "" VALUE 0x70022001 Scalar_BOOLEAN 0 VBU0428Test_CM_boolean_cnt 0.0 1.0 /end CHARACTERISTIC
/begin CHARACTERISTIC CbBCV_BdmBatteryOverCurrent_flg "" VALUE 0x70022002 Scalar_BOOLEAN 0 VBU0428Test_CM_boolean_cnt 0.0 1.0 /end CHARACTERISTIC
/begin CHARACTERISTIC CbBCV_BdmBatteryOverVoltage_flg "" VALUE 0x70022003 Scalar_BOOLEAN 0 VBU0428Test_CM_boolean_cnt 0.0 1.0 /end CHARACTERISTIC
/begin CHARACTERISTIC CbBCV_BdmBatteryUnderVoltage_flg "" VALUE 0x70022004 Scalar_BOOLEAN 0 VBU0428Test_CM_boolean_cnt 0.0 1.0 /end CHARACTERISTIC
/begin CHARACTERISTIC CbBCV_BdmBatteryVoltageOoR_flg "" VALUE 0x70022005 Scalar_BOOLEAN 0 VBU0428Test_CM_boolean_cnt 0.0 1.0 /end CHARACTERISTIC
/begin CHARACTERISTIC CbCTD_MnNegContactorStuckOpenFaultEnable_flg "" VALUE 0x70022025 Scalar_BOOLEAN 0 VBU0428Test_CM_boolean_cnt 0.0 1.0 /end CHARACTERISTIC
/begin CHARACTERISTIC CbCTD_MnPosContactorStuckOpenFaultEnable_flg "" VALUE 0x70022027 Scalar_BOOLEAN 0 VBU0428Test_CM_boolean_cnt 0.0 1.0 /end CHARACTERISTIC
/begin CHARACTERISTIC CbCTD_PrechargeEnergyHighFaultEnable_flg "" VALUE 0x70022029 Scalar_BOOLEAN 0 VBU0428Test_CM_boolean_cnt 0.0 1.0 /end CHARACTERISTIC
/begin CHARACTERISTIC CbCTD_PrechargeHeatProtectionEnable_flg "" VALUE 0x7002202a Scalar_BOOLEAN 0 VBU0428Test_CM_boolean_cnt 0.0 1.0 /end CHARACTERISTIC
/begin CHARACTERISTIC CbCTD_RnMnNegContactorStuckOpenFaultEnable_flg "" VALUE 0x7002202f Scalar_BOOLEAN 0 VBU0428Test_CM_boolean_cnt 0.0 1.0 /end CHARACTERISTIC
/begin CHARACTERISTIC CbCTD_RnMnPosContactorStuckOpenFaultEnable_flg "" VALUE 0x70022030 Scalar_BOOLEAN 0 VBU0428Test_CM_boolean_cnt 0.0 1.0 /end CHARACTERISTIC
/begin CHARACTERISTIC CbFCC_BatteryVoltageMaxlimitEnable_flg "" VALUE 0x70022052 Scalar_BOOLEAN 0 VBU0428Test_CM_boolean_cnt 0.0 1.0 /end CHARACTERISTIC
/begin CHARACTERISTIC CbFCC_CellVoltageMaxlimitEnable_flg "" VALUE 0x70022053 Scalar_BOOLEAN 0 VBU0428Test_CM_boolean_cnt 0.0 1.0 /end CHARACTERISTIC
/begin CHARACTERISTIC CbFCC_ChargeCurrentOvR_flg "" VALUE 0x70022054 Scalar_BOOLEAN 0 VBU0428Test_CM_boolean_cnt 0.0 1.0 /end CHARACTERISTIC
/begin CHARACTERISTIC CbFCC_ComputeResistanceEnable_flg "" VALUE 0x70022057 Scalar_BOOLEAN 0 VBU0428Test_CM_boolean_cnt 0.0 1.0 /end CHARACTERISTIC
/begin CHARACTERISTIC CbFCC_NoChargeHighTempEnable_flg "" VALUE 0x70022058 Scalar_BOOLEAN 0 VBU0428Test_CM_boolean_cnt 0.0 1.0 /end CHARACTERISTIC
/begin CHARACTERISTIC CbFCC_NoChargeLowTempEnable_flg "" VALUE 0x70022059 Scalar_BOOLEAN 0 VBU0428Test_CM_boolean_cnt 0.0 1.0 /end CHARACTERISTIC
/begin CHARACTERISTIC CbSOC_DisplaySOCRateDynamicEnable_flg "" VALUE 0x70022068 Scalar_BOOLEAN 0 VBU0428Test_CM_boolean_cnt 0.0 1.0 /end CHARACTERISTIC
/begin CHARACTERISTIC CbSOC_FastChargeCCCorrection2Enable_flg "" VALUE 0x70022069 Scalar_BOOLEAN 0 VBU0428Test_CM_boolean_cnt 0.0 1.0 /end CHARACTERISTIC
/begin CHARACTERISTIC CbSOH_EepromWriteCellCapacity_flg "" VALUE 0x70022077 Scalar_BOOLEAN 0 VBU0428Test_CM_boolean_cnt 0.0 1.0 /end CHARACTERISTIC
/begin CHARACTERISTIC CcFCC_ChargeCurrentOverEnable_flg "" VALUE 0x7002217b Scalar_BOOLEAN 0 VBU0428Test_CM_boolean_cnt 0.0 1.0 /end CHARACTERISTIC
/begin CHARACTERISTIC CcFCC_ChargeCurrentOverFuncEnable_flg "" VALUE 0x7002217e Scalar_BOOLEAN 0 VBU0428Test_CM_boolean_cnt 0.0 1.0 /end CHARACTERISTIC
/begin CHARACTERISTIC CcSOF_LowVoltageChargeLimitEnable_flg "" VALUE 0x70022199 Scalar_BOOLEAN 0 VBU0428Test_CM_boolean_cnt 0.0 1.0 /end CHARACTERISTIC
/begin CHARACTERISTIC CcTHM_CoolantGradientCheckEnable_flg "" VALUE 0x700221a4 Scalar_BOOLEAN 0 VBU0428Test_CM_boolean_cnt 0.0 1.0 /end CHARACTERISTIC
/begin CHARACTERISTIC CcTHM_CoolantSensorValidEnable_flg "" VALUE 0x700221a5 Scalar_BOOLEAN 0 VBU0428Test_CM_boolean_cnt 0.0 1.0 /end CHARACTERISTIC
/begin CHARACTERISTIC Gear_flgBrkPressConfig_C "" VALUE 0x90002817 Scalar_BOOLEAN 0 VBU0428Test_CM_boolean 0 1 /end CHARACTERISTIC
/begin CHARACTERISTIC Gear_flgDriveIntendGearVld_C "" VALUE 0x7002233f Scalar_BOOLEAN 0 VBU0428Test_CM_boolean_cnt 0.0 1.0 /end CHARACTERISTIC
/begin CHARACTERISTIC Gear_flgEmotTqSelect_C "" VALUE 0x70022341 Scalar_BOOLEAN 0 VBU0428Test_CM_boolean_cnt 0.0 1.0 /end CHARACTERISTIC
/begin CHARACTERISTIC Gear_flgTorqueProtectEn_C "" VALUE 0x70022343 Scalar_BOOLEAN 0 VBU0428Test_CM_boolean_cnt 0.0 1.0 /end CHARACTERISTIC
/begin CHARACTERISTIC HIGH "" VALUE 0x70022365 Scalar_BOOLEAN 0 VBU0428Test_CM_boolean_cnt 0.0 1.0 /end CHARACTERISTIC
/begin CHARACTERISTIC LOW "" VALUE 0x70022393 Scalar_BOOLEAN 0 VBU0428Test_CM_boolean_cnt 0.0 1.0 /end CHARACTERISTIC
/begin CHARACTERISTIC LbCTS_AbortPrechargeOvrdVal_flg "" VALUE 0x70022398 Scalar_BOOLEAN 0 VBU0428Test_CM_boolean 0 1 /end CHARACTERISTIC
/begin CHARACTERISTIC LbCTS_AbortPrechargeOvrd_flg "" VALUE 0x70022399 Scalar_BOOLEAN 0 VBU0428Test_CM_boolean 0 1 /end CHARACTERISTIC
/begin CHARACTERISTIC LbCTS_InhibitPrechargeOvrdVal_flg "" VALUE 0x7002239a Scalar_BOOLEAN 0 VBU0428Test_CM_boolean 0 1 /end CHARACTERISTIC
/begin CHARACTERISTIC LbCTS_InhibitPrechargeOvrd_flg "" VALUE 0x7002239b Scalar_BOOLEAN 0 VBU0428Test_CM_boolean 0 1 /end CHARACTERISTIC
/begin CHARACTERISTIC STC_flgRgnTrqCnclRA_C "" VALUE 0x70022423 Scalar_BOOLEAN 0 VBU0428Test_CM_boolean_cnt 0.0 1.0 /end CHARACTERISTIC
/begin CHARACTERISTIC TQDIS_flgLowPassFacCalFilter_C "" VALUE 0x7002244c Scalar_BOOLEAN 0 VBU0428Test_CM_boolean_cnt 0.0 1.0 /end CHARACTERISTIC
/begin CHARACTERISTIC TQDIS_flgUseFacCalFilter_C "" VALUE 0x7002244d Scalar_BOOLEAN 0 VBU0428Test_CM_boolean_cnt 0.0 1.0 /end CHARACTERISTIC
/begin CHARACTERISTIC TQDMP_flgROTCDisblORF "" VALUE 0x70022450 Scalar_BOOLEAN 0 VBU0428Test_CM_boolean 0 1 /end CHARACTERISTIC
/begin CHARACTERISTIC TQDMP_flgROTCDisblORV "" VALUE 0x70022451 Scalar_BOOLEAN 0 VBU0428Test_CM_boolean 0 1 /end CHARACTERISTIC
/begin CHARACTERISTIC TQD_flgBrkPresUsed_C "" VALUE 0x70022458 Scalar_BOOLEAN 0 VBU0428Test_CM_boolean_cnt 0.0 1.0 /end CHARACTERISTIC
/begin CHARACTERISTIC TQD_flgCreepFnctnEna_C "" VALUE 0x70022459 Scalar_BOOLEAN 0 VBU0428Test_CM_boolean_cnt 0.0 1.0 /end CHARACTERISTIC
/begin CHARACTERISTIC TQD_flgSlpEna_C "" VALUE 0x0000 Scalar_BOOLEAN 0 VBU0428Test_CM_boolean_cnt 0.0 1.0 /end CHARACTERISTIC
/begin CHARACTERISTIC TQD_flgTrqMinEn_C "" VALUE 0x7002245a Scalar_BOOLEAN 0 VBU0428Test_CM_boolean_cnt 0.0 1.0 /end CHARACTERISTIC
/begin CHARACTERISTIC VTQA_flgActDrvTrqLimORF "" VALUE 0x70022473 Scalar_BOOLEAN 0 VBU0428Test_CM_boolean 0 1 /end CHARACTERISTIC
/begin CHARACTERISTIC VTQA_flgActRgnTrqLimORF "" VALUE 0x70022474 Scalar_BOOLEAN 0 VBU0428Test_CM_boolean 0 1 /end CHARACTERISTIC
/begin CHARACTERISTIC VTQA_flgAxleMaxORF "" VALUE 0x70022475 Scalar_BOOLEAN 0 VBU0428Test_CM_boolean 0 1 /end CHARACTERISTIC
/begin CHARACTERISTIC VTQA_flgAxleMinORF "" VALUE 0x70022476 Scalar_BOOLEAN 0 VBU0428Test_CM_boolean 0 1 /end CHARACTERISTIC
/begin CHARACTERISTIC Veh_flgNetworkPartialEn_C "" VALUE 0x7002247c Scalar_BOOLEAN 0 VBU0428Test_CM_boolean_cnt 0.0 1.0 /end CHARACTERISTIC
/begin CHARACTERISTIC CcBCV_BdmBatteryBusVoltageMismatchFaultFIC_n "" VALUE 0x70022124 Scalar_BYTE 0 VBU0428Test_CM_int8_cnt -128.0 127.0 /end CHARACTERISTIC
/begin CHARACTERISTIC CcBCV_BdmBatteryBusVoltageMismatchFaultPIC_n "" VALUE 0x70022125 Scalar_BYTE 0 VBU0428Test_CM_int8_cnt -128.0 127.0 /end CHARACTERISTIC
/begin CHARACTERISTIC CcBCV_BdmBatteryCurrentOoRFaultFIC_n "" VALUE 0x70022126 Scalar_BYTE 0 VBU0428Test_CM_int8_cnt -128.0 127.0 /end CHARACTERISTIC
/begin CHARACTERISTIC CcBCV_BdmBatteryCurrentOoRFaultPIC_n "" VALUE 0x70022127 Scalar_BYTE 0 VBU0428Test_CM_int8_cnt -128.0 127.0 /end CHARACTERISTIC
/begin CHARACTERISTIC CcBCV_BdmBatteryOverCurrentFaultFIC_n "" VALUE 0x70022128 Scalar_BYTE 0 VBU0428Test_CM_int8_cnt -128.0 127.0 /end CHARACTERISTIC
/begin CHARACTERISTIC CcBCV_BdmBatteryOverCurrentFaultPIC_n "" VALUE 0x70022129 Scalar_BYTE 0 VBU0428Test_CM_int8_cnt -128.0 127.0 /end CHARACTERISTIC
/begin CHARACTERISTIC CcBCV_BdmBatteryOverVoltageFaultFIC_n "" VALUE 0x7002212a Scalar_BYTE 0 VBU0428Test_CM_int8_cnt -128.0 127.0 /end CHARACTERISTIC
/begin CHARACTERISTIC CcBCV_BdmBatteryOverVoltageFaultPIC_n "" VALUE 0x7002212b Scalar_BYTE 0 VBU0428Test_CM_int8_cnt -128.0 127.0 /end CHARACTERISTIC
/begin CHARACTERISTIC CcBCV_BdmBatteryUnderVoltageFaultFIC_n "" VALUE 0x7002212c Scalar_BYTE 0 VBU0428Test_CM_int8_cnt -128.0 127.0 /end CHARACTERISTIC
/begin CHARACTERISTIC CcBCV_BdmBatteryUnderVoltageFaultPIC_n "" VALUE 0x7002212d Scalar_BYTE 0 VBU0428Test_CM_int8_cnt -128.0 127.0 /end CHARACTERISTIC
/begin CHARACTERISTIC CcBCV_BdmBatteryVoltageOoRFaultFIC_n "" VALUE 0x7002212e Scalar_BYTE 0 VBU0428Test_CM_int8_cnt -128.0 127.0 /end CHARACTERISTIC
/begin CHARACTERISTIC CcBCV_BdmBatteryVoltageOoRFaultPIC_n "" VALUE 0x7002212f Scalar_BYTE 0 VBU0428Test_CM_int8_cnt -128.0 127.0 /end CHARACTERISTIC
/begin CHARACTERISTIC CcCTD_MnNegContactorStuckOpenFaultFIC_n "" VALUE 0x70022138 Scalar_BYTE 0 VBU0428Test_CM_int8_cnt -128.0 127.0 /end CHARACTERISTIC
/begin CHARACTERISTIC CcCTD_MnNegContactorStuckOpenFaultPIC_n "" VALUE 0x70022139 Scalar_BYTE 0 VBU0428Test_CM_int8_cnt -128.0 127.0 /end CHARACTERISTIC
/begin CHARACTERISTIC CcCTD_MnPosContactorStuckOpenFaultFIC_n "" VALUE 0x7002213c Scalar_BYTE 0 VBU0428Test_CM_int8_cnt -128.0 127.0 /end CHARACTERISTIC
/begin CHARACTERISTIC CcCTD_MnPosContactorStuckOpenFaultPIC_n "" VALUE 0x7002213d Scalar_BYTE 0 VBU0428Test_CM_int8_cnt -128.0 127.0 /end CHARACTERISTIC
/begin CHARACTERISTIC CcCTD_PrechargeEnergyHighFaultFIC_n "" VALUE 0x70022140 Scalar_BYTE 0 VBU0428Test_CM_int8_cnt -128.0 127.0 /end CHARACTERISTIC
/begin CHARACTERISTIC CcCTD_PrechargeEnergyHighFaultPIC_n "" VALUE 0x70022141 Scalar_BYTE 0 VBU0428Test_CM_int8_cnt -128.0 127.0 /end CHARACTERISTIC
/begin CHARACTERISTIC CcCTD_RnMnNegContactorStuckOpenFaultFIC_n "" VALUE 0x70022148 Scalar_BYTE 0 VBU0428Test_CM_int8_cnt -128.0 127.0 /end CHARACTERISTIC
/begin CHARACTERISTIC CcCTD_RnMnNegContactorStuckOpenFaultPIC_n "" VALUE 0x70022149 Scalar_BYTE 0 VBU0428Test_CM_int8_cnt -128.0 127.0 /end CHARACTERISTIC
/begin CHARACTERISTIC CcCTD_RnMnPosContactorStuckOpenFaultFIC_n "" VALUE 0x7002214a Scalar_BYTE 0 VBU0428Test_CM_int8_cnt -128.0 127.0 /end CHARACTERISTIC
/begin CHARACTERISTIC CcCTD_RnMnPosContactorStuckOpenFaultPIC_n "" VALUE 0x7002214b Scalar_BYTE 0 VBU0428Test_CM_int8_cnt -128.0 127.0 /end CHARACTERISTIC
/begin CHARACTERISTIC APD_stConfirmErr_C "" VALUE 0x70021f03 Scalar_UBYTE 0 VBU0428Test_CM_uint8_cnt 0.0 15.0 /end CHARACTERISTIC
/begin CHARACTERISTIC APD_stNoErr_C "" VALUE 0x70021f04 Scalar_UBYTE 0 VBU0428Test_CM_uint8_cnt 0.0 15.0 /end CHARACTERISTIC
/begin CHARACTERISTIC BATTERY_BOL_SOH "" VALUE 0x70021f5c Scalar_UBYTE 0 VBU0428Test_CM_uint8_cnt 0.0 255.0 /end CHARACTERISTIC
/begin CHARACTERISTIC BATTERY_EOL_SOH "" VALUE 0x70021f63 Scalar_UBYTE 0 VBU0428Test_CM_uint8_cnt 0.0 255.0 /end CHARACTERISTIC
/begin CHARACTERISTIC BPD_stBrkPedPrsActv_C "" VALUE 0x70021f8c Scalar_UBYTE 0 VBU0428Test_CM_uint8_cnt 0.0 15.0 /end CHARACTERISTIC
/begin CHARACTERISTIC BPD_stBrkPedPrsPsbl_C "" VALUE 0x70021f8e Scalar_UBYTE 0 VBU0428Test_CM_uint8_cnt 0.0 15.0 /end CHARACTERISTIC
/begin CHARACTERISTIC BPD_stBrkSwtConfig_C "" VALUE 0x70021f8f Scalar_UBYTE 0 VBU0428Test_CM_uint8_cnt 0.0 255.0 /end CHARACTERISTIC
/begin CHARACTERISTIC CDC_stVehAccr2Mod_C "" VALUE 0x70021f97 Scalar_UBYTE 0 VBU0428Test_CM_uint8_cnt 0.0 15.0 /end CHARACTERISTIC
/begin CHARACTERISTIC CDC_stVehAccrNormalMod_C "" VALUE 0x70021f98 Scalar_UBYTE 0 VBU0428Test_CM_uint8_cnt 0.0 15.0 /end CHARACTERISTIC
/begin CHARACTERISTIC CDC_stVehAccrSportMod_C "" VALUE 0x70021f99 Scalar_UBYTE 0 VBU0428Test_CM_uint8_cnt 0.0 15.0 /end CHARACTERISTIC
/begin CHARACTERISTIC CDC_stVehAutoMod_C "" VALUE 0x70021f9a Scalar_UBYTE 0 VBU0428Test_CM_uint8_cnt 0.0 15.0 /end CHARACTERISTIC
/begin CHARACTERISTIC CDC_stVehCreepON_C "" VALUE 0x70021f9b Scalar_UBYTE 0 VBU0428Test_CM_uint8_cnt 0.0 15.0 /end CHARACTERISTIC
/begin CHARACTERISTIC CDC_stVehCreepOffRgnOff_C "" VALUE 0x70021f9c Scalar_UBYTE 0 VBU0428Test_CM_uint8_cnt 0.0 15.0 /end CHARACTERISTIC
/begin CHARACTERISTIC CDC_stVehCreepOff_C "" VALUE 0x70021f9d Scalar_UBYTE 0 VBU0428Test_CM_uint8_cnt 0.0 15.0 /end CHARACTERISTIC
/begin CHARACTERISTIC CDC_stVehCreepOnRgnLow_C "" VALUE 0x70021f9e Scalar_UBYTE 0 VBU0428Test_CM_uint8_cnt 0.0 15.0 /end CHARACTERISTIC
/begin CHARACTERISTIC CDC_stVehCreepOnRgnNormal_C "" VALUE 0x70021f9f Scalar_UBYTE 0 VBU0428Test_CM_uint8_cnt 0.0 15.0 /end CHARACTERISTIC
/begin CHARACTERISTIC CDC_stVehCreepOnRgnZero_C "" VALUE 0x70021fa0 Scalar_UBYTE 0 VBU0428Test_CM_uint8_cnt 0.0 15.0 /end CHARACTERISTIC
/begin CHARACTERISTIC CDC_stVehECOMod_C "" VALUE 0x70021fa1 Scalar_UBYTE 0 VBU0428Test_CM_uint8_cnt 0.0 15.0 /end CHARACTERISTIC
/begin CHARACTERISTIC CGW_stVehAccr2Mod_C "" VALUE 0x70021fa9 Scalar_UBYTE 0 VBU0428Test_CM_uint8_cnt 0.0 15.0 /end CHARACTERISTIC
/begin CHARACTERISTIC CGW_stVehAccrModeCaliOvrdVal_C "" VALUE 0x70021faa Scalar_UBYTE 0 VBU0428Test_CM_uint8_cnt 0.0 15.0 /end CHARACTERISTIC
/begin CHARACTERISTIC CGW_stVehAccrNormalMod_C "" VALUE 0x70021fab Scalar_UBYTE 0 VBU0428Test_CM_uint8_cnt 0.0 15.0 /end CHARACTERISTIC
/begin CHARACTERISTIC CGW_stVehAccrSportMod_C "" VALUE 0x70021fac Scalar_UBYTE 0 VBU0428Test_CM_uint8_cnt 0.0 15.0 /end CHARACTERISTIC
/begin CHARACTERISTIC CGW_stVehCreepModeCaliOvrdVal_C "" VALUE 0x70021fad Scalar_UBYTE 0 VBU0428Test_CM_uint8_cnt 0.0 15.0 /end CHARACTERISTIC
/begin CHARACTERISTIC CGW_stVehCreepOff_C "" VALUE 0x70021fae Scalar_UBYTE 0 VBU0428Test_CM_uint8_cnt 0.0 15.0 /end CHARACTERISTIC
/begin CHARACTERISTIC CGW_stVehCreepOn_C "" VALUE 0x70021faf Scalar_UBYTE 0 VBU0428Test_CM_uint8_cnt 0.0 15.0 /end CHARACTERISTIC
/begin CHARACTERISTIC CGW_stVehDrvModeCaliOvrdVal_C "" VALUE 0x70021fb0 Scalar_UBYTE 0 VBU0428Test_CM_uint8_cnt 0.0 15.0 /end CHARACTERISTIC
/begin CHARACTERISTIC CGW_stVehECOMod_C "" VALUE 0x70021fb2 Scalar_UBYTE 0 VBU0428Test_CM_uint8_cnt 0.0 15.0 /end CHARACTERISTIC
/begin CHARACTERISTIC CGW_stVehNormalMod_C "" VALUE 0x70021fb3 Scalar_UBYTE 0 VBU0428Test_CM_uint8_cnt 0.0 15.0 /end CHARACTERISTIC
/begin CHARACTERISTIC CGW_stVehRgnLow_C "" VALUE 0x70021fb4 Scalar_UBYTE 0 VBU0428Test_CM_uint8_cnt 0.0 15.0 /end CHARACTERISTIC
/begin CHARACTERISTIC CGW_stVehRgnModeCaliOvrdVal_C "" VALUE 0x70021fb5 Scalar_UBYTE 0 VBU0428Test_CM_uint8_cnt 0.0 15.0 /end CHARACTERISTIC
/begin CHARACTERISTIC CGW_stVehRgnNormal_C "" VALUE 0x70021fb8 Scalar_UBYTE 0 VBU0428Test_CM_uint8_cnt 0.0 15.0 /end CHARACTERISTIC
/begin CHARACTERISTIC CGW_stVehRgnOff_C "" VALUE 0x70021fb9 Scalar_UBYTE 0 VBU0428Test_CM_uint8_cnt 0.0 15.0 /end CHARACTERISTIC
/begin CHARACTERISTIC CGW_stVehRgnZero_C "" VALUE 0x70021fba Scalar_UBYTE 0 VBU0428Test_CM_uint8_cnt 0.0 15.0 /end CHARACTERISTIC
/begin CHARACTERISTIC CGW_stVehSportMod_C "" VALUE 0x70021fbb Scalar_UBYTE 0 VBU0428Test_CM_uint8_cnt 0.0 15.0 /end CHARACTERISTIC
/begin CHARACTERISTIC CTD_MAIN_NEGATIVE_CONTACTOR_STUCK_OPEN_FAULT "" VALUE 0x70021fd5 Scalar_UBYTE 0 VBU0428Test_CM_uint8_cnt 0.0 255.0 /end CHARACTERISTIC
/begin CHARACTERISTIC CTD_MAIN_POSITIVE_CONTACTOR_STUCK_OPEN_FAULT "" VALUE 0x70021fd6 Scalar_UBYTE 0 VBU0428Test_CM_uint8_cnt 0.0 255.0 /end CHARACTERISTIC
/begin CHARACTERISTIC CTD_PRECHARGE_STATUS_IDLE "" VALUE 0x70021fd9 Scalar_UBYTE 0 VBU0428Test_CM_uint8_cnt 0.0 255.0 /end CHARACTERISTIC
/begin CHARACTERISTIC CaFCC_VCRVCUAuxPowerFactorVoltageTempMapDimension_n "" VAL_BLK 0x70022492 Scalar_UBYTE 0 VBU0428Test_CM_uint8_cnt 0.0 255.0 NUMBER 2 /end CHARACTERISTIC
/begin CHARACTERISTIC CcSOE_MaxInterationNumber_n "" VALUE 0x70022192 Scalar_UBYTE 0 VBU0428Test_CM_uint8_cnt 0.0 255.0 /end CHARACTERISTIC
/begin CHARACTERISTIC EPB_CompleteTight "" VALUE 0x7002230b Scalar_UBYTE 0 VBU0428Test_CM_uint8 0 255 /end CHARACTERISTIC
/begin CHARACTERISTIC EPB_stApplying "" VALUE 0x7002230e Scalar_UBYTE 0 VBU0428Test_CM_uint8 0 255 /end CHARACTERISTIC
/begin CHARACTERISTIC EPB_stClosed "" VALUE 0x7002230f Scalar_UBYTE 0 VBU0428Test_CM_uint8_cnt 0.0 255.0 /end CHARACTERISTIC
/begin CHARACTERISTIC Gear_stBCUEPBSwtPressed_C "" VALUE 0x70022344 Scalar_UBYTE 0 VBU0428Test_CM_uint8_cnt 0.0 15.0 /end CHARACTERISTIC
/begin CHARACTERISTIC Gear_stCurrentGearD_C "" VALUE 0x70022345 Scalar_UBYTE 0 VBU0428Test_CM_uint8_cnt 0.0 15.0 /end CHARACTERISTIC
/begin CHARACTERISTIC Gear_stCurrentGearR_C "" VALUE 0x7002234a Scalar_UBYTE 0 VBU0428Test_CM_uint8_cnt 0.0 15.0 /end CHARACTERISTIC
/begin CHARACTERISTIC Gear_stEPBApplied_C "" VALUE 0x7002234f Scalar_UBYTE 0 VBU0428Test_CM_uint8_cnt 0.0 15.0 /end CHARACTERISTIC
/begin CHARACTERISTIC Gear_stEPBApplyReq_C "" VALUE 0x70022350 Scalar_UBYTE 0 VBU0428Test_CM_uint8_cnt 0.0 15.0 /end CHARACTERISTIC
/begin CHARACTERISTIC Gear_stEPBFailNoErr_C "" VALUE 0x70022351 Scalar_UBYTE 0 VBU0428Test_CM_uint8_cnt 0.0 15.0 /end CHARACTERISTIC
/begin CHARACTERISTIC Gear_stEPBNoApplyReq_C "" VALUE 0x70022352 Scalar_UBYTE 0 VBU0428Test_CM_uint8_cnt 0.0 15.0 /end CHARACTERISTIC
/begin CHARACTERISTIC Gear_stEPBReleased_C "" VALUE 0x70022353 Scalar_UBYTE 0 VBU0428Test_CM_uint8_cnt 0.0 15.0 /end CHARACTERISTIC
/begin CHARACTERISTIC Gear_stEPBUnknow_C "" VALUE 0x70022355 Scalar_UBYTE 0 VBU0428Test_CM_uint8_cnt 0.0 15.0 /end CHARACTERISTIC
/begin CHARACTERISTIC Gear_stHVRelayClosed_C "" VALUE 0x70022359 Scalar_UBYTE 0 VBU0428Test_CM_uint8_cnt 0.0 15.0 /end CHARACTERISTIC
/begin CHARACTERISTIC Gear_stIntendGearP_C "" VALUE 0x7002235c Scalar_UBYTE 0 VBU0428Test_CM_uint8_cnt 0.0 15.0 /end CHARACTERISTIC
/begin CHARACTERISTIC Gear_stVehModeDCH_C "" VALUE 0x7002235e Scalar_UBYTE 0 VBU0428Test_CM_uint8_cnt 0.0 15.0 /end CHARACTERISTIC
/begin CHARACTERISTIC SOC_JUMP_ABNORMAL_POWER_OFF "" VALUE 0x7002240e Scalar_UBYTE 0 VBU0428Test_CM_uint8_cnt 0.0 255.0 /end CHARACTERISTIC
/begin CHARACTERISTIC SOC_JUMP_ABNORMAL_RESET "" VALUE 0x7002240f Scalar_UBYTE 0 VBU0428Test_CM_uint8_cnt 0.0 255.0 /end CHARACTERISTIC
/begin CHARACTERISTIC SOC_JUMP_NONE "" VALUE 0x70022410 Scalar_UBYTE 0 VBU0428Test_CM_uint8_cnt 0.0 255.0 /end CHARACTERISTIC
/begin CHARACTERISTIC SOC_JUMP_OCV_CORRECTION "" VALUE 0x70022411 Scalar_UBYTE 0 VBU0428Test_CM_uint8_cnt 0.0 255.0 /end CHARACTERISTIC
/begin CHARACTERISTIC STC_stRgnABS_SY "" VALUE 0x70022424 Scalar_UBYTE 0 VBU0428Test_CM_uint8_cnt 0.0 255.0 /end CHARACTERISTIC
/begin CHARACTERISTIC STC_stRgnNrm_SY "" VALUE 0x70022425 Scalar_UBYTE 0 VBU0428Test_CM_uint8_cnt 0.0 255.0 /end CHARACTERISTIC
/begin CHARACTERISTIC STC_stRgnPI_SY "" VALUE 0x70022426 Scalar_UBYTE 0 VBU0428Test_CM_uint8_cnt 0.0 255.0 /end CHARACTERISTIC
/begin CHARACTERISTIC STC_stRgnRev_SY "" VALUE 0x70022427 Scalar_UBYTE 0 VBU0428Test_CM_uint8_cnt 0.0 255.0 /end CHARACTERISTIC
/begin CHARACTERISTIC SYS_stMCUErr_SY "" VALUE 0x7002242b Scalar_UBYTE 0 VBU0428Test_CM_uint8_cnt 0.0 255.0 /end CHARACTERISTIC
/begin CHARACTERISTIC Veh_stCGWNetworkPartial_C "" VALUE 0x7002247d Scalar_UBYTE 0 VBU0428Test_CM_uint8_cnt 0.0 15.0 /end CHARACTERISTIC
/begin CHARACTERISTIC Veh_stDCPortTempErr_C "" VALUE 0x7002247e Scalar_UBYTE 0 VBU0428Test_CM_uint8_cnt 0.0 15.0 /end CHARACTERISTIC
/begin CHARACTERISTIC Veh_stDCPortTempNoErr_C "" VALUE 0x7002247f Scalar_UBYTE 0 VBU0428Test_CM_uint8_cnt 0.0 15.0 /end CHARACTERISTIC
/begin MEASUREMENT VCT_numBMSProtocalVersion "" ULONG VBU0428Test_CM_uint32 0 0 0 4294967295 ECU_ADDRESS 0x90000064 /end MEASUREMENT
/begin MEASUREMENT LcCTD_tiPrechargeHeatProtectionTime "" ULONG VBU0428Test_CM_uint32 0 0 0 4294967295 ECU_ADDRESS 0x6003bfaa /end MEASUREMENT
/begin MEASUREMENT BPD_pBrkPress "" FLOAT32_IEEE VBU0428Test_CM_single 0 0 -3.4E+38 3.4E+38 ECU_ADDRESS 0x6003bdc2 /end MEASUREMENT
/begin MEASUREMENT BPD_pctBrkPress "" FLOAT32_IEEE VBU0428Test_CM_single 0 0 -3.4E+38 3.4E+38 ECU_ADDRESS 0x6003bdca /end MEASUREMENT
/begin MEASUREMENT BPD_pctBrkPressPercent "" FLOAT32_IEEE VBU0428Test_CM_single 0 0 -3.4E+38 3.4E+38 ECU_ADDRESS 0x6003bdce /end MEASUREMENT
/begin MEASUREMENT BPD_pctBrkPos "" FLOAT32_IEEE VBU0428Test_CM_single 0 0 -3.4E+38 3.4E+38 ECU_ADDRESS 0x6003bdc6 /end MEASUREMENT
/begin MEASUREMENT SPD_vMotrSpd "" FLOAT32_IEEE VBU0428Test_CM_single 0 0 -3.4E+38 3.4E+38 ECU_ADDRESS 0x6003bc86 /end MEASUREMENT
/begin MEASUREMENT APD_pctAccPedPos "" FLOAT32_IEEE VBU0428Test_CM_single 0 0 -3.4E+38 3.4E+38 ECU_ADDRESS 0x6003bdb2 /end MEASUREMENT
/begin MEASUREMENT SPD_pctSlope "" FLOAT32_IEEE VBU0428Test_CM_single 0 0 -3.4E+38 3.4E+38 ECU_ADDRESS 0x6003bc7a /end MEASUREMENT
/begin MEASUREMENT VTQA_trqBrkTrqMax "" FLOAT32_IEEE VBU0428Test_CM_single 0 0 -10000.0 10000.0 ECU_ADDRESS 0x6003bece /end MEASUREMENT
/begin MEASUREMENT VTQA_trqBcuTrqMax "" FLOAT32_IEEE VBU0428Test_CM_single 0 0 -10000.0 10000.0 ECU_ADDRESS 0x6003beca /end MEASUREMENT
/begin MEASUREMENT VTQA_trqBattTrqMax "" FLOAT32_IEEE VBU0428Test_CM_single 0 0 -10000.0 10000.0 ECU_ADDRESS 0x6003bec2 /end MEASUREMENT
/begin MEASUREMENT VTQA_trqMotTrqMax "" FLOAT32_IEEE VBU0428Test_CM_single 0 0 -10000.0 10000.0 ECU_ADDRESS 0x6003beda /end MEASUREMENT
/begin MEASUREMENT VTQA_trqLimpTrqMax "" FLOAT32_IEEE VBU0428Test_CM_single 0 0 -10000.0 10000.0 ECU_ADDRESS 0x6003bed6 /end MEASUREMENT
/begin MEASUREMENT VTQA_trqLimpByPmpTrqMax "" FLOAT32_IEEE VBU0428Test_CM_single 0 0 -10000.0 10000.0 ECU_ADDRESS 0x6003bed2 /end MEASUREMENT
/begin MEASUREMENT VTQA_trqAxleMax "" FLOAT32_IEEE VBU0428Test_CM_single 0 0 -10000.0 10000.0 ECU_ADDRESS 0x6003beba /end MEASUREMENT
/begin MEASUREMENT VTQA_trqBattTrqMin "" FLOAT32_IEEE VBU0428Test_CM_single 0 0 -10000.0 10000.0 ECU_ADDRESS 0x6003bec6 /end MEASUREMENT
/begin MEASUREMENT VTQA_trqMotTrqMin "" FLOAT32_IEEE VBU0428Test_CM_single 0 0 -10000.0 10000.0 ECU_ADDRESS 0x6003bede /end MEASUREMENT
/begin MEASUREMENT VTQA_trqActvLimpLimit "" FLOAT32_IEEE VBU0428Test_CM_single 0 0 -3.4E+38 3.4E+38 ECU_ADDRESS 0x9000022c /end MEASUREMENT
/begin MEASUREMENT VTQA_trqInhibRegenLimit "" FLOAT32_IEEE VBU0428Test_CM_single 0 0 -3.4E+38 3.4E+38 ECU_ADDRESS 0x90000230 /end MEASUREMENT
/begin MEASUREMENT VTQA_trqABSFailLimit "" FLOAT32_IEEE VBU0428Test_CM_single 0 0 -3.4E+38 3.4E+38 ECU_ADDRESS 0x90000228 /end MEASUREMENT
/begin MEASUREMENT VTQA_trqAxleMin "" FLOAT32_IEEE VBU0428Test_CM_single 0 0 -10000.0 10000.0 ECU_ADDRESS 0x6003bebe /end MEASUREMENT
/begin MEASUREMENT VTQA_trqDes "" FLOAT32_IEEE VBU0428Test_CM_single 0 0 -3.4E+38 3.4E+38 ECU_ADDRESS 0x6003bdae /end MEASUREMENT
/begin MEASUREMENT VTQA_trqRMotrPos "" FLOAT32_IEEE VBU0428Test_CM_single 0 0 -10000.0 10000.0 ECU_ADDRESS 0x6003bee6 /end MEASUREMENT
/begin MEASUREMENT VTQA_trqRMotrNeg "" FLOAT32_IEEE VBU0428Test_CM_single 0 0 -10000.0 10000.0 ECU_ADDRESS 0x6003bee2 /end MEASUREMENT
/begin MEASUREMENT VTQA_pwrRMotActRgnLoss "" FLOAT32_IEEE VBU0428Test_CM_single 0 0 0.0 100.0 ECU_ADDRESS 0x6003beb6 /end MEASUREMENT
/begin MEASUREMENT VTQA_pwrRMotActDrvLoss "" FLOAT32_IEEE VBU0428Test_CM_single 0 0 0.0 100.0 ECU_ADDRESS 0x6003beb2 /end MEASUREMENT
/begin MEASUREMENT VTQA_trqActRgnTrqLim "" FLOAT32_IEEE VBU0428Test_CM_single 0 0 -2000.0 2000.0 ECU_ADDRESS 0x6003bdaa /end MEASUREMENT
/begin MEASUREMENT VTQA_trqActDrvTrqLim "" FLOAT32_IEEE VBU0428Test_CM_single 0 0 -2000.0 2000.0 ECU_ADDRESS 0x6003bda6 /end MEASUREMENT
/begin MEASUREMENT MTQL_trqDnAbsLimR "" FLOAT32_IEEE VBU0428Test_CM_single 0 0 -3.4E+38 3.4E+38 ECU_ADDRESS 0x6003bb96 /end MEASUREMENT
/begin MEASUREMENT MTQL_trqRMotrFIDDrvLim "" FLOAT32_IEEE VBU0428Test_CM_single 0 0 -10000.0 10000.0 ECU_ADDRESS 0x6003be52 /end MEASUREMENT
/begin MEASUREMENT TQDMP_trqCompRA "" FLOAT32_IEEE VBU0428Test_CM_single 0 0 -10000.0 10000.0 ECU_ADDRESS 0x6003bd56 /end MEASUREMENT
/begin MEASUREMENT TQO_facFilter "" FLOAT32_IEEE VBU0428Test_CM_single 0 0 -3.4E+38 3.4E+38 ECU_ADDRESS 0x6003bd8a /end MEASUREMENT
/begin MEASUREMENT TQARB_TrqRgnRA "" FLOAT32_IEEE VBU0428Test_CM_single 0 0 -10000.0 10000.0 ECU_ADDRESS 0x6003bca6 /end MEASUREMENT
/begin MEASUREMENT TQARB_trqArbRA2 "" FLOAT32_IEEE VBU0428Test_CM_single 0 0 -3.4E+38 3.4E+38 ECU_ADDRESS 0x90000218 /end MEASUREMENT
/begin MEASUREMENT TQARB_trqBattRAMax "" FLOAT32_IEEE VBU0428Test_CM_single 0 0 -10000.0 10000.0 ECU_ADDRESS 0x6003bcb2 /end MEASUREMENT
/begin MEASUREMENT TQARB_trqBattRAMin "" FLOAT32_IEEE VBU0428Test_CM_single 0 0 -10000.0 10000.0 ECU_ADDRESS 0x6003bcb6 /end MEASUREMENT
/begin MEASUREMENT TQARB_trqArbRA1 "" FLOAT32_IEEE VBU0428Test_CM_single 0 0 -10000.0 10000.0 ECU_ADDRESS 0x6003bcae /end MEASUREMENT
/begin MEASUREMENT TQARB_trqArbRA "" FLOAT32_IEEE VBU0428Test_CM_single 0 0 -10000.0 10000.0 ECU_ADDRESS 0x6003bcaa /end MEASUREMENT
/begin MEASUREMENT STC_trqRgnDTCRA "" FLOAT32_IEEE VBU0428Test_CM_single 0 0 -10000.0 10000.0 ECU_ADDRESS 0x6003bc9a /end MEASUREMENT
/begin MEASUREMENT STC_trqRgnRA "" FLOAT32_IEEE VBU0428Test_CM_single 0 0 -10000.0 10000.0 ECU_ADDRESS 0x6003bca2 /end MEASUREMENT
/begin MEASUREMENT STC_trqRgnABSRA "" FLOAT32_IEEE VBU0428Test_CM_single 0 0 -10000.0 10000.0 ECU_ADDRESS 0x6003bc96 /end MEASUREMENT
/begin MEASUREMENT TQDIS_trqRAPropLim "" FLOAT32_IEEE VBU0428Test_CM_single 0 0 -10000.0 10000.0 ECU_ADDRESS 0x6003bd3a /end MEASUREMENT
/begin MEASUREMENT TQDIS_trqRARgnLim "" FLOAT32_IEEE VBU0428Test_CM_single 0 0 -10000.0 10000.0 ECU_ADDRESS 0x6003bd3e /end MEASUREMENT
/begin MEASUREMENT TQDIS_trqForFacCal "" FLOAT32_IEEE VBU0428Test_CM_single 0 0 -10000.0 10000.0 ECU_ADDRESS 0x6003bd16 /end MEASUREMENT
/begin MEASUREMENT TQDIS_trqPreDisRA0 "" FLOAT32_IEEE VBU0428Test_CM_single 0 0 -10000.0 10000.0 ECU_ADDRESS 0x6003bd22 /end MEASUREMENT
/begin MEASUREMENT TQDIS_trqBrkRgnTarRA "" FLOAT32_IEEE VBU0428Test_CM_single 0 0 -10000.0 10000.0 ECU_ADDRESS 0x6003bcee /end MEASUREMENT
/begin MEASUREMENT TQDIS_trqRgnRAReq "" FLOAT32_IEEE VBU0428Test_CM_single 0 0 -10000.0 10000.0 ECU_ADDRESS 0x6003bd46 /end MEASUREMENT
/begin MEASUREMENT TQDIS_trqPreDisRA "" FLOAT32_IEEE VBU0428Test_CM_single 0 0 -10000.0 10000.0 ECU_ADDRESS 0x6003bd1e /end MEASUREMENT
/begin MEASUREMENT TQDIS_trqRALim "" FLOAT32_IEEE VBU0428Test_CM_single 0 0 -10000.0 10000.0 ECU_ADDRESS 0x6003bd36 /end MEASUREMENT
/begin MEASUREMENT TQD_vVehSpd "" FLOAT32_IEEE VBU0428Test_CM_single 0 0 -3.4E+38 3.4E+38 ECU_ADDRESS 0x6003bd86 /end MEASUREMENT
/begin MEASUREMENT TQD_pBrkPress "" FLOAT32_IEEE VBU0428Test_CM_single 0 0 -3.4E+38 3.4E+38 ECU_ADDRESS 0x6003bd72 /end MEASUREMENT
/begin MEASUREMENT TQD_facBrkPresCrpMod "" FLOAT32_IEEE VBU0428Test_CM_single 0 0 -3.4E+38 3.4E+38 ECU_ADDRESS 0x6003be7a /end MEASUREMENT
/begin MEASUREMENT TQD_facBrkPosCrpMod "" FLOAT32_IEEE VBU0428Test_CM_single 0 0 0.0 1.0 ECU_ADDRESS 0x6003be76 /end MEASUREMENT
/begin MEASUREMENT TQD_facBrkCrpPct "" FLOAT32_IEEE VBU0428Test_CM_single 0 0 -3.4E+38 3.4E+38 ECU_ADDRESS 0x6003bd6e /end MEASUREMENT
/begin MEASUREMENT TQD_trqCrpCst "" FLOAT32_IEEE VBU0428Test_CM_single 0 0 -10000.0 10000.0 ECU_ADDRESS 0x6003be8e /end MEASUREMENT
/begin MEASUREMENT TQD_trqCrpMode "" FLOAT32_IEEE VBU0428Test_CM_single 0 0 -10000.0 10000.0 ECU_ADDRESS 0x6003be92 /end MEASUREMENT
/begin MEASUREMENT TQD_trqCor "" FLOAT32_IEEE VBU0428Test_CM_single 0 0 -3.4E+38 3.4E+38 ECU_ADDRESS 0x6003bd76 /end MEASUREMENT
/begin MEASUREMENT VCT_tBMSMaximumCellTemp "" FLOAT32_IEEE VBU0428Test_CM_single 0 0 -3.4E+38 3.4E+38 ECU_ADDRESS 0x90000088 /end MEASUREMENT
/begin MEASUREMENT VCT_tBMSMinimumCellTemp "" FLOAT32_IEEE VBU0428Test_CM_single 0 0 -3.4E+38 3.4E+38 ECU_ADDRESS 0x9000008c /end MEASUREMENT
/begin MEASUREMENT VCT_pctBMSDCChrgFinalSOC "" FLOAT32_IEEE VBU0428Test_CM_single 0 0 -3.4E+38 3.4E+38 ECU_ADDRESS 0x90000074 /end MEASUREMENT
/begin MEASUREMENT VCT_uBMSBatteryRatedVoltage "" FLOAT32_IEEE VBU0428Test_CM_single 0 0 -3.4E+38 3.4E+38 ECU_ADDRESS 0x900000ac /end MEASUREMENT
/begin MEASUREMENT VCT_iABMSDCChargingCurrentMeasurement "" FLOAT32_IEEE VBU0428Test_CM_single 0 0 -3.4E+38 3.4E+38 ECU_ADDRESS 0x6003bfee /end MEASUREMENT
/begin MEASUREMENT VCT_uBMSDCChargingVoltageMeasurement "" FLOAT32_IEEE VBU0428Test_CM_single 0 0 -3.4E+38 3.4E+38 ECU_ADDRESS 0x900000bc /end MEASUREMENT
/begin MEASUREMENT VCT_uBMSMaxPermitDCChargeVoltage "" FLOAT32_IEEE VBU0428Test_CM_single 0 0 -3.4E+38 3.4E+38 ECU_ADDRESS 0x900000c4 /end MEASUREMENT
/begin MEASUREMENT VCT_AhBMSBatteryRatedCapacity "" FLOAT32_IEEE VBU0428Test_CM_single 0 0 -3.4E+38 3.4E+38 ECU_ADDRESS 0x6003bfe2 /end MEASUREMENT
/begin MEASUREMENT VCT_kwBMSChgPowerLimitST "" FLOAT32_IEEE VBU0428Test_CM_single 0 0 -3.4E+38 3.4E+38 ECU_ADDRESS 0x90000050 /end MEASUREMENT
/begin MEASUREMENT VCT_kwBMSChgPowerLimitLT "" FLOAT32_IEEE VBU0428Test_CM_single 0 0 -3.4E+38 3.4E+38 ECU_ADDRESS 0x9000004c /end MEASUREMENT
/begin MEASUREMENT VCT_kwBMSChgPowerLimitDynamic "" FLOAT32_IEEE VBU0428Test_CM_single 0 0 -3.4E+38 3.4E+38 ECU_ADDRESS 0x90000048 /end MEASUREMENT
/begin MEASUREMENT VCT_timinEstimatePercTime "" FLOAT32_IEEE VBU0428Test_CM_single 0 0 -3.4E+38 3.4E+38 ECU_ADDRESS 0x900000a8 /end MEASUREMENT
/begin MEASUREMENT VCT_uBMSCellVoltageMax "" FLOAT32_IEEE VBU0428Test_CM_single 0 0 -3.4E+38 3.4E+38 ECU_ADDRESS 0x900000b4 /end MEASUREMENT
/begin MEASUREMENT VCT_uBMSCellVoltageMin "" FLOAT32_IEEE VBU0428Test_CM_single 0 0 -3.4E+38 3.4E+38 ECU_ADDRESS 0x900000b8 /end MEASUREMENT
/begin MEASUREMENT VCT_timinBMSEstimateChargingTime "" FLOAT32_IEEE VBU0428Test_CM_single 0 0 -3.4E+38 3.4E+38 ECU_ADDRESS 0x900000a4 /end MEASUREMENT
/begin MEASUREMENT VCT_uBMSCellVoltageAve "" FLOAT32_IEEE VBU0428Test_CM_single 0 0 -3.4E+38 3.4E+38 ECU_ADDRESS 0x900000b0 /end MEASUREMENT
/begin MEASUREMENT VCT_kwBMSDischgPowerLimitLT "" FLOAT32_IEEE VBU0428Test_CM_single 0 0 -3.4E+38 3.4E+38 ECU_ADDRESS 0x90000058 /end MEASUREMENT
/begin MEASUREMENT VCT_kwBMSDischgPowerLimitST "" FLOAT32_IEEE VBU0428Test_CM_single 0 0 -3.4E+38 3.4E+38 ECU_ADDRESS 0x9000005c /end MEASUREMENT
/begin MEASUREMENT VCT_kwBMSDischgPowerLimitDynamic "" FLOAT32_IEEE VBU0428Test_CM_single 0 0 -3.4E+38 3.4E+38 ECU_ADDRESS 0x90000054 /end MEASUREMENT
/begin MEASUREMENT VCT_kohmBMSInsulationResistanceValue "" FLOAT32_IEEE VBU0428Test_CM_single 0 0 -3.4E+38 3.4E+38 ECU_ADDRESS 0x90000044 /end MEASUREMENT
/begin MEASUREMENT VCT_iABMSDCChrgCrntReq "" FLOAT32_IEEE VBU0428Test_CM_single 0 0 -3.4E+38 3.4E+38 ECU_ADDRESS 0x6003bff2 /end MEASUREMENT
/begin MEASUREMENT VCT_uBMSDCChrgVoltageReq "" FLOAT32_IEEE VBU0428Test_CM_single 0 0 -3.4E+38 3.4E+38 ECU_ADDRESS 0x900000c0 /end MEASUREMENT
/begin MEASUREMENT VCT_iABMSChgCurrentLimit "" FLOAT32_IEEE VBU0428Test_CM_single 0 0 -3.4E+38 3.4E+38 ECU_ADDRESS 0x6003bfea /end MEASUREMENT
/begin MEASUREMENT VCT_kwhBMSPackEnergyAvailable "" FLOAT32_IEEE VBU0428Test_CM_single 0 0 -3.4E+38 3.4E+38 ECU_ADDRESS 0x90000060 /end MEASUREMENT
/begin MEASUREMENT SOH_pctPackSoh "" FLOAT32_IEEE VBU0428Test_CM_single 0 0 -3.4E+38 3.4E+38 ECU_ADDRESS 0x900001fc /end MEASUREMENT
/begin MEASUREMENT SOH_iABeforeStepAveCurrent "" FLOAT32_IEEE VBU0428Test_CM_single 0 0 -3.4E+38 3.4E+38 ECU_ADDRESS 0x900001f8 /end MEASUREMENT
/begin MEASUREMENT SOF_iAContinuousChargeCurrentLimitBase "" FLOAT32_IEEE VBU0428Test_CM_single 0 0 -3.4E+38 3.4E+38 ECU_ADDRESS 0x6003bbd2 /end MEASUREMENT
/begin MEASUREMENT SOF_iAShortPulseChargeCurrentLimitBase "" FLOAT32_IEEE VBU0428Test_CM_single 0 0 -3.4E+38 3.4E+38 ECU_ADDRESS 0x6003bc16 /end MEASUREMENT
/begin MEASUREMENT SOF_iAContinuousDischargeCurrentLimitTarget "" FLOAT32_IEEE VBU0428Test_CM_single 0 0 -3.4E+38 3.4E+38 ECU_ADDRESS 0x6003bbee /end MEASUREMENT
/begin MEASUREMENT SOF_iAShortPulseDischargeCurrentLimitTarget "" FLOAT32_IEEE VBU0428Test_CM_single 0 0 -3.4E+38 3.4E+38 ECU_ADDRESS 0x6003bc32 /end MEASUREMENT
/begin MEASUREMENT SOF_iADynamicDischargeCurrentLimitTarget "" FLOAT32_IEEE VBU0428Test_CM_single 0 0 -3.4E+38 3.4E+38 ECU_ADDRESS 0x6003bc06 /end MEASUREMENT
/begin MEASUREMENT SOF_iAContinuousChargeCurrentLimitTarget "" FLOAT32_IEEE VBU0428Test_CM_single 0 0 -3.4E+38 3.4E+38 ECU_ADDRESS 0x6003bbe2 /end MEASUREMENT
/begin MEASUREMENT SOF_iAShortPulseChargeCurrentLimitTarget "" FLOAT32_IEEE VBU0428Test_CM_single 0 0 -3.4E+38 3.4E+38 ECU_ADDRESS 0x6003bc22 /end MEASUREMENT
/begin MEASUREMENT SOF_iADynamicChargeCurrentLimitTarget "" FLOAT32_IEEE VBU0428Test_CM_single 0 0 -3.4E+38 3.4E+38 ECU_ADDRESS 0x6003bbfa /end MEASUREMENT
/begin MEASUREMENT SOF_kwContinuousDischargePowerLimitTarget "" FLOAT32_IEEE VBU0428Test_CM_single 0 0 -3.4E+38 3.4E+38 ECU_ADDRESS 0x6003bc46 /end MEASUREMENT
/begin MEASUREMENT SOF_kwDischargePowerLimitTarget "" FLOAT32_IEEE VBU0428Test_CM_single 0 0 -3.4E+38 3.4E+38 ECU_ADDRESS 0x6003bc4e /end MEASUREMENT
/begin MEASUREMENT LaSOC_CellTemp_C "" FLOAT32_IEEE VBU0428Test_CM_single 0 0 -3.4E+38 3.4E+38 ARRAY_SIZE 198 ECU_ADDRESS 0x6003b27e /end MEASUREMENT
/begin MEASUREMENT SOC_pctCellVoltageMaxCorrectionSoc "" FLOAT32_IEEE VBU0428Test_CM_single 0 0 -3.4E+38 3.4E+38 ECU_ADDRESS 0x90000190 /end MEASUREMENT
/begin MEASUREMENT LaSOC_pctCellSocFastChargeCorrection "" FLOAT32_IEEE VBU0428Test_CM_single 0 0 0.0 100.0 ARRAY_SIZE 198 ECU_ADDRESS 0x60039cd6 /end MEASUREMENT
/begin MEASUREMENT SOC_pctBatteryDisplaySocDischargeDecRate "" FLOAT32_IEEE VBU0428Test_CM_single 0 0 -3.4E+38 3.4E+38 ECU_ADDRESS 0x90000184 /end MEASUREMENT
/begin MEASUREMENT SOC_pctBatteryDisplaySocDischargeIncRate "" FLOAT32_IEEE VBU0428Test_CM_single 0 0 -3.4E+38 3.4E+38 ECU_ADDRESS 0x90000188 /end MEASUREMENT
/begin MEASUREMENT SOC_pctBatteryDisplaySocChargeDecRate "" FLOAT32_IEEE VBU0428Test_CM_single 0 0 -3.4E+38 3.4E+38 ECU_ADDRESS 0x9000017c /end MEASUREMENT
/begin MEASUREMENT SOC_pctBatteryDisplaySocChargeIncRate "" FLOAT32_IEEE VBU0428Test_CM_single 0 0 -3.4E+38 3.4E+38 ECU_ADDRESS 0x90000180 /end MEASUREMENT
/begin MEASUREMENT FCC_iADecreasedChargeCurrentRequest "" FLOAT32_IEEE VBU0428Test_CM_single 0 0 -3.4E+38 3.4E+38 ECU_ADDRESS 0x90000124 /end MEASUREMENT
/begin MEASUREMENT FCC_iAChargeCurrentReqDec "" FLOAT32_IEEE VBU0428Test_CM_single 0 0 -3.4E+38 3.4E+38 ECU_ADDRESS 0x90000118 /end MEASUREMENT
/begin MEASUREMENT FCC_iARawChargeCurrentRequestFnl "" FLOAT32_IEEE VBU0428Test_CM_single 0 0 -3.4E+38 3.4E+38 ECU_ADDRESS 0x90000128 /end MEASUREMENT
/begin MEASUREMENT FCC_kwChargePowerReqFnl "" FLOAT32_IEEE VBU0428Test_CM_single 0 0 -3.4E+38 3.4E+38 ECU_ADDRESS 0x9000012c /end MEASUREMENT
/begin MEASUREMENT FCC_uChargeVoltageRequestFnl "" FLOAT32_IEEE VBU0428Test_CM_single 0 0 -3.4E+38 3.4E+38 ECU_ADDRESS 0x90000148 /end MEASUREMENT
/begin MEASUREMENT FCC_iAChargeCurrentRequestRaw "" FLOAT32_IEEE VBU0428Test_CM_single 0 0 -3.4E+38 3.4E+38 ECU_ADDRESS 0x9000023c /end MEASUREMENT
/begin MEASUREMENT FCC_pctMaxSetSocMappingRealSoc "" FLOAT32_IEEE VBU0428Test_CM_single 0 0 -3.4E+38 3.4E+38 ECU_ADDRESS 0x90000138 /end MEASUREMENT
/begin MEASUREMENT FCC_pctDisplaySocMappingRealSoc "" FLOAT32_IEEE VBU0428Test_CM_single 0 0 -3.4E+38 3.4E+38 ECU_ADDRESS 0x90000130 /end MEASUREMENT
/begin MEASUREMENT FCC_pctEightySOCMappingRealSoc "" FLOAT32_IEEE VBU0428Test_CM_single 0 0 -3.4E+38 3.4E+38 ECU_ADDRESS 0x90000134 /end MEASUREMENT
/begin MEASUREMENT LcCTD_PrechargeJouleHeat_J "" FLOAT32_IEEE VBU0428Test_CM_single 0 0 -3.4E+38 3.4E+38 ECU_ADDRESS 0x6003bfa6 /end MEASUREMENT
/begin MEASUREMENT BCV_AhOverallCoulombFCCChgCarry "" FLOAT32_IEEE VBU0428Test_CM_single 0 0 -3.4E+38 3.4E+38 ECU_ADDRESS 0x6003bf0e /end MEASUREMENT
/begin MEASUREMENT CTD_stRnMnPosContactorStuckOpenFault "" UWORD VBU0428Test_CM_uint16 0 0 0 65535 ECU_ADDRESS 0x900016c2 /end MEASUREMENT
/begin MEASUREMENT CTD_stMnPosContactorStuckOpenFault "" UWORD VBU0428Test_CM_uint16 0 0 0 65535 ECU_ADDRESS 0x900016b8 /end MEASUREMENT
/begin MEASUREMENT CTD_stMnNegContactorStuckOpenFault "" UWORD VBU0428Test_CM_uint16 0 0 0 65535 ECU_ADDRESS 0x900016b6 /end MEASUREMENT
/begin MEASUREMENT CTD_stRnMnNegContactorStuckOpenFault "" UWORD VBU0428Test_CM_uint16 0 0 0 65535 ECU_ADDRESS 0x900016c0 /end MEASUREMENT
/begin MEASUREMENT CTD_stPrechargeEnergyHighFault "" UWORD VBU0428Test_CM_uint16 0 0 0 65535 ECU_ADDRESS 0x900016ba /end MEASUREMENT
/begin MEASUREMENT SPD_numWhlSpdInvld "" UBYTE VBU0428Test_CM_uint8 0 0 0 255 ECU_ADDRESS 0x90001d50 /end MEASUREMENT
/begin MEASUREMENT BPD_stBrkPedSwtRaw "" UBYTE VBU0428Test_CM_uint8 0 0 0.0 15.0 ECU_ADDRESS 0x90001cbb /end MEASUREMENT
/begin MEASUREMENT BPD_stBrkSwt "" UBYTE VBU0428Test_CM_uint8 0 0 0.0 15.0 ECU_ADDRESS 0x90001d62 /end MEASUREMENT
/begin MEASUREMENT TQO_stShft "" UBYTE VBU0428Test_CM_uint8 0 0 0.0 15.0 ECU_ADDRESS 0x90001d5e /end MEASUREMENT
/begin MEASUREMENT STC_stRgn "" UBYTE VBU0428Test_CM_uint8 0 0 0.0 15.0 ECU_ADDRESS 0x90001d52 /end MEASUREMENT
/begin MEASUREMENT VCT_stBMSSOCOverUnder "" UBYTE VBU0428Test_CM_uint8 0 0 0 255 ECU_ADDRESS 0x90001f0a /end MEASUREMENT
/begin MEASUREMENT VCT_stBatteryTempDifferAlarm "" UBYTE VBU0428Test_CM_uint8 0 0 0 255 ECU_ADDRESS 0x90001f12 /end MEASUREMENT
/begin MEASUREMENT VCT_stBetteryCellTempHighAlarm "" UBYTE VBU0428Test_CM_uint8 0 0 0 255 ECU_ADDRESS 0x90001f15 /end MEASUREMENT
/begin MEASUREMENT VCT_stBetteryCellTempLowAlarm "" UBYTE VBU0428Test_CM_uint8 0 0 0 255 ECU_ADDRESS 0x90001f16 /end MEASUREMENT
/begin MEASUREMENT VCT_numBMSMaximumCellVoltageNumber "" UBYTE VBU0428Test_CM_uint8 0 0 0 255 ECU_ADDRESS 0x90001ef0 /end MEASUREMENT
/begin MEASUREMENT VCT_numBMSMaximumTempNumber "" UBYTE VBU0428Test_CM_uint8 0 0 0 255 ECU_ADDRESS 0x90001ef1 /end MEASUREMENT
/begin MEASUREMENT VCT_numBMSMinimumTempNumber "" UBYTE VBU0428Test_CM_uint8 0 0 0 255 ECU_ADDRESS 0x90001ef5 /end MEASUREMENT
/begin MEASUREMENT VCT_stBMSReadyDCCharging "" UBYTE VBU0428Test_CM_uint8 0 0 0 255 ECU_ADDRESS 0x90001f09 /end MEASUREMENT
/begin MEASUREMENT VCT_stBMSBatteryType "" UBYTE VBU0428Test_CM_uint8 0 0 0 255 ECU_ADDRESS 0x90001ef6 /end MEASUREMENT
/begin MEASUREMENT VCT_stDCChargeMode "" UBYTE VBU0428Test_CM_uint8 0 0 0 255 ECU_ADDRESS 0x90001f22 /end MEASUREMENT
/begin MEASUREMENT VCT_stCTMCellThermalRunaway "" UBYTE VBU0428Test_CM_uint8 0 0 0 255 ECU_ADDRESS 0x90001f21 /end MEASUREMENT
/begin MEASUREMENT THM_flgInletTempValid "" UBYTE VBU0428Test_CM_uint8 0 0 0 255 ECU_ADDRESS 0x90001e9f /end MEASUREMENT
/begin MEASUREMENT THM_flgOutletTempValid "" UBYTE VBU0428Test_CM_uint8 0 0 0 255 ECU_ADDRESS 0x90001ea0 /end MEASUREMENT
/begin MEASUREMENT CTD_stPrechargeRelayStuckOpenDiagnosticStatus "" UBYTE VBU0428Test_CM_uint8 0 0 0 255 ECU_ADDRESS 0x90001dde /end MEASUREMENT
/begin MEASUREMENT CTD_stMnPosContactorWeldDiagnosticStatus "" UBYTE VBU0428Test_CM_uint8 0 0 0 255 ECU_ADDRESS 0x90001f6c /end MEASUREMENT
/begin MEASUREMENT CTD_stMnNegContactorWeldDiagnosticStatus "" UBYTE VBU0428Test_CM_uint8 0 0 0 255 ECU_ADDRESS 0x90001f6b /end MEASUREMENT
/begin MEASUREMENT BPD_flgMainBrkSwt "" UBYTE VBU0428Test_CM_boolean 0 0 0.0 1.0 ECU_ADDRESS 0x90001cba /end MEASUREMENT
/begin MEASUREMENT SPD_flgVehSpdVld "" UBYTE VBU0428Test_CM_boolean 0 0 0.0 1.0 ECU_ADDRESS 0x90001d4f /end MEASUREMENT
/begin MEASUREMENT APD_flgDftRatioPlausibility "" UBYTE VBU0428Test_CM_boolean 0 0 0.0 1.0 ECU_ADDRESS 0x90001d5f /end MEASUREMENT
/begin MEASUREMENT Gear_flgBrkPrssed "" UBYTE VBU0428Test_CM_boolean 0 0 0.0 1.0 ECU_ADDRESS 0x90001d15 /end MEASUREMENT
/begin MEASUREMENT Gear_flgGearShiftReady "" UBYTE VBU0428Test_CM_boolean 0 0 0.0 1.0 ECU_ADDRESS 0x90001d68 /end MEASUREMENT
/begin MEASUREMENT MTQL_flgRMotrInhbt "" UBYTE VBU0428Test_CM_boolean 0 0 0.0 1.0 ECU_ADDRESS 0x90001d73 /end MEASUREMENT
/begin MEASUREMENT TQD_flgVehSlide "" UBYTE VBU0428Test_CM_boolean 0 0 0.0 1.0 ECU_ADDRESS 0x90001d5c /end MEASUREMENT
/begin MEASUREMENT TQD_flgCrpEna "" UBYTE VBU0428Test_CM_boolean 0 0 0.0 1.0 ECU_ADDRESS 0x90001d85 /end MEASUREMENT
/begin MEASUREMENT TQD_flgHillHld "" UBYTE VBU0428Test_CM_boolean 0 0 0.0 1.0 ECU_ADDRESS 0x90001d5a /end MEASUREMENT
/begin MEASUREMENT VCT_flgBMSCellVoltageMaxValidity "" UBYTE VBU0428Test_CM_boolean 0 0 0 1 ECU_ADDRESS 0x90001ede /end MEASUREMENT
/begin MEASUREMENT VCT_flgBMSCellVoltageMinValidity "" UBYTE VBU0428Test_CM_boolean 0 0 0 1 ECU_ADDRESS 0x90001edf /end MEASUREMENT
/begin MEASUREMENT VCT_flgBMSCellVoltageAveValidity "" UBYTE VBU0428Test_CM_boolean 0 0 0 1 ECU_ADDRESS 0x90001edd /end MEASUREMENT
/begin MEASUREMENT VCT_flgCTMCellThermalRunawayFaultValid "" UBYTE VBU0428Test_CM_boolean 0 0 0 1 ECU_ADDRESS 0x90001ee9 /end MEASUREMENT
/begin MEASUREMENT SOH_flgBeforeStepCurrentEnable "" UBYTE VBU0428Test_CM_boolean 0 0 0 1 ECU_ADDRESS 0x90001d4c /end MEASUREMENT
/begin MEASUREMENT SOH_flgSingalSocStart "" UBYTE VBU0428Test_CM_boolean 0 0 0 1 ECU_ADDRESS 0x90001d4d /end MEASUREMENT
/begin MEASUREMENT SOC_flgOcvShortTimeCurrentEnable "" UBYTE VBU0428Test_CM_boolean 0 0 0.0 1.0 ECU_ADDRESS 0x90001d40 /end MEASUREMENT
/begin MEASUREMENT SOC_flgSocFastChargeCorrection "" UBYTE VBU0428Test_CM_boolean 0 0 0.0 1.0 ECU_ADDRESS 0x90001d44 /end MEASUREMENT
/begin MEASUREMENT FCC_flgCellTempLowProhibitCharge "" UBYTE VBU0428Test_CM_boolean 0 0 0.0 1.0 ECU_ADDRESS 0x90001d03 /end MEASUREMENT
/begin MEASUREMENT FCC_flgCellTempProhibitCharge "" UBYTE VBU0428Test_CM_boolean 0 0 0.0 1.0 ECU_ADDRESS 0x90001d04 /end MEASUREMENT
/begin MEASUREMENT FCC_flgVoltageProhibitCharge "" UBYTE VBU0428Test_CM_boolean 0 0 0.0 1.0 ECU_ADDRESS 0x90001d12 /end MEASUREMENT
/begin MEASUREMENT FCC_flgFullChargeComplete "" UBYTE VBU0428Test_CM_boolean 0 0 0.0 1.0 ECU_ADDRESS 0x90001d0e /end MEASUREMENT
/begin MEASUREMENT FCC_flgChargeCurrentDerate "" UBYTE VBU0428Test_CM_boolean 0 0 0.0 1.0 ECU_ADDRESS 0x90001d06 /end MEASUREMENT
/begin MEASUREMENT FCC_flgComputeResistancePrecondition "" UBYTE VBU0428Test_CM_boolean 0 0 0.0 1.0 ECU_ADDRESS 0x90001d0a /end MEASUREMENT
/begin MEASUREMENT CTS_flgInhibitPrecharge "" UBYTE VBU0428Test_CM_boolean 0 0 0 1 ECU_ADDRESS 0x90001de6 /end MEASUREMENT
/begin MEASUREMENT CTS_flgAbortPrecharge "" UBYTE VBU0428Test_CM_boolean 0 0 0 1 ECU_ADDRESS 0x90001de2 /end MEASUREMENT
/begin MEASUREMENT LbCTD_RnMnPosContactorStuckOpenTestEnable_flg "" UBYTE VBU0428Test_CM_boolean 0 0 0 1 ECU_ADDRESS 0x90001e44 /end MEASUREMENT
/begin MEASUREMENT CTD_flgRnMnPosContactorStuckOpenTestFail "" UBYTE VBU0428Test_CM_boolean 0 0 0 1 ECU_ADDRESS 0x90001dd9 /end MEASUREMENT
/begin MEASUREMENT CTD_flgRnMnNegContactorStuckOpenTestEnable "" UBYTE VBU0428Test_CM_boolean 0 0 0 1 ECU_ADDRESS 0x90001dd7 /end MEASUREMENT
/begin MEASUREMENT CTD_flgRnMnNegContactorStuckOpenTestFail "" UBYTE VBU0428Test_CM_boolean 0 0 0 1 ECU_ADDRESS 0x90001dd8 /end MEASUREMENT
/begin MEASUREMENT LbCTD_PrechargeEnergyHighTestEnable_flg "" UBYTE VBU0428Test_CM_boolean 0 0 0 1 ECU_ADDRESS 0x90001e42 /end MEASUREMENT
/begin MEASUREMENT LbCTD_PrechargeEnergyHighTestFail_flg "" UBYTE VBU0428Test_CM_boolean 0 0 0 1 ECU_ADDRESS 0x90001e43 /end MEASUREMENT
/begin MEASUREMENT BCV_flgBatteryVoltageValid "" UBYTE VBU0428Test_CM_boolean 0 0 0.0 1.0 ECU_ADDRESS 0x90001f28 /end MEASUREMENT
/begin MEASUREMENT BCV_flgBusNegativeVoltageValid "" UBYTE VBU0428Test_CM_boolean 0 0 0 1 ECU_ADDRESS 0x90001db8 /end MEASUREMENT
/begin MEASUREMENT BCV_flgBusVoltageValid "" UBYTE VBU0428Test_CM_boolean 0 0 0 1 ECU_ADDRESS 0x90001db9 /end MEASUREMENT
/begin MEASUREMENT BCV_flgFuseVoltageValid "" UBYTE VBU0428Test_CM_boolean 0 0 0 1 ECU_ADDRESS 0x90001dba /end MEASUREMENT
/begin MEASUREMENT BCV_flgPrechargeVoltageValid "" UBYTE VBU0428Test_CM_boolean 0 0 0 1 ECU_ADDRESS 0x90001dbb /end MEASUREMENT
/begin MEASUREMENT BCV_flgVx1VoltageValid "" UBYTE VBU0428Test_CM_boolean 0 0 0 1 ECU_ADDRESS 0x90001f2b /end MEASUREMENT
/begin MEASUREMENT BCV_flgVx2VoltageValid "" UBYTE VBU0428Test_CM_boolean 0 0 0 1 ECU_ADDRESS 0x90001dbc /end MEASUREMENT
/begin MEASUREMENT BCV_flgBatteryCurrentValid "" UBYTE VBU0428Test_CM_boolean 0 0 0 1 ECU_ADDRESS 0x90001cb3 /end MEASUREMENT
/begin COMPU_METHOD VBU0428Test_CM_single_C "Q = V" RAT_FUNC "%8.6" "C" COEFFS 0 1 0 0 0 1 /end COMPU_METHOD
/begin COMPU_METHOD VBU0428Test_CM_single_cnt "Q = V" RAT_FUNC "%8.6" "cnt" COEFFS 0 1 0 0 0 1 /end COMPU_METHOD
/begin COMPU_METHOD VBU0428Test_CM_uint16_cnt "Q = V" RAT_FUNC "%5.0" "cnt" COEFFS 0 1 0 0 0 1 /end COMPU_METHOD
/begin COMPU_METHOD VBU0428Test_CM_single_Nm "Q = V" RAT_FUNC "%8.6" "Nm" COEFFS 0 1 0 0 0 1 /end COMPU_METHOD
/begin COMPU_METHOD VBU0428Test_CM_single_kph "Q = V" RAT_FUNC "%8.6" "kph" COEFFS 0 1 0 0 0 1 /end COMPU_METHOD
/begin COMPU_METHOD VBU0428Test_CM_single_pct "Q = V" RAT_FUNC "%8.6" "pct" COEFFS 0 1 0 0 0 1 /end COMPU_METHOD
/begin COMPU_METHOD VBU0428Test_CM_single_fac "Q = V" RAT_FUNC "%8.6" "fac" COEFFS 0 1 0 0 0 1 /end COMPU_METHOD
/begin COMPU_METHOD VBU0428Test_CM_single_p "Q = V" RAT_FUNC "%8.6" "p" COEFFS 0 1 0 0 0 1 /end COMPU_METHOD
/begin COMPU_METHOD VBU0428Test_CM_single_phi "Q = V" RAT_FUNC "%8.6" "phi" COEFFS 0 1 0 0 0 1 /end COMPU_METHOD
/begin COMPU_METHOD VBU0428Test_CM_uint8 "Q = V" RAT_FUNC "%3.0" "" COEFFS 0 1 0 0 0 1 /end COMPU_METHOD
/begin COMPU_METHOD VBU0428Test_CM_double_cnt "Q = V" RAT_FUNC "%15.10" "cnt" COEFFS 0 1 0 0 0 1 /end COMPU_METHOD
/begin COMPU_METHOD VBU0428Test_CM_single_MPa "Q = V" RAT_FUNC "%8.6" "MPa" COEFFS 0 1 0 0 0 1 /end COMPU_METHOD
/begin COMPU_METHOD VBU0428Test_CM_single_V "Q = V" RAT_FUNC "%8.6" "V" COEFFS 0 1 0 0 0 1 /end COMPU_METHOD
/begin COMPU_METHOD VBU0428Test_CM_uint16 "Q = V" RAT_FUNC "%5.0" "" COEFFS 0 1 0 0 0 1 /end COMPU_METHOD
/begin COMPU_METHOD VBU0428Test_CM_single "Q = V" RAT_FUNC "%8.6" "" COEFFS 0 1 0 0 0 1 /end COMPU_METHOD
/begin COMPU_METHOD VBU0428Test_CM_uint32_cnt "Q = V" RAT_FUNC "%10.0" "cnt" COEFFS 0 1 0 0 0 1 /end COMPU_METHOD
/begin COMPU_METHOD VBU0428Test_CM_uint32 "Q = V" RAT_FUNC "%10.0" "" COEFFS 0 1 0 0 0 1 /end COMPU_METHOD
/begin COMPU_METHOD VBU0428Test_CM_boolean_cnt "Q = V" RAT_FUNC "%1.0" "cnt" COEFFS 0 1 0 0 0 1 /end COMPU_METHOD
/begin COMPU_METHOD VBU0428Test_CM_boolean "Q = V" RAT_FUNC "%1.0" "" COEFFS 0 1 0 0 0 1 /end COMPU_METHOD
/begin COMPU_METHOD VBU0428Test_CM_int8_cnt "Q = V" RAT_FUNC "%3.0" "cnt" COEFFS 0 1 0 0 0 1 /end COMPU_METHOD
/begin COMPU_METHOD VBU0428Test_CM_uint8_cnt "Q = V" RAT_FUNC "%3.0" "cnt" COEFFS 0 1 0 0 0 1 /end COMPU_METHOD
/begin GROUP S3722_SlopeCal "VBU0428Test/VBUSystem/VCU /SPD/SPD/SignalProcessing_10ms/SlopeCal1/SlopeCal" /begin REF_CHARACTERISTIC SPD_pctSlope_CUR_v /end REF_CHARACTERISTIC /begin REF_MEASUREMENT SPD_pctSlope /end REF_MEASUREMENT /end GROUP
/begin GROUP S3722_VehSt "VBU0428Test/VBUSystem/VCU /SPD/SPD/SignalProcessing_10ms/SlopeCal1/VehSt" /begin REF_CHARACTERISTIC SPD_tiSlopeFilter_C SPD_vGoThd_C /end REF_CHARACTERISTIC /end GROUP
/begin GROUP S3723_vWhlProcess "VBU0428Test/VBUSystem/VCU /SPD/SPD/SignalProcessing_10ms/Subsystem1/vWhlProcess" /begin REF_MEASUREMENT SPD_numWhlSpdInvld /end REF_MEASUREMENT /end GROUP
/begin GROUP S3723_v_Axle "VBU0428Test/VBUSystem/VCU /SPD/SPD/SignalProcessing_10ms/Subsystem1/v_Axle" /begin SUB_GROUP S3741_Front S3741_Rear /end SUB_GROUP /end GROUP
/begin GROUP S3724_RearWhl "VBU0428Test/VBUSystem/VCU /SPD/SPD/SignalProcessing_10ms/VehDir/RearWhl" /begin SUB_GROUP S3744_SR_Flip_Flop /end SUB_GROUP
 /begin REF_CHARACTERISTIC SPD_nMotrDrvRvsThd_C SPD_trqRvsRst_C SPD_vVehRvsRst_C SPD_vVehRvsThd_C /end REF_CHARACTERISTIC
/end GROUP
/begin GROUP S3725_Normal_VehSpdCal "VBU0428Test/VBUSystem/VCU /SPD/SPD/SignalProcessing_10ms/VehSpdNorm/Normal_VehSpdCal" /begin SUB_GROUP S3746_First_Order_Low_Pass_Filter /end SUB_GROUP /begin REF_CHARACTERISTIC SPD_facSpdFlt_C SPD_vVehOvrdFlg_C SPD_vVehOvrdVal_C /end REF_CHARACTERISTIC /begin REF_MEASUREMENT SPD_flgVehSpdVld /end REF_MEASUREMENT /end GROUP
/begin GROUP S3725_nMotr2vVeh "VBU0428Test/VBUSystem/VCU /SPD/SPD/SignalProcessing_10ms/VehSpdNorm/nMotr2vVeh" /begin REF_CHARACTERISTIC SPD_tiSample10ms_SY SPD_tiSpdFil_C /end REF_CHARACTERISTIC /begin REF_MEASUREMENT SPD_vMotrSpd /end REF_MEASUREMENT /end GROUP
/begin GROUP S3829_BrakeCrpModify "VBU0428Test/VBUSystem/VCU /TQD/TrqDem/TrqDem_DrvTrq_Cal/TrqDem_MinTrq_Cal/BrakeCrpModify"
 /begin REF_CHARACTERISTIC TQD_flgBrkPresUsed_C TQD_pctCrpCtrlBrkPctS_CUR_v TQD_pctCrpCtrlBrkPct_MAP_v TQD_pctCrpCtrlBrkPresS_CUR_v TQD_pctCrpCtrlBrkPres_MAP_v /end REF_CHARACTERISTIC
 /begin REF_MEASUREMENT TQD_facBrkCrpPct TQD_facBrkPosCrpMod TQD_facBrkPresCrpMod /end REF_MEASUREMENT
/end GROUP
/begin GROUP S3829_CrpEnaArb "VBU0428Test/VBUSystem/VCU /TQD/TrqDem/TrqDem_DrvTrq_Cal/TrqDem_MinTrq_Cal/CrpEnaArb" /begin REF_CHARACTERISTIC EPB_stClosed TQD_flgCreepFnctnEna_C /end REF_CHARACTERISTIC /begin REF_MEASUREMENT TQD_flgCrpEna /end REF_MEASUREMENT /end GROUP
/begin GROUP S3829_CrpRgnTrqArb "VBU0428Test/VBUSystem/VCU /TQD/TrqDem/TrqDem_DrvTrq_Cal/TrqDem_MinTrq_Cal/CrpRgnTrqArb" /begin REF_CHARACTERISTIC TQD_flgSlpEna_C TQD_trqCrpCtrlSlp_MAP_v /end REF_CHARACTERISTIC /begin REF_MEASUREMENT TQD_flgHillHld TQD_trqCor TQD_trqCrpMode /end REF_MEASUREMENT /end GROUP
/begin GROUP S3829_CrpRgnTrqCal "VBU0428Test/VBUSystem/VCU /TQD/TrqDem/TrqDem_DrvTrq_Cal/TrqDem_MinTrq_Cal/CrpRgnTrqCal"
 /begin REF_CHARACTERISTIC TQD_trqCrpCstModeA_CUR_v TQD_trqCrpCstModeB_CUR_v TQD_trqCrpCstModeC_CUR_v TQD_trqCrpCstModeD_CUR_v /end REF_CHARACTERISTIC
 /begin REF_MEASUREMENT TQD_trqCrpCst /end REF_MEASUREMENT
/end GROUP
/begin GROUP S3829_CrpRgnTrqLim "VBU0428Test/VBUSystem/VCU /TQD/TrqDem/TrqDem_DrvTrq_Cal/TrqDem_MinTrq_Cal/CrpRgnTrqLim"
 /begin REF_CHARACTERISTIC TQD_flgTrqMinEn_C TQD_trqModeChngDecGrad_C TQD_trqModeChngIncGrad_C TQD_trqNrmDecGrad_C TQD_trqNrmIncGrad_C TQD_trqRateLimThres_C /end REF_CHARACTERISTIC
/end GROUP
/begin GROUP S3841_First_Order_Low_Pass_Filter "VBU0428Test/VBUSystem/VCU /TQD/TrqDem/TrqDem_InputTransfer/BrakePressureFilter/First_Order_Low_Pass_Filter" /begin REF_MEASUREMENT TQD_pBrkPress /end REF_MEASUREMENT /end GROUP
/begin GROUP S3844_DejitterFIL "VBU0428Test/VBUSystem/VCU /TQD/TrqDem/TrqDem_InputTransfer/TrqDem_VehSpeed_Filter/DejitterFIL" /begin REF_MEASUREMENT TQD_vVehSpd /end REF_MEASUREMENT /end GROUP
/begin GROUP S3844_SR_Flip_Flop "VBU0428Test/VBUSystem/VCU /TQD/TrqDem/TrqDem_InputTransfer/TrqDem_VehSpeed_Filter/SR_Flip_Flop" /begin REF_MEASUREMENT TQD_flgVehSlide /end REF_MEASUREMENT /end GROUP
/begin GROUP S3861_ABSRgnTorque "VBU0428Test/VBUSystem/VCU /TQO/TQOAll/STC/STC/ABSRgnTorque" /begin REF_MEASUREMENT STC_trqRgnABSRA /end REF_MEASUREMENT /end GROUP
/begin GROUP S3861_DTCRgnTorque "VBU0428Test/VBUSystem/VCU /TQO/TQOAll/STC/STC/DTCRgnTorque" /begin REF_CHARACTERISTIC STC_flgRgnTrqCnclRA_C /end REF_CHARACTERISTIC /begin REF_MEASUREMENT STC_trqRgnDTCRA /end REF_MEASUREMENT /end GROUP
/begin GROUP S3861_PIRgnTorque "VBU0428Test/VBUSystem/VCU /TQO/TQOAll/STC/STC/PIRgnTorque"
 /begin SUB_GROUP S3864_DeltaSpeedCal S3864_PI_Controller S3864_ResetCondition /end SUB_GROUP
/end GROUP
/begin GROUP S3861_ReverseRgnTorque "VBU0428Test/VBUSystem/VCU /TQO/TQOAll/STC/STC/ReverseRgnTorque" /begin REF_MEASUREMENT STC_trqRgnRA /end REF_MEASUREMENT /end GROUP
/begin GROUP S3861_RgnControlState "VBU0428Test/VBUSystem/VCU /TQO/TQOAll/STC/STC/RgnControlState"
 /begin REF_CHARACTERISTIC STC_stRgnABS_SY STC_stRgnNrm_SY STC_stRgnPI_SY STC_stRgnRev_SY /end REF_CHARACTERISTIC
 /begin REF_MEASUREMENT STC_stRgn /end REF_MEASUREMENT
/end GROUP
/begin GROUP S3874_CMB "VBU0428Test/VBUSystem/VCU /TQO/TQOAll/Subsystem/TQDMP/CMB" /begin REF_MEASUREMENT TQDMP_trqCompRA /end REF_MEASUREMENT /end GROUP
/begin GROUP S3874_Dibl "VBU0428Test/VBUSystem/VCU /TQO/TQOAll/Subsystem/TQDMP/Dibl"
 /begin REF_CHARACTERISTIC TQDMP_flgROTCDisblORF TQDMP_flgROTCDisblORV TQDMP_vVehEnaMax_C TQDMP_vVehEnaMin_C /end REF_CHARACTERISTIC
/end GROUP
/begin GROUP S3874_RAROTC "VBU0428Test/VBUSystem/VCU /TQO/TQOAll/Subsystem/TQDMP/RAROTC"
 /begin SUB_GROUP S3877_CalcSpdHiFre S3877_Foreback S3877_ROTCArbRA S3877_ROTCConidtion S3877_TorqueCal /end SUB_GROUP
/end GROUP
/begin GROUP S3917_Limitation "VBU0428Test/VBUSystem/VCU /TQO/TQOAll/TQARB/TQARB/Limitation"
 /begin REF_MEASUREMENT TQARB_trqArbRA TQARB_trqArbRA1 TQARB_trqArbRA2 TQARB_trqBattRAMax TQARB_trqBattRAMin /end REF_MEASUREMENT
/end GROUP
/begin GROUP S3917_TrqArb "VBU0428Test/VBUSystem/VCU /TQO/TQOAll/TQARB/TQARB/TrqArb" /begin SUB_GROUP S3919_SignalProcess /end SUB_GROUP /begin REF_MEASUREMENT TQARB_TrqRgnRA /end REF_MEASUREMENT /end GROUP
/begin GROUP S3923_SinCmp "VBU0428Test/VBUSystem/VCU /TQO/TQOAll/TQCMP/TQCMP/SinCmp" /begin SUB_GROUP S3924_RASinCmp /end SUB_GROUP /end GROUP
/begin GROUP S3923_TrqPulse "VBU0428Test/VBUSystem/VCU /TQO/TQOAll/TQCMP/TQCMP/TrqPulse" /begin SUB_GROUP S3925_PulseTime S3925_PulseTrig S3925_PulseTrq /end SUB_GROUP /end GROUP
/begin GROUP S3947_AxleArb "VBU0428Test/VBUSystem/VCU /TQO/TQOAll/TQDIS/TQDIS/AxleArb" /begin SUB_GROUP S3948_SysRst /end SUB_GROUP /begin REF_MEASUREMENT TQDIS_trqPreDisRA0 /end REF_MEASUREMENT /end GROUP
/begin GROUP S3947_BrkRgnCp "VBU0428Test/VBUSystem/VCU /TQO/TQOAll/TQDIS/TQDIS/BrkRgnCp" /begin SUB_GROUP S3949_BrkRgnFilter S3949_CstBrkCal S3949_facBCUVCUCal /end SUB_GROUP /end GROUP
/begin GROUP S3947_CstBrkArb "VBU0428Test/VBUSystem/VCU /TQO/TQOAll/TQDIS/TQDIS/CstBrkArb" /begin REF_MEASUREMENT TQDIS_trqPreDisRA TQDIS_trqRgnRAReq /end REF_MEASUREMENT /end GROUP
/begin GROUP S3947_Dmp "VBU0428Test/VBUSystem/VCU /TQO/TQOAll/TQDIS/TQDIS/Dmp" /begin SUB_GROUP S3951_BattLim S3951_DmpFilter S3951_MotorLim /end SUB_GROUP /end GROUP
/begin GROUP S3947_TrqFilter "VBU0428Test/VBUSystem/VCU /TQO/TQOAll/TQDIS/TQDIS/TrqFilter" /begin SUB_GROUP S3952_Arb S3952_DrvLim S3952_Subsystem /end SUB_GROUP /end GROUP
/begin GROUP S3947_TrqForFacCal "VBU0428Test/VBUSystem/VCU /TQO/TQOAll/TQDIS/TQDIS/TrqForFacCal"
 /begin REF_CHARACTERISTIC TQDIS_flgLowPassFacCalFilter_C TQDIS_flgUseFacCalFilter_C TQDIS_tiForFacCal_C TQDIS_trqDecForFacCal_C TQDIS_trqIncForFacCal_C /end REF_CHARACTERISTIC
 /begin REF_MEASUREMENT TQDIS_trqForFacCal /end REF_MEASUREMENT
/end GROUP
/begin GROUP S3947_TrqLim "VBU0428Test/VBUSystem/VCU /TQO/TQOAll/TQDIS/TQDIS/TrqLim" /begin REF_CHARACTERISTIC SYS_facGearRatioR_SY /end REF_CHARACTERISTIC
 /begin REF_MEASUREMENT TQDIS_trqBrkRgnTarRA TQDIS_trqRALim TQDIS_trqRAPropLim TQDIS_trqRARgnLim /end REF_MEASUREMENT
/end GROUP
/begin GROUP S4002_MotorTorque "VBU0428Test/VBUSystem/VCU /TQO/TQOAll/TQO/TQO/MotorTorque" /begin SUB_GROUP S4003_ShftChange S4003_Subsystem /end SUB_GROUP /begin REF_CHARACTERISTIC TQO_pctSlopeShft_C TQO_tiShftDR_C TQO_tiShftOut_C /end REF_CHARACTERISTIC /begin REF_MEASUREMENT TQO_facFilter TQO_stShft /end REF_MEASUREMENT /end GROUP
/begin GROUP S4002_Subsystem "VBU0428Test/VBUSystem/VCU /TQO/TQOAll/TQO/TQO/Subsystem" /begin SUB_GROUP S4004_VirtualAPD /end SUB_GROUP /end GROUP
/begin GROUP S4002_Trq "VBU0428Test/VBUSystem/VCU /TQO/TQOAll/TQO/TQO/Trq" /begin SUB_GROUP S4005_TrqProtect /end SUB_GROUP /end GROUP
/begin GROUP S4020_FIDTrqLim "VBU0428Test/VBUSystem/VCU /VTQA/Subsystem/MTrqLim/TrqCapacityLim/FIDTrqLim" /begin REF_CHARACTERISTIC MTQL_trqPEURFidByTempLim_C MTQL_trqPEURFidLim_C /end REF_CHARACTERISTIC /begin REF_MEASUREMENT MTQL_trqRMotrFIDDrvLim /end REF_MEASUREMENT /end GROUP
/begin GROUP S4020_Motor_Inhibit "VBU0428Test/VBUSystem/VCU /VTQA/Subsystem/MTrqLim/TrqCapacityLim/Motor_Inhibit" /begin REF_CHARACTERISTIC SYS_stMCUErr_SY /end REF_CHARACTERISTIC /begin REF_MEASUREMENT MTQL_flgRMotrInhbt /end REF_MEASUREMENT /end GROUP
/begin GROUP S4020_VehicleSpeedLim "VBU0428Test/VBUSystem/VCU /VTQA/Subsystem/MTrqLim/TrqCapacityLim/VehicleSpeedLim" /begin SUB_GROUP S4028_IF_Then_Else1 /end SUB_GROUP /begin REF_CHARACTERISTIC MTQL_trqVehSpdLimNormRMot_MAP_v /end REF_CHARACTERISTIC /end GROUP
/begin GROUP S4020_dnLim "VBU0428Test/VBUSystem/VCU /VTQA/Subsystem/MTrqLim/TrqCapacityLim/dnLim" /begin REF_CHARACTERISTIC MTQL_trqWhlRLim_CUR_v /end REF_CHARACTERISTIC /begin REF_MEASUREMENT MTQL_trqDnAbsLimR /end REF_MEASUREMENT /end GROUP
/begin GROUP S4031_AxleTrq_Limit_Calc "VBU0428Test/VBUSystem/VCU /VTQA/Subsystem/VehTrqArb/BattLim_Transfer/AxleTrq_Limit_Calc"
 /begin REF_CHARACTERISTIC VTQA_facActDrvPwrFltr_C VTQA_facActRgnPwrFltr_C VTQA_facMotorAvgFltr_C VTQA_facMtrDrvPwrUpLim_MAP_v VTQA_flgActDrvTrqLimORF VTQA_flgActRgnTrqLimORF VTQA_trqActDrvLoLim_C VTQA_trqActDrvTrqLimORV VTQA_trqActDrvUpLim_C VTQA_trqActRgnLoLim_C VTQA_trqActRgnTrqLimORV VTQA_trqActRgnUpLim_C /end REF_CHARACTERISTIC
 /begin REF_MEASUREMENT VTQA_trqActDrvTrqLim VTQA_trqActRgnTrqLim /end REF_MEASUREMENT
/end GROUP
/begin GROUP S4031_Motor_PwrLoss_Calc "VBU0428Test/VBUSystem/VCU /VTQA/Subsystem/VehTrqArb/BattLim_Transfer/Motor_PwrLoss_Calc"
 /begin REF_CHARACTERISTIC VTQA_facVehSpd2MotSpd_C VTQA_pwrRMtrDrvPwrLoss_MAP_v VTQA_pwrRMtrRgnPwrLoss_MAP_v /end REF_CHARACTERISTIC
 /begin REF_MEASUREMENT VTQA_pwrRMotActDrvLoss VTQA_pwrRMotActRgnLoss VTQA_trqRMotrNeg VTQA_trqRMotrPos /end REF_MEASUREMENT
/end GROUP
/begin GROUP S4032_AlxeMax "VBU0428Test/VBUSystem/VCU /VTQA/Subsystem/VehTrqArb/Trq_Arb/AlxeMax"
 /begin REF_CHARACTERISTIC EPB_CompleteTight EPB_stApplying SYS_facGearRatioR_SY VTQA_flgAxleMaxORF VTQA_trqAxleMaxLimit_C VTQA_trqAxleMaxORV VTQA_trqAxleMax_CUR_v VTQA_trqBrkSwtTrqLim_C VTQA_trqBrk_MAP_v VTQA_trqLimpModeByPmpMax_CUR_v VTQA_trqLimpModeMax_CUR_v /end REF_CHARACTERISTIC
 /begin REF_MEASUREMENT VTQA_trqAxleMax VTQA_trqBattTrqMax VTQA_trqBcuTrqMax VTQA_trqBrkTrqMax VTQA_trqLimpByPmpTrqMax VTQA_trqLimpTrqMax VTQA_trqMotTrqMax /end REF_MEASUREMENT
/end GROUP
/begin GROUP S4032_AlxeMin "VBU0428Test/VBUSystem/VCU /VTQA/Subsystem/VehTrqArb/Trq_Arb/AlxeMin"
 /begin REF_CHARACTERISTIC SYS_facGearRatioR_SY VTQA_flgAxleMinORF VTQA_trqABSFailMin_C VTQA_trqAxleMinORV VTQA_trqAxleMin_C VTQA_trqLimphomeMin_C /end REF_CHARACTERISTIC
 /begin REF_MEASUREMENT VTQA_trqABSFailLimit VTQA_trqActvLimpLimit VTQA_trqAxleMin VTQA_trqBattTrqMin VTQA_trqInhibRegenLimit VTQA_trqMotTrqMin /end REF_MEASUREMENT
/end GROUP
/begin GROUP S4032_Arb "VBU0428Test/VBUSystem/VCU /VTQA/Subsystem/VehTrqArb/Trq_Arb/Arb" /begin REF_MEASUREMENT VTQA_trqDes /end REF_MEASUREMENT /end GROUP
/begin GROUP S4060_APD1_Norm "VBU0428Test/VBUSystem/VCU /VehINP/VehINP_Logic/APD/APD/APD1_Norm" /begin REF_CHARACTERISTIC APD_uSetPoint1Max_C APD_uSetPoint1Min_C /end REF_CHARACTERISTIC /end GROUP
/begin GROUP S4060_APD2_Norm "VBU0428Test/VBUSystem/VCU /VehINP/VehINP_Logic/APD/APD/APD2_Norm" /begin REF_CHARACTERISTIC APD_uSetPoint2Max_C APD_uSetPoint2Min_C /end REF_CHARACTERISTIC /end GROUP
/begin GROUP S4060_APD_Dejitter1 "VBU0428Test/VBUSystem/VCU /VehINP/VehINP_Logic/APD/APD/APD_Dejitter1" /begin REF_CHARACTERISTIC APD_uJitterFil1_C APD_uSetPoint1Min_C /end REF_CHARACTERISTIC /end GROUP
/begin GROUP S4060_APD_Dejitter2 "VBU0428Test/VBUSystem/VCU /VehINP/VehINP_Logic/APD/APD/APD_Dejitter2" /begin REF_CHARACTERISTIC APD_uJitterFil2_C APD_uSetPoint2Min_C /end REF_CHARACTERISTIC /end GROUP
/begin GROUP S4060_APD_Override "VBU0428Test/VBUSystem/VCU /VehINP/VehINP_Logic/APD/APD/APD_Override"
 /begin REF_CHARACTERISTIC APD_efAccPedPos_C APD_flgAccPedPosPctVld_C APD_pctAccPedPosLimit_C APD_pctAccPedPosOverrideVal_C APD_pctAccPedPosOverride_C /end REF_CHARACTERISTIC
 /begin REF_MEASUREMENT APD_pctAccPedPos /end REF_MEASUREMENT
/end GROUP
/begin GROUP S4060_Diag_Ratio "VBU0428Test/VBUSystem/VCU /VehINP/VehINP_Logic/APD/APD/Diag_Ratio"
 /begin REF_CHARACTERISTIC APD_numPlausibilityDec_C APD_numPlausibilityInc_C APD_numPlausibilityLim_C APD_stNoErr_C APD_uThdDiff12_CUR_v /end REF_CHARACTERISTIC
 /begin REF_MEASUREMENT APD_flgDftRatioPlausibility /end REF_MEASUREMENT
/end GROUP
/begin GROUP S4060_Diag_Status "VBU0428Test/VBUSystem/VCU /VehINP/VehINP_Logic/APD/APD/Diag_Status" /begin REF_CHARACTERISTIC APD_stConfirmErr_C /end REF_CHARACTERISTIC /end GROUP
/begin GROUP S4060_Value_Selection "VBU0428Test/VBUSystem/VCU /VehINP/VehINP_Logic/APD/APD/Value_Selection"
 /begin SUB_GROUP S4068_BrakeStickyCheck S4068_FullPedal S4068_PedalPercentSelection S4068_PedalSelection /end SUB_GROUP
/end GROUP
/begin GROUP S4092_Veh_DCPortTempPlausibility "VBU0428Test/VBUSystem/VCU /VehINP/VehINP_Logic/DCPortTemp/Charge_Port_Temp/Veh_DCPortTempPlausibility"
 /begin REF_CHARACTERISTIC Veh_stDCPortTempNoErr_C Veh_tDCPortTempPlausibility_CUR_v Veh_tiDCPortPlausibilityConfirm_C /end REF_CHARACTERISTIC
/end GROUP
/begin GROUP S4092_Veh_DCPortTempStatus "VBU0428Test/VBUSystem/VCU /VehINP/VehINP_Logic/DCPortTemp/Charge_Port_Temp/Veh_DCPortTempStatus"
 /begin REF_CHARACTERISTIC Veh_stDCPortTempErr_C Veh_stDCPortTempNoErr_C Veh_tDCPortNegativeTempCheckEn_C /end REF_CHARACTERISTIC
/end GROUP
/begin GROUP S4101_Digital_Gear_D_R "VBU0428Test/VBUSystem/VCU /VehINP/VehINP_Logic/GearShift/Gear1/Digital_Gear_D_R"
 /begin SUB_GROUP S4102_Gear4DriveIntend S4102_Gear_Bit S4102_Gear_DR_Req S4102_Gear_DR_Warning S4102_Gear_RawReq S4102_Gear_Warning /end SUB_GROUP
/end GROUP
/begin GROUP S4101_Gear4DriveIntend "VBU0428Test/VBUSystem/VCU /VehINP/VehINP_Logic/GearShift/Gear1/Gear4DriveIntend" /begin REF_CHARACTERISTIC Gear_flgDriveIntendGearVld_C /end REF_CHARACTERISTIC /end GROUP
/begin GROUP S4101_Gear_BrakeCondition "VBU0428Test/VBUSystem/VCU /VehINP/VehINP_Logic/GearShift/Gear1/Gear_BrakeCondition" /begin REF_CHARACTERISTIC Gear_flgBrkPressConfig_C Gear_pctBrkPosPressed_C /end REF_CHARACTERISTIC /begin REF_MEASUREMENT Gear_flgBrkPrssed /end REF_MEASUREMENT /end GROUP
/begin GROUP S4101_Gear_DriverShiftPReq "VBU0428Test/VBUSystem/VCU /VehINP/VehINP_Logic/GearShift/Gear1/Gear_DriverShiftPReq"
 /begin REF_CHARACTERISTIC Gear_stEPBApplyReq_C Gear_stEPBNoApplyReq_C Gear_stIntendGearP_C /end REF_CHARACTERISTIC
/end GROUP
/begin GROUP S4101_Gear_EPBStatus "VBU0428Test/VBUSystem/VCU /VehINP/VehINP_Logic/GearShift/Gear1/Gear_EPBStatus"
 /begin REF_CHARACTERISTIC Gear_stEPBApplied_C Gear_stEPBFailNoErr_C Gear_stEPBReleased_C Gear_stEPBUnknow_C Veh_flgNetworkPartialEn_C Veh_stCGWNetworkPartial_C /end REF_CHARACTERISTIC
/end GROUP
/begin GROUP S4101_Gear_ExternalReq "VBU0428Test/VBUSystem/VCU /VehINP/VehINP_Logic/GearShift/Gear1/Gear_ExternalReq" /begin REF_CHARACTERISTIC Gear_tiGearDebounceCnt_C Gear_tiSampleTime_C /end REF_CHARACTERISTIC /end GROUP
/begin GROUP S4101_Gear_P "VBU0428Test/VBUSystem/VCU /VehINP/VehINP_Logic/GearShift/Gear1/Gear_P"
 /begin REF_CHARACTERISTIC Gear_stBCUEPBSwtPressed_C Gear_tiGearPSwitchDebounceCnt_C Gear_tiSampleTime_C /end REF_CHARACTERISTIC
/end GROUP
/begin GROUP S4101_Gear_ProtectCondition "VBU0428Test/VBUSystem/VCU /VehINP/VehINP_Logic/GearShift/Gear1/Gear_ProtectCondition"
 /begin REF_CHARACTERISTIC Gear_flgEmotTqSelect_C Gear_flgTorqueProtectEn_C Gear_stCurrentGearD_C Gear_stCurrentGearR_C Gear_tiSampleTime_C Gear_tiShiftEnableCnt_C Gear_trqShiftDriveEnableLe_C Gear_trqShiftDriveEnableRi_C /end REF_CHARACTERISTIC
/end GROUP
/begin GROUP S4101_Gear_Status "VBU0428Test/VBUSystem/VCU /VehINP/VehINP_Logic/GearShift/Gear1/Gear_Status"
 /begin SUB_GROUP S4110_Gear4Reset S4110_Gear_CurrentValid S4110_Gear_DGear S4110_Gear_DefaultGear S4110_Gear_DriverShiftDReq S4110_Gear_DriverShiftRReq S4110_Gear_DriverShiftTowReq S4110_Gear_GearReq S4110_Gear_InitGear S4110_Gear_PGear S4110_Gear_PGear1 S4110_Gear_Powertrain S4110_Gear_RGear S4110_Warning /end SUB_GROUP
/end GROUP
/begin GROUP S4101_Gear_VehSpeed "VBU0428Test/VBUSystem/VCU /VehINP/VehINP_Logic/GearShift/Gear1/Gear_VehSpeed"
 /begin REF_CHARACTERISTIC Gear_vForce2NThreshold_C Gear_vGearDLowThreshold_C Gear_vGearDMiThreshold_C Gear_vGearPThreshold_C Gear_vTowThreshold_C /end REF_CHARACTERISTIC
/end GROUP
/begin GROUP S4101_Gear_VehicleStatus "VBU0428Test/VBUSystem/VCU /VehINP/VehINP_Logic/GearShift/Gear1/Gear_VehicleStatus" /begin REF_CHARACTERISTIC Gear_stHVRelayClosed_C Gear_stVehModeDCH_C /end REF_CHARACTERISTIC /begin REF_MEASUREMENT Gear_flgGearShiftReady /end REF_MEASUREMENT /end GROUP
/begin GROUP S4218_Veh_AccrMode "VBU0428Test/VBUSystem/VCU /VehINP/VehINP_Logic/Mode/VehMode/Veh_AccrMode"
 /begin REF_CHARACTERISTIC CDC_stVehAccr2Mod_C CDC_stVehAccrNormalMod_C CDC_stVehAccrSportMod_C CGW_flgVehAccrModeCaliOvrd_C CGW_stVehAccr2Mod_C CGW_stVehAccrModeCaliOvrdVal_C CGW_stVehAccrNormalMod_C CGW_stVehAccrSportMod_C Veh_tiModeDebTime_C Veh_tiModeSampleTime_C /end REF_CHARACTERISTIC
/end GROUP
/begin GROUP S4218_Veh_CreepMode "VBU0428Test/VBUSystem/VCU /VehINP/VehINP_Logic/Mode/VehMode/Veh_CreepMode" /begin SUB_GROUP S4220_override_signal1 /end SUB_GROUP
 /begin REF_CHARACTERISTIC CDC_stVehCreepON_C CDC_stVehCreepOff_C CGW_flgVehCreepModeCaliOvrd_C CGW_stVehCreepModeCaliOvrdVal_C CGW_stVehCreepOff_C CGW_stVehCreepOn_C Veh_tiModeDebTime_C Veh_tiModeSampleTime_C /end REF_CHARACTERISTIC
/end GROUP
/begin GROUP S4218_Veh_DrvMode "VBU0428Test/VBUSystem/VCU /VehINP/VehINP_Logic/Mode/VehMode/Veh_DrvMode"
 /begin REF_CHARACTERISTIC CDC_stVehAccrNormalMod_C CDC_stVehAccrSportMod_C CDC_stVehAutoMod_C CDC_stVehECOMod_C CGW_flgVehDrvModeCaliOvrd_C CGW_stVehDrvModeCaliOvrdVal_C CGW_stVehECOMod_C CGW_stVehNormalMod_C CGW_stVehSportMod_C Veh_tiModeDebTime_C Veh_tiModeSampleTime_C /end REF_CHARACTERISTIC
/end GROUP
/begin GROUP S4218_Veh_RgnMode "VBU0428Test/VBUSystem/VCU /VehINP/VehINP_Logic/Mode/VehMode/Veh_RgnMode"
 /begin REF_CHARACTERISTIC CDC_stVehCreepOffRgnOff_C CDC_stVehCreepOnRgnLow_C CDC_stVehCreepOnRgnNormal_C CDC_stVehCreepOnRgnZero_C CGW_flgVehRgnModeCaliOvrd_C CGW_stVehRgnLow_C CGW_stVehRgnModeCaliOvrdVal_C CGW_stVehRgnNormal_C CGW_stVehRgnOff_C CGW_stVehRgnZero_C Veh_tiModeDebTime_C Veh_tiModeSampleTime_C /end REF_CHARACTERISTIC
/end GROUP
/begin GROUP S4261_BPD_BrakePercentStatus "VBU0428Test/VBUSystem/VCU /VehINP/VehINP_Logic/VehINP_BPD/BPD_BrakePercent/BPD_BrakePercentStatus"
 /begin REF_CHARACTERISTIC BPD_pctBrkPedalDownStep_C BPD_pctBrkPedalPressedZero_C BPD_pctBrkPedalPressed_C /end REF_CHARACTERISTIC
 /begin REF_MEASUREMENT BPD_pctBrkPressPercent /end REF_MEASUREMENT
/end GROUP
/begin GROUP S4261_BPD_PressBrake "VBU0428Test/VBUSystem/VCU /VehINP/VehINP_Logic/VehINP_BPD/BPD_BrakePercent/BPD_PressBrake" /begin SUB_GROUP S4266_First_Order_Low_Pass_Filter /end SUB_GROUP
 /begin REF_CHARACTERISTIC BCU_pBrkPres BPD_facBrkPresVoltFilt_C BPD_pctBrkPress_CUR_v /end REF_CHARACTERISTIC
 /begin REF_MEASUREMENT BPD_pBrkPress BPD_pctBrkPress /end REF_MEASUREMENT
/end GROUP
/begin GROUP S4262_BPD_BrakeSwitchHW "VBU0428Test/VBUSystem/VCU /VehINP/VehINP_Logic/VehINP_BPD/BPD_BrakeSwitch/BPD_BrakeSwitchHW" /begin REF_CHARACTERISTIC BPD_numHWBrkSwtDebounce_C /end REF_CHARACTERISTIC /end GROUP
/begin GROUP S4262_BPD_BrakeSwitchSelect "VBU0428Test/VBUSystem/VCU /VehINP/VehINP_Logic/VehINP_BPD/BPD_BrakeSwitch/BPD_BrakeSwitchSelect"
 /begin REF_CHARACTERISTIC BPD_stBrkPedPrsActv_C BPD_stBrkPedPrsPsbl_C BPD_stBrkSwtConfig_C /end REF_CHARACTERISTIC
 /begin REF_MEASUREMENT BPD_flgMainBrkSwt BPD_stBrkPedSwtRaw /end REF_MEASUREMENT
/end GROUP
/begin GROUP S4263_DiagBrkPosDft "VBU0428Test/VBUSystem/VCU /VehINP/VehINP_Logic/VehINP_BPD/BPD_BrkSwtPosPlausibilityCheck/DiagBrkPosDft"
 /begin REF_CHARACTERISTIC BPD_pctBrkPressDiag_C BPD_pctBrkReleaseDiag_C BPD_stBrkPedPrsActv_C BPD_tiDftBrkPosSwtPress_C BPD_tiDftBrkPosSwtRelease_C BPD_tiSampleTime_C /end REF_CHARACTERISTIC
/end GROUP
/begin GROUP S4264_override_signal1 "VBU0428Test/VBUSystem/VCU /VehINP/VehINP_Logic/VehINP_BPD/VehINP_BrkPedOverride/override_signal1" /begin REF_MEASUREMENT BPD_pctBrkPos /end REF_MEASUREMENT /end GROUP
/begin GROUP S4264_override_signal4 "VBU0428Test/VBUSystem/VCU /VehINP/VehINP_Logic/VehINP_BPD/VehINP_BrkPedOverride/override_signal4" /begin REF_MEASUREMENT BPD_stBrkSwt /end REF_MEASUREMENT /end GROUP
/begin GROUP S4281_HVIL "VBU0428Test/VBUSystem/VCU /VehINP/VehINP_Logic/Veh_Status/VehHVIL/HVIL" /begin SUB_GROUP S4282_Veh_HVILCheck S4282_Veh_VCUHVIL /end SUB_GROUP /end GROUP
/begin GROUP S54_Calculate_BatteryCurrent_ZeroDrift "VBU0428Test/VBUSystem/BMS/BCV/BCV/Subsystem/Calculate_BatteryCurrent/Correct_BatteryCurrent/Calculate_BatteryCurrent_ZeroDrift" /begin SUB_GROUP S56_Calculate_Current_ZeroDruft S56_Calculate_ExtremeData /end SUB_GROUP /end GROUP
/begin GROUP S54_Delay_RisingEdge "VBU0428Test/VBUSystem/BMS/BCV/BCV/Subsystem/Calculate_BatteryCurrent/Correct_BatteryCurrent/Delay_RisingEdge" /begin REF_MEASUREMENT BCV_flgBatteryCurrentValid /end REF_MEASUREMENT /end GROUP
/begin GROUP S68_Delay_FallingEdge "VBU0428Test/VBUSystem/BMS/BCV/BCV/Subsystem/Calculate_BatteryVoltage/Check_BatteryVoltage_Valid/Delay_FallingEdge" /begin REF_MEASUREMENT BCV_flgBatteryVoltageValid /end REF_MEASUREMENT /end GROUP
/begin GROUP S69_Delay_FallingEdge "VBU0428Test/VBUSystem/BMS/BCV/BCV/Subsystem/Calculate_BatteryVoltage/Check_BusNegativeVoltage_Valid/Delay_FallingEdge" /begin REF_MEASUREMENT BCV_flgBusNegativeVoltageValid /end REF_MEASUREMENT /end GROUP
/begin GROUP S70_Delay_FallingEdge "VBU0428Test/VBUSystem/BMS/BCV/BCV/Subsystem/Calculate_BatteryVoltage/Check_BusVoltage_Valid/Delay_FallingEdge" /begin REF_MEASUREMENT BCV_flgBusVoltageValid /end REF_MEASUREMENT /end GROUP
/begin GROUP S71_Delay_FallingEdge "VBU0428Test/VBUSystem/BMS/BCV/BCV/Subsystem/Calculate_BatteryVoltage/Check_FuseVoltage_Valid/Delay_FallingEdge" /begin REF_MEASUREMENT BCV_flgFuseVoltageValid /end REF_MEASUREMENT /end GROUP
/begin GROUP S72_Delay_FallingEdge "VBU0428Test/VBUSystem/BMS/BCV/BCV/Subsystem/Calculate_BatteryVoltage/Check_PrechargeVoltage_Valid/Delay_FallingEdge" /begin REF_MEASUREMENT BCV_flgPrechargeVoltageValid /end REF_MEASUREMENT /end GROUP
/begin GROUP S73_Delay_FallingEdge "VBU0428Test/VBUSystem/BMS/BCV/BCV/Subsystem/Calculate_BatteryVoltage/Check_Vx1Voltage_Valid/Delay_FallingEdge" /begin REF_MEASUREMENT BCV_flgVx1VoltageValid /end REF_MEASUREMENT /end GROUP
/begin GROUP S74_Delay_FallingEdge "VBU0428Test/VBUSystem/BMS/BCV/BCV/Subsystem/Calculate_BatteryVoltage/Check_Vx2Voltage_Valid/Delay_FallingEdge" /begin REF_MEASUREMENT BCV_flgVx2VoltageValid /end REF_MEASUREMENT /end GROUP
/begin GROUP S107_Accumulate_Carry "VBU0428Test/VBUSystem/BMS/BCV/BCV/Subsystem/Calculate_Lifetime_Data/Calculate_LifeTimeFastcharge/Accumulate_Carry" /begin REF_MEASUREMENT BCV_AhOverallCoulombFCCChgCarry /end REF_MEASUREMENT /end GROUP
/begin GROUP S136_EVM_FDC_Handler "VBU0428Test/VBUSystem/BMS/BCV/BCV/Subsystem/Diagnose_BCV_Data_Fault/Diagnose_VoltageCurrent_Fault/EVM_FDC_Handler" /begin SUB_GROUP S143_DetermineFault S143_DetermineFaultCounter /end SUB_GROUP /end GROUP
/begin GROUP S136_EVM_FDC_Handler1 "VBU0428Test/VBUSystem/BMS/BCV/BCV/Subsystem/Diagnose_BCV_Data_Fault/Diagnose_VoltageCurrent_Fault/EVM_FDC_Handler1" /begin SUB_GROUP S144_DetermineFault S144_DetermineFaultCounter /end SUB_GROUP /end GROUP
/begin GROUP S136_EVM_FDC_Handler2 "VBU0428Test/VBUSystem/BMS/BCV/BCV/Subsystem/Diagnose_BCV_Data_Fault/Diagnose_VoltageCurrent_Fault/EVM_FDC_Handler2" /begin SUB_GROUP S145_DetermineFault S145_DetermineFaultCounter /end SUB_GROUP /end GROUP
/begin GROUP S186_Diagnose_BdmOutOfRange_Fault "VBU0428Test/VBUSystem/BMS/BCV/BCV/Subsystem/Monitor_BCV_Performance/Diagnose_BDM_BCV_Communication_Fault/Diagnose_BdmOutOfRange_Fault" /begin SUB_GROUP S192_BigDataMonitor_Handler S192_BigDataMonitor_Handler1 /end SUB_GROUP
 /begin REF_CHARACTERISTIC CbBCV_BdmBatteryCurrentOoR_flg CbBCV_BdmBatteryVoltageOoR_flg CcBCV_BdmBatteryCurrentOoRFaultFIC_n CcBCV_BdmBatteryCurrentOoRFaultPIC_n CcBCV_BdmBatteryCurrentOoR_A CcBCV_BdmBatteryVoltageOoRFaultFIC_n CcBCV_BdmBatteryVoltageOoRFaultPIC_n CcBCV_BdmBatteryVoltageOoRHigh_V CcBCV_BdmBatteryVoltageOoRLow_V /end REF_CHARACTERISTIC
/end GROUP
/begin GROUP S187_Diagnose_BdmBatteryBusVoltageMismatch_Fault "VBU0428Test/VBUSystem/BMS/BCV/BCV/Subsystem/Monitor_BCV_Performance/Diagnose_BDM_BCV_Data_Fault/Diagnose_BdmBatteryBusVoltageMismatch_Fault" /begin SUB_GROUP S203_BigDataMonitor_Handler1 /end SUB_GROUP
 /begin REF_CHARACTERISTIC CbBCV_BdmBatteryBusVoltageMismatch_flg CcBCV_BdmBatteryBusVoltageMismatchFaultDelta_V CcBCV_BdmBatteryBusVoltageMismatchFaultFIC_n CcBCV_BdmBatteryBusVoltageMismatchFaultPIC_n CcBCV_BdmBatteryBusVoltageMismatchFault_V /end REF_CHARACTERISTIC
/end GROUP
/begin GROUP S187_Diagnose_BdmVoltageCurrent_Fault "VBU0428Test/VBUSystem/BMS/BCV/BCV/Subsystem/Monitor_BCV_Performance/Diagnose_BDM_BCV_Data_Fault/Diagnose_BdmVoltageCurrent_Fault"
 /begin SUB_GROUP S204_BigDataMonitor_Handler S204_BigDataMonitor_Handler1 S204_BigDataMonitor_Handler2 /end SUB_GROUP
 /begin REF_CHARACTERISTIC CbBCV_BdmBatteryOverCurrent_flg CbBCV_BdmBatteryOverVoltage_flg CbBCV_BdmBatteryUnderVoltage_flg CcBCV_BdmBatteryOverCurrentFaultFIC_n CcBCV_BdmBatteryOverCurrentFaultPIC_n CcBCV_BdmBatteryOverCurrent_A CcBCV_BdmBatteryOverVoltageFaultFIC_n CcBCV_BdmBatteryOverVoltageFaultPIC_n CcBCV_BdmBatteryOverVoltage_V CcBCV_BdmBatteryUnderVoltage1_V CcBCV_BdmBatteryUnderVoltage2_V CcBCV_BdmBatteryUnderVoltageFaultFIC_n CcBCV_BdmBatteryUnderVoltageFaultPIC_n CcBCV_BdmBatteryUnderVoltageTemp_C /end REF_CHARACTERISTIC
/end GROUP
/begin GROUP S317_Cell0 "VBU0428Test/VBUSystem/BMS/CBL/Subsystem8/Subsystem/Determine_CSCCellBalanceRequest/Determine_CellBalanceRequest/Cell0"
 /begin SUB_GROUP S324_Determine_CellBlanceTime S324_Determine_SocBalanceReq S324_Determine_VoltageBalanceReq /end SUB_GROUP
/end GROUP
/begin GROUP S322_Balance_Fault_Diagnostic1 "VBU0428Test/VBUSystem/BMS/CBL/Subsystem8/Subsystem/Determine_CSCCellBalanceRequest/Subsystem/Balance_Fault_Diagnostic1" /begin REF_CHARACTERISTIC CcCBL_CellBalanceRespMismatchReqtTimeLmt_ms /end REF_CHARACTERISTIC /end GROUP
/begin GROUP S387_Determine_Diagnostic_Status "VBU0428Test/VBUSystem/BMS/CTD/Subsystem/Subsystem4/DiagnoseRelayWeld/MNC_Weld_Check/Determine_Diagnostic_Status" /begin REF_MEASUREMENT CTD_stMnNegContactorWeldDiagnosticStatus /end REF_MEASUREMENT /end GROUP
/begin GROUP S387_Equal_to_LOW1 "VBU0428Test/VBUSystem/BMS/CTD/Subsystem/Subsystem4/DiagnoseRelayWeld/MNC_Weld_Check/Equal_to_LOW1" /begin REF_CHARACTERISTIC LOW /end REF_CHARACTERISTIC /end GROUP
/begin GROUP S388_Determine_Diagnostic_Status "VBU0428Test/VBUSystem/BMS/CTD/Subsystem/Subsystem4/DiagnoseRelayWeld/MPC_Weld_Check/Determine_Diagnostic_Status" /begin REF_MEASUREMENT CTD_stMnPosContactorWeldDiagnosticStatus /end REF_MEASUREMENT /end GROUP
/begin GROUP S388_Equal_to_LOW1 "VBU0428Test/VBUSystem/BMS/CTD/Subsystem/Subsystem4/DiagnoseRelayWeld/MPC_Weld_Check/Equal_to_LOW1" /begin REF_CHARACTERISTIC LOW /end REF_CHARACTERISTIC /end GROUP
/begin GROUP S388_Equal_to_LOW2 "VBU0428Test/VBUSystem/BMS/CTD/Subsystem/Subsystem4/DiagnoseRelayWeld/MPC_Weld_Check/Equal_to_LOW2" /begin REF_CHARACTERISTIC LOW /end REF_CHARACTERISTIC /end GROUP
/begin GROUP S428_Determine_Heat_LockTime "VBU0428Test/VBUSystem/BMS/CTD/Subsystem/Subsystem4/Lockout_Precharge_Process/HeatProtection_Lockout/Determine_Heat_LockTime"
 /begin REF_CHARACTERISTIC CbCTD_PrechargeHeatProtectionEnable_flg CcCTD_MinHeatDissipation_J CcCTD_OnePrechargeHeat_J /end REF_CHARACTERISTIC
 /begin REF_MEASUREMENT LcCTD_tiPrechargeHeatProtectionTime /end REF_MEASUREMENT
/end GROUP
/begin GROUP S428_Determine_LockPoint_AvaliableHeat "VBU0428Test/VBUSystem/BMS/CTD/Subsystem/Subsystem4/Lockout_Precharge_Process/HeatProtection_Lockout/Determine_LockPoint_AvaliableHeat" /begin REF_CHARACTERISTIC CcCTD_OnePrechargeHeat_J /end REF_CHARACTERISTIC /end GROUP
/begin GROUP S454_Determine_Precharge_JouleHeat "VBU0428Test/VBUSystem/BMS/CTD/Subsystem/Subsystem4/PrechrgProcessMonitoring/Precharge_Thermal_Management/Determine_Precharge_JouleHeat" /begin SUB_GROUP S458_Determine_Accumulated_RemainingHeat /end SUB_GROUP /begin REF_CHARACTERISTIC CcCTD_MaxJouleHeat_J CcCTD_PrechargeResistance_ohm /end REF_CHARACTERISTIC /begin REF_MEASUREMENT LcCTD_PrechargeJouleHeat_J /end REF_MEASUREMENT /end GROUP
/begin GROUP S454_Perform_OverEnergy_Diagnostic "VBU0428Test/VBUSystem/BMS/CTD/Subsystem/Subsystem4/PrechrgProcessMonitoring/Precharge_Thermal_Management/Perform_OverEnergy_Diagnostic"
 /begin REF_CHARACTERISTIC CbCTD_PrechargeEnergyHighFaultEnable_flg CcCTD_PrechargeEnergyHighFaultFIC_n CcCTD_PrechargeEnergyHighFaultPIC_n CcCTD_PrechargeOverEnergy_J /end REF_CHARACTERISTIC
 /begin REF_MEASUREMENT CTD_stPrechargeEnergyHighFault LbCTD_PrechargeEnergyHighTestEnable_flg LbCTD_PrechargeEnergyHighTestFail_flg /end REF_MEASUREMENT
/end GROUP
/begin GROUP S456_Status_Idle "VBU0428Test/VBUSystem/BMS/CTD/Subsystem/Subsystem4/PrechrgProcessMonitoring/Precharging_Process_Monitoring/Status_Idle" /begin REF_CHARACTERISTIC CTD_PRECHARGE_STATUS_IDLE /end REF_CHARACTERISTIC /end GROUP
/begin GROUP S476_MNC_Stuck_Open_With_VehicleSpeed "VBU0428Test/VBUSystem/BMS/CTD/Subsystem/Subsystem4/Stuck_Open_Diagnostic/MNC_Stuck_Open/MNC_Stuck_Open_With_VehicleSpeed"
 /begin SUB_GROUP S480_CONTACTOR_STATUS_CLOSED1 S480_Determine_Diagnostic_Status S480_Equal_to_HIGH1 /end SUB_GROUP
 /begin REF_CHARACTERISTIC CTD_MAIN_NEGATIVE_CONTACTOR_STUCK_OPEN_FAULT CbCTD_MnNegContactorStuckOpenFaultEnable_flg CcCTD_MNCStuckOpenCurrentMax_A CcCTD_MnNegContactorOpenDeltaVoltage_V CcCTD_MnNegContactorStuckOpenFaultFIC_n CcCTD_MnNegContactorStuckOpenFaultPIC_n /end REF_CHARACTERISTIC
 /begin REF_MEASUREMENT CTD_stMnNegContactorStuckOpenFault /end REF_MEASUREMENT
/end GROUP
/begin GROUP S476_MNC_Stuck_Open_Without_VehicleSpeed "VBU0428Test/VBUSystem/BMS/CTD/Subsystem/Subsystem4/Stuck_Open_Diagnostic/MNC_Stuck_Open/MNC_Stuck_Open_Without_VehicleSpeed" /begin SUB_GROUP S481_CONTACTOR_STATUS_CLOSED1 S481_Equal_to_HIGH1 /end SUB_GROUP
 /begin REF_CHARACTERISTIC CbCTD_RnMnNegContactorStuckOpenFaultEnable_flg CcCTD_RnMNCStuckOpenCurrentMax_A CcCTD_RnMnNegContactorOpenDeltaVoltage_V CcCTD_RnMnNegContactorStuckOpenFaultFIC_n CcCTD_RnMnNegContactorStuckOpenFaultPIC_n /end REF_CHARACTERISTIC
 /begin REF_MEASUREMENT CTD_flgRnMnNegContactorStuckOpenTestEnable CTD_flgRnMnNegContactorStuckOpenTestFail CTD_stRnMnNegContactorStuckOpenFault /end REF_MEASUREMENT
/end GROUP
/begin GROUP S477_MPC_Stuck_Open_Within_VehicleSpeed "VBU0428Test/VBUSystem/BMS/CTD/Subsystem/Subsystem4/Stuck_Open_Diagnostic/MPC_Stuck_Open/MPC_Stuck_Open_Within_VehicleSpeed" /begin SUB_GROUP S503_CONTACTOR_STATUS_CLOSED1 /end SUB_GROUP
 /begin REF_CHARACTERISTIC CbCTD_RnMnPosContactorStuckOpenFaultEnable_flg CcCTD_RnMnPosContactorOpenDeltaVoltage_V CcCTD_RnMnPosContactorStuckOpenFaultFIC_n CcCTD_RnMnPosContactorStuckOpenFaultPIC_n /end REF_CHARACTERISTIC
 /begin REF_MEASUREMENT CTD_flgRnMnPosContactorStuckOpenTestFail CTD_stRnMnPosContactorStuckOpenFault LbCTD_RnMnPosContactorStuckOpenTestEnable_flg /end REF_MEASUREMENT
/end GROUP
/begin GROUP S477_MPC_Stuck_Open_Without_VehicleSpeed "VBU0428Test/VBUSystem/BMS/CTD/Subsystem/Subsystem4/Stuck_Open_Diagnostic/MPC_Stuck_Open/MPC_Stuck_Open_Without_VehicleSpeed"
 /begin SUB_GROUP S504_CONTACTOR_STATUS_CLOSED1 S504_Determine_Diagnostic_Status S504_Equal_to_HIGH1 /end SUB_GROUP
 /begin REF_CHARACTERISTIC CTD_MAIN_POSITIVE_CONTACTOR_STUCK_OPEN_FAULT CbCTD_MnPosContactorStuckOpenFaultEnable_flg CcCTD_MnPosContactorOpenDeltaVoltage_V CcCTD_MnPosContactorStuckOpenFaultFIC_n CcCTD_MnPosContactorStuckOpenFaultPIC_n /end REF_CHARACTERISTIC
 /begin REF_MEASUREMENT CTD_stMnPosContactorStuckOpenFault /end REF_MEASUREMENT
/end GROUP
/begin GROUP S478_Determine_Diagnostic_Status "VBU0428Test/VBUSystem/BMS/CTD/Subsystem/Subsystem4/Stuck_Open_Diagnostic/MPR_Stuck_Open/Determine_Diagnostic_Status" /begin REF_MEASUREMENT CTD_stPrechargeRelayStuckOpenDiagnosticStatus /end REF_MEASUREMENT /end GROUP
/begin GROUP S478_Equal_to_HIGH "VBU0428Test/VBUSystem/BMS/CTD/Subsystem/Subsystem4/Stuck_Open_Diagnostic/MPR_Stuck_Open/Equal_to_HIGH" /begin REF_CHARACTERISTIC HIGH /end REF_CHARACTERISTIC /end GROUP
/begin GROUP S593_CellTemp_ChangeRate_Calculate "VBU0428Test/VBUSystem/BMS/CTM/CTM/Subsystem/Determine_Thermal_Runaway/DetermineTempRiseRate/CellTemp_ChangeRate_Calculate" /begin REF_CHARACTERISTIC CcCTM_CellThermalRunawayRatePerSecond_C /end REF_CHARACTERISTIC /end GROUP
/begin GROUP S631_Combine_Precharge_Conditions "VBU0428Test/VBUSystem/BMS/CTS/CTS/Subsystem/DeterminePrechargeConditions/Precharge_Inhibit_Abort/Combine_Precharge_Conditions"
 /begin REF_CHARACTERISTIC LbCTS_AbortPrechargeOvrdVal_flg LbCTS_AbortPrechargeOvrd_flg LbCTS_InhibitPrechargeOvrdVal_flg LbCTS_InhibitPrechargeOvrd_flg /end REF_CHARACTERISTIC
 /begin REF_MEASUREMENT CTS_flgAbortPrecharge CTS_flgInhibitPrecharge /end REF_MEASUREMENT
/end GROUP
/begin GROUP S690_BigDataMonitor_Handler1 "VBU0428Test/VBUSystem/BMS/CVT/CVT/Subsystem/Monitor_CVT_Performance/Determine_CellVoltage_OverDeviationBDM/BigDataMonitor_Handler1" /begin SUB_GROUP S693_DetermineFault S693_DetermineFaultCounter /end SUB_GROUP /end GROUP
/begin GROUP S691_BigDataMonitor_Handler "VBU0428Test/VBUSystem/BMS/CVT/CVT/Subsystem/Monitor_CVT_Performance/Determine_CellVoltage_OverUnderBDM/BigDataMonitor_Handler" /begin SUB_GROUP S698_DetermineFault S698_DetermineFaultCounter /end SUB_GROUP /end GROUP
/begin GROUP S691_BigDataMonitor_Handler2 "VBU0428Test/VBUSystem/BMS/CVT/CVT/Subsystem/Monitor_CVT_Performance/Determine_CellVoltage_OverUnderBDM/BigDataMonitor_Handler2" /begin SUB_GROUP S699_DetermineFault S699_DetermineFaultCounter /end SUB_GROUP /end GROUP
/begin GROUP S754_EqualPorportionMapping3 "VBU0428Test/VBUSystem/BMS/FCC /FCC/Subsystem/Calculate_Fastcharge_Time/SOC_Mapping/EqualPorportionMapping3" /begin REF_MEASUREMENT FCC_pctEightySOCMappingRealSoc /end REF_MEASUREMENT /end GROUP
/begin GROUP S754_EqualPorportionMapping4 "VBU0428Test/VBUSystem/BMS/FCC /FCC/Subsystem/Calculate_Fastcharge_Time/SOC_Mapping/EqualPorportionMapping4" /begin REF_MEASUREMENT FCC_pctDisplaySocMappingRealSoc /end REF_MEASUREMENT /end GROUP
/begin GROUP S754_EqualPorportionMapping5 "VBU0428Test/VBUSystem/BMS/FCC /FCC/Subsystem/Calculate_Fastcharge_Time/SOC_Mapping/EqualPorportionMapping5" /begin REF_MEASUREMENT FCC_pctMaxSetSocMappingRealSoc /end REF_MEASUREMENT /end GROUP
/begin GROUP S798_Decrease_ChargeCurrentRequest "VBU0428Test/VBUSystem/BMS/FCC /FCC/Subsystem/Determine_Fastcharge_Request/Charge_Request_Protection/Decrease_ChargeCurrentRequest"
 /begin REF_CHARACTERISTIC CcFCC_ChargeCurrentOverDelay_s CcFCC_ChargeCurrentOverEnable_flg CcFCC_ChargeCurrentOverFuncEnable_flg CcFCC_ChargeCurrentRequestDec_A /end REF_CHARACTERISTIC
 /begin REF_MEASUREMENT FCC_flgChargeCurrentDerate FCC_iAChargeCurrentReqDec FCC_iADecreasedChargeCurrentRequest /end REF_MEASUREMENT
/end GROUP
/begin GROUP S798_Override_Block1 "VBU0428Test/VBUSystem/BMS/FCC /FCC/Subsystem/Determine_Fastcharge_Request/Charge_Request_Protection/Override_Block1" /begin REF_CHARACTERISTIC CbFCC_ChargeCurrentOvR_flg CcFCC_ChargeCurrentOvRValue_A /end REF_CHARACTERISTIC /begin REF_MEASUREMENT FCC_iARawChargeCurrentRequestFnl /end REF_MEASUREMENT /end GROUP
/begin GROUP S798_Override_Voltage_Request "VBU0428Test/VBUSystem/BMS/FCC /FCC/Subsystem/Determine_Fastcharge_Request/Charge_Request_Protection/Override_Voltage_Request" /begin SUB_GROUP S804_Override_Block3 /end SUB_GROUP /begin REF_CHARACTERISTIC CcFCC_ChargeVoltageDelta_V /end REF_CHARACTERISTIC /begin REF_MEASUREMENT FCC_uChargeVoltageRequestFnl /end REF_MEASUREMENT /end GROUP
/begin GROUP S798_Rate_Limiter "VBU0428Test/VBUSystem/BMS/FCC /FCC/Subsystem/Determine_Fastcharge_Request/Charge_Request_Protection/Rate_Limiter" /begin REF_MEASUREMENT FCC_kwChargePowerReqFnl /end REF_MEASUREMENT /end GROUP
/begin GROUP S799_Determine_ComputeResistanceCondition "VBU0428Test/VBUSystem/BMS/FCC /FCC/Subsystem/Determine_Fastcharge_Request/DetermineComputeResistancePulseCurrent/Determine_ComputeResistanceCondition" /begin SUB_GROUP S812_Delay_FallingEdge S812_RS_Flip_Flop S812_S_H /end SUB_GROUP
 /begin REF_CHARACTERISTIC CbFCC_ComputeResistanceEnable_flg CcFCC_ComputeResistanceDelayTime_ms CcFCC_ComputeResistanceEndVoltage_mV CcFCC_ComputeResistanceRelaxationTime_ms CcFCC_ComputeResistanceStartVoltage_mV CcFCC_ComputeResistanceTempMax_C CcFCC_ComputeResistanceTempMin_C CcSYS_ResisCalPulseCurrentDurationTime_ms /end REF_CHARACTERISTIC
 /begin REF_MEASUREMENT FCC_flgComputeResistancePrecondition /end REF_MEASUREMENT
/end GROUP
/begin GROUP S799_Determine_ComputeResistancePulseRequest "VBU0428Test/VBUSystem/BMS/FCC /FCC/Subsystem/Determine_Fastcharge_Request/DetermineComputeResistancePulseCurrent/Determine_ComputeResistancePulseRequest"
 /begin REF_CHARACTERISTIC CcSYS_ResisCalFCCPulseCurrent_A CcSYS_ResisCalRelaxationCurrent_A /end REF_CHARACTERISTIC
/end GROUP
/begin GROUP S799_Determine_FastChargeRequest "VBU0428Test/VBUSystem/BMS/FCC /FCC/Subsystem/Determine_Fastcharge_Request/DetermineComputeResistancePulseCurrent/Determine_FastChargeRequest" /begin REF_MEASUREMENT FCC_iAChargeCurrentRequestRaw /end REF_MEASUREMENT /end GROUP
/begin GROUP S800_Request_At_Charging "VBU0428Test/VBUSystem/BMS/FCC /FCC/Subsystem/Determine_Fastcharge_Request/Determine_Base_ChargeRequest/Request_At_Charging"
 /begin REF_CHARACTERISTIC CaFCC_VCRVCUAuxPowerFactorVoltageTempMapDimension_n CaFCC_VCRVCUAuxPowerFactorVoltageTempMapZ_nbr CcFCC_ChargeCurrentDerateSocDelta_pct CcFCC_ChargeCurrentDerateSoc_pct /end REF_CHARACTERISTIC
/end GROUP
/begin GROUP S800_Request_At_NoCharging "VBU0428Test/VBUSystem/BMS/FCC /FCC/Subsystem/Determine_Fastcharge_Request/Determine_Base_ChargeRequest/Request_At_NoCharging"
 /begin REF_CHARACTERISTIC CaFCC_VCRVCUAuxPowerFactorVoltageTempMapDimension_n CaFCC_VCRVCUAuxPowerFactorVoltageTempMapZ_nbr CcFCC_ChargeVoltageDelta_V /end REF_CHARACTERISTIC
/end GROUP
/begin GROUP S832_Cell_Temp_Protection "VBU0428Test/VBUSystem/BMS/FCC /FCC/Subsystem/Fastcharge_Conditions_Check/Condition_Categorize/Cell_Temp_Protection"
 /begin REF_CHARACTERISTIC CbFCC_NoChargeHighTempEnable_flg CbFCC_NoChargeLowTempEnable_flg CcFCC_HighTempDebounceTime_s /end REF_CHARACTERISTIC
 /begin REF_MEASUREMENT FCC_flgCellTempLowProhibitCharge FCC_flgCellTempProhibitCharge /end REF_MEASUREMENT
/end GROUP
/begin GROUP S832_Full_Charge_Determination "VBU0428Test/VBUSystem/BMS/FCC /FCC/Subsystem/Fastcharge_Conditions_Check/Condition_Categorize/Full_Charge_Determination"
 /begin SUB_GROUP S841_FullCharge_criteria1 S841_FullCharge_criteria2 S841_FullCharge_criteria4 /end SUB_GROUP
 /begin REF_MEASUREMENT FCC_flgFullChargeComplete /end REF_MEASUREMENT
/end GROUP
/begin GROUP S832_Voltage_Protection "VBU0428Test/VBUSystem/BMS/FCC /FCC/Subsystem/Fastcharge_Conditions_Check/Condition_Categorize/Voltage_Protection"
 /begin REF_CHARACTERISTIC CbFCC_BatteryVoltageMaxlimitEnable_flg CbFCC_CellVoltageMaxlimitEnable_flg CcFCC_BatteryVoltageMaxLimitDebounceTime_s CcFCC_CellVoltageMaxLimitDebounceTime_s /end REF_CHARACTERISTIC
 /begin REF_MEASUREMENT FCC_flgVoltageProhibitCharge /end REF_MEASUREMENT
/end GROUP
/begin GROUP S986_Determine_Cell_Balanced_Capacity "VBU0428Test/VBUSystem/BMS/SOC/Subsystem5/Subsystem/Determine_AhIntegral_SoC/Determine_AhIntegral_Capacity/Determine_Cell_Balanced_Capacity"
 /begin REF_CHARACTERISTIC CcSYS_BalanceResistance_ohm CcSYS_CellBalanceDutyCycle_pct MILIAMPERES_PER_AMPERE /end REF_CHARACTERISTIC
/end GROUP
/begin GROUP S1021_Determine_SOC_RateLimit "VBU0428Test/VBUSystem/BMS/SOC/Subsystem5/Subsystem/Determine_Display_SOC/DisplaySOC_Driving_Calculation/Determine_SOC_RateLimit"
 /begin REF_CHARACTERISTIC CaSOC_BatteryDisplaySocDischargeDecRateY_n CaSOC_BatteryDisplaySocDischargeIncRateY_n CaSOC_SOCDisChargeDecOffsetY_n CaSOC_SOCDisChargeIncOffsetY_n CbSOC_DisplaySOCRateDynamicEnable_flg CcSOC_BatteryDisplaySocChargeDecRate_n CcSOC_BatteryDisplaySocChargeIncRate_n /end REF_CHARACTERISTIC
 /begin REF_MEASUREMENT SOC_pctBatteryDisplaySocChargeDecRate SOC_pctBatteryDisplaySocChargeIncRate SOC_pctBatteryDisplaySocDischargeDecRate SOC_pctBatteryDisplaySocDischargeIncRate /end REF_MEASUREMENT
/end GROUP
/begin GROUP S1045_FastCharge_DynamicCorrection_Enable "VBU0428Test/VBUSystem/BMS/SOC/Subsystem5/Subsystem/Determine_FastChargeCorrection_Soc/FastCharge_DynamicCorrection/FastCharge_DynamicCorrection_Enable"
 /begin SUB_GROUP S1053_Calculate_WindowAverage_BatteryCurrent S1053_Determine_CurrentStable_Condition S1053_VoltThldEdge S1053_VoltThldEdge1 /end SUB_GROUP
 /begin REF_CHARACTERISTIC BATTERY_BOL_SOH BATTERY_EOL_SOH CaSOC_CCCorrectionMapDimension_n CaSOC_FastChargeCCCorrectionBOLVoltThd1Z_mV CaSOC_FastChargeCCCorrectionEOLVoltThd1Z_mV CaSOC_FastChargeCCCorrectionSoc1Z_pct CaSOC_FastChargeCCCorrectionSoc2Z_pct CaSOC_FastChargeCCCorrectionVoltThd2Z_mV CbSOC_FastChargeCCCorrection2Enable_flg /end REF_CHARACTERISTIC
 /begin REF_MEASUREMENT LaSOC_pctCellSocFastChargeCorrection SOC_flgSocFastChargeCorrection SOC_pctCellVoltageMaxCorrectionSoc /end REF_MEASUREMENT
/end GROUP
/begin GROUP S1069_After_Startup "VBU0428Test/VBUSystem/BMS/SOC/Subsystem5/Subsystem/Determine_Initial_SoC/Determine_Soc_Jump/After_Startup"
 /begin REF_CHARACTERISTIC SOC_JUMP_ABNORMAL_POWER_OFF SOC_JUMP_ABNORMAL_RESET SOC_JUMP_NONE SOC_JUMP_OCV_CORRECTION /end REF_CHARACTERISTIC
/end GROUP
/begin GROUP S1069_Startup "VBU0428Test/VBUSystem/BMS/SOC/Subsystem5/Subsystem/Determine_Initial_SoC/Determine_Soc_Jump/Startup"
 /begin REF_CHARACTERISTIC SOC_JUMP_ABNORMAL_POWER_OFF SOC_JUMP_ABNORMAL_RESET SOC_JUMP_NONE SOC_JUMP_OCV_CORRECTION /end REF_CHARACTERISTIC
/end GROUP
/begin GROUP S1093_Calculate_Cell_Temperature "VBU0428Test/VBUSystem/BMS/SOC/Subsystem5/Subsystem/Determine_OcvSoc/Replace_Invalid_CellTemperature/Calculate_Cell_Temperature" /begin REF_MEASUREMENT LaSOC_CellTemp_C /end REF_MEASUREMENT /end GROUP
/begin GROUP S1097_Current_Limit "VBU0428Test/VBUSystem/BMS/SOC/Subsystem5/Subsystem/Determine_ShortTimeCorrection_Condition/Current_Limit_Condition/Current_Limit" /begin REF_CHARACTERISTIC CcSOC_iAOcvShortTimeCurrentLimit /end REF_CHARACTERISTIC /begin REF_MEASUREMENT SOC_flgOcvShortTimeCurrentEnable /end REF_MEASUREMENT /end GROUP
/begin GROUP S1131_Calculate_Energy_Retention_Factor "VBU0428Test/VBUSystem/BMS/SOE/Subsystem2/Subsystem/Calculate_Pack_Remaining_Energy/Discharge_Mode/Calculate_Energy_Retention_Factor" /begin REF_CHARACTERISTIC CaSOE_SocOcvMapZ_mV CaSOE_SocResistanceLongMapZ_mohm /end REF_CHARACTERISTIC /end GROUP
/begin GROUP S1131_Predict_SOC_End "VBU0428Test/VBUSystem/BMS/SOE/Subsystem2/Subsystem/Calculate_Pack_Remaining_Energy/Discharge_Mode/Predict_SOC_End"
 /begin REF_CHARACTERISTIC CaSOE_SocOcvMapZ_mV CaSOE_SocResistanceLongMapZ_mohm CcSOE_CellVoltageLowerLimit_mV CcSOE_MaxInterationNumber_n /end REF_CHARACTERISTIC
/end GROUP
/begin GROUP S1178_Rate_Limiter "VBU0428Test/VBUSystem/BMS/SOF/Subsystem6/Subsystem/Calculate_PowerLimit/Calculate_Pack_OCV/Rate_Limiter" /begin REF_CHARACTERISTIC CcSOF_DischargeLowOCVStepSlope_V /end REF_CHARACTERISTIC /end GROUP
/begin GROUP S1179_Power_Limit_Cycle_Level1 "VBU0428Test/VBUSystem/BMS/SOF/Subsystem6/Subsystem/Calculate_PowerLimit/Determine_Capacity_Cycle_PowerLimit/Power_Limit_Cycle_Level1"
 /begin SUB_GROUP S1187_Power_Limit_Level1_ChargePowerLimit S1187_Power_Limit_Level1_DischargePowerLimit /end SUB_GROUP
/end GROUP
/begin GROUP S1179_Power_Limit_Cycle_Level2 "VBU0428Test/VBUSystem/BMS/SOF/Subsystem6/Subsystem/Calculate_PowerLimit/Determine_Capacity_Cycle_PowerLimit/Power_Limit_Cycle_Level2"
 /begin SUB_GROUP S1188_Power_Limit_Cycle_Level2_ChargePowerLimit S1188_Power_Limit_Cycle_Level2_DischargePowerLimit /end SUB_GROUP
/end GROUP
/begin GROUP S1179_Power_Limit_Cycle_Level3 "VBU0428Test/VBUSystem/BMS/SOF/Subsystem6/Subsystem/Calculate_PowerLimit/Determine_Capacity_Cycle_PowerLimit/Power_Limit_Cycle_Level3"
 /begin SUB_GROUP S1189_Power_Limit_Cycle_Level3_ChargePowerLimit S1189_Power_Limit_Cycle_Level3_DischargePowerLimit /end SUB_GROUP
/end GROUP
/begin GROUP S1180_Determine_ContinuousDischargePowerLimitTarget "VBU0428Test/VBUSystem/BMS/SOF/Subsystem6/Subsystem/Calculate_PowerLimit/Determine_SOCP_PowerLimit/Determine_ContinuousDischargePowerLimitTarget" /begin SUB_GROUP S1197_Determine_SOCP_Condition /end SUB_GROUP
 /begin REF_CHARACTERISTIC CcSOF_SocpDischargePowerMin_Kw CcSOF_SocpDischargePowerSlope_Kw /end REF_CHARACTERISTIC
 /begin REF_MEASUREMENT SOF_kwContinuousDischargePowerLimitTarget /end REF_MEASUREMENT
/end GROUP
/begin GROUP S1180_Determine_DischargePowerLimitTarget "VBU0428Test/VBUSystem/BMS/SOF/Subsystem6/Subsystem/Calculate_PowerLimit/Determine_SOCP_PowerLimit/Determine_DischargePowerLimitTarget" /begin SUB_GROUP S1198_Determine_SOCP_Condition /end SUB_GROUP
 /begin REF_CHARACTERISTIC CcSOF_SocpDischargePowerMin_Kw CcSOF_SocpDischargePowerSlope_Kw /end REF_CHARACTERISTIC
 /begin REF_MEASUREMENT SOF_kwDischargePowerLimitTarget /end REF_MEASUREMENT
/end GROUP
/begin GROUP S1210_Calculate_CurrentLimit_Base "VBU0428Test/VBUSystem/BMS/SOF/Subsystem6/Subsystem/Determine_Currentlimit_Target/Calculate_CurrentLimit_Target/Calculate_CurrentLimit_Base"
 /begin SUB_GROUP S1212_Calculate_ContinuousChargeCurrent S1212_Calculate_ContinuousDischargeCurrent S1212_Calculate_ShortPulseChargeCurrent S1212_Calculate_ShortPulseDischargeCurrent S1212_Determine_LowVoltageLimitChargeCurrent /end SUB_GROUP
 /begin REF_CHARACTERISTIC CcSOF_LowVoltChgCurtSloDelay_ms CcSOF_LowVoltageChargeCurrentMax_A CcSOF_LowVoltageChargeCurrentSlopeDec_A CcSOF_LowVoltageChargeCurrentSlopeInc_A CcSOF_LowVoltageChargeLimitEnable_flg CcSOF_LowVoltagePowerOnDelay_ms /end REF_CHARACTERISTIC
 /begin REF_MEASUREMENT SOF_iAContinuousChargeCurrentLimitBase SOF_iAShortPulseChargeCurrentLimitBase /end REF_MEASUREMENT
/end GROUP
/begin GROUP S1210_Calculate_Dynamic_CurrentLimit "VBU0428Test/VBUSystem/BMS/SOF/Subsystem6/Subsystem/Determine_Currentlimit_Target/Calculate_CurrentLimit_Target/Calculate_Dynamic_CurrentLimit"
 /begin SUB_GROUP S1213_Calculate_Dynamic_ChargeCurrentLimit S1213_Calculate_Dynamic_DischargeCurrentLimit /end SUB_GROUP
/end GROUP
/begin GROUP S1210_CurrentLimit_FastCharge_Check "VBU0428Test/VBUSystem/BMS/SOF/Subsystem6/Subsystem/Determine_Currentlimit_Target/Calculate_CurrentLimit_Target/CurrentLimit_FastCharge_Check"
 /begin SUB_GROUP S1214_FastChrgOneThirdRateCurrentLimitCheck S1214_SegmentChargeCheck /end SUB_GROUP
/end GROUP
/begin GROUP S1210_CurrentLimit_Fault_Correct "VBU0428Test/VBUSystem/BMS/SOF/Subsystem6/Subsystem/Determine_Currentlimit_Target/Calculate_CurrentLimit_Target/CurrentLimit_Fault_Correct" /begin SUB_GROUP S1215_CAT4 S1215_Determine_StopCharge_Condition /end SUB_GROUP
 /begin REF_MEASUREMENT SOF_iAContinuousChargeCurrentLimitTarget SOF_iAContinuousDischargeCurrentLimitTarget SOF_iADynamicChargeCurrentLimitTarget SOF_iADynamicDischargeCurrentLimitTarget SOF_iAShortPulseChargeCurrentLimitTarget SOF_iAShortPulseDischargeCurrentLimitTarget /end REF_MEASUREMENT
/end GROUP
/begin GROUP S1210_CurrentLimit_Voltage_Correct "VBU0428Test/VBUSystem/BMS/SOF/Subsystem6/Subsystem/Determine_Currentlimit_Target/Calculate_CurrentLimit_Target/CurrentLimit_Voltage_Correct" /begin SUB_GROUP S1216_Correct_CurrentLimit S1216_Enable_Voltage_Correction /end SUB_GROUP /end GROUP
/begin GROUP S1404_Caculate_CellCapacity_LifeTimeQ "VBU0428Test/VBUSystem/BMS/SOH/Subsystem4/Subsystem1/Calculate_Capacity/Calculate_CellCapacity/Caculate_CellCapacity_LifeTimeQ"
 /begin SUB_GROUP S1409_Caculate_WeightingLifeTimeCharge S1409_NVM_ReadWrite_Check /end SUB_GROUP
 /begin REF_CHARACTERISTIC CaSOH_CellCapacity_Ah CaSOH_InvalidCellCapacity_Ah /end REF_CHARACTERISTIC
/end GROUP
/begin GROUP S1404_CellCapacity_Limit "VBU0428Test/VBUSystem/BMS/SOH/Subsystem4/Subsystem1/Calculate_Capacity/Calculate_CellCapacity/CellCapacity_Limit" /begin SUB_GROUP S1410_LimittedByNVMvalue /end SUB_GROUP /begin REF_CHARACTERISTIC CcSOH_CellCapacityLowThershold_Ah /end REF_CHARACTERISTIC /end GROUP
/begin GROUP S1404_Determine_CellCapacity "VBU0428Test/VBUSystem/BMS/SOH/Subsystem4/Subsystem1/Calculate_Capacity/Calculate_CellCapacity/Determine_CellCapacity" /begin SUB_GROUP S1411_MMASVC1 /end SUB_GROUP /end GROUP
/begin GROUP S1404_Determine_PackSoh "VBU0428Test/VBUSystem/BMS/SOH/Subsystem4/Subsystem1/Calculate_Capacity/Calculate_CellCapacity/Determine_PackSoh" /begin REF_MEASUREMENT SOH_pctPackSoh /end REF_MEASUREMENT /end GROUP
/begin GROUP S1404_PackSoh_Storage "VBU0428Test/VBUSystem/BMS/SOH/Subsystem4/Subsystem1/Calculate_Capacity/Calculate_CellCapacity/PackSoh_Storage"
 /begin REF_CHARACTERISTIC CaSOH_CellCapacityWrite_Ah CaSOH_LifeTimeDischargeLookUp_Ah CbSOH_EepromWriteCellCapacity_flg /end REF_CHARACTERISTIC
/end GROUP
/begin GROUP S1405_Determine_AhIntegral_DeltaQ "VBU0428Test/VBUSystem/BMS/SOH/Subsystem4/Subsystem1/Calculate_Capacity/Calculate_CellCapacity_SlowCharge/Determine_AhIntegral_DeltaQ"
 /begin SUB_GROUP S1443_Determine_AhIntegral_Q S1443_Determine_Module_Current /end SUB_GROUP
/end GROUP
/begin GROUP S1405_Determine_Soc "VBU0428Test/VBUSystem/BMS/SOH/Subsystem4/Subsystem1/Calculate_Capacity/Calculate_CellCapacity_SlowCharge/Determine_Soc" /begin SUB_GROUP S1445_Determine_Module_Current S1445_Lookup_Table_Cal_Soc /end SUB_GROUP /end GROUP
/begin GROUP S1405_Determine_SocEndandCondition "VBU0428Test/VBUSystem/BMS/SOH/Subsystem4/Subsystem1/Calculate_Capacity/Calculate_CellCapacity_SlowCharge/Determine_SocEndandCondition"
 /begin REF_CHARACTERISTIC CcSOH_DeltaSocLowerLimit_pct CcSOH_DeltaSocThreshold_pct CcSOH_DeltaSocUpperLimit_pct CcSOH_DeltaTemThreshold_C CcSOH_LowTemThreshold_C /end REF_CHARACTERISTIC
/end GROUP
/begin GROUP S1405_Determine_SocStart "VBU0428Test/VBUSystem/BMS/SOH/Subsystem4/Subsystem1/Calculate_Capacity/Calculate_CellCapacity_SlowCharge/Determine_SocStart"
 /begin REF_CHARACTERISTIC CcSOH_UdSocInvalidLowerLimit_pct CcSOH_UdSocInvalidUpperLimit_pct /end REF_CHARACTERISTIC
 /begin REF_MEASUREMENT SOH_flgSingalSocStart /end REF_MEASUREMENT
/end GROUP
/begin GROUP S1407_Determine_SlowCharge "VBU0428Test/VBUSystem/BMS/SOH/Subsystem4/Subsystem1/Calculate_Capacity/Determine_CalculateCellCapacity_Condition/Determine_SlowCharge" /begin SUB_GROUP S1465_OBC_CHARGE_MODE1 /end SUB_GROUP /begin REF_CHARACTERISTIC CcSOH_AfertSlowChargeEndTime_ms /end REF_CHARACTERISTIC /end GROUP
/begin GROUP S1407_Determine_SlowChargeStart "VBU0428Test/VBUSystem/BMS/SOH/Subsystem4/Subsystem1/Calculate_Capacity/Determine_CalculateCellCapacity_Condition/Determine_SlowChargeStart" /begin REF_CHARACTERISTIC CcSOH_AfertSlowChargeStartTime_ms /end REF_CHARACTERISTIC /end GROUP
/begin GROUP S1473_BeforStep_DuringStep_AfterStep_Check "VBU0428Test/VBUSystem/BMS/SOH/Subsystem4/Subsystem1/Calculate_Resistance/BasicCellResistance_Calculation_Check/BeforStep_DuringStep_AfterStep_Check" /begin SUB_GROUP S1482_DuringStep_AfterStep_Check /end SUB_GROUP /end GROUP
/begin GROUP S1473_ResistanceCalc_Check "VBU0428Test/VBUSystem/BMS/SOH/Subsystem4/Subsystem1/Calculate_Resistance/BasicCellResistance_Calculation_Check/ResistanceCalc_Check" /begin SUB_GROUP S1483_NVM_ReadWrite_Check /end SUB_GROUP /end GROUP
/begin GROUP S1476_CalCurrent_Data_BeforeStep "VBU0428Test/VBUSystem/BMS/SOH/Subsystem4/Subsystem1/Calculate_Resistance/Calculate_Relaxation_Average_CurrentVoltage/CalCurrent_Data_BeforeStep"
 /begin REF_CHARACTERISTIC CaSOH_InvalidHistoryCurrentData_A CcSOH_ComResisTempLowerLimit_C CcSOH_ComResisTempUpperLimit_C CcSOH_DeltaModuleCurrent_A CcSOH_HistoryDataDimension_n CcSYS_ResisCalRelaxationCurrent_A /end REF_CHARACTERISTIC
 /begin REF_MEASUREMENT SOH_flgBeforeStepCurrentEnable SOH_iABeforeStepAveCurrent /end REF_MEASUREMENT
/end GROUP
/begin GROUP S1480_Calculate_Pulse_Average_CurrentVoltage "VBU0428Test/VBUSystem/BMS/SOH/Subsystem4/Subsystem1/Calculate_Resistance/Determine_Condition_Calculate_Pulse_Average_CurrentVoltage/Calculate_Pulse_Average_CurrentVoltage" /begin SUB_GROUP S1497_Cal_Pulse_Current_Data /end SUB_GROUP /end GROUP
/begin GROUP S1480_Determine_Condition "VBU0428Test/VBUSystem/BMS/SOH/Subsystem4/Subsystem1/Calculate_Resistance/Determine_Condition_Calculate_Pulse_Average_CurrentVoltage/Determine_Condition"
 /begin SUB_GROUP S1498_Determine_FCCPulseCurrent_Condition S1498_Determine_OBCPulseCurrent_Condition /end SUB_GROUP
/end GROUP
/begin GROUP S1539_Determine_InletTemp_Validation "VBU0428Test/VBUSystem/BMS/THM/Subsystem/Subsystem/Calculate_PipeTemperature/Determine_CoolantSensorTemp_Validation/Determine_InletTemp_Validation" /begin SUB_GROUP S1540_Determinate_InletTempValidationDelay /end SUB_GROUP
 /begin REF_CHARACTERISTIC CcTHM_CoolantGradientCheckEnable_flg CcTHM_CoolantSensorGradient_C CcTHM_CoolantSensorValidEnable_flg CcTHM_CoolantTempOorDebounceTime_s /end REF_CHARACTERISTIC
 /begin REF_MEASUREMENT THM_flgInletTempValid /end REF_MEASUREMENT
/end GROUP
/begin GROUP S1539_Determine_OutletTemp_Validation "VBU0428Test/VBUSystem/BMS/THM/Subsystem/Subsystem/Calculate_PipeTemperature/Determine_CoolantSensorTemp_Validation/Determine_OutletTemp_Validation" /begin SUB_GROUP S1541_Determinate_OutletTempValidationDelay /end SUB_GROUP
 /begin REF_CHARACTERISTIC CcTHM_CoolantGradientCheckEnable_flg CcTHM_CoolantSensorGradient_C CcTHM_CoolantSensorValidEnable_flg CcTHM_CoolantTempOorDebounceTime_s /end REF_CHARACTERISTIC
 /begin REF_MEASUREMENT THM_flgOutletTempValid /end REF_MEASUREMENT
/end GROUP
/begin GROUP S1551_Normal_Condition "VBU0428Test/VBUSystem/BMS/THM/Subsystem/Subsystem/Charge_Mode_Temp_Request/OBC_Temp_Request/Normal_Condition"
 /begin REF_CHARACTERISTIC CaTHM_ObcHighSocRequestTempMapZ_C CaTHM_ObcSohFactorMapY_n CcTHM_ObcChargeTempRequestLowThreshold_C CcTHM_ObcSohTempLowThreshold_C /end REF_CHARACTERISTIC
/end GROUP
/begin GROUP S1592_SOC_Hysteretic_Determination "VBU0428Test/VBUSystem/BMS/THM/Subsystem/Subsystem/Valid_Condition_Determination/FCC_Temp_Valid/SOC_Hysteretic_Determination" /begin REF_CHARACTERISTIC CcTHM_FccChargeHysterSOC_pct CcTHM_FccSocHighThreshold_pct /end REF_CHARACTERISTIC /end GROUP
/begin GROUP S1592_Temp_Hysteretic_Determination "VBU0428Test/VBUSystem/BMS/THM/Subsystem/Subsystem/Valid_Condition_Determination/FCC_Temp_Valid/Temp_Hysteretic_Determination"
 /begin REF_CHARACTERISTIC CcTHM_FccCellTempHighThreshold_C CcTHM_FccChargeTempRequestHysterTemp_C /end REF_CHARACTERISTIC
/end GROUP
/begin GROUP S1594_Hysteretic_Determination "VBU0428Test/VBUSystem/BMS/THM/Subsystem/Subsystem/Valid_Condition_Determination/OBC_Temp_Valid/Hysteretic_Determination"
 /begin REF_CHARACTERISTIC CcTHM_ObcCellTempHighThreshold_C CcTHM_ObcChargeTempRequestHysterTemp_C /end REF_CHARACTERISTIC
/end GROUP
/begin GROUP S1594_SOC_Hysteretic_Determination "VBU0428Test/VBUSystem/BMS/THM/Subsystem/Subsystem/Valid_Condition_Determination/OBC_Temp_Valid/SOC_Hysteretic_Determination" /begin REF_CHARACTERISTIC CcTHM_ObcChargeHysterSOC_pct CcTHM_ObcSocHighThreshold_pct /end REF_CHARACTERISTIC /end GROUP
/begin GROUP S1619_LOW_HIGH1 "VBU0428Test/VBUSystem/BMS/VCT/Subsystem/Subsystem/Determine_BMS_VCU_267/Override/LOW_HIGH1" /begin REF_MEASUREMENT VCT_uBMSDCChrgVoltageReq /end REF_MEASUREMENT /end GROUP
/begin GROUP S1619_LOW_HIGH17 "VBU0428Test/VBUSystem/BMS/VCT/Subsystem/Subsystem/Determine_BMS_VCU_267/Override/LOW_HIGH17" /begin REF_MEASUREMENT VCT_iABMSDCChrgCrntReq /end REF_MEASUREMENT /end GROUP
/begin GROUP S1619_LOW_HIGH2 "VBU0428Test/VBUSystem/BMS/VCT/Subsystem/Subsystem/Determine_BMS_VCU_267/Override/LOW_HIGH2" /begin REF_MEASUREMENT VCT_iABMSChgCurrentLimit /end REF_MEASUREMENT /end GROUP
/begin GROUP S1619_LOW_HIGH3 "VBU0428Test/VBUSystem/BMS/VCT/Subsystem/Subsystem/Determine_BMS_VCU_267/Override/LOW_HIGH3" /begin REF_MEASUREMENT VCT_kwhBMSPackEnergyAvailable /end REF_MEASUREMENT /end GROUP
/begin GROUP S1619_LOW_HIGH4 "VBU0428Test/VBUSystem/BMS/VCT/Subsystem/Subsystem/Determine_BMS_VCU_267/Override/LOW_HIGH4" /begin REF_MEASUREMENT VCT_stDCChargeMode /end REF_MEASUREMENT /end GROUP
/begin GROUP S1619_LOW_HIGH5 "VBU0428Test/VBUSystem/BMS/VCT/Subsystem/Subsystem/Determine_BMS_VCU_267/Override/LOW_HIGH5" /begin REF_MEASUREMENT VCT_stCTMCellThermalRunaway /end REF_MEASUREMENT /end GROUP
/begin GROUP S1619_LOW_HIGH7 "VBU0428Test/VBUSystem/BMS/VCT/Subsystem/Subsystem/Determine_BMS_VCU_267/Override/LOW_HIGH7" /begin REF_MEASUREMENT VCT_flgCTMCellThermalRunawayFaultValid /end REF_MEASUREMENT /end GROUP
/begin GROUP S1628_LOW_HIGH1 "VBU0428Test/VBUSystem/BMS/VCT/Subsystem/Subsystem/Determine_BMS_VCU_268/Override/LOW_HIGH1" /begin REF_MEASUREMENT VCT_kwBMSDischgPowerLimitST /end REF_MEASUREMENT /end GROUP
/begin GROUP S1628_LOW_HIGH14 "VBU0428Test/VBUSystem/BMS/VCT/Subsystem/Subsystem/Determine_BMS_VCU_268/Override/LOW_HIGH14" /begin REF_MEASUREMENT VCT_kwBMSDischgPowerLimitLT /end REF_MEASUREMENT /end GROUP
/begin GROUP S1628_LOW_HIGH2 "VBU0428Test/VBUSystem/BMS/VCT/Subsystem/Subsystem/Determine_BMS_VCU_268/Override/LOW_HIGH2" /begin REF_MEASUREMENT VCT_kwBMSDischgPowerLimitDynamic /end REF_MEASUREMENT /end GROUP
/begin GROUP S1628_LOW_HIGH3 "VBU0428Test/VBUSystem/BMS/VCT/Subsystem/Subsystem/Determine_BMS_VCU_268/Override/LOW_HIGH3" /begin REF_MEASUREMENT VCT_kohmBMSInsulationResistanceValue /end REF_MEASUREMENT /end GROUP
/begin GROUP S1636_LOW_HIGH1 "VBU0428Test/VBUSystem/BMS/VCT/Subsystem/Subsystem/Determine_BMS_VCU_269/Override/LOW_HIGH1" /begin REF_MEASUREMENT VCT_uBMSCellVoltageMin /end REF_MEASUREMENT /end GROUP
/begin GROUP S1636_LOW_HIGH17 "VBU0428Test/VBUSystem/BMS/VCT/Subsystem/Subsystem/Determine_BMS_VCU_269/Override/LOW_HIGH17" /begin REF_MEASUREMENT VCT_uBMSCellVoltageMax /end REF_MEASUREMENT /end GROUP
/begin GROUP S1636_LOW_HIGH2 "VBU0428Test/VBUSystem/BMS/VCT/Subsystem/Subsystem/Determine_BMS_VCU_269/Override/LOW_HIGH2" /begin REF_MEASUREMENT VCT_timinBMSEstimateChargingTime /end REF_MEASUREMENT /end GROUP
/begin GROUP S1636_LOW_HIGH3 "VBU0428Test/VBUSystem/BMS/VCT/Subsystem/Subsystem/Determine_BMS_VCU_269/Override/LOW_HIGH3" /begin REF_MEASUREMENT VCT_uBMSCellVoltageAve /end REF_MEASUREMENT /end GROUP
/begin GROUP S1636_LOW_HIGH4 "VBU0428Test/VBUSystem/BMS/VCT/Subsystem/Subsystem/Determine_BMS_VCU_269/Override/LOW_HIGH4" /begin REF_MEASUREMENT VCT_flgBMSCellVoltageMaxValidity /end REF_MEASUREMENT /end GROUP
/begin GROUP S1636_LOW_HIGH5 "VBU0428Test/VBUSystem/BMS/VCT/Subsystem/Subsystem/Determine_BMS_VCU_269/Override/LOW_HIGH5" /begin REF_MEASUREMENT VCT_flgBMSCellVoltageAveValidity /end REF_MEASUREMENT /end GROUP
/begin GROUP S1636_LOW_HIGH6 "VBU0428Test/VBUSystem/BMS/VCT/Subsystem/Subsystem/Determine_BMS_VCU_269/Override/LOW_HIGH6" /begin REF_MEASUREMENT VCT_flgBMSCellVoltageMinValidity /end REF_MEASUREMENT /end GROUP
/begin GROUP S1644_LOW_HIGH1 "VBU0428Test/VBUSystem/BMS/VCT/Subsystem/Subsystem/Determine_BMS_VCU_26A/Override/LOW_HIGH1" /begin REF_MEASUREMENT VCT_kwBMSChgPowerLimitLT /end REF_MEASUREMENT /end GROUP
/begin GROUP S1644_LOW_HIGH14 "VBU0428Test/VBUSystem/BMS/VCT/Subsystem/Subsystem/Determine_BMS_VCU_26A/Override/LOW_HIGH14" /begin REF_MEASUREMENT VCT_kwBMSChgPowerLimitST /end REF_MEASUREMENT /end GROUP
/begin GROUP S1644_LOW_HIGH2 "VBU0428Test/VBUSystem/BMS/VCT/Subsystem/Subsystem/Determine_BMS_VCU_26A/Override/LOW_HIGH2" /begin REF_MEASUREMENT VCT_kwBMSChgPowerLimitDynamic /end REF_MEASUREMENT /end GROUP
/begin GROUP S1644_LOW_HIGH3 "VBU0428Test/VBUSystem/BMS/VCT/Subsystem/Subsystem/Determine_BMS_VCU_26A/Override/LOW_HIGH3" /begin REF_MEASUREMENT VCT_timinEstimatePercTime /end REF_MEASUREMENT /end GROUP
/begin GROUP S1649_LOW_HIGH1 "VBU0428Test/VBUSystem/BMS/VCT/Subsystem/Subsystem/Determine_BMS_VCU_26F/Override/LOW_HIGH1" /begin REF_MEASUREMENT VCT_stBMSBatteryType /end REF_MEASUREMENT /end GROUP
/begin GROUP S1649_LOW_HIGH14 "VBU0428Test/VBUSystem/BMS/VCT/Subsystem/Subsystem/Determine_BMS_VCU_26F/Override/LOW_HIGH14" /begin REF_MEASUREMENT VCT_numBMSProtocalVersion /end REF_MEASUREMENT /end GROUP
/begin GROUP S1649_LOW_HIGH2 "VBU0428Test/VBUSystem/BMS/VCT/Subsystem/Subsystem/Determine_BMS_VCU_26F/Override/LOW_HIGH2" /begin REF_MEASUREMENT VCT_uBMSMaxPermitDCChargeVoltage /end REF_MEASUREMENT /end GROUP
/begin GROUP S1649_LOW_HIGH3 "VBU0428Test/VBUSystem/BMS/VCT/Subsystem/Subsystem/Determine_BMS_VCU_26F/Override/LOW_HIGH3" /begin REF_MEASUREMENT VCT_AhBMSBatteryRatedCapacity /end REF_MEASUREMENT /end GROUP
/begin GROUP S1655_LOW_HIGH1 "VBU0428Test/VBUSystem/BMS/VCT/Subsystem/Subsystem/Determine_BMS_VCU_270/Override/LOW_HIGH1" /begin REF_MEASUREMENT VCT_stBMSReadyDCCharging /end REF_MEASUREMENT /end GROUP
/begin GROUP S1655_LOW_HIGH14 "VBU0428Test/VBUSystem/BMS/VCT/Subsystem/Subsystem/Determine_BMS_VCU_270/Override/LOW_HIGH14" /begin REF_MEASUREMENT VCT_uBMSBatteryRatedVoltage /end REF_MEASUREMENT /end GROUP
/begin GROUP S1655_LOW_HIGH2 "VBU0428Test/VBUSystem/BMS/VCT/Subsystem/Subsystem/Determine_BMS_VCU_270/Override/LOW_HIGH2" /begin REF_MEASUREMENT VCT_iABMSDCChargingCurrentMeasurement /end REF_MEASUREMENT /end GROUP
/begin GROUP S1655_LOW_HIGH3 "VBU0428Test/VBUSystem/BMS/VCT/Subsystem/Subsystem/Determine_BMS_VCU_270/Override/LOW_HIGH3" /begin REF_MEASUREMENT VCT_uBMSDCChargingVoltageMeasurement /end REF_MEASUREMENT /end GROUP
/begin GROUP S1660_LOW_HIGH1 "VBU0428Test/VBUSystem/BMS/VCT/Subsystem/Subsystem/Determine_BMS_VCU_271/Override/LOW_HIGH1" /begin REF_MEASUREMENT VCT_numBMSMaximumTempNumber /end REF_MEASUREMENT /end GROUP
/begin GROUP S1660_LOW_HIGH14 "VBU0428Test/VBUSystem/BMS/VCT/Subsystem/Subsystem/Determine_BMS_VCU_271/Override/LOW_HIGH14" /begin REF_MEASUREMENT VCT_numBMSMaximumCellVoltageNumber /end REF_MEASUREMENT /end GROUP
/begin GROUP S1660_LOW_HIGH2 "VBU0428Test/VBUSystem/BMS/VCT/Subsystem/Subsystem/Determine_BMS_VCU_271/Override/LOW_HIGH2" /begin REF_MEASUREMENT VCT_numBMSMinimumTempNumber /end REF_MEASUREMENT /end GROUP
/begin GROUP S1660_LOW_HIGH3 "VBU0428Test/VBUSystem/BMS/VCT/Subsystem/Subsystem/Determine_BMS_VCU_271/Override/LOW_HIGH3" /begin REF_MEASUREMENT VCT_tBMSMaximumCellTemp /end REF_MEASUREMENT /end GROUP
/begin GROUP S1660_LOW_HIGH4 "VBU0428Test/VBUSystem/BMS/VCT/Subsystem/Subsystem/Determine_BMS_VCU_271/Override/LOW_HIGH4" /begin REF_MEASUREMENT VCT_tBMSMinimumCellTemp /end REF_MEASUREMENT /end GROUP
/begin GROUP S1660_LOW_HIGH5 "VBU0428Test/VBUSystem/BMS/VCT/Subsystem/Subsystem/Determine_BMS_VCU_271/Override/LOW_HIGH5" /begin REF_MEASUREMENT VCT_pctBMSDCChrgFinalSOC /end REF_MEASUREMENT /end GROUP
/begin GROUP S1668_LOW_HIGH1 "VBU0428Test/VBUSystem/BMS/VCT/Subsystem/Subsystem/Determine_BMS_VCU_272/Override/LOW_HIGH1" /begin REF_MEASUREMENT VCT_stBMSSOCOverUnder /end REF_MEASUREMENT /end GROUP
/begin GROUP S1668_LOW_HIGH10 "VBU0428Test/VBUSystem/BMS/VCT/Subsystem/Subsystem/Determine_BMS_VCU_272/Override/LOW_HIGH10" /begin REF_MEASUREMENT VCT_stBatteryTempDifferAlarm /end REF_MEASUREMENT /end GROUP
/begin GROUP S1668_LOW_HIGH11 "VBU0428Test/VBUSystem/BMS/VCT/Subsystem/Subsystem/Determine_BMS_VCU_272/Override/LOW_HIGH11" /begin REF_MEASUREMENT VCT_stBetteryCellTempHighAlarm /end REF_MEASUREMENT /end GROUP
/begin GROUP S1668_LOW_HIGH12 "VBU0428Test/VBUSystem/BMS/VCT/Subsystem/Subsystem/Determine_BMS_VCU_272/Override/LOW_HIGH12" /begin REF_MEASUREMENT VCT_stBetteryCellTempLowAlarm /end REF_MEASUREMENT /end GROUP
/begin GROUP S3503_setpiont "VBU0428Test/VBUSystem/VCU /EDIS/EDIS_Ctrl/battery_power_calculate/charge_power_calculate/ChPowSetPoint/setpiont" /begin REF_CHARACTERISTIC SYS_facGearRatioR_SY /end REF_CHARACTERISTIC /end GROUP
/begin GROUP S3948_SysRst "VBU0428Test/VBUSystem/VCU /TQO/TQOAll/TQDIS/TQDIS/AxleArb/SysRst" /begin REF_CHARACTERISTIC SYS_facGearRatioR_SY /end REF_CHARACTERISTIC /end GROUP
/begin GROUP S4003_Subsystem "VBU0428Test/VBUSystem/VCU /TQO/TQOAll/TQO/TQO/MotorTorque/Subsystem" /begin REF_CHARACTERISTIC SYS_facGearRatioR_SY /end REF_CHARACTERISTIC /end GROUP
/begin GROUP S4068_BrakeStickyCheck "VBU0428Test/VBUSystem/VCU /VehINP/VehINP_Logic/APD/APD/Value_Selection/BrakeStickyCheck" /begin REF_CHARACTERISTIC BPD_stBrkPedPrsActv_C /end REF_CHARACTERISTIC /end GROUP
/begin GROUP S4102_Gear_DR_Req "VBU0428Test/VBUSystem/VCU /VehINP/VehINP_Logic/GearShift/Gear1/Digital_Gear_D_R/Gear_DR_Req" /begin REF_CHARACTERISTIC Gear_tiSampleTime_C /end REF_CHARACTERISTIC /end GROUP
/begin GROUP S4102_Gear_DR_Warning "VBU0428Test/VBUSystem/VCU /VehINP/VehINP_Logic/GearShift/Gear1/Digital_Gear_D_R/Gear_DR_Warning" /begin REF_CHARACTERISTIC Gear_tiSampleTime_C /end REF_CHARACTERISTIC /end GROUP
/begin GROUP S4110_Gear4Reset "VBU0428Test/VBUSystem/VCU /VehINP/VehINP_Logic/GearShift/Gear1/Gear_Status/Gear4Reset"
 /begin REF_CHARACTERISTIC Gear_stCurrentGearD_C Gear_stCurrentGearR_C Gear_tiSampleTime_C /end REF_CHARACTERISTIC
/end GROUP
/begin GROUP S4110_Gear_DGear "VBU0428Test/VBUSystem/VCU /VehINP/VehINP_Logic/GearShift/Gear1/Gear_Status/Gear_DGear" /begin REF_CHARACTERISTIC Gear_stCurrentGearD_C /end REF_CHARACTERISTIC /end GROUP
/begin GROUP S4110_Gear_DefaultGear "VBU0428Test/VBUSystem/VCU /VehINP/VehINP_Logic/GearShift/Gear1/Gear_Status/Gear_DefaultGear" /begin REF_CHARACTERISTIC Gear_tiSampleTime_C /end REF_CHARACTERISTIC /end GROUP
/begin GROUP S4110_Gear_DriverShiftDReq "VBU0428Test/VBUSystem/VCU /VehINP/VehINP_Logic/GearShift/Gear1/Gear_Status/Gear_DriverShiftDReq" /begin REF_CHARACTERISTIC Gear_stCurrentGearD_C Gear_stCurrentGearR_C /end REF_CHARACTERISTIC /end GROUP
/begin GROUP S4110_Gear_DriverShiftRReq "VBU0428Test/VBUSystem/VCU /VehINP/VehINP_Logic/GearShift/Gear1/Gear_Status/Gear_DriverShiftRReq" /begin REF_CHARACTERISTIC Gear_stCurrentGearD_C Gear_stCurrentGearR_C /end REF_CHARACTERISTIC /end GROUP
/begin GROUP S4110_Gear_DriverShiftTowReq "VBU0428Test/VBUSystem/VCU /VehINP/VehINP_Logic/GearShift/Gear1/Gear_Status/Gear_DriverShiftTowReq" /begin REF_CHARACTERISTIC Gear_stCurrentGearD_C Gear_stCurrentGearR_C /end REF_CHARACTERISTIC /end GROUP
/begin GROUP S4110_Gear_GearReq "VBU0428Test/VBUSystem/VCU /VehINP/VehINP_Logic/GearShift/Gear1/Gear_Status/Gear_GearReq" /begin REF_CHARACTERISTIC Gear_tiSampleTime_C /end REF_CHARACTERISTIC /end GROUP
/begin GROUP S4110_Gear_InitGear "VBU0428Test/VBUSystem/VCU /VehINP/VehINP_Logic/GearShift/Gear1/Gear_Status/Gear_InitGear" /begin REF_CHARACTERISTIC Gear_tiSampleTime_C /end REF_CHARACTERISTIC /end GROUP
/begin GROUP S4110_Gear_PGear "VBU0428Test/VBUSystem/VCU /VehINP/VehINP_Logic/GearShift/Gear1/Gear_Status/Gear_PGear" /begin REF_CHARACTERISTIC Gear_stIntendGearP_C Gear_tiSampleTime_C /end REF_CHARACTERISTIC /end GROUP
/begin GROUP S4110_Gear_RGear "VBU0428Test/VBUSystem/VCU /VehINP/VehINP_Logic/GearShift/Gear1/Gear_Status/Gear_RGear" /begin REF_CHARACTERISTIC Gear_stCurrentGearR_C /end REF_CHARACTERISTIC /end GROUP
/begin GROUP S4110_Warning "VBU0428Test/VBUSystem/VCU /VehINP/VehINP_Logic/GearShift/Gear1/Gear_Status/Warning" /begin REF_CHARACTERISTIC Gear_tiSampleTime_C /end REF_CHARACTERISTIC /end GROUP
/begin GROUP S324_Determine_CellBlanceTime "VBU0428Test/VBUSystem/BMS/CBL/Subsystem8/Subsystem/Determine_CSCCellBalanceRequest/Determine_CellBalanceRequest/Cell0/Determine_CellBlanceTime" /begin REF_CHARACTERISTIC MILIAMPERES_PER_AMPERE /end REF_CHARACTERISTIC /end GROUP
/begin GROUP S480_Equal_to_HIGH1 "VBU0428Test/VBUSystem/BMS/CTD/Subsystem/Subsystem4/Stuck_Open_Diagnostic/MNC_Stuck_Open/MNC_Stuck_Open_With_VehicleSpeed/Equal_to_HIGH1" /begin REF_CHARACTERISTIC HIGH /end REF_CHARACTERISTIC /end GROUP
/begin GROUP S481_Equal_to_HIGH1 "VBU0428Test/VBUSystem/BMS/CTD/Subsystem/Subsystem4/Stuck_Open_Diagnostic/MNC_Stuck_Open/MNC_Stuck_Open_Without_VehicleSpeed/Equal_to_HIGH1" /begin REF_CHARACTERISTIC HIGH /end REF_CHARACTERISTIC /end GROUP
/begin GROUP S504_Equal_to_HIGH1 "VBU0428Test/VBUSystem/BMS/CTD/Subsystem/Subsystem4/Stuck_Open_Diagnostic/MPC_Stuck_Open/MPC_Stuck_Open_Without_VehicleSpeed/Equal_to_HIGH1" /begin REF_CHARACTERISTIC HIGH /end REF_CHARACTERISTIC /end GROUP
/begin GROUP S1214_FastChrgOneThirdRateCurrentLimitCheck "VBU0428Test/VBUSystem/BMS/SOF/Subsystem6/Subsystem/Determine_Currentlimit_Target/Calculate_CurrentLimit_Target/CurrentLimit_FastCharge_Check/FastChrgOneThirdRateCurrentLimitCheck" /begin REF_CHARACTERISTIC BATTERY_BOL_SOH BATTERY_EOL_SOH /end REF_CHARACTERISTIC /end GROUP
/begin GROUP S1497_Cal_Pulse_Current_Data "VBU0428Test/VBUSystem/BMS/SOH/Subsystem4/Subsystem1/Calculate_Resistance/Determine_Condition_Calculate_Pulse_Average_CurrentVoltage/Calculate_Pulse_Average_CurrentVoltage/Cal_Pulse_Current_Data"
 /begin REF_CHARACTERISTIC CaSOH_InvalidHistoryCurrentData_A CcSOH_HistoryDataDimension_n /end REF_CHARACTERISTIC
/end GROUP
/begin GROUP S1498_Determine_FCCPulseCurrent_Condition "VBU0428Test/VBUSystem/BMS/SOH/Subsystem4/Subsystem1/Calculate_Resistance/Determine_Condition_Calculate_Pulse_Average_CurrentVoltage/Determine_Condition/Determine_FCCPulseCurrent_Condition"
 /begin REF_CHARACTERISTIC CcSOH_DeltaModuleCurrent_A CcSYS_ResisCalFCCPulseCurrent_A CcSYS_ResisCalPulseCurrentDurationTime_ms /end REF_CHARACTERISTIC
/end GROUP
/begin GROUP S1498_Determine_OBCPulseCurrent_Condition "VBU0428Test/VBUSystem/BMS/SOH/Subsystem4/Subsystem1/Calculate_Resistance/Determine_Condition_Calculate_Pulse_Average_CurrentVoltage/Determine_Condition/Determine_OBCPulseCurrent_Condition"
 /begin REF_CHARACTERISTIC CcSOH_DeltaModuleCurrent_A CcSYS_ResisCalPulseCurrentDurationTime_ms /end REF_CHARACTERISTIC
/end GROUP
/begin GROUP S460_Determine_Accumulated_Cooling "VBU0428Test/VBUSystem/BMS/CTD/Subsystem/Subsystem4/PrechrgProcessMonitoring/Precharge_Thermal_Management/Determine_Precharge_JouleHeat/Determine_Accumulated_RemainingHeat/Determine_Accumulated_Cooling" /begin REF_CHARACTERISTIC CcCTD_MinHeatDissipation_J /end REF_CHARACTERISTIC /end GROUP
/begin GROUP S1449_Determine_Cell_Balanced_Capacity "VBU0428Test/VBUSystem/BMS/SOH/Subsystem4/Subsystem1/Calculate_Capacity/Calculate_CellCapacity_SlowCharge/Determine_AhIntegral_DeltaQ/Determine_AhIntegral_Q/Determine_Cell_Balanced_Capacity"
 /begin REF_CHARACTERISTIC CcSYS_BalanceResistance_ohm CcSYS_CellBalanceDutyCycle_pct MILIAMPERES_PER_AMPERE /end REF_CHARACTERISTIC
/end GROUP
/end MODULE
/end PROJECT
