ASAP2_VERSION 1 31
/begin PROJECT ProjectName "Project Comment Goes Here"
/begin HEADER "Header Comments go here" /end HEADER
/begin MODULE ModuleName "Module Comment Goes Here"
/begin MOD_COMMON "Mod Common Comment Here" BYTE_ORDER MSB_LAST /end MOD_COMMON
/begin RECORD_LAYOUT Scalar_BOOLEAN FNC_VALUES 1 UBYTE COLUMN_DIR DIRECT /end RECORD_LAYOUT
/begin RECORD_LAYOUT Scalar_UBYTE FNC_VALUES 1 UBYTE COLUMN_DIR DIRECT /end RECORD_LAYOUT
/begin RECORD_LAYOUT Scalar_BYTE FNC_VALUES 1 SBYTE COLUMN_DIR DIRECT /end RECORD_LAYOUT
/begin RECORD_LAYOUT Scalar_UWORD FNC_VALUES 1 UWORD COLUMN_DIR DIRECT /end RECORD_LAYOUT
/begin RECORD_LAYOUT Scalar_ULONG FNC_VALUES 1 ULONG COLUMN_DIR DIRECT /end RECORD_LAYOUT
/begin RECORD_LAYOUT Scalar_FLOAT32_IEEE FNC_VALUES 1 FLOAT32_IEEE COLUMN_DIR DIRECT /end RECORD_LAYOUT
/begin RECORD_LAYOUT Lookup1D_SLONG FNC_VALUES 1 SLONG COLUMN_DIR DIRECT /end RECORD_LAYOUT
/begin RECORD_LAYOUT Lookup1D_X_LONG AXIS_PTS_X 1 SLONG INDEX_INCR DIRECT /end RECORD_LAYOUT
/begin RECORD_LAYOUT Lookup1D_FLOAT32_IEEE FNC_VALUES 1 FLOAT32_IEEE COLUMN_DIR DIRECT /end RECORD_LAYOUT
/begin RECORD_LAYOUT Lookup1D_X_FLOAT32_IEEE AXIS_PTS_X 1 FLOAT32_IEEE INDEX_INCR DIRECT /end RECORD_LAYOUT
/begin RECORD_LAYOUT Lookup2D_X_UWORD AXIS_PTS_X 1 UWORD INDEX_INCR DIRECT /end RECORD_LAYOUT
/begin RECORD_LAYOUT Lookup2D_FLOAT32_IEEE FNC_VALUES 1 FLOAT32_IEEE COLUMN_DIR DIRECT /end RECORD_LAYOUT
/begin RECORD_LAYOUT Lookup2D_X_FLOAT32_IEEE AXIS_PTS_X 1 FLOAT32_IEEE INDEX_INCR DIRECT /end RECORD_LAYOUT
/begin CHARACTERISTIC CaFCC_IdealRemainChargeTimeSocTempMapZ_min "" MAP 0x70017674 Lookup2D_FLOAT32_IEEE 0 VBU0428Test_CM_single_cnt -3.4028234663852886E+38 3.4028234663852886E+38
 /begin AXIS_DESCR COM_AXIS NO_INPUT_QUANTITY VBU0428Test_CM_single_cnt 13 -3.4028234663852886E+38 3.4028234663852886E+38 AXIS_PTS_REF CaFCC_IdealRemainChargeTimeSocTempMapY_pct /end AXIS_DESCR
 /begin AXIS_DESCR COM_AXIS NO_INPUT_QUANTITY VBU0428Test_CM_single_cnt 11 -3.4028234663852886E+38 3.4028234663852886E+38 AXIS_PTS_REF CaFCC_IdealRemainChargeTimeSocTempMapX_C /end AXIS_DESCR
/end CHARACTERISTIC
/begin AXIS_PTS CaFCC_IdealRemainChargeTimeSocTempMapX_C "" 0x70012bee NO_INPUT_QUANTITY Lookup2D_X_FLOAT32_IEEE 0 VBU0428Test_CM_single_cnt 11 -3.4028234663852886E+38 3.4028234663852886E+38 /end AXIS_PTS
/begin AXIS_PTS CaFCC_IdealRemainChargeTimeSocTempMapY_pct "" 0x7001333a NO_INPUT_QUANTITY Lookup2D_X_FLOAT32_IEEE 0 VBU0428Test_CM_single_cnt 13 -3.4028234663852886E+38 3.4028234663852886E+38 /end AXIS_PTS
/begin CHARACTERISTIC CaFCC_CurrentLimitRemainChargeTimeSocTempMapZ_min "" MAP 0x70017438 Lookup2D_FLOAT32_IEEE 0 VBU0428Test_CM_single_cnt -3.4028234663852886E+38 3.4028234663852886E+38
 /begin AXIS_DESCR COM_AXIS NO_INPUT_QUANTITY VBU0428Test_CM_single_cnt 13 -3.4028234663852886E+38 3.4028234663852886E+38 AXIS_PTS_REF CaFCC_CurrentLimitRemainChargeTimeSocTempMapY_pct /end AXIS_DESCR
 /begin AXIS_DESCR COM_AXIS NO_INPUT_QUANTITY VBU0428Test_CM_single_cnt 11 -3.4028234663852886E+38 3.4028234663852886E+38 AXIS_PTS_REF CaFCC_CurrentLimitRemainChargeTimeSocTempMapX_C /end AXIS_DESCR
/end CHARACTERISTIC
/begin AXIS_PTS CaFCC_CurrentLimitRemainChargeTimeSocTempMapX_C "" 0x70012bc2 NO_INPUT_QUANTITY Lookup2D_X_FLOAT32_IEEE 0 VBU0428Test_CM_single_cnt 11 -3.4028234663852886E+38 3.4028234663852886E+38 /end AXIS_PTS
/begin AXIS_PTS CaFCC_CurrentLimitRemainChargeTimeSocTempMapY_pct "" 0x70013306 NO_INPUT_QUANTITY Lookup2D_X_FLOAT32_IEEE 0 VBU0428Test_CM_single_cnt 13 -3.4028234663852886E+38 3.4028234663852886E+38 /end AXIS_PTS
/begin CHARACTERISTIC CaFCC_EstimateChargingTimeDeltaMapY_min "" CURVE 0x70011c5a Lookup1D_FLOAT32_IEEE 0 VBU0428Test_CM_single_cnt -3.4028234663852886E+38 3.4028234663852886E+38
 /begin AXIS_DESCR COM_AXIS LcFCC_timinEstimatePercTime VBU0428Test_CM_single_cnt 4 -3.4028234663852886E+38 3.4028234663852886E+38 AXIS_PTS_REF CaFCC_EstimateChargingTimeDeltaMapX_min /end AXIS_DESCR
/end CHARACTERISTIC
/begin AXIS_PTS CaFCC_EstimateChargingTimeDeltaMapX_min "" 0x70011c4a LcFCC_timinEstimatePercTime Lookup1D_X_FLOAT32_IEEE 0 VBU0428Test_CM_single_cnt 4 -3.4028234663852886E+38 3.4028234663852886E+38 /end AXIS_PTS
/begin CHARACTERISTIC CaOCV_QuasiOCVCurrentZ_A "" MAP 0x70015092 Lookup2D_FLOAT32_IEEE 0 VBU0428Test_CM_single_cnt -3.4028234663852886E+38 3.4028234663852886E+38
 /begin AXIS_DESCR COM_AXIS CVT_mvCellVoltageMin VBU0428Test_CM_uint16_cnt 7 0.0 65535.0 AXIS_PTS_REF CaOCV_QuasiOCVCurrentY_mV /end AXIS_DESCR
 /begin AXIS_DESCR COM_AXIS CTM_tCellTempMin VBU0428Test_CM_single_cnt 6 -3.4028234663852886E+38 3.4028234663852886E+38 AXIS_PTS_REF CaOCV_QuasiOCVCurrentX_C /end AXIS_DESCR
/end CHARACTERISTIC
/begin AXIS_PTS CaOCV_QuasiOCVCurrentX_C "" 0x70012102 CTM_tCellTempMin Lookup2D_X_FLOAT32_IEEE 0 VBU0428Test_CM_single_cnt 6 -3.4028234663852886E+38 3.4028234663852886E+38 /end AXIS_PTS
/begin AXIS_PTS CaOCV_QuasiOCVCurrentY_mV "" 0x70011c1c CVT_mvCellVoltageMin Lookup2D_X_UWORD 0 VBU0428Test_CM_uint16_cnt 7 0.0 65535.0 /end AXIS_PTS
/begin CHARACTERISTIC CaSOF_mvDischargeOcvSocTempMap_v "" MAP 0x7001dd2c Lookup2D_FLOAT32_IEEE 0 VBU0428Test_CM_single_v 0.0 5.0
 /begin AXIS_DESCR COM_AXIS NO_INPUT_QUANTITY VBU0428Test_CM_single_pct 21 0.0 100.0 AXIS_PTS_REF CaSOF_pctDischargeOcvSocTempMap_y /end AXIS_DESCR
 /begin AXIS_DESCR COM_AXIS CTM_tCellTempAve VBU0428Test_CM_single_t 19 -40.0 120.0 AXIS_PTS_REF CaSOF_tDischargeOcvSocTempMap_x /end AXIS_DESCR
/end CHARACTERISTIC
/begin AXIS_PTS CaSOF_tDischargeOcvSocTempMap_x "" 0x700140ce CTM_tCellTempAve Lookup2D_X_FLOAT32_IEEE 0 VBU0428Test_CM_single_t 19 -40.0 120.0 /end AXIS_PTS
/begin AXIS_PTS CaSOF_pctDischargeOcvSocTempMap_y "" 0x70014482 NO_INPUT_QUANTITY Lookup2D_X_FLOAT32_IEEE 0 VBU0428Test_CM_single_pct 21 0.0 100.0 /end AXIS_PTS
/begin CHARACTERISTIC CaSOF_mvChargeOcvSocTempMap_v "" MAP 0x7001c12c Lookup2D_FLOAT32_IEEE 0 VBU0428Test_CM_single_v 0.0 5.0
 /begin AXIS_DESCR COM_AXIS NO_INPUT_QUANTITY VBU0428Test_CM_single_pct 20 0.0 100.0 AXIS_PTS_REF CaSOF_pctChargeOcvSocTempMap_y /end AXIS_DESCR
 /begin AXIS_DESCR COM_AXIS CTM_tCellTempAve VBU0428Test_CM_single_t 17 -40.0 120.0 AXIS_PTS_REF CaSOF_tChargeOcvSocTempMap_x /end AXIS_DESCR
/end CHARACTERISTIC
/begin AXIS_PTS CaSOF_tChargeOcvSocTempMap_x "" 0x70013d06 CTM_tCellTempAve Lookup2D_X_FLOAT32_IEEE 0 VBU0428Test_CM_single_t 17 -40.0 120.0 /end AXIS_PTS
/begin AXIS_PTS CaSOF_pctChargeOcvSocTempMap_y "" 0x700142ea NO_INPUT_QUANTITY Lookup2D_X_FLOAT32_IEEE 0 VBU0428Test_CM_single_pct 20 0.0 100.0 /end AXIS_PTS
/begin CHARACTERISTIC CaSOF_SocpDischargeSocMinMapY_pct "" CURVE 0x70011cda Lookup1D_FLOAT32_IEEE 0 VBU0428Test_CM_single_cnt -3.4028234663852886E+38 3.4028234663852886E+38
 /begin AXIS_DESCR COM_AXIS CTM_tCellTempMin VBU0428Test_CM_single_cnt 4 -3.4028234663852886E+38 3.4028234663852886E+38 AXIS_PTS_REF CaSOF_SocpDischargeSocMinMapX_C /end AXIS_DESCR
/end CHARACTERISTIC
/begin AXIS_PTS CaSOF_SocpDischargeSocMinMapX_C "" 0x70011cca CTM_tCellTempMin Lookup1D_X_FLOAT32_IEEE 0 VBU0428Test_CM_single_cnt 4 -3.4028234663852886E+38 3.4028234663852886E+38 /end AXIS_PTS
/begin CHARACTERISTIC CaTHM_FccSohFactorMapY_n "" CURVE 0x70011ef2 Lookup1D_FLOAT32_IEEE 0 VBU0428Test_CM_single_cnt 0.0 1.0
 /begin AXIS_DESCR COM_AXIS NO_INPUT_QUANTITY VBU0428Test_CM_single_cnt 5 0.0 100.0 AXIS_PTS_REF CaTHM_PackSohMapX_pct /end AXIS_DESCR
/end CHARACTERISTIC
/begin AXIS_PTS CaTHM_PackSohMapX_pct "" 0x70011f2e NO_INPUT_QUANTITY Lookup1D_X_FLOAT32_IEEE 0 VBU0428Test_CM_single_cnt 5 0.0 100.0 /end AXIS_PTS
/begin CHARACTERISTIC CaTHM_FccHighSocRequestTempMapZ_C "" MAP 0x70014d66 Lookup2D_FLOAT32_IEEE 0 VBU0428Test_CM_single_cnt -40.0 80.0
 /begin AXIS_DESCR COM_AXIS SOC_pctCellSocMax VBU0428Test_CM_single_cnt 5 0.0 100.0 AXIS_PTS_REF CaTHM_CellSocMaxMapY_pct /end AXIS_DESCR
 /begin AXIS_DESCR COM_AXIS CTM_tCellTempMax VBU0428Test_CM_single_cnt 6 -40.0 80.0 AXIS_PTS_REF CaTHM_CellTempMaxMapX_C /end AXIS_DESCR
/end CHARACTERISTIC
/begin AXIS_PTS CaTHM_CellTempMaxMapX_C "" 0x70012192 CTM_tCellTempMax Lookup2D_X_FLOAT32_IEEE 0 VBU0428Test_CM_single_cnt 6 -40.0 80.0 /end AXIS_PTS
/begin AXIS_PTS CaTHM_CellSocMaxMapY_pct "" 0x70011ede SOC_pctCellSocMax Lookup2D_X_FLOAT32_IEEE 0 VBU0428Test_CM_single_cnt 5 0.0 100.0 /end AXIS_PTS
/begin CHARACTERISTIC BCU_cntFLWhlSpdPlusCntOvrdVal_C "" VALUE 0x70010320 Scalar_FLOAT32_IEEE 0 VBU0428Test_CM_single 0.0 4.294967295E+9 /end CHARACTERISTIC
/begin CHARACTERISTIC BCU_cntFRWhlSpdPlusCntOvrdVal_C "" VALUE 0x70010324 Scalar_FLOAT32_IEEE 0 VBU0428Test_CM_single 0.0 4.294967295E+9 /end CHARACTERISTIC
/begin CHARACTERISTIC BCU_cntRLWhlSpdPlusCntOvrdVal_C "" VALUE 0x70010328 Scalar_FLOAT32_IEEE 0 VBU0428Test_CM_single 0.0 4.294967295E+9 /end CHARACTERISTIC
/begin CHARACTERISTIC BCU_cntRRWhlSpdPlusCntOvrdVal_C "" VALUE 0x7001032c Scalar_FLOAT32_IEEE 0 VBU0428Test_CM_single 0.0 4.294967295E+9 /end CHARACTERISTIC
/begin CHARACTERISTIC BCU_flgABSActvOvrdVal_C "" VALUE 0x70010330 Scalar_FLOAT32_IEEE 0 VBU0428Test_CM_single 0.0 1.0 /end CHARACTERISTIC
/begin CHARACTERISTIC BCU_flgABSFailOvrdVal_C "" VALUE 0x70010334 Scalar_FLOAT32_IEEE 0 VBU0428Test_CM_single 0.0 1.0 /end CHARACTERISTIC
/begin CHARACTERISTIC BCU_flgCntFLWhlSpdPlusCntOvrd_C "" VALUE 0x70010338 Scalar_FLOAT32_IEEE 0 VBU0428Test_CM_single 0.0 1.0 /end CHARACTERISTIC
/begin CHARACTERISTIC BCU_flgCntFRWhlSpdPlusCntOvrd_C "" VALUE 0x7001033c Scalar_FLOAT32_IEEE 0 VBU0428Test_CM_single 0.0 1.0 /end CHARACTERISTIC
/begin CHARACTERISTIC BCU_flgCntRLWhlSpdPlusCntOvrd_C "" VALUE 0x70010340 Scalar_FLOAT32_IEEE 0 VBU0428Test_CM_single 0.0 1.0 /end CHARACTERISTIC
/begin CHARACTERISTIC BCU_flgCntRRWhlSpdPlusCntOvrd_C "" VALUE 0x70010344 Scalar_FLOAT32_IEEE 0 VBU0428Test_CM_single 0.0 1.0 /end CHARACTERISTIC
/begin CHARACTERISTIC BCU_flgEBDActiveOvrdVal_C "" VALUE 0x70010348 Scalar_FLOAT32_IEEE 0 VBU0428Test_CM_single 0.0 1.0 /end CHARACTERISTIC
/begin CHARACTERISTIC BCU_flgEBDFailOvrdVal_C "" VALUE 0x7001034c Scalar_FLOAT32_IEEE 0 VBU0428Test_CM_single 0.0 1.0 /end CHARACTERISTIC
/begin CHARACTERISTIC BCU_flgFLWhlSpdPlusCntOvrdVal_C "" VALUE 0x70010350 Scalar_FLOAT32_IEEE 0 VBU0428Test_CM_single 0.0 1.0 /end CHARACTERISTIC
/begin CHARACTERISTIC BCU_flgFRWhlSpdPlusCntOvrdVal_C "" VALUE 0x70010354 Scalar_FLOAT32_IEEE 0 VBU0428Test_CM_single 0.0 1.0 /end CHARACTERISTIC
/begin CHARACTERISTIC BCU_flgFlgABSActvOvrd_C "" VALUE 0x70010358 Scalar_FLOAT32_IEEE 0 VBU0428Test_CM_single 0.0 1.0 /end CHARACTERISTIC
/begin CHARACTERISTIC BCU_flgFlgABSFailOvrd_C "" VALUE 0x7001035c Scalar_FLOAT32_IEEE 0 VBU0428Test_CM_single 0.0 1.0 /end CHARACTERISTIC
/begin CHARACTERISTIC BCU_flgFlgEBDActiveOvrd_C "" VALUE 0x70010360 Scalar_FLOAT32_IEEE 0 VBU0428Test_CM_single 0.0 1.0 /end CHARACTERISTIC
/begin CHARACTERISTIC BCU_flgFlgEBDFailOvrd_C "" VALUE 0x70010364 Scalar_FLOAT32_IEEE 0 VBU0428Test_CM_single 0.0 1.0 /end CHARACTERISTIC
/begin CHARACTERISTIC BCU_flgFlgFLWhlSpdPlusCntOvrd_C "" VALUE 0x70010368 Scalar_FLOAT32_IEEE 0 VBU0428Test_CM_single 0.0 1.0 /end CHARACTERISTIC
/begin CHARACTERISTIC BCU_flgFlgFRWhlSpdPlusCntOvrd_C "" VALUE 0x7001036c Scalar_FLOAT32_IEEE 0 VBU0428Test_CM_single 0.0 1.0 /end CHARACTERISTIC
/begin CHARACTERISTIC BCU_flgFlgRLWhlSpdPlusCntOvrd_C "" VALUE 0x70010370 Scalar_FLOAT32_IEEE 0 VBU0428Test_CM_single 0.0 1.0 /end CHARACTERISTIC
/begin CHARACTERISTIC BCU_flgFlgRRWhlSpdPlusCntOvrd_C "" VALUE 0x70010374 Scalar_FLOAT32_IEEE 0 VBU0428Test_CM_single 0.0 1.0 /end CHARACTERISTIC
/begin CHARACTERISTIC BCU_flgFlgVehicleSpeedValidOvrd_C "" VALUE 0x70010378 Scalar_FLOAT32_IEEE 0 VBU0428Test_CM_single 0.0 1.0 /end CHARACTERISTIC
/begin CHARACTERISTIC BCU_flgRLWhlSpdPlusCntOvrdVal_C "" VALUE 0x7001037c Scalar_FLOAT32_IEEE 0 VBU0428Test_CM_single 0.0 1.0 /end CHARACTERISTIC
/begin CHARACTERISTIC BCU_flgRRWhlSpdPlusCntOvrdVal_C "" VALUE 0x70010380 Scalar_FLOAT32_IEEE 0 VBU0428Test_CM_single 0.0 1.0 /end CHARACTERISTIC
/begin CHARACTERISTIC BCU_flgStWhlFLOvrd_C "" VALUE 0x70010384 Scalar_FLOAT32_IEEE 0 VBU0428Test_CM_single 0.0 1.0 /end CHARACTERISTIC
/begin CHARACTERISTIC BCU_flgStWhlFROvrd_C "" VALUE 0x70010388 Scalar_FLOAT32_IEEE 0 VBU0428Test_CM_single 0.0 1.0 /end CHARACTERISTIC
/begin CHARACTERISTIC BCU_flgStWhlRLOvrd_C "" VALUE 0x7001038c Scalar_FLOAT32_IEEE 0 VBU0428Test_CM_single 0.0 1.0 /end CHARACTERISTIC
/begin CHARACTERISTIC BCU_flgStWhlRROvrd_C "" VALUE 0x70010390 Scalar_FLOAT32_IEEE 0 VBU0428Test_CM_single 0.0 1.0 /end CHARACTERISTIC
/begin CHARACTERISTIC BCU_flgVVehicleSpeedOvrd_C "" VALUE 0x70010394 Scalar_FLOAT32_IEEE 0 VBU0428Test_CM_single 0.0 1.0 /end CHARACTERISTIC
/begin CHARACTERISTIC BCU_flgVWhlFLOvrd_C "" VALUE 0x70010398 Scalar_FLOAT32_IEEE 0 VBU0428Test_CM_single 0.0 1.0 /end CHARACTERISTIC
/begin CHARACTERISTIC BCU_flgVWhlFROvrd_C "" VALUE 0x7001039c Scalar_FLOAT32_IEEE 0 VBU0428Test_CM_single 0.0 1.0 /end CHARACTERISTIC
/begin CHARACTERISTIC BCU_flgVWhlRLOvrd_C "" VALUE 0x700103a0 Scalar_FLOAT32_IEEE 0 VBU0428Test_CM_single 0.0 1.0 /end CHARACTERISTIC
/begin CHARACTERISTIC BCU_flgVWhlRROvrd_C "" VALUE 0x700103a4 Scalar_FLOAT32_IEEE 0 VBU0428Test_CM_single 0.0 1.0 /end CHARACTERISTIC
/begin CHARACTERISTIC BCU_flgVehicleSpeedValidOvrdVal_C "" VALUE 0x700103a8 Scalar_FLOAT32_IEEE 0 VBU0428Test_CM_single 0.0 1.0 /end CHARACTERISTIC
/begin CHARACTERISTIC BCU_stWhlFLOvrdVal_C "" VALUE 0x700103ac Scalar_FLOAT32_IEEE 0 VBU0428Test_CM_single 0.0 255.0 /end CHARACTERISTIC
/begin CHARACTERISTIC BCU_stWhlFROvrdVal_C "" VALUE 0x700103b0 Scalar_FLOAT32_IEEE 0 VBU0428Test_CM_single 0.0 255.0 /end CHARACTERISTIC
/begin CHARACTERISTIC BCU_stWhlRLOvrdVal_C "" VALUE 0x700103b4 Scalar_FLOAT32_IEEE 0 VBU0428Test_CM_single 0.0 255.0 /end CHARACTERISTIC
/begin CHARACTERISTIC BCU_stWhlRROvrdVal_C "" VALUE 0x700103b8 Scalar_FLOAT32_IEEE 0 VBU0428Test_CM_single 0.0 255.0 /end CHARACTERISTIC
/begin CHARACTERISTIC BCU_vVehicleSpeedOvrdVal_C "" VALUE 0x700103bc Scalar_FLOAT32_IEEE 0 VBU0428Test_CM_single -3.40282346638528E+38 3.40282346638528E+38 /end CHARACTERISTIC
/begin CHARACTERISTIC BCU_vWhlFLOvrdVal_C "" VALUE 0x700103c0 Scalar_FLOAT32_IEEE 0 VBU0428Test_CM_single -3.40282346638528E+38 3.40282346638528E+38 /end CHARACTERISTIC
/begin CHARACTERISTIC BCU_vWhlFROvrdVal_C "" VALUE 0x700103c4 Scalar_FLOAT32_IEEE 0 VBU0428Test_CM_single -3.40282346638528E+38 3.40282346638528E+38 /end CHARACTERISTIC
/begin CHARACTERISTIC BCU_vWhlRLOvrdVal_C "" VALUE 0x700103c8 Scalar_FLOAT32_IEEE 0 VBU0428Test_CM_single -3.40282346638528E+38 3.40282346638528E+38 /end CHARACTERISTIC
/begin CHARACTERISTIC BCU_vWhlRROvrdVal_C "" VALUE 0x700103cc Scalar_FLOAT32_IEEE 0 VBU0428Test_CM_single -3.40282346638528E+38 3.40282346638528E+38 /end CHARACTERISTIC
/begin CHARACTERISTIC CcCTD_MessageDataValidDelay_ms "" VALUE 0x700105d0 Scalar_FLOAT32_IEEE 0 VBU0428Test_CM_single_cnt -3.4028234663852886E+38 3.4028234663852886E+38 /end CHARACTERISTIC
/begin CHARACTERISTIC CcCTD_MnPosContactorCloseDeltaVoltage_V "" VALUE 0x700105e0 Scalar_FLOAT32_IEEE 0 VBU0428Test_CM_single_cnt -3.4028234663852886E+38 3.4028234663852886E+38 /end CHARACTERISTIC
/begin CHARACTERISTIC CcCTD_PEURDCVoltageThreshold_V "" VALUE 0x700105f0 Scalar_FLOAT32_IEEE 0 VBU0428Test_CM_single_cnt -3.4028234663852886E+38 3.4028234663852886E+38 /end CHARACTERISTIC
/begin CHARACTERISTIC CcCTD_PrechargeOverEnergyLockoutInterval_s "" VALUE 0x700105fc Scalar_FLOAT32_IEEE 0 VBU0428Test_CM_single_cnt 0.0 65535.0 /end CHARACTERISTIC
/begin CHARACTERISTIC CcCTD_PrechargeRelayStuckOpenDeltaVoltage_V "" VALUE 0x70010604 Scalar_FLOAT32_IEEE 0 VBU0428Test_CM_single_cnt -3.4028234663852886E+38 3.4028234663852886E+38 /end CHARACTERISTIC
/begin CHARACTERISTIC CcCTD_PrechargeSuccessMax_pct "" VALUE 0x70010610 Scalar_FLOAT32_IEEE 0 VBU0428Test_CM_single_cnt -3.4028234663852886E+38 3.4028234663852886E+38 /end CHARACTERISTIC
/begin CHARACTERISTIC CcCTD_PrechargeSuccessMin_pct "" VALUE 0x70010614 Scalar_FLOAT32_IEEE 0 VBU0428Test_CM_single_cnt -3.4028234663852886E+38 3.4028234663852886E+38 /end CHARACTERISTIC
/begin CHARACTERISTIC CcCTD_VehSpdPrechargeDiag_kmh "" VALUE 0x70010624 Scalar_FLOAT32_IEEE 0 VBU0428Test_CM_single_cnt -3.4028234663852886E+38 3.4028234663852886E+38 /end CHARACTERISTIC
/begin CHARACTERISTIC CcCTM_ThermalRunawayOverTemp_C "" VALUE 0x70010668 Scalar_FLOAT32_IEEE 0 VBU0428Test_CM_single_cnt -3.4028234663852886E+38 3.4028234663852886E+38 /end CHARACTERISTIC
/begin CHARACTERISTIC CcCTM_ThermalRunawayResetTemp_C "" VALUE 0x7001066c Scalar_FLOAT32_IEEE 0 VBU0428Test_CM_single_cnt -3.4028234663852886E+38 3.4028234663852886E+38 /end CHARACTERISTIC
/begin CHARACTERISTIC CcCTM_ThermalRunawayTempRiseDelayTime_ms "" VALUE 0x70010670 Scalar_FLOAT32_IEEE 0 VBU0428Test_CM_single_cnt -3.4028234663852886E+38 3.4028234663852886E+38 /end CHARACTERISTIC
/begin CHARACTERISTIC CcCTM_ThermalRunawayTriggerTime_ms "" VALUE 0x70010674 Scalar_FLOAT32_IEEE 0 VBU0428Test_CM_single_cnt -3.4028234663852886E+38 3.4028234663852886E+38 /end CHARACTERISTIC
/begin CHARACTERISTIC CcCTM_ThermalRunawayValidDelayTime_ms "" VALUE 0x70010678 Scalar_FLOAT32_IEEE 0 VBU0428Test_CM_single_cnt -3.4028234663852886E+38 3.4028234663852886E+38 /end CHARACTERISTIC
/begin CHARACTERISTIC CcCTS_BatteryVoltageMinLimit_V "" VALUE 0x7001067c Scalar_FLOAT32_IEEE 0 VBU0428Test_CM_single_cnt -3.4028234663852886E+38 3.4028234663852886E+38 /end CHARACTERISTIC
/begin CHARACTERISTIC CcCTS_CellVoltageMinLimitDelta_mV "" VALUE 0x70010680 Scalar_FLOAT32_IEEE 0 VBU0428Test_CM_single_cnt -3.4028234663852886E+38 3.4028234663852886E+38 /end CHARACTERISTIC
/begin CHARACTERISTIC CcCTS_CellVoltageMinLimit_mV "" VALUE 0x70010684 Scalar_FLOAT32_IEEE 0 VBU0428Test_CM_single_cnt -3.4028234663852886E+38 3.4028234663852886E+38 /end CHARACTERISTIC
/begin CHARACTERISTIC CcCTS_SocInitialDelayTime_s "" VALUE 0x70010698 Scalar_FLOAT32_IEEE 0 VBU0428Test_CM_single_cnt -3.4028234663852886E+38 3.4028234663852886E+38 /end CHARACTERISTIC
/begin CHARACTERISTIC CcCVT_BdmCellVoltageOverDeviationDisableCrrnt_A "" VALUE 0x7001069c Scalar_FLOAT32_IEEE 0 VBU0428Test_CM_single_A -3.4028234663852886E+38 3.4028234663852886E+38 /end CHARACTERISTIC
/begin CHARACTERISTIC CcFCC_BatteryChargeCurrentFactor_n "" VALUE 0x700106bc Scalar_FLOAT32_IEEE 0 VBU0428Test_CM_single_cnt -3.4028234663852886E+38 3.4028234663852886E+38 /end CHARACTERISTIC
/begin CHARACTERISTIC CcFCC_CellVoltageMaxCorrectEndDelta_mV "" VALUE 0x700106c0 Scalar_FLOAT32_IEEE 0 VBU0428Test_CM_single_cnt -3.4028234663852886E+38 3.4028234663852886E+38 /end CHARACTERISTIC
/begin CHARACTERISTIC CcFCC_CellVoltageMaxCorrectMiddleDelta_mV "" VALUE 0x700106c4 Scalar_FLOAT32_IEEE 0 VBU0428Test_CM_single_cnt -3.4028234663852886E+38 3.4028234663852886E+38 /end CHARACTERISTIC
/begin CHARACTERISTIC CcFCC_CellVoltageMaxCorrectSlopMax_nbr "" VALUE 0x700106c8 Scalar_FLOAT32_IEEE 0 VBU0428Test_CM_single_cnt -3.4028234663852886E+38 3.4028234663852886E+38 /end CHARACTERISTIC
/begin CHARACTERISTIC CcFCC_CellVoltageMaxCorrectSlopMin_nbr "" VALUE 0x700106cc Scalar_FLOAT32_IEEE 0 VBU0428Test_CM_single_cnt -3.4028234663852886E+38 3.4028234663852886E+38 /end CHARACTERISTIC
/begin CHARACTERISTIC CcFCC_CellVoltageMaxCorrectStartDelta_mV "" VALUE 0x700106d0 Scalar_FLOAT32_IEEE 0 VBU0428Test_CM_single_cnt -3.4028234663852886E+38 3.4028234663852886E+38 /end CHARACTERISTIC
/begin CHARACTERISTIC CcFCC_CellVoltageMaxFactorEnd_nbr "" VALUE 0x700106d4 Scalar_FLOAT32_IEEE 0 VBU0428Test_CM_single_cnt -3.4028234663852886E+38 3.4028234663852886E+38 /end CHARACTERISTIC
/begin CHARACTERISTIC CcFCC_CellVoltageMaxFactorMiddle_nbr "" VALUE 0x700106d8 Scalar_FLOAT32_IEEE 0 VBU0428Test_CM_single_cnt -3.4028234663852886E+38 3.4028234663852886E+38 /end CHARACTERISTIC
/begin CHARACTERISTIC CcFCC_CellVoltageMaxFactorStart_nbr "" VALUE 0x700106dc Scalar_FLOAT32_IEEE 0 VBU0428Test_CM_single_cnt -3.4028234663852886E+38 3.4028234663852886E+38 /end CHARACTERISTIC
/begin CHARACTERISTIC CcFCC_ChargePowerDecRate_Kw "" VALUE 0x70010708 Scalar_FLOAT32_IEEE 0 VBU0428Test_CM_single_cnt -3.4028234663852886E+38 3.4028234663852886E+38 /end CHARACTERISTIC
/begin CHARACTERISTIC CcFCC_ChargePowerIncRate_Kw "" VALUE 0x7001070c Scalar_FLOAT32_IEEE 0 VBU0428Test_CM_single_cnt -3.4028234663852886E+38 3.4028234663852886E+38 /end CHARACTERISTIC
/begin CHARACTERISTIC CcFCC_ComputeResistanceCurrentDecRate_A "" VALUE 0x7001071c Scalar_FLOAT32_IEEE 0 VBU0428Test_CM_single_cnt -3.4028234663852886E+38 3.4028234663852886E+38 /end CHARACTERISTIC
/begin CHARACTERISTIC CcFCC_ComputeResistanceCurrentIncRate_A "" VALUE 0x70010720 Scalar_FLOAT32_IEEE 0 VBU0428Test_CM_single_cnt -3.4028234663852886E+38 3.4028234663852886E+38 /end CHARACTERISTIC
/begin CHARACTERISTIC CcFCC_CustomSetSOCEnable_pct "" VALUE 0x70010730 Scalar_FLOAT32_IEEE 0 VBU0428Test_CM_single_cnt -3.4028234663852886E+38 3.4028234663852886E+38 /end CHARACTERISTIC
/begin CHARACTERISTIC CcFCC_EstimateChargeTimeCurrent_A "" VALUE 0x7001073c Scalar_FLOAT32_IEEE 0 VBU0428Test_CM_single_cnt -3.4028234663852886E+38 3.4028234663852886E+38 /end CHARACTERISTIC
/begin CHARACTERISTIC CcFCC_FullChargeSoc1_pct "" VALUE 0x70010744 Scalar_FLOAT32_IEEE 0 VBU0428Test_CM_single_cnt -3.4028234663852886E+38 3.4028234663852886E+38 /end CHARACTERISTIC
/begin CHARACTERISTIC CcFCC_FullChargeSoc2_pct "" VALUE 0x70010748 Scalar_FLOAT32_IEEE 0 VBU0428Test_CM_single_cnt -3.4028234663852886E+38 3.4028234663852886E+38 /end CHARACTERISTIC
/begin CHARACTERISTIC CcFCC_FullChargeSoc3_pct "" VALUE 0x7001074c Scalar_FLOAT32_IEEE 0 VBU0428Test_CM_single_cnt -3.4028234663852886E+38 3.4028234663852886E+38 /end CHARACTERISTIC
/begin CHARACTERISTIC CcFCC_NoChargeHighTemp_C "" VALUE 0x70010758 Scalar_FLOAT32_IEEE 0 VBU0428Test_CM_single_C -40.0 200.0 /end CHARACTERISTIC
/begin CHARACTERISTIC CcFCC_NoChargeLowTemp_C "" VALUE 0x7001075c Scalar_FLOAT32_IEEE 0 VBU0428Test_CM_single_C -40.0 200.0 /end CHARACTERISTIC
/begin CHARACTERISTIC CcFCC_StandardPowerLimit_Kw "" VALUE 0x70010760 Scalar_FLOAT32_IEEE 0 VBU0428Test_CM_single_cnt -3.4028234663852886E+38 3.4028234663852886E+38 /end CHARACTERISTIC
/begin CHARACTERISTIC CcFCC_TrickleChargeCurrent_A "" VALUE 0x70010764 Scalar_FLOAT32_IEEE 0 VBU0428Test_CM_single_cnt -3.4028234663852886E+38 3.4028234663852886E+38 /end CHARACTERISTIC
/begin CHARACTERISTIC CcSOC_BatteryDisplaySocUpdateDelta_pct "" VALUE 0x700107c8 Scalar_FLOAT32_IEEE 0 VBU0428Test_CM_single_cnt -3.4028234663852886E+38 3.4028234663852886E+38 /end CHARACTERISTIC
/begin CHARACTERISTIC CcSOC_BatterySOCOvrdVal_pct "" VALUE 0x700107d4 Scalar_FLOAT32_IEEE 0 VBU0428Test_CM_single_cnt -3.4028234663852886E+38 3.4028234663852886E+38 /end CHARACTERISTIC
/begin CHARACTERISTIC CcSOC_BatterySocUpdateDelta_pct "" VALUE 0x700107f4 Scalar_FLOAT32_IEEE 0 VBU0428Test_CM_single_cnt -3.4028234663852886E+38 3.4028234663852886E+38 /end CHARACTERISTIC
/begin CHARACTERISTIC CcSOC_CCCorrectionDisableTem_C "" VALUE 0x7001081c Scalar_FLOAT32_IEEE 0 VBU0428Test_CM_single_cnt -3.4028234663852886E+38 3.4028234663852886E+38 /end CHARACTERISTIC
/begin CHARACTERISTIC CcSOC_CCCorrectionEnableTem_C "" VALUE 0x70010820 Scalar_FLOAT32_IEEE 0 VBU0428Test_CM_single_cnt -3.4028234663852886E+38 3.4028234663852886E+38 /end CHARACTERISTIC
/begin CHARACTERISTIC CcSOC_CellCapacityOvrdVal_Ah "" VALUE 0x70010828 Scalar_FLOAT32_IEEE 0 VBU0428Test_CM_single_cnt -3.4028234663852886E+38 3.4028234663852886E+38 /end CHARACTERISTIC
/begin CHARACTERISTIC CcSOC_CellSocDefault_pct "" VALUE 0x7001082c Scalar_FLOAT32_IEEE 0 VBU0428Test_CM_single_cnt -3.4028234663852886E+38 3.4028234663852886E+38 /end CHARACTERISTIC
/begin CHARACTERISTIC CcSOC_CellSocMaxOverrunLimit_pct "" VALUE 0x70010834 Scalar_FLOAT32_IEEE 0 VBU0428Test_CM_single_cnt -3.4028234663852886E+38 3.4028234663852886E+38 /end CHARACTERISTIC
/begin CHARACTERISTIC CcSOC_CellSocMinOverrunLimit_pct "" VALUE 0x70010838 Scalar_FLOAT32_IEEE 0 VBU0428Test_CM_single_cnt -3.4028234663852886E+38 3.4028234663852886E+38 /end CHARACTERISTIC
/begin CHARACTERISTIC CcSOC_MaxAllowSOCDeviation_pct "" VALUE 0x7001084c Scalar_FLOAT32_IEEE 0 VBU0428Test_CM_single_cnt -3.4028234663852886E+38 3.4028234663852886E+38 /end CHARACTERISTIC
/begin CHARACTERISTIC CcSOC_MaxBalancedCapacity_As "" VALUE 0x70010850 Scalar_FLOAT32_IEEE 0 VBU0428Test_CM_single_cnt -3.4028234663852886E+38 3.4028234663852886E+38 /end CHARACTERISTIC
/begin CHARACTERISTIC CcSOC_MaxCurrentIntegral_As "" VALUE 0x70010854 Scalar_FLOAT32_IEEE 0 VBU0428Test_CM_single_cnt -3.4028234663852886E+38 3.4028234663852886E+38 /end CHARACTERISTIC
/begin CHARACTERISTIC CcSOC_MinBalancedCapacity_As "" VALUE 0x70010858 Scalar_FLOAT32_IEEE 0 VBU0428Test_CM_single_cnt -3.4028234663852886E+38 3.4028234663852886E+38 /end CHARACTERISTIC
/begin CHARACTERISTIC CcSOC_MinCurrentIntegral_As "" VALUE 0x7001085c Scalar_FLOAT32_IEEE 0 VBU0428Test_CM_single_cnt -3.4028234663852886E+38 3.4028234663852886E+38 /end CHARACTERISTIC
/begin CHARACTERISTIC CcSOC_NoJumpSocChargeRate_pct "" VALUE 0x70010860 Scalar_FLOAT32_IEEE 0 VBU0428Test_CM_single_cnt -3.4028234663852886E+38 3.4028234663852886E+38 /end CHARACTERISTIC
/begin CHARACTERISTIC CcSOE_CellEnergyBoL_Kwh "" VALUE 0x70010874 Scalar_FLOAT32_IEEE 0 VBU0428Test_CM_single_cnt -3.4028234663852886E+38 3.4028234663852886E+38 /end CHARACTERISTIC
/begin CHARACTERISTIC CcSOE_CellSocDelta_pct "" VALUE 0x70010878 Scalar_FLOAT32_IEEE 0 VBU0428Test_CM_single_cnt -3.4028234663852886E+38 3.4028234663852886E+38 /end CHARACTERISTIC
/begin CHARACTERISTIC CcSOE_CellSocEndPredictUpperLimit_pct "" VALUE 0x7001087c Scalar_FLOAT32_IEEE 0 VBU0428Test_CM_single_cnt -3.4028234663852886E+38 3.4028234663852886E+38 /end CHARACTERISTIC
/begin CHARACTERISTIC CcSOE_HistoryAveCurrentTimeIntervalNumber_n "" VALUE 0x70010890 Scalar_FLOAT32_IEEE 0 VBU0428Test_CM_single_cnt -3.4028234663852886E+38 3.4028234663852886E+38 /end CHARACTERISTIC
/begin CHARACTERISTIC CcSOE_HistoryAveCurrentTotalTime_s "" VALUE 0x70010894 Scalar_FLOAT32_IEEE 0 VBU0428Test_CM_single_cnt -3.4028234663852886E+38 3.4028234663852886E+38 /end CHARACTERISTIC
/begin CHARACTERISTIC CcSOF_DischargeOCVInLowSOCforPowerLimit_V "" VALUE 0x7001091c Scalar_FLOAT32_IEEE 0 VBU0428Test_CM_single_cnt -3.4028234663852886E+38 3.4028234663852886E+38 /end CHARACTERISTIC
/begin CHARACTERISTIC CcSOF_SOCLowValueForConstantOCV_pct "" VALUE 0x700109b4 Scalar_FLOAT32_IEEE 0 VBU0428Test_CM_single_cnt -3.4028234663852886E+38 3.4028234663852886E+38 /end CHARACTERISTIC
/begin CHARACTERISTIC CcSOH_CellCapacityLowFault_pct "" VALUE 0x70010a24 Scalar_FLOAT32_IEEE 0 VBU0428Test_CM_single_cnt -3.4028234663852886E+38 3.4028234663852886E+38 /end CHARACTERISTIC
/begin CHARACTERISTIC CcSOH_CellCapacityOverDeviationFault_Ah "" VALUE 0x70010a2c Scalar_FLOAT32_IEEE 0 VBU0428Test_CM_single_cnt -3.4028234663852886E+38 3.4028234663852886E+38 /end CHARACTERISTIC
/begin CHARACTERISTIC CcSOH_CellResistanceHighFault_pct "" VALUE 0x70010a30 Scalar_FLOAT32_IEEE 0 VBU0428Test_CM_single_cnt -3.4028234663852886E+38 3.4028234663852886E+38 /end CHARACTERISTIC
/begin CHARACTERISTIC CcSOH_FastChargeFactor_n "" VALUE 0x70010a58 Scalar_FLOAT32_IEEE 0 VBU0428Test_CM_single_cnt -3.4028234663852886E+38 3.4028234663852886E+38 /end CHARACTERISTIC
/begin CHARACTERISTIC CcSOH_NotCalculatedSoh_pct "" VALUE 0x70010a74 Scalar_FLOAT32_IEEE 0 VBU0428Test_CM_single_cnt -3.4028234663852886E+38 3.4028234663852886E+38 /end CHARACTERISTIC
/begin CHARACTERISTIC CcSOH_ResistanceBase_mohm "" VALUE 0x70010a7c Scalar_FLOAT32_IEEE 0 VBU0428Test_CM_single_cnt -3.4028234663852886E+38 3.4028234663852886E+38 /end CHARACTERISTIC
/begin CHARACTERISTIC CcSYS_MappedCellCapacity_Ah "" VALUE 0x70010a9c Scalar_FLOAT32_IEEE 0 VBU0428Test_CM_single_cnt -3.4028234663852886E+38 3.4028234663852886E+38 /end CHARACTERISTIC
/begin CHARACTERISTIC CcTHM_ChargeTempRequestHighThreshold_C "" VALUE 0x70010abc Scalar_FLOAT32_IEEE 0 VBU0428Test_CM_single_cnt -3.4028234663852886E+38 3.4028234663852886E+38 /end CHARACTERISTIC
/begin CHARACTERISTIC CcTHM_FccChargeTempRequestLowThreshold_C "" VALUE 0x70010ae0 Scalar_FLOAT32_IEEE 0 VBU0428Test_CM_single_cnt -3.4028234663852886E+38 3.4028234663852886E+38 /end CHARACTERISTIC
/begin CHARACTERISTIC CcTHM_FccSohTempLowThreshold_C "" VALUE 0x70010ae8 Scalar_FLOAT32_IEEE 0 VBU0428Test_CM_single_cnt -3.4028234663852886E+38 3.4028234663852886E+38 /end CHARACTERISTIC
/begin CHARACTERISTIC CcTHM_InvaildTempRequest_C "" VALUE 0x70010af4 Scalar_FLOAT32_IEEE 0 VBU0428Test_CM_single_cnt -3.4028234663852886E+38 3.4028234663852886E+38 /end CHARACTERISTIC
/begin CHARACTERISTIC CcTHM_PackSohORV_pct "" VALUE 0x70010b10 Scalar_FLOAT32_IEEE 0 VBU0428Test_CM_single_cnt -3.4028234663852886E+38 3.4028234663852886E+38 /end CHARACTERISTIC
/begin CHARACTERISTIC CcVCT_BMSBatteryRatedCapacityORV_Ah "" VALUE 0x70010b14 Scalar_FLOAT32_IEEE 0 VBU0428Test_CM_single_Ah -3.4028234663852886E+38 3.4028234663852886E+38 /end CHARACTERISTIC
/begin CHARACTERISTIC CcVCT_BMSBatteryRatedVoltageORV_V "" VALUE 0x70010b18 Scalar_FLOAT32_IEEE 0 VBU0428Test_CM_single_V -3.4028234663852886E+38 3.4028234663852886E+38 /end CHARACTERISTIC
/begin CHARACTERISTIC CcVCT_BMSCellTempStandardDeviationORV_C "" VALUE 0x70010b1c Scalar_FLOAT32_IEEE 0 VBU0428Test_CM_single_cnt -3.4028234663852886E+38 3.4028234663852886E+38 /end CHARACTERISTIC
/begin CHARACTERISTIC CcVCT_BMSCellVoltageAveORV_V "" VALUE 0x70010b20 Scalar_FLOAT32_IEEE 0 VBU0428Test_CM_single_V -3.4028234663852886E+38 3.4028234663852886E+38 /end CHARACTERISTIC
/begin CHARACTERISTIC CcVCT_BMSCellVoltageMaxORV_V "" VALUE 0x70010b24 Scalar_FLOAT32_IEEE 0 VBU0428Test_CM_single_V -3.4028234663852886E+38 3.4028234663852886E+38 /end CHARACTERISTIC
/begin CHARACTERISTIC CcVCT_BMSCellVoltageMinORV_V "" VALUE 0x70010b28 Scalar_FLOAT32_IEEE 0 VBU0428Test_CM_single_V -3.4028234663852886E+38 3.4028234663852886E+38 /end CHARACTERISTIC
/begin CHARACTERISTIC CcVCT_BMSChgCurrentLimitORV_A "" VALUE 0x70010b2c Scalar_FLOAT32_IEEE 0 VBU0428Test_CM_single_A -3.4028234663852886E+38 3.4028234663852886E+38 /end CHARACTERISTIC
/begin CHARACTERISTIC CcVCT_BMSChgPowerLimitDynamicORV_Kw "" VALUE 0x70010b30 Scalar_FLOAT32_IEEE 0 VBU0428Test_CM_single_Kw -3.4028234663852886E+38 3.4028234663852886E+38 /end CHARACTERISTIC
/begin CHARACTERISTIC CcVCT_BMSChgPowerLimitLTORV_Kw "" VALUE 0x70010b34 Scalar_FLOAT32_IEEE 0 VBU0428Test_CM_single_Kw -3.4028234663852886E+38 3.4028234663852886E+38 /end CHARACTERISTIC
/begin CHARACTERISTIC CcVCT_BMSChgPowerLimitSTORV_Kw "" VALUE 0x70010b38 Scalar_FLOAT32_IEEE 0 VBU0428Test_CM_single_Kw -3.4028234663852886E+38 3.4028234663852886E+38 /end CHARACTERISTIC
/begin CHARACTERISTIC CcVCT_BMSCustomerUsageSOCORV_pct "" VALUE 0x70010b3c Scalar_FLOAT32_IEEE 0 VBU0428Test_CM_single_pct -3.4028234663852886E+38 3.4028234663852886E+38 /end CHARACTERISTIC
/begin CHARACTERISTIC CcVCT_BMSDCChargingCurrentMeasurementORV_A "" VALUE 0x70010b40 Scalar_FLOAT32_IEEE 0 VBU0428Test_CM_single_A -3.4028234663852886E+38 3.4028234663852886E+38 /end CHARACTERISTIC
/begin CHARACTERISTIC CcVCT_BMSDCChargingVoltageMeasurementORV_V "" VALUE 0x70010b44 Scalar_FLOAT32_IEEE 0 VBU0428Test_CM_single_V -3.4028234663852886E+38 3.4028234663852886E+38 /end CHARACTERISTIC
/begin CHARACTERISTIC CcVCT_BMSDCChrgCrntReqORV_A "" VALUE 0x70010b48 Scalar_FLOAT32_IEEE 0 VBU0428Test_CM_single_A -3.4028234663852886E+38 3.4028234663852886E+38 /end CHARACTERISTIC
/begin CHARACTERISTIC CcVCT_BMSDCChrgFinalSOCORV_pct "" VALUE 0x70010b4c Scalar_FLOAT32_IEEE 0 VBU0428Test_CM_single_pct -3.4028234663852886E+38 3.4028234663852886E+38 /end CHARACTERISTIC
/begin CHARACTERISTIC CcVCT_BMSDCChrgVoltageReqORV_V "" VALUE 0x70010b50 Scalar_FLOAT32_IEEE 0 VBU0428Test_CM_single_V -3.4028234663852886E+38 3.4028234663852886E+38 /end CHARACTERISTIC
/begin CHARACTERISTIC CcVCT_BMSDischgCurrentLimitORV_A "" VALUE 0x70010b54 Scalar_FLOAT32_IEEE 0 VBU0428Test_CM_single_A -3.4028234663852886E+38 3.4028234663852886E+38 /end CHARACTERISTIC
/begin CHARACTERISTIC CcVCT_BMSDischgPowerLimitDynamicORV_Kw "" VALUE 0x70010b58 Scalar_FLOAT32_IEEE 0 VBU0428Test_CM_single_Kw -3.4028234663852886E+38 3.4028234663852886E+38 /end CHARACTERISTIC
/begin CHARACTERISTIC CcVCT_BMSDischgPowerLimitLTIORV_Kw "" VALUE 0x70010b5c Scalar_FLOAT32_IEEE 0 VBU0428Test_CM_single_Kw -3.4028234663852886E+38 3.4028234663852886E+38 /end CHARACTERISTIC
/begin CHARACTERISTIC CcVCT_BMSDischgPowerLimitSTORV_Kw "" VALUE 0x70010b60 Scalar_FLOAT32_IEEE 0 VBU0428Test_CM_single_Kw -3.4028234663852886E+38 3.4028234663852886E+38 /end CHARACTERISTIC
/begin CHARACTERISTIC CcVCT_BMSEstimateChargingTimeORV_min "" VALUE 0x70010b64 Scalar_FLOAT32_IEEE 0 VBU0428Test_CM_single_min -3.4028234663852886E+38 3.4028234663852886E+38 /end CHARACTERISTIC
/begin CHARACTERISTIC CcVCT_BMSInletTempRequestORV_C "" VALUE 0x70010b68 Scalar_FLOAT32_IEEE 0 VBU0428Test_CM_single_cnt -3.4028234663852886E+38 3.4028234663852886E+38 /end CHARACTERISTIC
/begin CHARACTERISTIC CcVCT_BMSInletWaterTempORV_C "" VALUE 0x70010b6c Scalar_FLOAT32_IEEE 0 VBU0428Test_CM_single_cnt -3.4028234663852886E+38 3.4028234663852886E+38 /end CHARACTERISTIC
/begin CHARACTERISTIC CcVCT_BMSInsulationResistanceValueORV_Kohm "" VALUE 0x70010b70 Scalar_FLOAT32_IEEE 0 VBU0428Test_CM_single_Kohm -3.4028234663852886E+38 3.4028234663852886E+38 /end CHARACTERISTIC
/begin CHARACTERISTIC CcVCT_BMSMaxPermitDCChargeVoltageORV_V "" VALUE 0x70010b74 Scalar_FLOAT32_IEEE 0 VBU0428Test_CM_single_V -3.4028234663852886E+38 3.4028234663852886E+38 /end CHARACTERISTIC
/begin CHARACTERISTIC CcVCT_BMSMaximumCellTempORV_C "" VALUE 0x70010b78 Scalar_FLOAT32_IEEE 0 VBU0428Test_CM_single_cnt -3.4028234663852886E+38 3.4028234663852886E+38 /end CHARACTERISTIC
/begin CHARACTERISTIC CcVCT_BMSMinimumCellTempORV_C "" VALUE 0x70010b7c Scalar_FLOAT32_IEEE 0 VBU0428Test_CM_single_cnt -3.4028234663852886E+38 3.4028234663852886E+38 /end CHARACTERISTIC
/begin CHARACTERISTIC CcVCT_BMSOutletWaterTempORV_C "" VALUE 0x70010b80 Scalar_FLOAT32_IEEE 0 VBU0428Test_CM_single_cnt -3.4028234663852886E+38 3.4028234663852886E+38 /end CHARACTERISTIC
/begin CHARACTERISTIC CcVCT_BMSPackCrntORV_A "" VALUE 0x70010b84 Scalar_FLOAT32_IEEE 0 VBU0428Test_CM_single_A -3.4028234663852886E+38 3.4028234663852886E+38 /end CHARACTERISTIC
/begin CHARACTERISTIC CcVCT_BMSPackEnergyAvailableORV_Kwh "" VALUE 0x70010b88 Scalar_FLOAT32_IEEE 0 VBU0428Test_CM_single_Kwh -3.4028234663852886E+38 3.4028234663852886E+38 /end CHARACTERISTIC
/begin CHARACTERISTIC CcVCT_BMSPackVoltageORV_V "" VALUE 0x70010b8c Scalar_FLOAT32_IEEE 0 VBU0428Test_CM_single_V -3.4028234663852886E+38 3.4028234663852886E+38 /end CHARACTERISTIC
/begin CHARACTERISTIC CcVCT_BMSSOCORV_pct "" VALUE 0x70010b98 Scalar_FLOAT32_IEEE 0 VBU0428Test_CM_single_pct -3.4028234663852886E+38 3.4028234663852886E+38 /end CHARACTERISTIC
/begin CHARACTERISTIC CcVCT_BMSTemperatureAverageORV_C "" VALUE 0x70010b9c Scalar_FLOAT32_IEEE 0 VBU0428Test_CM_single_cnt -3.4028234663852886E+38 3.4028234663852886E+38 /end CHARACTERISTIC
/begin CHARACTERISTIC CcVCT_BMSTemperatureMaxORV_C "" VALUE 0x70010ba0 Scalar_FLOAT32_IEEE 0 VBU0428Test_CM_single_cnt -3.4028234663852886E+38 3.4028234663852886E+38 /end CHARACTERISTIC
/begin CHARACTERISTIC CcVCT_BMSTemperatureMinORF_flg "" VALUE 0x70010ba4 Scalar_FLOAT32_IEEE 0 VBU0428Test_CM_single_flg -3.4028234663852886E+38 3.4028234663852886E+38 /end CHARACTERISTIC
/begin CHARACTERISTIC CcVCT_BMSTemperatureMinORV_C "" VALUE 0x70010ba8 Scalar_FLOAT32_IEEE 0 VBU0428Test_CM_single_cnt -3.4028234663852886E+38 3.4028234663852886E+38 /end CHARACTERISTIC
/begin CHARACTERISTIC CcVCT_BMSVoltageLimitMaxORV_V "" VALUE 0x70010bac Scalar_FLOAT32_IEEE 0 VBU0428Test_CM_single_V -3.4028234663852886E+38 3.4028234663852886E+38 /end CHARACTERISTIC
/begin CHARACTERISTIC CcVCT_BMSVoltageLimitMinORV_V "" VALUE 0x70010bb0 Scalar_FLOAT32_IEEE 0 VBU0428Test_CM_single_V -3.4028234663852886E+38 3.4028234663852886E+38 /end CHARACTERISTIC
/begin CHARACTERISTIC CcVCT_BatteryNomalCapacityORV_Kwh "" VALUE 0x70010bb4 Scalar_FLOAT32_IEEE 0 VBU0428Test_CM_single_Kwh -3.4028234663852886E+38 3.4028234663852886E+38 /end CHARACTERISTIC
/begin CHARACTERISTIC CcVCT_EstimatePercTimeORV_min "" VALUE 0x70010bc4 Scalar_FLOAT32_IEEE 0 VBU0428Test_CM_single_min -3.4028234663852886E+38 3.4028234663852886E+38 /end CHARACTERISTIC
/begin CHARACTERISTIC CcVCT_HVBattStopDchaThdORV_pct "" VALUE 0x70010bc8 Scalar_FLOAT32_IEEE 0 VBU0428Test_CM_single_pct -3.4028234663852886E+38 3.4028234663852886E+38 /end CHARACTERISTIC
/begin CHARACTERISTIC CcVCT_MaximumChargingCurrentORV_A "" VALUE 0x70010bcc Scalar_FLOAT32_IEEE 0 VBU0428Test_CM_single_A -3.4028234663852886E+38 3.4028234663852886E+38 /end CHARACTERISTIC
/begin CHARACTERISTIC CcVCT_MaximumChargingVoltageORV_V "" VALUE 0x70010bd0 Scalar_FLOAT32_IEEE 0 VBU0428Test_CM_single_V -3.4028234663852886E+38 3.4028234663852886E+38 /end CHARACTERISTIC
/begin CHARACTERISTIC CcVCT_MaximumPermitChargeCellVoltageORV_V "" VALUE 0x70010bd4 Scalar_FLOAT32_IEEE 0 VBU0428Test_CM_single_V -3.4028234663852886E+38 3.4028234663852886E+38 /end CHARACTERISTIC
/begin CHARACTERISTIC CcVCT_MaximumPermitTempORV_C "" VALUE 0x70010bd8 Scalar_FLOAT32_IEEE 0 VBU0428Test_CM_single_cnt -3.4028234663852886E+38 3.4028234663852886E+38 /end CHARACTERISTIC
/begin CHARACTERISTIC EPB_flgFlgIGNOvrd_C "" VALUE 0x700111b4 Scalar_FLOAT32_IEEE 0 VBU0428Test_CM_single 0.0 1.0 /end CHARACTERISTIC
/begin CHARACTERISTIC EPB_flgFlgShutDownOvrd_C "" VALUE 0x700111b8 Scalar_FLOAT32_IEEE 0 VBU0428Test_CM_single 0.0 1.0 /end CHARACTERISTIC
/begin CHARACTERISTIC EPB_flgFrDragForceOvrd_C "" VALUE 0x700111bc Scalar_FLOAT32_IEEE 0 VBU0428Test_CM_single 0.0 1.0 /end CHARACTERISTIC
/begin CHARACTERISTIC EPB_flgIGNOvrdVal_C "" VALUE 0x700111c0 Scalar_FLOAT32_IEEE 0 VBU0428Test_CM_single 0.0 1.0 /end CHARACTERISTIC
/begin CHARACTERISTIC EPB_flgShutDownOvrdVal_C "" VALUE 0x700111c4 Scalar_FLOAT32_IEEE 0 VBU0428Test_CM_single 0.0 1.0 /end CHARACTERISTIC
/begin CHARACTERISTIC EPB_flgStCtlModeOvrd_C "" VALUE 0x700111c8 Scalar_FLOAT32_IEEE 0 VBU0428Test_CM_single 0.0 1.0 /end CHARACTERISTIC
/begin CHARACTERISTIC EPB_flgStFaultLevelOvrd_C "" VALUE 0x700111cc Scalar_FLOAT32_IEEE 0 VBU0428Test_CM_single 0.0 1.0 /end CHARACTERISTIC
/begin CHARACTERISTIC EPB_flgStParkLampOvrd_C "" VALUE 0x700111d0 Scalar_FLOAT32_IEEE 0 VBU0428Test_CM_single 0.0 1.0 /end CHARACTERISTIC
/begin CHARACTERISTIC EPB_flgStStateOvrd_C "" VALUE 0x700111d4 Scalar_FLOAT32_IEEE 0 VBU0428Test_CM_single 0.0 1.0 /end CHARACTERISTIC
/begin CHARACTERISTIC EPB_flgStSwitchFaultOvrd_C "" VALUE 0x700111d8 Scalar_FLOAT32_IEEE 0 VBU0428Test_CM_single 0.0 1.0 /end CHARACTERISTIC
/begin CHARACTERISTIC EPB_flgStSwitchOvrd_C "" VALUE 0x700111dc Scalar_FLOAT32_IEEE 0 VBU0428Test_CM_single 0.0 1.0 /end CHARACTERISTIC
/begin CHARACTERISTIC EPB_frDragForceOvrdVal_C "" VALUE 0x700111e0 Scalar_FLOAT32_IEEE 0 VBU0428Test_CM_single -3.40282346638528E+38 3.40282346638528E+38 /end CHARACTERISTIC
/begin CHARACTERISTIC EPB_stCtlModeOvrdVal_C "" VALUE 0x700111e4 Scalar_FLOAT32_IEEE 0 VBU0428Test_CM_single 0.0 255.0 /end CHARACTERISTIC
/begin CHARACTERISTIC EPB_stFaultLevelOvrdVal_C "" VALUE 0x700111e8 Scalar_FLOAT32_IEEE 0 VBU0428Test_CM_single 0.0 255.0 /end CHARACTERISTIC
/begin CHARACTERISTIC EPB_stParkLampOvrdVal_C "" VALUE 0x700111ec Scalar_FLOAT32_IEEE 0 VBU0428Test_CM_single 0.0 255.0 /end CHARACTERISTIC
/begin CHARACTERISTIC EPB_stStateOvrdVal_C "" VALUE 0x700111f0 Scalar_FLOAT32_IEEE 0 VBU0428Test_CM_single 0.0 255.0 /end CHARACTERISTIC
/begin CHARACTERISTIC EPB_stSwitchFaultOvrdVal_C "" VALUE 0x700111f4 Scalar_FLOAT32_IEEE 0 VBU0428Test_CM_single 0.0 255.0 /end CHARACTERISTIC
/begin CHARACTERISTIC EPB_stSwitchOvrdVal_C "" VALUE 0x700111f8 Scalar_FLOAT32_IEEE 0 VBU0428Test_CM_single 0.0 255.0 /end CHARACTERISTIC
/begin CHARACTERISTIC EPS_degStrngAgSpdOvrdVal_C "" VALUE 0x70011204 Scalar_FLOAT32_IEEE 0 VBU0428Test_CM_single -3.40282346638528E+38 3.40282346638528E+38 /end CHARACTERISTIC
/begin CHARACTERISTIC EPS_flgDegStrngAgSpdOvrd_C "" VALUE 0x7001120c Scalar_FLOAT32_IEEE 0 VBU0428Test_CM_single 0.0 1.0 /end CHARACTERISTIC
/begin CHARACTERISTIC EPS_flgStECUModeCntOvrd_C "" VALUE 0x70011214 Scalar_FLOAT32_IEEE 0 VBU0428Test_CM_single 0.0 1.0 /end CHARACTERISTIC
/begin CHARACTERISTIC EPS_flgTrqTrqMotrOvrd_C "" VALUE 0x70011218 Scalar_FLOAT32_IEEE 0 VBU0428Test_CM_single 0.0 1.0 /end CHARACTERISTIC
/begin CHARACTERISTIC EPS_flgTrqTrqStrngOvrd_C "" VALUE 0x7001121c Scalar_FLOAT32_IEEE 0 VBU0428Test_CM_single 0.0 1.0 /end CHARACTERISTIC
/begin CHARACTERISTIC EPS_stECUModeCntOvrdVal_C "" VALUE 0x70011224 Scalar_FLOAT32_IEEE 0 VBU0428Test_CM_single 0.0 255.0 /end CHARACTERISTIC
/begin CHARACTERISTIC EPS_trqTrqMotrOvrdVal_C "" VALUE 0x70011228 Scalar_FLOAT32_IEEE 0 VBU0428Test_CM_single -3.40282346638528E+38 3.40282346638528E+38 /end CHARACTERISTIC
/begin CHARACTERISTIC EPS_trqTrqStrngOvrdVal_C "" VALUE 0x7001122c Scalar_FLOAT32_IEEE 0 VBU0428Test_CM_single -3.40282346638528E+38 3.40282346638528E+38 /end CHARACTERISTIC
/begin CHARACTERISTIC CcFCC_BatteryCapacityCycle1_n "" VALUE 0x700106b4 Scalar_ULONG 0 VBU0428Test_CM_uint32_cnt 0.0 4.294967295E+9 /end CHARACTERISTIC
/begin CHARACTERISTIC CcFCC_BatteryCapacityCycle2_n "" VALUE 0x700106b8 Scalar_ULONG 0 VBU0428Test_CM_uint32_cnt 0.0 4.294967295E+9 /end CHARACTERISTIC
/begin CHARACTERISTIC CcSOC_BatteryDisplaySocUpdateInterval_s "" VALUE 0x700107cc Scalar_ULONG 0 VBU0428Test_CM_uint32_cnt 0.0 4.294967295E+9 /end CHARACTERISTIC
/begin CHARACTERISTIC CcSOC_BatteryPolarizationMaxTime_ms "" VALUE 0x700107d0 Scalar_ULONG 0 VBU0428Test_CM_uint32_cnt 0.0 4.294967295E+9 /end CHARACTERISTIC
/begin CHARACTERISTIC CcSOC_InvalidLastShutdownTime_s "" VALUE 0x70010848 Scalar_ULONG 0 VBU0428Test_CM_uint32_cnt 0.0 4.294967295E+9 /end CHARACTERISTIC
/begin CHARACTERISTIC CcSOF_BatteryCycleLevel1_n "" VALUE 0x700108a4 Scalar_ULONG 0 VBU0428Test_CM_uint32_cnt 0.0 4.294967295E+9 /end CHARACTERISTIC
/begin CHARACTERISTIC CcSOF_BatteryCycleLevel2_n "" VALUE 0x700108a8 Scalar_ULONG 0 VBU0428Test_CM_uint32_cnt 0.0 4.294967295E+9 /end CHARACTERISTIC
/begin CHARACTERISTIC CcSOH_CellResistanceIncRatioUpdateTime_s "" VALUE 0x70010a34 Scalar_ULONG 0 VBU0428Test_CM_uint32_cnt 0.0 4.294967295E+9 /end CHARACTERISTIC
/begin CHARACTERISTIC CcVCT_BMSProtocalVersionORV_n "" VALUE 0x70010b90 Scalar_ULONG 0 VBU0428Test_CM_uint32_n 0.0 4.294967295E+9 /end CHARACTERISTIC
/begin CHARACTERISTIC CTM_CELL_THERMAL_RUNAWAY_FAULT "" VALUE 0x70010020 Scalar_UWORD 0 VBU0428Test_CM_uint16_cnt 0.0 65535.0 /end CHARACTERISTIC
/begin CHARACTERISTIC CcCTD_PrechargeFailLockoutInterval_s "" VALUE 0x7001005a Scalar_UWORD 0 VBU0428Test_CM_uint16_cnt 0.0 65535.0 /end CHARACTERISTIC
/begin CHARACTERISTIC CcCTD_PrechargeTimeMax_ms "" VALUE 0x7001005c Scalar_UWORD 0 VBU0428Test_CM_uint16_cnt 0.0 65535.0 /end CHARACTERISTIC
/begin CHARACTERISTIC CcCTS_ContactorRequestCloseDelay_ms "" VALUE 0x70010062 Scalar_UWORD 0 VBU0428Test_CM_uint16_cnt 0.0 65535.0 /end CHARACTERISTIC
/begin CHARACTERISTIC CcCVT_BdmCellOverVoltageFault_mV "" VALUE 0x70010074 Scalar_UWORD 0 VBU0428Test_CM_uint16_mV 0.0 65535.0 /end CHARACTERISTIC
/begin CHARACTERISTIC CcCVT_BdmCellUnderVoltageFault_mV "" VALUE 0x70010076 Scalar_UWORD 0 VBU0428Test_CM_uint16_mV 0.0 65535.0 /end CHARACTERISTIC
/begin CHARACTERISTIC CcCVT_BdmCellVoltageOverDeviationFault_mV "" VALUE 0x70010078 Scalar_UWORD 0 VBU0428Test_CM_uint16_mV 0.0 65535.0 /end CHARACTERISTIC
/begin CHARACTERISTIC CcCVT_BdmDelayTime_ms "" VALUE 0x7001007a Scalar_UWORD 0 VBU0428Test_CM_uint16_ms 0.0 65535.0 /end CHARACTERISTIC
/begin CHARACTERISTIC CcCVT_BdmVoltageDeviationDynamic_mV "" VALUE 0x7001007c Scalar_UWORD 0 VBU0428Test_CM_uint16_mV 0.0 65535.0 /end CHARACTERISTIC
/begin CHARACTERISTIC CcFCC_CurrentValueCrossZeroFlagDelay_ms "" VALUE 0x700100a2 Scalar_UWORD 0 VBU0428Test_CM_uint16_cnt 0.0 65535.0 /end CHARACTERISTIC
/begin CHARACTERISTIC CcFCC_EstimateChargeTimeRefresh_s "" VALUE 0x700100a4 Scalar_UWORD 0 VBU0428Test_CM_uint16_cnt 0.0 65535.0 /end CHARACTERISTIC
/begin CHARACTERISTIC CcFCC_MaxValidChargeTime_min "" VALUE 0x700100ac Scalar_UWORD 0 VBU0428Test_CM_uint16_cnt 0.0 65535.0 /end CHARACTERISTIC
/begin CHARACTERISTIC CcSOC_ChargeStateDelay_ms "" VALUE 0x700100be Scalar_UWORD 0 VBU0428Test_CM_uint16_cnt 0.0 65535.0 /end CHARACTERISTIC
/begin CHARACTERISTIC CcSOC_CorrectionEnableCellVoltageDeviation_mV "" VALUE 0x700100c0 Scalar_UWORD 0 VBU0428Test_CM_uint16_cnt 0.0 65535.0 /end CHARACTERISTIC
/begin CHARACTERISTIC CcSOC_OneThirdRateDeviationCellVoltage_mV "" VALUE 0x700100ce Scalar_UWORD 0 VBU0428Test_CM_uint16_cnt 0.0 65535.0 /end CHARACTERISTIC
/begin CHARACTERISTIC CcSOC_RelaxationDeviationCellVoltage_mV "" VALUE 0x700100d0 Scalar_UWORD 0 VBU0428Test_CM_uint16_cnt 0.0 65535.0 /end CHARACTERISTIC
/begin CHARACTERISTIC CcSOF_PowerOnDiscOcvSloDelay_ms "" VALUE 0x700100f8 Scalar_UWORD 0 VBU0428Test_CM_uint16_cnt 0.0 65535.0 /end CHARACTERISTIC
/begin CHARACTERISTIC CcSOH_BDMOutputDelayTime_ms "" VALUE 0x70010106 Scalar_UWORD 0 VBU0428Test_CM_uint16_cnt 0.0 65535.0 /end CHARACTERISTIC
/begin CHARACTERISTIC MINUTES_PER_HOUR "" VALUE 0x70010132 Scalar_UWORD 0 VBU0428Test_CM_uint16_cnt 0.0 65535.0 /end CHARACTERISTIC
/begin CHARACTERISTIC CaDSM_CscValueUncertainFault_flg "" VAL_BLK 0x7002262e Scalar_BOOLEAN 0 VBU0428Test_CM_boolean_cnt 0.0 1.0 NUMBER 330 /end CHARACTERISTIC
/begin CHARACTERISTIC CaDSM_CycleUploadAbnormalEvent_flg "" VAL_BLK 0x70022778 Scalar_BOOLEAN 0 VBU0428Test_CM_boolean_cnt 0.0 1.0 NUMBER 330 /end CHARACTERISTIC
/begin CHARACTERISTIC CaDSM_NoChargeFault_flg "" VAL_BLK 0x70022a0c Scalar_BOOLEAN 0 VBU0428Test_CM_boolean_cnt 0.0 1.0 NUMBER 330 /end CHARACTERISTIC
/begin CHARACTERISTIC CbCTD_MnPosContactorWeldFaultEnable_flg "" VALUE 0x70022028 Scalar_BOOLEAN 0 VBU0428Test_CM_boolean_cnt 0.0 1.0 /end CHARACTERISTIC
/begin CHARACTERISTIC CbCTD_PrechargeOverEnergyLockoutEnable_flg "" VALUE 0x7002202b Scalar_BOOLEAN 0 VBU0428Test_CM_boolean_cnt 0.0 1.0 /end CHARACTERISTIC
/begin CHARACTERISTIC CbCTD_PrechargeRelayStuckOpenFaultEnable_flg "" VALUE 0x7002202c Scalar_BOOLEAN 0 VBU0428Test_CM_boolean_cnt 0.0 1.0 /end CHARACTERISTIC
/begin CHARACTERISTIC CbCTD_PrechargeTimeoutFaultEnable_flg "" VALUE 0x7002202e Scalar_BOOLEAN 0 VBU0428Test_CM_boolean_cnt 0.0 1.0 /end CHARACTERISTIC
/begin CHARACTERISTIC CbCVT_BdmCellOverVoltageFaultEnable_flg "" VALUE 0x70022040 Scalar_BOOLEAN 0 VBU0428Test_CM_boolean_flg 0.0 1.0 /end CHARACTERISTIC
/begin CHARACTERISTIC CbCVT_BdmCellUnderVoltageFaultEnable_flg "" VALUE 0x70022041 Scalar_BOOLEAN 0 VBU0428Test_CM_boolean_flg 0.0 1.0 /end CHARACTERISTIC
/begin CHARACTERISTIC CbCVT_BdmCellVoltageOverDeviationFaultEnable_flg "" VALUE 0x70022042 Scalar_BOOLEAN 0 VBU0428Test_CM_boolean_flg 0.0 1.0 /end CHARACTERISTIC
/begin CHARACTERISTIC CbSOC_BatterySOCOvrdFlg_flg "" VALUE 0x70022063 Scalar_BOOLEAN 0 VBU0428Test_CM_boolean_cnt 0.0 1.0 /end CHARACTERISTIC
/begin CHARACTERISTIC CbSOC_CellCapacityOvrdFlg_flg "" VALUE 0x70022067 Scalar_BOOLEAN 0 VBU0428Test_CM_boolean_cnt 0.0 1.0 /end CHARACTERISTIC
/begin CHARACTERISTIC CbSOC_ForceOcvSocInitialize_flg "" VALUE 0x7002206a Scalar_BOOLEAN 0 VBU0428Test_CM_boolean_cnt 0.0 1.0 /end CHARACTERISTIC
/begin CHARACTERISTIC CbSOC_ReadMemorySOCEnable_flg "" VALUE 0x7002206c Scalar_BOOLEAN 0 VBU0428Test_CM_boolean_cnt 0.0 1.0 /end CHARACTERISTIC
/begin CHARACTERISTIC CbSOH_CellCapacityLowFaultEnable_flg "" VALUE 0x70022072 Scalar_BOOLEAN 0 VBU0428Test_CM_boolean_cnt 0.0 1.0 /end CHARACTERISTIC
/begin CHARACTERISTIC CbSOH_CellCapacityOverDeviationFaultEnable_flg "" VALUE 0x70022073 Scalar_BOOLEAN 0 VBU0428Test_CM_boolean_cnt 0.0 1.0 /end CHARACTERISTIC
/begin CHARACTERISTIC CbSOH_CellResistanceHighFaultEnable_flg "" VALUE 0x70022074 Scalar_BOOLEAN 0 VBU0428Test_CM_boolean_cnt 0.0 1.0 /end CHARACTERISTIC
/begin CHARACTERISTIC CbSOH_ComputeResistanceRequestORF_flg "" VALUE 0x70022075 Scalar_BOOLEAN 0 VBU0428Test_CM_boolean_cnt 0.0 1.0 /end CHARACTERISTIC
/begin CHARACTERISTIC CbSOH_ComputeResistanceRequestORV_flg "" VALUE 0x70022076 Scalar_BOOLEAN 0 VBU0428Test_CM_boolean_cnt 0.0 1.0 /end CHARACTERISTIC
/begin CHARACTERISTIC CbVCT_AbortPrechargeCauseORF_flg "" VALUE 0x70022080 Scalar_BOOLEAN 0 VBU0428Test_CM_boolean_flg 0.0 1.0 /end CHARACTERISTIC
/begin CHARACTERISTIC CbVCT_BMSBMSRollingCounterORF_flg "" VALUE 0x70022081 Scalar_BOOLEAN 0 VBU0428Test_CM_boolean_flg 0.0 1.0 /end CHARACTERISTIC
/begin CHARACTERISTIC CbVCT_BMSBalanceStatusORF_flg "" VALUE 0x70022082 Scalar_BOOLEAN 0 VBU0428Test_CM_boolean_flg 0.0 1.0 /end CHARACTERISTIC
/begin CHARACTERISTIC CbVCT_BMSBatteryRatedCapacityORF_flg "" VALUE 0x70022083 Scalar_BOOLEAN 0 VBU0428Test_CM_boolean_flg 0.0 1.0 /end CHARACTERISTIC
/begin CHARACTERISTIC CbVCT_BMSBatteryRatedVoltageORF_flg "" VALUE 0x70022084 Scalar_BOOLEAN 0 VBU0428Test_CM_boolean_flg 0.0 1.0 /end CHARACTERISTIC
/begin CHARACTERISTIC CbVCT_BMSBatteryTypeORF_flg "" VALUE 0x70022085 Scalar_BOOLEAN 0 VBU0428Test_CM_boolean_flg 0.0 1.0 /end CHARACTERISTIC
/begin CHARACTERISTIC CbVCT_BMSCellTempStandardDeviationORF_flg "" VALUE 0x70022086 Scalar_BOOLEAN 0 VBU0428Test_CM_boolean_flg 0.0 1.0 /end CHARACTERISTIC
/begin CHARACTERISTIC CbVCT_BMSCellVoltageAveORF_flg "" VALUE 0x70022087 Scalar_BOOLEAN 0 VBU0428Test_CM_boolean_flg 0.0 1.0 /end CHARACTERISTIC
/begin CHARACTERISTIC CbVCT_BMSCellVoltageAveValidityORF_flg "" VALUE 0x70022088 Scalar_BOOLEAN 0 VBU0428Test_CM_boolean_flg 0.0 1.0 /end CHARACTERISTIC
/begin CHARACTERISTIC CbVCT_BMSCellVoltageAveValidityORV_flg "" VALUE 0x70022089 Scalar_BOOLEAN 0 VBU0428Test_CM_boolean_flg 0.0 1.0 /end CHARACTERISTIC
/begin CHARACTERISTIC CbVCT_BMSCellVoltageMaxORF_flg "" VALUE 0x7002208a Scalar_BOOLEAN 0 VBU0428Test_CM_boolean_flg 0.0 1.0 /end CHARACTERISTIC
/begin CHARACTERISTIC CbVCT_BMSCellVoltageMaxValidityORF_flg "" VALUE 0x7002208b Scalar_BOOLEAN 0 VBU0428Test_CM_boolean_flg 0.0 1.0 /end CHARACTERISTIC
/begin CHARACTERISTIC CbVCT_BMSCellVoltageMaxValidityORV_flg "" VALUE 0x7002208c Scalar_BOOLEAN 0 VBU0428Test_CM_boolean_flg 0.0 1.0 /end CHARACTERISTIC
/begin CHARACTERISTIC CbVCT_BMSCellVoltageMinORF_flg "" VALUE 0x7002208d Scalar_BOOLEAN 0 VBU0428Test_CM_boolean_flg 0.0 1.0 /end CHARACTERISTIC
/begin CHARACTERISTIC CbVCT_BMSCellVoltageMinValidityORF_flg "" VALUE 0x7002208e Scalar_BOOLEAN 0 VBU0428Test_CM_boolean_flg 0.0 1.0 /end CHARACTERISTIC
/begin CHARACTERISTIC CbVCT_BMSCellVoltageMinValidityORV_flg "" VALUE 0x7002208f Scalar_BOOLEAN 0 VBU0428Test_CM_boolean_flg 0.0 1.0 /end CHARACTERISTIC
/begin CHARACTERISTIC CbVCT_BMSCellVoltageOverUnderORF_flg "" VALUE 0x70022090 Scalar_BOOLEAN 0 VBU0428Test_CM_boolean_flg 0.0 1.0 /end CHARACTERISTIC
/begin CHARACTERISTIC CbVCT_BMSChargeStateORF_flg "" VALUE 0x70022091 Scalar_BOOLEAN 0 VBU0428Test_CM_boolean_flg 0.0 1.0 /end CHARACTERISTIC
/begin CHARACTERISTIC CbVCT_BMSChgCurrentLimitORF_flg "" VALUE 0x70022092 Scalar_BOOLEAN 0 VBU0428Test_CM_boolean_flg 0.0 1.0 /end CHARACTERISTIC
/begin CHARACTERISTIC CbVCT_BMSChgPowerLimitDynamicORF_flg "" VALUE 0x70022093 Scalar_BOOLEAN 0 VBU0428Test_CM_boolean_flg 0.0 1.0 /end CHARACTERISTIC
/begin CHARACTERISTIC CbVCT_BMSChgPowerLimitLTORF_flg "" VALUE 0x70022094 Scalar_BOOLEAN 0 VBU0428Test_CM_boolean_flg 0.0 1.0 /end CHARACTERISTIC
/begin CHARACTERISTIC CbVCT_BMSChgPowerLimitSTORF_flg "" VALUE 0x70022095 Scalar_BOOLEAN 0 VBU0428Test_CM_boolean_flg 0.0 1.0 /end CHARACTERISTIC
/begin CHARACTERISTIC CbVCT_BMSChrgConnErrorORF_flg "" VALUE 0x70022096 Scalar_BOOLEAN 0 VBU0428Test_CM_boolean_flg 0.0 1.0 /end CHARACTERISTIC
/begin CHARACTERISTIC CbVCT_BMSChrgConnOvertempORF_flg "" VALUE 0x70022097 Scalar_BOOLEAN 0 VBU0428Test_CM_boolean_flg 0.0 1.0 /end CHARACTERISTIC
/begin CHARACTERISTIC CbVCT_BMSConnectorOvertempORF_flg "" VALUE 0x70022098 Scalar_BOOLEAN 0 VBU0428Test_CM_boolean_flg 0.0 1.0 /end CHARACTERISTIC
/begin CHARACTERISTIC CbVCT_BMSContactorStateORF_flg "" VALUE 0x70022099 Scalar_BOOLEAN 0 VBU0428Test_CM_boolean_flg 0.0 1.0 /end CHARACTERISTIC
/begin CHARACTERISTIC CbVCT_BMSCustomerUsageSOCORF_flg "" VALUE 0x7002209a Scalar_BOOLEAN 0 VBU0428Test_CM_boolean_flg 0.0 1.0 /end CHARACTERISTIC
/begin CHARACTERISTIC CbVCT_BMSDCChargeCurrentOverUnderORF_flg "" VALUE 0x7002209b Scalar_BOOLEAN 0 VBU0428Test_CM_boolean_flg 0.0 1.0 /end CHARACTERISTIC
/begin CHARACTERISTIC CbVCT_BMSDCChargingCurrentMeasurementORF_flg "" VALUE 0x7002209c Scalar_BOOLEAN 0 VBU0428Test_CM_boolean_flg 0.0 1.0 /end CHARACTERISTIC
/begin CHARACTERISTIC CbVCT_BMSDCChargingVoltageMeasurementORF_flg "" VALUE 0x7002209d Scalar_BOOLEAN 0 VBU0428Test_CM_boolean_flg 0.0 1.0 /end CHARACTERISTIC
/begin CHARACTERISTIC CbVCT_BMSDCChrgCrntReqORF_flg "" VALUE 0x7002209e Scalar_BOOLEAN 0 VBU0428Test_CM_boolean_flg 0.0 1.0 /end CHARACTERISTIC
/begin CHARACTERISTIC CbVCT_BMSDCChrgFinalSOCORF_flg "" VALUE 0x7002209f Scalar_BOOLEAN 0 VBU0428Test_CM_boolean_flg 0.0 1.0 /end CHARACTERISTIC
/begin CHARACTERISTIC CbVCT_BMSDCChrgVoltageReqORF_flg "" VALUE 0x700220a0 Scalar_BOOLEAN 0 VBU0428Test_CM_boolean_flg 0.0 1.0 /end CHARACTERISTIC
/begin CHARACTERISTIC CbVCT_BMSDischgCurrentLimitORF_flg "" VALUE 0x700220a1 Scalar_BOOLEAN 0 VBU0428Test_CM_boolean_flg 0.0 1.0 /end CHARACTERISTIC
/begin CHARACTERISTIC CbVCT_BMSDischgPowerLimitDynamicORF_flg "" VALUE 0x700220a2 Scalar_BOOLEAN 0 VBU0428Test_CM_boolean_flg 0.0 1.0 /end CHARACTERISTIC
/begin CHARACTERISTIC CbVCT_BMSDischgPowerLimitLTORF_flg "" VALUE 0x700220a3 Scalar_BOOLEAN 0 VBU0428Test_CM_boolean_flg 0.0 1.0 /end CHARACTERISTIC
/begin CHARACTERISTIC CbVCT_BMSDischgPowerLimitSTORF_flg "" VALUE 0x700220a4 Scalar_BOOLEAN 0 VBU0428Test_CM_boolean_flg 0.0 1.0 /end CHARACTERISTIC
/begin CHARACTERISTIC CbVCT_BMSESSInletTempMaskORF_flg "" VALUE 0x700220a5 Scalar_BOOLEAN 0 VBU0428Test_CM_boolean_flg 0.0 1.0 /end CHARACTERISTIC
/begin CHARACTERISTIC CbVCT_BMSESSInletTempMaskORV_flg "" VALUE 0x700220a6 Scalar_BOOLEAN 0 VBU0428Test_CM_boolean_flg 0.0 1.0 /end CHARACTERISTIC
/begin CHARACTERISTIC CbVCT_BMSESSInletTempValidityORF_flg "" VALUE 0x700220a7 Scalar_BOOLEAN 0 VBU0428Test_CM_boolean_flg 0.0 1.0 /end CHARACTERISTIC
/begin CHARACTERISTIC CbVCT_BMSESSInletTempValidityORV_flg "" VALUE 0x700220a8 Scalar_BOOLEAN 0 VBU0428Test_CM_boolean_flg 0.0 1.0 /end CHARACTERISTIC
/begin CHARACTERISTIC CbVCT_BMSESSOutletTempMaskORF_flg "" VALUE 0x700220a9 Scalar_BOOLEAN 0 VBU0428Test_CM_boolean_flg 0.0 1.0 /end CHARACTERISTIC
/begin CHARACTERISTIC CbVCT_BMSESSOutletTempMaskORV_flg "" VALUE 0x700220aa Scalar_BOOLEAN 0 VBU0428Test_CM_boolean_flg 0.0 1.0 /end CHARACTERISTIC
/begin CHARACTERISTIC CbVCT_BMSESSOutletTempValidityORF_flg "" VALUE 0x700220ab Scalar_BOOLEAN 0 VBU0428Test_CM_boolean_flg 0.0 1.0 /end CHARACTERISTIC
/begin CHARACTERISTIC CbVCT_BMSESSOutletTempValidityORV_flg "" VALUE 0x700220ac Scalar_BOOLEAN 0 VBU0428Test_CM_boolean_flg 0.0 1.0 /end CHARACTERISTIC
/begin CHARACTERISTIC CbVCT_BMSEstimateChargingTimeORF_flg "" VALUE 0x700220ad Scalar_BOOLEAN 0 VBU0428Test_CM_boolean_flg 0.0 1.0 /end CHARACTERISTIC
/begin CHARACTERISTIC CbVCT_BMSFaultCatORF_flg "" VALUE 0x700220ae Scalar_BOOLEAN 0 VBU0428Test_CM_boolean_flg 0.0 1.0 /end CHARACTERISTIC
/begin CHARACTERISTIC CbVCT_BMSFaultLvlORF_flg "" VALUE 0x700220af Scalar_BOOLEAN 0 VBU0428Test_CM_boolean_flg 0.0 1.0 /end CHARACTERISTIC
/begin CHARACTERISTIC CbVCT_BMSHVShutdownReqORF_flg "" VALUE 0x700220b0 Scalar_BOOLEAN 0 VBU0428Test_CM_boolean_flg 0.0 1.0 /end CHARACTERISTIC
/begin CHARACTERISTIC CbVCT_BMSHVShutdownReqORV_flg "" VALUE 0x700220b1 Scalar_BOOLEAN 0 VBU0428Test_CM_boolean_flg 0.0 1.0 /end CHARACTERISTIC
/begin CHARACTERISTIC CbVCT_BMSHvConectorErrorORF_flg "" VALUE 0x700220b2 Scalar_BOOLEAN 0 VBU0428Test_CM_boolean_flg 0.0 1.0 /end CHARACTERISTIC
/begin CHARACTERISTIC CbVCT_BMSHvIsolationORF_flg "" VALUE 0x700220b3 Scalar_BOOLEAN 0 VBU0428Test_CM_boolean_flg 0.0 1.0 /end CHARACTERISTIC
/begin CHARACTERISTIC CbVCT_BMSIfBmsSocSetORF_flg "" VALUE 0x700220b4 Scalar_BOOLEAN 0 VBU0428Test_CM_boolean_flg 0.0 1.0 /end CHARACTERISTIC
/begin CHARACTERISTIC CbVCT_BMSIfCellVoltageSetORF_flg "" VALUE 0x700220b5 Scalar_BOOLEAN 0 VBU0428Test_CM_boolean_flg 0.0 1.0 /end CHARACTERISTIC
/begin CHARACTERISTIC CbVCT_BMSIfPackVoltageSetORF_flg "" VALUE 0x700220b6 Scalar_BOOLEAN 0 VBU0428Test_CM_boolean_flg 0.0 1.0 /end CHARACTERISTIC
/begin CHARACTERISTIC CbVCT_BMSInletTempRequestORF_flg "" VALUE 0x700220b7 Scalar_BOOLEAN 0 VBU0428Test_CM_boolean_flg 0.0 1.0 /end CHARACTERISTIC
/begin CHARACTERISTIC CbVCT_BMSInletWaterTempORF_flg "" VALUE 0x700220b8 Scalar_BOOLEAN 0 VBU0428Test_CM_boolean_flg 0.0 1.0 /end CHARACTERISTIC
/begin CHARACTERISTIC CbVCT_BMSInsulationResistanceValueORF_flg "" VALUE 0x700220b9 Scalar_BOOLEAN 0 VBU0428Test_CM_boolean_flg 0.0 1.0 /end CHARACTERISTIC
/begin CHARACTERISTIC CbVCT_BMSInterlockStatusORF_flg "" VALUE 0x700220ba Scalar_BOOLEAN 0 VBU0428Test_CM_boolean_flg 0.0 1.0 /end CHARACTERISTIC
/begin CHARACTERISTIC CbVCT_BMSIsolationLevelORF_flg "" VALUE 0x700220bb Scalar_BOOLEAN 0 VBU0428Test_CM_boolean_flg 0.0 1.0 /end CHARACTERISTIC
/begin CHARACTERISTIC CbVCT_BMSMaxPermitDCChargeVoltageORF_flg "" VALUE 0x700220bc Scalar_BOOLEAN 0 VBU0428Test_CM_boolean_flg 0.0 1.0 /end CHARACTERISTIC
/begin CHARACTERISTIC CbVCT_BMSMaxTempSubSysNumberORF_flg "" VALUE 0x700220bd Scalar_BOOLEAN 0 VBU0428Test_CM_boolean_flg 0.0 1.0 /end CHARACTERISTIC
/begin CHARACTERISTIC CbVCT_BMSMaxVoltageSubSysNumberORF_flg "" VALUE 0x700220be Scalar_BOOLEAN 0 VBU0428Test_CM_boolean_flg 0.0 1.0 /end CHARACTERISTIC
/begin CHARACTERISTIC CbVCT_BMSMaximumCellTempORF_flg "" VALUE 0x700220bf Scalar_BOOLEAN 0 VBU0428Test_CM_boolean_flg 0.0 1.0 /end CHARACTERISTIC
/begin CHARACTERISTIC CbVCT_BMSMaximumCellVoltageNumberORF_flg "" VALUE 0x700220c0 Scalar_BOOLEAN 0 VBU0428Test_CM_boolean_flg 0.0 1.0 /end CHARACTERISTIC
/begin CHARACTERISTIC CbVCT_BMSMaximumTempNumberORF_flg "" VALUE 0x700220c1 Scalar_BOOLEAN 0 VBU0428Test_CM_boolean_flg 0.0 1.0 /end CHARACTERISTIC
/begin CHARACTERISTIC CbVCT_BMSMinTempSubSysNumberORF_flg "" VALUE 0x700220c2 Scalar_BOOLEAN 0 VBU0428Test_CM_boolean_flg 0.0 1.0 /end CHARACTERISTIC
/begin CHARACTERISTIC CbVCT_BMSMinVoltageSubSysNumberORF_flg "" VALUE 0x700220c3 Scalar_BOOLEAN 0 VBU0428Test_CM_boolean_flg 0.0 1.0 /end CHARACTERISTIC
/begin CHARACTERISTIC CbVCT_BMSMinimumCellTempORF_flg "" VALUE 0x700220c4 Scalar_BOOLEAN 0 VBU0428Test_CM_boolean_flg 0.0 1.0 /end CHARACTERISTIC
/begin CHARACTERISTIC CbVCT_BMSMinimumCellVoltageNumberORF_flg "" VALUE 0x700220c5 Scalar_BOOLEAN 0 VBU0428Test_CM_boolean_flg 0.0 1.0 /end CHARACTERISTIC
/begin CHARACTERISTIC CbVCT_BMSMinimumTempNumberORF_flg "" VALUE 0x700220c6 Scalar_BOOLEAN 0 VBU0428Test_CM_boolean_flg 0.0 1.0 /end CHARACTERISTIC
/begin CHARACTERISTIC CbVCT_BMSOtherErrorORF_flg "" VALUE 0x700220c7 Scalar_BOOLEAN 0 VBU0428Test_CM_boolean_flg 0.0 1.0 /end CHARACTERISTIC
/begin CHARACTERISTIC CbVCT_BMSOutletWaterTempORF_flg "" VALUE 0x700220c8 Scalar_BOOLEAN 0 VBU0428Test_CM_boolean_flg 0.0 1.0 /end CHARACTERISTIC
/begin CHARACTERISTIC CbVCT_BMSOverCurrentORF_flg "" VALUE 0x700220c9 Scalar_BOOLEAN 0 VBU0428Test_CM_boolean_flg 0.0 1.0 /end CHARACTERISTIC
/begin CHARACTERISTIC CbVCT_BMSPackCrntORF_flg "" VALUE 0x700220ca Scalar_BOOLEAN 0 VBU0428Test_CM_boolean_flg 0.0 1.0 /end CHARACTERISTIC
/begin CHARACTERISTIC CbVCT_BMSPackEnergyAvailableORF_flg "" VALUE 0x700220cb Scalar_BOOLEAN 0 VBU0428Test_CM_boolean_flg 0.0 1.0 /end CHARACTERISTIC
/begin CHARACTERISTIC CbVCT_BMSPackOverTempORF_flg "" VALUE 0x700220cc Scalar_BOOLEAN 0 VBU0428Test_CM_boolean_flg 0.0 1.0 /end CHARACTERISTIC
/begin CHARACTERISTIC CbVCT_BMSPackVoltageORF_flg "" VALUE 0x700220cd Scalar_BOOLEAN 0 VBU0428Test_CM_boolean_flg 0.0 1.0 /end CHARACTERISTIC
/begin CHARACTERISTIC CbVCT_BMSProtocalVersionORF_flg "" VALUE 0x700220ce Scalar_BOOLEAN 0 VBU0428Test_CM_boolean_flg 0.0 1.0 /end CHARACTERISTIC
/begin CHARACTERISTIC CbVCT_BMSReadyDCChargingORF_flg "" VALUE 0x700220cf Scalar_BOOLEAN 0 VBU0428Test_CM_boolean_flg 0.0 1.0 /end CHARACTERISTIC
/begin CHARACTERISTIC CbVCT_BMSRollingCounter225ORF_flg "" VALUE 0x700220d0 Scalar_BOOLEAN 0 VBU0428Test_CM_boolean_flg 0.0 1.0 /end CHARACTERISTIC
/begin CHARACTERISTIC CbVCT_BMSSOCORF_flg "" VALUE 0x700220d1 Scalar_BOOLEAN 0 VBU0428Test_CM_boolean_flg 0.0 1.0 /end CHARACTERISTIC
/begin CHARACTERISTIC CbVCT_BMSSOCOverUnderORF_flg "" VALUE 0x700220d2 Scalar_BOOLEAN 0 VBU0428Test_CM_boolean_flg 0.0 1.0 /end CHARACTERISTIC
/begin CHARACTERISTIC CbVCT_BMSStsORF_flg "" VALUE 0x700220d3 Scalar_BOOLEAN 0 VBU0428Test_CM_boolean_flg 0.0 1.0 /end CHARACTERISTIC
/begin CHARACTERISTIC CbVCT_BMSTempAverageValidityORF_flg "" VALUE 0x700220d4 Scalar_BOOLEAN 0 VBU0428Test_CM_boolean_flg 0.0 1.0 /end CHARACTERISTIC
/begin CHARACTERISTIC CbVCT_BMSTempAverageValidityORV_flg "" VALUE 0x700220d5 Scalar_BOOLEAN 0 VBU0428Test_CM_boolean_flg 0.0 1.0 /end CHARACTERISTIC
/begin CHARACTERISTIC CbVCT_BMSTempMaxValidityORF_flg "" VALUE 0x700220d6 Scalar_BOOLEAN 0 VBU0428Test_CM_boolean_flg 0.0 1.0 /end CHARACTERISTIC
/begin CHARACTERISTIC CbVCT_BMSTempMaxValidityORV_flg "" VALUE 0x700220d7 Scalar_BOOLEAN 0 VBU0428Test_CM_boolean_flg 0.0 1.0 /end CHARACTERISTIC
/begin CHARACTERISTIC CbVCT_BMSTempMinValidityORF_flg "" VALUE 0x700220d8 Scalar_BOOLEAN 0 VBU0428Test_CM_boolean_flg 0.0 1.0 /end CHARACTERISTIC
/begin CHARACTERISTIC CbVCT_BMSTempMinValidityORV_flg "" VALUE 0x700220d9 Scalar_BOOLEAN 0 VBU0428Test_CM_boolean_flg 0.0 1.0 /end CHARACTERISTIC
/begin CHARACTERISTIC CbVCT_BMSTempRequestValidORF_flg "" VALUE 0x700220da Scalar_BOOLEAN 0 VBU0428Test_CM_boolean_flg 0.0 1.0 /end CHARACTERISTIC
/begin CHARACTERISTIC CbVCT_BMSTempRequestValidORV_flg "" VALUE 0x700220db Scalar_BOOLEAN 0 VBU0428Test_CM_boolean_flg 0.0 1.0 /end CHARACTERISTIC
/begin CHARACTERISTIC CbVCT_BMSTemperatureAverageORF_flg "" VALUE 0x700220dc Scalar_BOOLEAN 0 VBU0428Test_CM_boolean_flg 0.0 1.0 /end CHARACTERISTIC
/begin CHARACTERISTIC CbVCT_BMSTemperatureMaxORF_flg "" VALUE 0x700220dd Scalar_BOOLEAN 0 VBU0428Test_CM_boolean_flg 0.0 1.0 /end CHARACTERISTIC
/begin CHARACTERISTIC CbVCT_BMSVolMismatchORF_flg "" VALUE 0x700220de Scalar_BOOLEAN 0 VBU0428Test_CM_boolean_flg 0.0 1.0 /end CHARACTERISTIC
/begin CHARACTERISTIC CbVCT_BMSVoltageLimitMaxORF_flg "" VALUE 0x700220df Scalar_BOOLEAN 0 VBU0428Test_CM_boolean_flg 0.0 1.0 /end CHARACTERISTIC
/begin CHARACTERISTIC CbVCT_BMSVoltageLimitMinORF_flg "" VALUE 0x700220e0 Scalar_BOOLEAN 0 VBU0428Test_CM_boolean_flg 0.0 1.0 /end CHARACTERISTIC
/begin CHARACTERISTIC CbVCT_BatteryAbnormalAlarm1ORF_flg "" VALUE 0x700220e1 Scalar_BOOLEAN 0 VBU0428Test_CM_boolean_flg 0.0 1.0 /end CHARACTERISTIC
/begin CHARACTERISTIC CbVCT_BatteryAbnormalAlarm1ORV_flg "" VALUE 0x700220e2 Scalar_BOOLEAN 0 VBU0428Test_CM_boolean_flg 0.0 1.0 /end CHARACTERISTIC
/begin CHARACTERISTIC CbVCT_BatteryAbnormalAlarm2ORF_flg "" VALUE 0x700220e3 Scalar_BOOLEAN 0 VBU0428Test_CM_boolean_flg 0.0 1.0 /end CHARACTERISTIC
/begin CHARACTERISTIC CbVCT_BatteryAbnormalAlarm2ORV_flg "" VALUE 0x700220e4 Scalar_BOOLEAN 0 VBU0428Test_CM_boolean_flg 0.0 1.0 /end CHARACTERISTIC
/begin CHARACTERISTIC CbVCT_BatteryAbnormalAlarm3ORF_flg "" VALUE 0x700220e5 Scalar_BOOLEAN 0 VBU0428Test_CM_boolean_flg 0.0 1.0 /end CHARACTERISTIC
/begin CHARACTERISTIC CbVCT_BatteryAbnormalAlarm3ORV_flg "" VALUE 0x700220e6 Scalar_BOOLEAN 0 VBU0428Test_CM_boolean_flg 0.0 1.0 /end CHARACTERISTIC
/begin CHARACTERISTIC CbVCT_BatteryConsistencyAlarmORF_flg "" VALUE 0x700220e7 Scalar_BOOLEAN 0 VBU0428Test_CM_boolean_flg 0.0 1.0 /end CHARACTERISTIC
/begin CHARACTERISTIC CbVCT_BatteryNomalCapacityORF_flg "" VALUE 0x700220e8 Scalar_BOOLEAN 0 VBU0428Test_CM_boolean_flg 0.0 1.0 /end CHARACTERISTIC
/begin CHARACTERISTIC CbVCT_BatteryOutputConnectorStateORF_flg "" VALUE 0x700220e9 Scalar_BOOLEAN 0 VBU0428Test_CM_boolean_flg 0.0 1.0 /end CHARACTERISTIC
/begin CHARACTERISTIC CbVCT_BatteryTempDifferAlarmORF_flg "" VALUE 0x700220ea Scalar_BOOLEAN 0 VBU0428Test_CM_boolean_flg 0.0 1.0 /end CHARACTERISTIC
/begin CHARACTERISTIC CbVCT_BatteryTempOverORF_flg "" VALUE 0x700220eb Scalar_BOOLEAN 0 VBU0428Test_CM_boolean_flg 0.0 1.0 /end CHARACTERISTIC
/begin CHARACTERISTIC CbVCT_BatteryTypeDismatchAlarmORF_flg "" VALUE 0x700220ec Scalar_BOOLEAN 0 VBU0428Test_CM_boolean_flg 0.0 1.0 /end CHARACTERISTIC
/begin CHARACTERISTIC CbVCT_BetteryCellTempHighAlarmORF_flg "" VALUE 0x700220ed Scalar_BOOLEAN 0 VBU0428Test_CM_boolean_flg 0.0 1.0 /end CHARACTERISTIC
/begin CHARACTERISTIC CbVCT_BetteryCellTempLowAlarmORF_flg "" VALUE 0x700220ee Scalar_BOOLEAN 0 VBU0428Test_CM_boolean_flg 0.0 1.0 /end CHARACTERISTIC
/begin CHARACTERISTIC CbVCT_BetteryCellVolHighAlarmORF_flg "" VALUE 0x700220ef Scalar_BOOLEAN 0 VBU0428Test_CM_boolean_flg 0.0 1.0 /end CHARACTERISTIC
/begin CHARACTERISTIC CbVCT_BetteryCellVolLowAlarmORF_flg "" VALUE 0x700220f0 Scalar_BOOLEAN 0 VBU0428Test_CM_boolean_flg 0.0 1.0 /end CHARACTERISTIC
/begin CHARACTERISTIC CbVCT_BetteryPckVoltOverAlarmORF_flg "" VALUE 0x700220f1 Scalar_BOOLEAN 0 VBU0428Test_CM_boolean_flg 0.0 1.0 /end CHARACTERISTIC
/begin CHARACTERISTIC CbVCT_BetteryPckVoltUnderAlarmORF_flg "" VALUE 0x700220f2 Scalar_BOOLEAN 0 VBU0428Test_CM_boolean_flg 0.0 1.0 /end CHARACTERISTIC
/begin CHARACTERISTIC CbVCT_CTDMnNegContactorWeldORF_flg "" VALUE 0x700220f3 Scalar_BOOLEAN 0 VBU0428Test_CM_boolean_flg 0.0 1.0 /end CHARACTERISTIC
/begin CHARACTERISTIC CbVCT_CTDMnPosContactorWeldORF_flg "" VALUE 0x700220f4 Scalar_BOOLEAN 0 VBU0428Test_CM_boolean_flg 0.0 1.0 /end CHARACTERISTIC
/begin CHARACTERISTIC CbVCT_CTDPrechargeEnergyHighORF_flg "" VALUE 0x700220f5 Scalar_BOOLEAN 0 VBU0428Test_CM_boolean_flg 0.0 1.0 /end CHARACTERISTIC
/begin CHARACTERISTIC CbVCT_CTDPrechargeRelayBlownORF_flg "" VALUE 0x700220f6 Scalar_BOOLEAN 0 VBU0428Test_CM_boolean_flg 0.0 1.0 /end CHARACTERISTIC
/begin CHARACTERISTIC CbVCT_CTDPrechargeRelayStuckOpenORF_flg "" VALUE 0x700220f7 Scalar_BOOLEAN 0 VBU0428Test_CM_boolean_flg 0.0 1.0 /end CHARACTERISTIC
/begin CHARACTERISTIC CbVCT_CTDPrechargeTimeoutORF_flg "" VALUE 0x700220f8 Scalar_BOOLEAN 0 VBU0428Test_CM_boolean_flg 0.0 1.0 /end CHARACTERISTIC
/begin CHARACTERISTIC CbVCT_CTMCellThermalRunawayORF_flg "" VALUE 0x700220f9 Scalar_BOOLEAN 0 VBU0428Test_CM_boolean_flg 0.0 1.0 /end CHARACTERISTIC
/begin CHARACTERISTIC CbVCT_CTMCellThermalRunawayValidORF_flg "" VALUE 0x700220fa Scalar_BOOLEAN 0 VBU0428Test_CM_boolean_flg 0.0 1.0 /end CHARACTERISTIC
/begin CHARACTERISTIC CbVCT_CTMCellThermalRunawayValidORV_flg "" VALUE 0x700220fb Scalar_BOOLEAN 0 VBU0428Test_CM_boolean_flg 0.0 1.0 /end CHARACTERISTIC
/begin CHARACTERISTIC CbVCT_ChargeAvailableORF_flg "" VALUE 0x700220fc Scalar_BOOLEAN 0 VBU0428Test_CM_boolean_flg 0.0 1.0 /end CHARACTERISTIC
/begin CHARACTERISTIC CbVCT_ChargeAvailableORV_flg "" VALUE 0x700220fd Scalar_BOOLEAN 0 VBU0428Test_CM_boolean_flg 0.0 1.0 /end CHARACTERISTIC
/begin CHARACTERISTIC CbVCT_ChargeCurrentDerateORF_flg "" VALUE 0x700220fe Scalar_BOOLEAN 0 VBU0428Test_CM_boolean_flg 0.0 1.0 /end CHARACTERISTIC
/begin CHARACTERISTIC CbVCT_ChargeCurrentDerateORV_flg "" VALUE 0x700220ff Scalar_BOOLEAN 0 VBU0428Test_CM_boolean_flg 0.0 1.0 /end CHARACTERISTIC
/begin CHARACTERISTIC CbVCT_DCChargeModeORF_flg "" VALUE 0x70022100 Scalar_BOOLEAN 0 VBU0428Test_CM_boolean_flg 0.0 1.0 /end CHARACTERISTIC
/begin CHARACTERISTIC CbVCT_DCChargingPermitStatusORF_flg "" VALUE 0x70022101 Scalar_BOOLEAN 0 VBU0428Test_CM_boolean_flg 0.0 1.0 /end CHARACTERISTIC
/begin CHARACTERISTIC CbVCT_EstimatePercTimeORF_flg "" VALUE 0x70022102 Scalar_BOOLEAN 0 VBU0428Test_CM_boolean_flg 0.0 1.0 /end CHARACTERISTIC
/begin CHARACTERISTIC CbVCT_HVBattSOCLowCritORF_flg "" VALUE 0x70022103 Scalar_BOOLEAN 0 VBU0428Test_CM_boolean_flg 0.0 1.0 /end CHARACTERISTIC
/begin CHARACTERISTIC CbVCT_HVBattSOCLowCritORV_flg "" VALUE 0x70022104 Scalar_BOOLEAN 0 VBU0428Test_CM_boolean_flg 0.0 1.0 /end CHARACTERISTIC
/begin CHARACTERISTIC CbVCT_HVBattSOCLowWarnORF_flg "" VALUE 0x70022105 Scalar_BOOLEAN 0 VBU0428Test_CM_boolean_flg 0.0 1.0 /end CHARACTERISTIC
/begin CHARACTERISTIC CbVCT_HVBattSOCLowWarnORV_flg "" VALUE 0x70022106 Scalar_BOOLEAN 0 VBU0428Test_CM_boolean_flg 0.0 1.0 /end CHARACTERISTIC
/begin CHARACTERISTIC CbVCT_HVBattStopDchaThdORF_flg "" VALUE 0x70022107 Scalar_BOOLEAN 0 VBU0428Test_CM_boolean_flg 0.0 1.0 /end CHARACTERISTIC
/begin CHARACTERISTIC CbVCT_InhibitPrechargeCauseORF_flg "" VALUE 0x70022108 Scalar_BOOLEAN 0 VBU0428Test_CM_boolean_flg 0.0 1.0 /end CHARACTERISTIC
/begin CHARACTERISTIC CbVCT_MaximumChargingCurrentORF_flg "" VALUE 0x70022109 Scalar_BOOLEAN 0 VBU0428Test_CM_boolean_flg 0.0 1.0 /end CHARACTERISTIC
/begin CHARACTERISTIC CbVCT_MaximumChargingVoltageORF_flg "" VALUE 0x7002210a Scalar_BOOLEAN 0 VBU0428Test_CM_boolean_flg 0.0 1.0 /end CHARACTERISTIC
/begin CHARACTERISTIC CbVCT_MaximumPermitChargeCellVoltageORF_flg "" VALUE 0x7002210b Scalar_BOOLEAN 0 VBU0428Test_CM_boolean_flg 0.0 1.0 /end CHARACTERISTIC
/begin CHARACTERISTIC CbVCT_MaximumPermitTempORF_flg "" VALUE 0x7002210c Scalar_BOOLEAN 0 VBU0428Test_CM_boolean_flg 0.0 1.0 /end CHARACTERISTIC
/begin CHARACTERISTIC CbVCT_SOCJumpAlarmORF_flg "" VALUE 0x7002210d Scalar_BOOLEAN 0 VBU0428Test_CM_boolean_flg 0.0 1.0 /end CHARACTERISTIC
/begin CHARACTERISTIC CbVCT_SOCJumpReasonORF_flg "" VALUE 0x7002210e Scalar_BOOLEAN 0 VBU0428Test_CM_boolean_flg 0.0 1.0 /end CHARACTERISTIC
/begin CHARACTERISTIC CcTHM_PackSohORF_flg "" VALUE 0x700221b0 Scalar_BOOLEAN 0 VBU0428Test_CM_boolean_cnt 0.0 1.0 /end CHARACTERISTIC
/begin CHARACTERISTIC CcCTD_MnPosContactorWeldFaultFIC_n "" VALUE 0x7002213e Scalar_BYTE 0 VBU0428Test_CM_int8_cnt -128.0 127.0 /end CHARACTERISTIC
/begin CHARACTERISTIC CcCTD_MnPosContactorWeldFaultPIC_n "" VALUE 0x7002213f Scalar_BYTE 0 VBU0428Test_CM_int8_cnt -128.0 127.0 /end CHARACTERISTIC
/begin CHARACTERISTIC CcCTD_PrechargeRelayStuckOpenFaultFIC_n "" VALUE 0x70022142 Scalar_BYTE 0 VBU0428Test_CM_int8_cnt -128.0 127.0 /end CHARACTERISTIC
/begin CHARACTERISTIC CcCTD_PrechargeRelayStuckOpenFaultPIC_n "" VALUE 0x70022143 Scalar_BYTE 0 VBU0428Test_CM_int8_cnt -128.0 127.0 /end CHARACTERISTIC
/begin CHARACTERISTIC CcCTD_PrechargeTimeoutFaultFIC_n "" VALUE 0x70022146 Scalar_BYTE 0 VBU0428Test_CM_int8_cnt -128.0 127.0 /end CHARACTERISTIC
/begin CHARACTERISTIC CcCTD_PrechargeTimeoutFaultPIC_n "" VALUE 0x70022147 Scalar_BYTE 0 VBU0428Test_CM_int8_cnt -128.0 127.0 /end CHARACTERISTIC
/begin CHARACTERISTIC CcCTM_CellThermalRunawayFaultFIC_n "" VALUE 0x7002215a Scalar_BYTE 0 VBU0428Test_CM_int8_cnt -128.0 127.0 /end CHARACTERISTIC
/begin CHARACTERISTIC CcCTM_CellThermalRunawayFaultPIC_n "" VALUE 0x7002215b Scalar_BYTE 0 VBU0428Test_CM_int8_cnt -128.0 127.0 /end CHARACTERISTIC
/begin CHARACTERISTIC CcCTM_ThermalRunawayFaultFIC_n "" VALUE 0x7002215e Scalar_BYTE 0 VBU0428Test_CM_int8_cnt -128.0 127.0 /end CHARACTERISTIC
/begin CHARACTERISTIC CcCTM_ThermalRunawayFaultPIC_n "" VALUE 0x7002215f Scalar_BYTE 0 VBU0428Test_CM_int8_cnt -128.0 127.0 /end CHARACTERISTIC
/begin CHARACTERISTIC CcCVT_BdmCellOverVoltageFaultFIC_n "" VALUE 0x70022168 Scalar_BYTE 0 VBU0428Test_CM_int8_n -128.0 127.0 /end CHARACTERISTIC
/begin CHARACTERISTIC CcCVT_BdmCellOverVoltageFaultPIC_n "" VALUE 0x70022169 Scalar_BYTE 0 VBU0428Test_CM_int8_n -128.0 127.0 /end CHARACTERISTIC
/begin CHARACTERISTIC CcCVT_BdmCellUnderVoltageFaultFIC_n "" VALUE 0x7002216a Scalar_BYTE 0 VBU0428Test_CM_int8_n -128.0 127.0 /end CHARACTERISTIC
/begin CHARACTERISTIC CcCVT_BdmCellUnderVoltageFaultPIC_n "" VALUE 0x7002216b Scalar_BYTE 0 VBU0428Test_CM_int8_n -128.0 127.0 /end CHARACTERISTIC
/begin CHARACTERISTIC CcCVT_BdmCellVoltageOverDeviationFaultFIC_n "" VALUE 0x7002216c Scalar_BYTE 0 VBU0428Test_CM_int8_n -128.0 127.0 /end CHARACTERISTIC
/begin CHARACTERISTIC CcCVT_BdmCellVoltageOverDeviationFaultPIC_n "" VALUE 0x7002216d Scalar_BYTE 0 VBU0428Test_CM_int8_n -128.0 127.0 /end CHARACTERISTIC
/begin CHARACTERISTIC CcFDC_MaxCount_n "" VALUE 0x7002217f Scalar_BYTE 0 VBU0428Test_CM_int8_cnt -128.0 127.0 /end CHARACTERISTIC
/begin CHARACTERISTIC CcFDC_MinCount_n "" VALUE 0x70022180 Scalar_BYTE 0 VBU0428Test_CM_int8_cnt -128.0 127.0 /end CHARACTERISTIC
/begin CHARACTERISTIC CcSOH_CellCapacityLowFaultFIC_n "" VALUE 0x7002219b Scalar_BYTE 0 VBU0428Test_CM_int8_cnt -128.0 127.0 /end CHARACTERISTIC
/begin CHARACTERISTIC CcSOH_CellCapacityLowFaultPIC_n "" VALUE 0x7002219c Scalar_BYTE 0 VBU0428Test_CM_int8_cnt -128.0 127.0 /end CHARACTERISTIC
/begin CHARACTERISTIC CcSOH_CellCapacityOverDeviationFaultFIC_n "" VALUE 0x7002219d Scalar_BYTE 0 VBU0428Test_CM_int8_cnt -128.0 127.0 /end CHARACTERISTIC
/begin CHARACTERISTIC CcSOH_CellCapacityOverDeviationFaultPIC_n "" VALUE 0x7002219e Scalar_BYTE 0 VBU0428Test_CM_int8_cnt -128.0 127.0 /end CHARACTERISTIC
/begin CHARACTERISTIC CcSOH_CellResistanceHighFaultFIC_n "" VALUE 0x7002219f Scalar_BYTE 0 VBU0428Test_CM_int8_cnt -128.0 127.0 /end CHARACTERISTIC
/begin CHARACTERISTIC CcSOH_CellResistanceHighFaultPIC_n "" VALUE 0x700221a0 Scalar_BYTE 0 VBU0428Test_CM_int8_cnt -128.0 127.0 /end CHARACTERISTIC
/begin CHARACTERISTIC BMM_STATE_POWER_SWAP "" VALUE 0x70021f7e Scalar_UBYTE 0 VBU0428Test_CM_uint8_cnt 0.0 255.0 /end CHARACTERISTIC
/begin CHARACTERISTIC CTD_PRECHARGE_STATUS_CHARGING "" VALUE 0x70021fd7 Scalar_UBYTE 0 VBU0428Test_CM_uint8_cnt 0.0 255.0 /end CHARACTERISTIC
/begin CHARACTERISTIC CaFCC_CurrentLimitRemainChargeTimeSocTempMapDimension_n "" VAL_BLK 0x70022486 Scalar_UBYTE 0 VBU0428Test_CM_uint8_cnt 0.0 255.0 NUMBER 2 /end CHARACTERISTIC
/begin CHARACTERISTIC CaFCC_IdealRemainChargeTimeSocTempMapDimension_n "" VAL_BLK 0x70022490 Scalar_UBYTE 0 VBU0428Test_CM_uint8_cnt 0.0 255.0 NUMBER 2 /end CHARACTERISTIC
/begin CHARACTERISTIC CaOCV_QuasiOCVCurrentDimension_n "" VAL_BLK 0x70022494 Scalar_UBYTE 0 VBU0428Test_CM_uint8_cnt 0.0 255.0 NUMBER 2 /end CHARACTERISTIC
/begin CHARACTERISTIC CaSOE_InvalidHistoryCurrentData_A "" VALUE 0x70021ff4 Scalar_UBYTE 0 VBU0428Test_CM_uint8_cnt 0.0 255.0 /end CHARACTERISTIC
/begin CHARACTERISTIC CbCTM_CellThermalRunawayEnable_flg "" VALUE 0x70022037 Scalar_UBYTE 0 VBU0428Test_CM_uint8_cnt 0.0 255.0 /end CHARACTERISTIC
/begin CHARACTERISTIC CbCTM_ThermalRunawayTestFailORF_flg "" VALUE 0x70022039 Scalar_UBYTE 0 VBU0428Test_CM_uint8_cnt 0.0 255.0 /end CHARACTERISTIC
/begin CHARACTERISTIC CbCTM_ThermalRunawayTestFailORV_flg "" VALUE 0x7002203a Scalar_UBYTE 0 VBU0428Test_CM_uint8_cnt 0.0 255.0 /end CHARACTERISTIC
/begin CHARACTERISTIC CbCTS_CellDataInvalidSerialCheckEnable_flg "" VALUE 0x7002203b Scalar_UBYTE 0 VBU0428Test_CM_uint8_cnt 0.0 255.0 /end CHARACTERISTIC
/begin CHARACTERISTIC CbCTS_ContactorComandBypassBMUModeEnable_flg "" VALUE 0x7002203c Scalar_UBYTE 0 VBU0428Test_CM_uint8_cnt 0.0 255.0 /end CHARACTERISTIC
/begin CHARACTERISTIC CbCTS_EnergyProtectEnable_flg "" VALUE 0x7002203d Scalar_UBYTE 0 VBU0428Test_CM_uint8_cnt 0.0 255.0 /end CHARACTERISTIC
/begin CHARACTERISTIC CbCTS_SocInitialInhibitEnable_flg "" VALUE 0x7002203f Scalar_UBYTE 0 VBU0428Test_CM_uint8_cnt 0.0 255.0 /end CHARACTERISTIC
/begin CHARACTERISTIC CcCTD_MnCntcStuckOpenVhclSpdThreshold_kmh "" VALUE 0x70022137 Scalar_UBYTE 0 VBU0428Test_CM_uint8_cnt 0.0 255.0 /end CHARACTERISTIC
/begin CHARACTERISTIC CcCTS_BatteryDisplaySocLimit_pct "" VALUE 0x70022160 Scalar_UBYTE 0 VBU0428Test_CM_uint8_cnt 0.0 255.0 /end CHARACTERISTIC
/begin CHARACTERISTIC CcCTS_SocMinLimit_pct "" VALUE 0x70022167 Scalar_UBYTE 0 VBU0428Test_CM_uint8_cnt 0.0 255.0 /end CHARACTERISTIC
/begin CHARACTERISTIC CcSOE_HistoryCurrentDataDimension_n "" VALUE 0x70022191 Scalar_UBYTE 0 VBU0428Test_CM_uint8_cnt 0.0 255.0 /end CHARACTERISTIC
/begin CHARACTERISTIC CcSOH_ComputeResistanceUpdateCycle_n "" VALUE 0x700221a1 Scalar_UBYTE 0 VBU0428Test_CM_uint8_cnt 0.0 255.0 /end CHARACTERISTIC
/begin CHARACTERISTIC CcSYS_NoOfInvalidCellVoltages_n "" VALUE 0x700221a3 Scalar_UBYTE 0 VBU0428Test_CM_uint8_cnt 0.0 255.0 /end CHARACTERISTIC
/begin CHARACTERISTIC CcVCT_BMSMaxTempSubSysNumberORV_n "" VALUE 0x700221b2 Scalar_UBYTE 0 VBU0428Test_CM_uint8_n 0.0 255.0 /end CHARACTERISTIC
/begin CHARACTERISTIC CcVCT_BMSMaxVoltageSubSysNumberORV_n "" VALUE 0x700221b3 Scalar_UBYTE 0 VBU0428Test_CM_uint8_n 0.0 255.0 /end CHARACTERISTIC
/begin CHARACTERISTIC CcVCT_BMSMaximumCellVoltageNumberORV_n "" VALUE 0x700221b4 Scalar_UBYTE 0 VBU0428Test_CM_uint8_n 0.0 255.0 /end CHARACTERISTIC
/begin CHARACTERISTIC CcVCT_BMSMaximumTempNumberORV_n "" VALUE 0x700221b5 Scalar_UBYTE 0 VBU0428Test_CM_uint8_n 0.0 255.0 /end CHARACTERISTIC
/begin CHARACTERISTIC CcVCT_BMSMinTempSubSysNumberORV_n "" VALUE 0x700221b6 Scalar_UBYTE 0 VBU0428Test_CM_uint8_n 0.0 255.0 /end CHARACTERISTIC
/begin CHARACTERISTIC CcVCT_BMSMinVoltageSubSysNumberORV_n "" VALUE 0x700221b7 Scalar_UBYTE 0 VBU0428Test_CM_uint8_n 0.0 255.0 /end CHARACTERISTIC
/begin CHARACTERISTIC CcVCT_BMSMinimumCellVoltageNumberORV_n "" VALUE 0x700221b8 Scalar_UBYTE 0 VBU0428Test_CM_uint8_n 0.0 255.0 /end CHARACTERISTIC
/begin CHARACTERISTIC CcVCT_BMSMinimumTempNumberORV_n "" VALUE 0x700221b9 Scalar_UBYTE 0 VBU0428Test_CM_uint8_n 0.0 255.0 /end CHARACTERISTIC
/begin CHARACTERISTIC CcVCT_BMSReadyDCChargingORV_enum "" VALUE 0x700221ba Scalar_UBYTE 0 VBU0428Test_CM_uint8_enum 0.0 255.0 /end CHARACTERISTIC
/begin CHARACTERISTIC CcVCT_BMSRollingCounter225ORV_n "" VALUE 0x700221bb Scalar_UBYTE 0 VBU0428Test_CM_uint8_n 0.0 255.0 /end CHARACTERISTIC
/begin CHARACTERISTIC CeVCT_AbortPrechargeCauseORV_enum "" VALUE 0x700221bc Scalar_UBYTE 0 VBU0428Test_CM_uint8_enum 0.0 255.0 /end CHARACTERISTIC
/begin CHARACTERISTIC CeVCT_BMSBMSRollingCounterORV_enum "" VALUE 0x700221bd Scalar_UBYTE 0 VBU0428Test_CM_uint8_enum 0.0 255.0 /end CHARACTERISTIC
/begin CHARACTERISTIC CeVCT_BMSBalanceStatusORV_enum "" VALUE 0x700221be Scalar_UBYTE 0 VBU0428Test_CM_uint8_enum 0.0 255.0 /end CHARACTERISTIC
/begin CHARACTERISTIC CeVCT_BMSBatteryTypeORV_enum "" VALUE 0x700221bf Scalar_UBYTE 0 VBU0428Test_CM_uint8_enum 0.0 255.0 /end CHARACTERISTIC
/begin CHARACTERISTIC CeVCT_BMSCellVoltageOverUnderORV_enum "" VALUE 0x700221c1 Scalar_UBYTE 0 VBU0428Test_CM_uint8_enum 0.0 255.0 /end CHARACTERISTIC
/begin CHARACTERISTIC CeVCT_BMSChargeStateORV_enum "" VALUE 0x700221c2 Scalar_UBYTE 0 VBU0428Test_CM_uint8_enum 0.0 255.0 /end CHARACTERISTIC
/begin CHARACTERISTIC CeVCT_BMSChrgConnErrorORV_enum "" VALUE 0x700221c3 Scalar_UBYTE 0 VBU0428Test_CM_uint8_enum 0.0 255.0 /end CHARACTERISTIC
/begin CHARACTERISTIC CeVCT_BMSChrgConnOvertempORV_enum "" VALUE 0x700221c4 Scalar_UBYTE 0 VBU0428Test_CM_uint8_enum 0.0 255.0 /end CHARACTERISTIC
/begin CHARACTERISTIC CeVCT_BMSConnectorOvertempORV_enum "" VALUE 0x700221c5 Scalar_UBYTE 0 VBU0428Test_CM_uint8_enum 0.0 255.0 /end CHARACTERISTIC
/begin CHARACTERISTIC CeVCT_BMSContactorStateORV_enum "" VALUE 0x700221c6 Scalar_UBYTE 0 VBU0428Test_CM_uint8_enum 0.0 255.0 /end CHARACTERISTIC
/begin CHARACTERISTIC CeVCT_BMSDCChargeCurrentOverUnderORV_enum "" VALUE 0x700221c7 Scalar_UBYTE 0 VBU0428Test_CM_uint8_enum 0.0 255.0 /end CHARACTERISTIC
/begin CHARACTERISTIC CeVCT_BMSFaultCatORV_enum "" VALUE 0x700221c8 Scalar_UBYTE 0 VBU0428Test_CM_uint8_enum 0.0 255.0 /end CHARACTERISTIC
/begin CHARACTERISTIC CeVCT_BMSFaultLvlORV_enum "" VALUE 0x700221c9 Scalar_UBYTE 0 VBU0428Test_CM_uint8_enum 0.0 255.0 /end CHARACTERISTIC
/begin CHARACTERISTIC CeVCT_BMSHvConectorErrorORV_enum "" VALUE 0x700221ca Scalar_UBYTE 0 VBU0428Test_CM_uint8_enum 0.0 255.0 /end CHARACTERISTIC
/begin CHARACTERISTIC CeVCT_BMSHvIsolationORV_enum "" VALUE 0x700221cb Scalar_UBYTE 0 VBU0428Test_CM_uint8_enum 0.0 255.0 /end CHARACTERISTIC
/begin CHARACTERISTIC CeVCT_BMSIfBmsSocSetORV_enum "" VALUE 0x700221cc Scalar_UBYTE 0 VBU0428Test_CM_uint8_enum 0.0 255.0 /end CHARACTERISTIC
/begin CHARACTERISTIC CeVCT_BMSIfCellVoltageSetORV_enum "" VALUE 0x700221cd Scalar_UBYTE 0 VBU0428Test_CM_uint8_enum 0.0 255.0 /end CHARACTERISTIC
/begin CHARACTERISTIC CeVCT_BMSIfPackVoltageSetORV_enum "" VALUE 0x700221ce Scalar_UBYTE 0 VBU0428Test_CM_uint8_enum 0.0 255.0 /end CHARACTERISTIC
/begin CHARACTERISTIC CeVCT_BMSInterlockStatusORV_enum "" VALUE 0x700221cf Scalar_UBYTE 0 VBU0428Test_CM_uint8_enum 0.0 255.0 /end CHARACTERISTIC
/begin CHARACTERISTIC CeVCT_BMSIsolationLevelORV_enum "" VALUE 0x700221d0 Scalar_UBYTE 0 VBU0428Test_CM_uint8_enum 0.0 255.0 /end CHARACTERISTIC
/begin CHARACTERISTIC CeVCT_BMSOtherErrorORV_enum "" VALUE 0x700221d1 Scalar_UBYTE 0 VBU0428Test_CM_uint8_enum 0.0 255.0 /end CHARACTERISTIC
/begin CHARACTERISTIC CeVCT_BMSOverCurrentORV_enum "" VALUE 0x700221d2 Scalar_UBYTE 0 VBU0428Test_CM_uint8_enum 0.0 255.0 /end CHARACTERISTIC
/begin CHARACTERISTIC CeVCT_BMSPackOverTempORV_enum "" VALUE 0x700221d3 Scalar_UBYTE 0 VBU0428Test_CM_uint8_enum 0.0 255.0 /end CHARACTERISTIC
/begin CHARACTERISTIC CeVCT_BMSSOCOverUnderORV_enum "" VALUE 0x700221d4 Scalar_UBYTE 0 VBU0428Test_CM_uint8_enum 0.0 255.0 /end CHARACTERISTIC
/begin CHARACTERISTIC CeVCT_BMSStsORV_enum "" VALUE 0x700221d5 Scalar_UBYTE 0 VBU0428Test_CM_uint8_enum 0.0 255.0 /end CHARACTERISTIC
/begin CHARACTERISTIC CeVCT_BMSVolMismatchORV_enum "" VALUE 0x700221d6 Scalar_UBYTE 0 VBU0428Test_CM_uint8_enum 0.0 255.0 /end CHARACTERISTIC
/begin CHARACTERISTIC CeVCT_BatteryConsistencyAlarmORV_enum "" VALUE 0x700221d7 Scalar_UBYTE 0 VBU0428Test_CM_uint8_enum 0.0 255.0 /end CHARACTERISTIC
/begin CHARACTERISTIC CeVCT_BatteryOutputConnectorStateORV_enum "" VALUE 0x700221d8 Scalar_UBYTE 0 VBU0428Test_CM_uint8_enum 0.0 255.0 /end CHARACTERISTIC
/begin CHARACTERISTIC CeVCT_BatteryTempDifferAlarmORV_enum "" VALUE 0x700221d9 Scalar_UBYTE 0 VBU0428Test_CM_uint8_enum 0.0 255.0 /end CHARACTERISTIC
/begin CHARACTERISTIC CeVCT_BatteryTempOverORV_enum "" VALUE 0x700221da Scalar_UBYTE 0 VBU0428Test_CM_uint8_enum 0.0 255.0 /end CHARACTERISTIC
/begin CHARACTERISTIC CeVCT_BatteryTypeDismatchAlarmORV_enum "" VALUE 0x700221db Scalar_UBYTE 0 VBU0428Test_CM_uint8_enum 0.0 255.0 /end CHARACTERISTIC
/begin CHARACTERISTIC CeVCT_BetteryCellTempHighAlarmORV_enum "" VALUE 0x700221dc Scalar_UBYTE 0 VBU0428Test_CM_uint8_enum 0.0 255.0 /end CHARACTERISTIC
/begin CHARACTERISTIC CeVCT_BetteryCellTempLowAlarmORV_enum "" VALUE 0x700221dd Scalar_UBYTE 0 VBU0428Test_CM_uint8_enum 0.0 255.0 /end CHARACTERISTIC
/begin CHARACTERISTIC CeVCT_BetteryCellVolHighAlarmORV_enum "" VALUE 0x700221de Scalar_UBYTE 0 VBU0428Test_CM_uint8_enum 0.0 255.0 /end CHARACTERISTIC
/begin CHARACTERISTIC CeVCT_BetteryCellVolLowAlarmORV_enum "" VALUE 0x700221df Scalar_UBYTE 0 VBU0428Test_CM_uint8_enum 0.0 255.0 /end CHARACTERISTIC
/begin CHARACTERISTIC CeVCT_BetteryPckVoltOverAlarmORV_enum "" VALUE 0x700221e0 Scalar_UBYTE 0 VBU0428Test_CM_uint8_enum 0.0 255.0 /end CHARACTERISTIC
/begin CHARACTERISTIC CeVCT_BetteryPckVoltUnderAlarmORV_enum "" VALUE 0x700221e1 Scalar_UBYTE 0 VBU0428Test_CM_uint8_enum 0.0 255.0 /end CHARACTERISTIC
/begin CHARACTERISTIC CeVCT_CTDMnNegContactorWeldORV_enum "" VALUE 0x700221e2 Scalar_UBYTE 0 VBU0428Test_CM_uint8_enum 0.0 255.0 /end CHARACTERISTIC
/begin CHARACTERISTIC CeVCT_CTDMnPosContactorWeldORV_enum "" VALUE 0x700221e3 Scalar_UBYTE 0 VBU0428Test_CM_uint8_enum 0.0 255.0 /end CHARACTERISTIC
/begin CHARACTERISTIC CeVCT_CTDPrechargeEnergyHighORV_enum "" VALUE 0x700221e4 Scalar_UBYTE 0 VBU0428Test_CM_uint8_enum 0.0 255.0 /end CHARACTERISTIC
/begin CHARACTERISTIC CeVCT_CTDPrechargeRelayBlownORV_enum "" VALUE 0x700221e5 Scalar_UBYTE 0 VBU0428Test_CM_uint8_enum 0.0 255.0 /end CHARACTERISTIC
/begin CHARACTERISTIC CeVCT_CTDPrechargeRelayStuckOpenORV_enum "" VALUE 0x700221e6 Scalar_UBYTE 0 VBU0428Test_CM_uint8_enum 0.0 255.0 /end CHARACTERISTIC
/begin CHARACTERISTIC CeVCT_CTDPrechargeTimeoutORV_enum "" VALUE 0x700221e7 Scalar_UBYTE 0 VBU0428Test_CM_uint8_enum 0.0 255.0 /end CHARACTERISTIC
/begin CHARACTERISTIC CeVCT_CTMCellThermalRunawayORV_enum "" VALUE 0x700221e8 Scalar_UBYTE 0 VBU0428Test_CM_uint8_enum 0.0 255.0 /end CHARACTERISTIC
/begin CHARACTERISTIC CeVCT_DCChargeModeORV_enum "" VALUE 0x700221e9 Scalar_UBYTE 0 VBU0428Test_CM_uint8_enum 0.0 255.0 /end CHARACTERISTIC
/begin CHARACTERISTIC CeVCT_DCChargingPermitStatusORV_enum "" VALUE 0x700221ea Scalar_UBYTE 0 VBU0428Test_CM_uint8_enum 0.0 255.0 /end CHARACTERISTIC
/begin CHARACTERISTIC CeVCT_InhibitPrechargeCauseORV_enum "" VALUE 0x700221eb Scalar_UBYTE 0 VBU0428Test_CM_uint8_enum 0.0 255.0 /end CHARACTERISTIC
/begin CHARACTERISTIC CeVCT_SOCJumpAlarmORV_enum "" VALUE 0x700221ec Scalar_UBYTE 0 VBU0428Test_CM_uint8_enum 0.0 255.0 /end CHARACTERISTIC
/begin CHARACTERISTIC CeVCT_SOCJumpReasonORV_enum "" VALUE 0x700221ed Scalar_UBYTE 0 VBU0428Test_CM_uint8_enum 0.0 255.0 /end CHARACTERISTIC
/begin CHARACTERISTIC CmDSM_MILFaultCat_enum "" VALUE 0x700221ee Scalar_UBYTE 0 VBU0428Test_CM_uint8_cnt 0.0 255.0 /end CHARACTERISTIC
/begin CHARACTERISTIC CmFCC_NoChargeCellTempHigh_enum "" VALUE 0x700221ef Scalar_UBYTE 0 VBU0428Test_CM_uint8_cnt 0.0 255.0 /end CHARACTERISTIC
/begin CHARACTERISTIC CmFCC_NoChargeCellTempLow_enum "" VALUE 0x700221f0 Scalar_UBYTE 0 VBU0428Test_CM_uint8_cnt 0.0 255.0 /end CHARACTERISTIC
/begin CHARACTERISTIC CmFCC_NoChargeFaultCat_enum "" VALUE 0x700221f1 Scalar_UBYTE 0 VBU0428Test_CM_uint8_cnt 0.0 255.0 /end CHARACTERISTIC
/begin CHARACTERISTIC CmFCC_NoChargeFault_enum "" VALUE 0x700221f2 Scalar_UBYTE 0 VBU0428Test_CM_uint8_cnt 0.0 255.0 /end CHARACTERISTIC
/begin CHARACTERISTIC CmFCC_NoChargeVoltageHigh_enum "" VALUE 0x700221f3 Scalar_UBYTE 0 VBU0428Test_CM_uint8_cnt 0.0 255.0 /end CHARACTERISTIC
/begin CHARACTERISTIC CmSYS_BatteryPowerOffFaultCat_enum "" VALUE 0x700221f4 Scalar_UBYTE 0 VBU0428Test_CM_uint8_cnt 0.0 255.0 /end CHARACTERISTIC
/begin CHARACTERISTIC DIAGNOSTIC_ON_GOING "" VALUE 0x700222e6 Scalar_UBYTE 0 VBU0428Test_CM_uint8_cnt 0.0 255.0 /end CHARACTERISTIC
/begin CHARACTERISTIC FAULT_CAT_NONE "" VALUE 0x70022312 Scalar_UBYTE 0 VBU0428Test_CM_uint8_cnt 0.0 255.0 /end CHARACTERISTIC
/begin CHARACTERISTIC SOH_CELL_CAPACITY_LOW_FAULT "" VALUE 0x7002241e Scalar_UBYTE 0 VBU0428Test_CM_uint8_cnt 0.0 255.0 /end CHARACTERISTIC
/begin CHARACTERISTIC SOH_CELL_CAPACITY_OVER_DEVIATION_FAULT "" VALUE 0x7002241f Scalar_UBYTE 0 VBU0428Test_CM_uint8_cnt 0.0 255.0 /end CHARACTERISTIC
/begin CHARACTERISTIC SOH_CELL_RESISTANCE_HIGH_FAULT "" VALUE 0x70022420 Scalar_UBYTE 0 VBU0428Test_CM_uint8_cnt 0.0 255.0 /end CHARACTERISTIC
/begin MEASUREMENT CTD_tisPrechargeLockoutTime "" ULONG VBU0428Test_CM_uint32 0 0 0 4294967295 ECU_ADDRESS 0x6003bf46 /end MEASUREMENT
/begin MEASUREMENT CTD_tiLastPrechargeStartTime "" ULONG VBU0428Test_CM_uint32 0 0 0 4294967295 ECU_ADDRESS 0x6003bf42 /end MEASUREMENT
/begin MEASUREMENT THM_tInletCoolantTemp "" FLOAT32_IEEE VBU0428Test_CM_single 0 0 -3.4E+38 3.4E+38 ECU_ADDRESS 0x6003bfce /end MEASUREMENT
/begin MEASUREMENT THM_tOutletCoolantTemp "" FLOAT32_IEEE VBU0428Test_CM_single 0 0 -3.4E+38 3.4E+38 ECU_ADDRESS 0x6003bfd6 /end MEASUREMENT
/begin MEASUREMENT SOE_kwhPackRemainingEnergySoc "" FLOAT32_IEEE VBU0428Test_CM_single 0 0 -3.4E+38 3.4E+38 ECU_ADDRESS 0x6003be6a /end MEASUREMENT
/begin MEASUREMENT SOF_uPackChargeOcv "" FLOAT32_IEEE VBU0428Test_CM_single 0 0 -3.4E+38 3.4E+38 ECU_ADDRESS 0x900001e4 /end MEASUREMENT
/begin MEASUREMENT SOF_uPackDischargeOcv "" FLOAT32_IEEE VBU0428Test_CM_single 0 0 -3.4E+38 3.4E+38 ECU_ADDRESS 0x900001e8 /end MEASUREMENT
/begin MEASUREMENT LcSOF_kwChargePowerLimitCycle "" FLOAT32_IEEE VBU0428Test_CM_single 0 0 -3.4E+38 3.4E+38 ECU_ADDRESS 0x90000158 /end MEASUREMENT
/begin MEASUREMENT SOC_pctCellBatterySOCDeviation "" FLOAT32_IEEE VBU0428Test_CM_single 0 0 -3.4E+38 3.4E+38 ECU_ADDRESS 0x9000018c /end MEASUREMENT
/begin MEASUREMENT SOC_iAModuleCurrent "" FLOAT32_IEEE VBU0428Test_CM_single 0 0 -3.4E+38 3.4E+38 ECU_ADDRESS 0x90000174 /end MEASUREMENT
/begin MEASUREMENT LaSOC_pctCellSocCurrentIntegral "" FLOAT32_IEEE VBU0428Test_CM_single 0 0 0.0 100.0 ARRAY_SIZE 198 ECU_ADDRESS 0x600399be /end MEASUREMENT
/begin MEASUREMENT FCC_iABaseChargeCurrentRequest "" FLOAT32_IEEE VBU0428Test_CM_single 0 0 -3.4E+38 3.4E+38 ECU_ADDRESS 0x90000114 /end MEASUREMENT
/begin MEASUREMENT FCC_uBaseChargeVoltageRequest "" FLOAT32_IEEE VBU0428Test_CM_single 0 0 -3.4E+38 3.4E+38 ECU_ADDRESS 0x90000144 /end MEASUREMENT
/begin MEASUREMENT FCC_kwBaseChargePowerRequest "" FLOAT32_IEEE VBU0428Test_CM_single 0 0 0.0 10000.0 ECU_ADDRESS 0x6003bb7a /end MEASUREMENT
/begin MEASUREMENT FCC_iAChargeRequestCurrentLimit "" FLOAT32_IEEE VBU0428Test_CM_single 0 0 -3.4E+38 3.4E+38 ECU_ADDRESS 0x90000120 /end MEASUREMENT
/begin MEASUREMENT FCC_iAChargeCurrentRequestFnl "" FLOAT32_IEEE VBU0428Test_CM_single 0 0 -3.4E+38 3.4E+38 ECU_ADDRESS 0x9000011c /end MEASUREMENT
/begin MEASUREMENT FCC_timinFastChargeBaseRemainTime "" FLOAT32_IEEE VBU0428Test_CM_single 0 0 -3.4E+38 3.4E+38 ECU_ADDRESS 0x90000140 /end MEASUREMENT
/begin MEASUREMENT LcFCC_timinEstimatePercTime "" FLOAT32_IEEE VBU0428Test_CM_single 0 0 -3.4E+38 3.4E+38 ECU_ADDRESS 0x6003bb92 /end MEASUREMENT
/begin MEASUREMENT CTD_pctBusOfBatteryVoltage "" FLOAT32_IEEE VBU0428Test_CM_single 0 0 -3.4E+38 3.4E+38 ECU_ADDRESS 0x6003bf2e /end MEASUREMENT
/begin MEASUREMENT SOC_mvFastChargeCorrectionCellVoltage "" UWORD VBU0428Test_CM_uint16 0 0 0 65535 ECU_ADDRESS 0x900016ee /end MEASUREMENT
/begin MEASUREMENT CTD_stPrechargeRelayStuckOpenFault "" UWORD VBU0428Test_CM_uint16 0 0 0 65535 ECU_ADDRESS 0x900016bc /end MEASUREMENT
/begin MEASUREMENT CTD_stPrechargeTimeoutFault "" UWORD VBU0428Test_CM_uint16 0 0 0 65535 ECU_ADDRESS 0x900016be /end MEASUREMENT
/begin MEASUREMENT CTD_timsPrechargeTimer "" UWORD VBU0428Test_CM_uint16 0 0 0 65535 ECU_ADDRESS 0x900014aa /end MEASUREMENT
/begin MEASUREMENT CTD_stMnPosContactorWeldFault "" UWORD VBU0428Test_CM_uint16 0 0 0 65535 ECU_ADDRESS 0x900014a6 /end MEASUREMENT
/begin MEASUREMENT VCT_stBatteryAbnormalAlarm1 "" UBYTE VBU0428Test_CM_uint8 0 0 0 255 ECU_ADDRESS 0x90001f0d /end MEASUREMENT
/begin MEASUREMENT VCT_stBatteryAbnormalAlarm2 "" UBYTE VBU0428Test_CM_uint8 0 0 0 255 ECU_ADDRESS 0x90001f0e /end MEASUREMENT
/begin MEASUREMENT VCT_stBatteryAbnormalAlarm3 "" UBYTE VBU0428Test_CM_uint8 0 0 0 255 ECU_ADDRESS 0x90001f0f /end MEASUREMENT
/begin MEASUREMENT VCT_stCTDPrechargeTimeout "" UBYTE VBU0428Test_CM_uint8 0 0 0 255 ECU_ADDRESS 0x90001f20 /end MEASUREMENT
/begin MEASUREMENT VCT_stCTDPrechargeEnergyHigh "" UBYTE VBU0428Test_CM_uint8 0 0 0 255 ECU_ADDRESS 0x90001f1d /end MEASUREMENT
/begin MEASUREMENT VCT_stCTDPrechargeRelayBlown "" UBYTE VBU0428Test_CM_uint8 0 0 0 255 ECU_ADDRESS 0x90001f1e /end MEASUREMENT
/begin MEASUREMENT VCT_stCTDPrechargeRelayStuckOpen "" UBYTE VBU0428Test_CM_uint8 0 0 0 255 ECU_ADDRESS 0x90001f1f /end MEASUREMENT
/begin MEASUREMENT VCT_stCTDMnPosContactorWeld "" UBYTE VBU0428Test_CM_uint8 0 0 0 255 ECU_ADDRESS 0x90001f1c /end MEASUREMENT
/begin MEASUREMENT VCT_stCTDMnNegContactorWeld "" UBYTE VBU0428Test_CM_uint8 0 0 0 255 ECU_ADDRESS 0x90001f1b /end MEASUREMENT
/begin MEASUREMENT SOC_numFastChargeCorrectionCellVoltageID "" UBYTE VBU0428Test_CM_uint8 0 0 0 255 ECU_ADDRESS 0x90001f86 /end MEASUREMENT
/begin MEASUREMENT SOC_stBatterySocJump "" UBYTE VBU0428Test_CM_uint8 0 0 0 255 ECU_ADDRESS 0x90001f87 /end MEASUREMENT
/begin MEASUREMENT FCC_stNoChargeCause "" UBYTE VBU0428Test_CM_uint8 0 0 0 255 ECU_ADDRESS 0x90001f74 /end MEASUREMENT
/begin MEASUREMENT DSM_stFaultCat "" UBYTE VBU0428Test_CM_uint8 0 0 0 255 ECU_ADDRESS 0x90001cff /end MEASUREMENT
/begin MEASUREMENT CTD_stPrechargeStatus "" UBYTE VBU0428Test_CM_uint8 0 0 0 255 ECU_ADDRESS 0x90001ddf /end MEASUREMENT
/begin MEASUREMENT CTD_stPrechargeRelayBlownDiagnosticStatus "" UBYTE VBU0428Test_CM_uint8 0 0 0 255 ECU_ADDRESS 0x90001ddd /end MEASUREMENT
/begin MEASUREMENT CTD_stMainFuseBlownDiagnosticStatus "" UBYTE VBU0428Test_CM_uint8 0 0 0 255 ECU_ADDRESS 0x90001dda /end MEASUREMENT
/begin MEASUREMENT THM_flgSystemCoolingAbilityDecrease "" UBYTE VBU0428Test_CM_boolean 0 0 0 1 ECU_ADDRESS 0x90001ea1 /end MEASUREMENT
/begin MEASUREMENT SOF_flgCurrentLimitTargetCalculateEnable "" UBYTE VBU0428Test_CM_boolean 0 0 0 1 ECU_ADDRESS 0x90001d49 /end MEASUREMENT
/begin MEASUREMENT SOC_flgInternalResistanceCausedDevCellVoltage "" UBYTE VBU0428Test_CM_boolean 0 0 0 1 ECU_ADDRESS 0x90001f85 /end MEASUREMENT
/begin MEASUREMENT SOC_flgFastChargeCorrectionEnable "" UBYTE VBU0428Test_CM_boolean 0 0 0 1 ECU_ADDRESS 0x90001f84 /end MEASUREMENT
/begin MEASUREMENT LbSOC_EolFlashingInitialize_flg "" UBYTE VBU0428Test_CM_boolean 0 0 0 1 ECU_ADDRESS 0x90001f7d /end MEASUREMENT
/begin MEASUREMENT SOC_flgCellSOCArrayInvalid "" UBYTE VBU0428Test_CM_boolean 0 0 0 1 ECU_ADDRESS 0x90001f83 /end MEASUREMENT
/begin MEASUREMENT SOC_flgRelaxationST "" UBYTE VBU0428Test_CM_boolean 0 0 0.0 1.0 ECU_ADDRESS 0x90001d43 /end MEASUREMENT
/begin MEASUREMENT OCV_flgOcvCriteriaMet "" UBYTE VBU0428Test_CM_boolean 0 0 0.0 1.0 ECU_ADDRESS 0x90001d33 /end MEASUREMENT
/begin MEASUREMENT OCV_flgQuasiOcvCriteria "" UBYTE VBU0428Test_CM_boolean 0 0 0.0 1.0 ECU_ADDRESS 0x90001d35 /end MEASUREMENT
/begin MEASUREMENT FCC_flgChargeProtection "" UBYTE VBU0428Test_CM_boolean 0 0 0.0 1.0 ECU_ADDRESS 0x90001d07 /end MEASUREMENT
/begin MEASUREMENT FCC_flgChargeNoFault "" UBYTE VBU0428Test_CM_boolean 0 0 0.0 1.0 ECU_ADDRESS 0x90001f36 /end MEASUREMENT
/begin MEASUREMENT FCC_flgChargeAvailable "" UBYTE VBU0428Test_CM_boolean 0 0 0.0 1.0 ECU_ADDRESS 0x90001d05 /end MEASUREMENT
/begin MEASUREMENT FCC_flgInvalidEstimatedChargeTime "" UBYTE VBU0428Test_CM_boolean 0 0 0.0 1.0 ECU_ADDRESS 0x90001d11 /end MEASUREMENT
/begin MEASUREMENT LbFCC_flgInvalidEstimatedChargeTimeCFT "" UBYTE VBU0428Test_CM_boolean 0 0 0 1 ECU_ADDRESS 0x90001f3a /end MEASUREMENT
/begin MEASUREMENT FCC_flgPackCurrentUpdatePercTime "" UBYTE VBU0428Test_CM_boolean 0 0 0 1 ECU_ADDRESS 0x90001f73 /end MEASUREMENT
/begin MEASUREMENT DSM_flgMILRequest "" UBYTE VBU0428Test_CM_boolean 0 0 0.0 1.0 ECU_ADDRESS 0x90001cfd /end MEASUREMENT
/begin MEASUREMENT CTS_CellDataInvalidInhibitPrecharge_flg "" UBYTE VBU0428Test_CM_boolean 0 0 0 1 ECU_ADDRESS 0x90001de0 /end MEASUREMENT
/begin MEASUREMENT CTS_flgEnergyProtectInhibitPrecharge "" UBYTE VBU0428Test_CM_boolean 0 0 0 1 ECU_ADDRESS 0x90001f6d /end MEASUREMENT
/begin MEASUREMENT LbCTS_FaultInhibitPrecharge_flg "" UBYTE VBU0428Test_CM_boolean 0 0 0 1 ECU_ADDRESS 0x90001e45 /end MEASUREMENT
/begin MEASUREMENT LbCTS_FaultAbortPrecharge_flg "" UBYTE VBU0428Test_CM_boolean 0 0 0 1 ECU_ADDRESS 0x90001f39 /end MEASUREMENT
/begin MEASUREMENT CTS_flgHVDataInvalidInhibitPrecharge "" UBYTE VBU0428Test_CM_boolean 0 0 0 1 ECU_ADDRESS 0x90001de5 /end MEASUREMENT
/begin MEASUREMENT LbCTS_HVSafetyStatusInhibitPrecharge_flg "" UBYTE VBU0428Test_CM_boolean 0 0 0 1 ECU_ADDRESS 0x90001e46 /end MEASUREMENT
/begin MEASUREMENT CTS_SocInitialInhibitPrecharge_flg "" UBYTE VBU0428Test_CM_boolean 0 0 0 1 ECU_ADDRESS 0x90001de1 /end MEASUREMENT
/begin MEASUREMENT CTD_flgDisablePrechargeDiagInAbnormalPowerOff "" UBYTE VBU0428Test_CM_boolean 0 0 0 1 ECU_ADDRESS 0x90001dd2 /end MEASUREMENT
/begin MEASUREMENT CTD_MnPosContactorWeldTestEnable_flg "" UBYTE VBU0428Test_CM_boolean 0 0 0 1 ECU_ADDRESS 0x90001f6a /end MEASUREMENT
/begin COMPU_METHOD VBU0428Test_CM_single_C "Q = V" RAT_FUNC "%8.6" "C" COEFFS 0 1 0 0 0 1 /end COMPU_METHOD
/begin COMPU_METHOD VBU0428Test_CM_single_cnt "Q = V" RAT_FUNC "%8.6" "cnt" COEFFS 0 1 0 0 0 1 /end COMPU_METHOD
/begin COMPU_METHOD VBU0428Test_CM_uint16_cnt "Q = V" RAT_FUNC "%5.0" "cnt" COEFFS 0 1 0 0 0 1 /end COMPU_METHOD
/begin COMPU_METHOD VBU0428Test_CM_single_pct "Q = V" RAT_FUNC "%8.6" "pct" COEFFS 0 1 0 0 0 1 /end COMPU_METHOD
/begin COMPU_METHOD VBU0428Test_CM_single_v "Q = V" RAT_FUNC "%8.6" "v" COEFFS 0 1 0 0 0 1 /end COMPU_METHOD
/begin COMPU_METHOD VBU0428Test_CM_single_t "Q = V" RAT_FUNC "%8.6" "t" COEFFS 0 1 0 0 0 1 /end COMPU_METHOD
/begin COMPU_METHOD VBU0428Test_CM_single_A "Q = V" RAT_FUNC "%8.6" "A" COEFFS 0 1 0 0 0 1 /end COMPU_METHOD
/begin COMPU_METHOD VBU0428Test_CM_uint8 "Q = V" RAT_FUNC "%3.0" "" COEFFS 0 1 0 0 0 1 /end COMPU_METHOD
/begin COMPU_METHOD VBU0428Test_CM_single_V "Q = V" RAT_FUNC "%8.6" "V" COEFFS 0 1 0 0 0 1 /end COMPU_METHOD
/begin COMPU_METHOD VBU0428Test_CM_uint16 "Q = V" RAT_FUNC "%5.0" "" COEFFS 0 1 0 0 0 1 /end COMPU_METHOD
/begin COMPU_METHOD VBU0428Test_CM_single "Q = V" RAT_FUNC "%8.6" "" COEFFS 0 1 0 0 0 1 /end COMPU_METHOD
/begin COMPU_METHOD VBU0428Test_CM_single_Ah "Q = V" RAT_FUNC "%8.6" "Ah" COEFFS 0 1 0 0 0 1 /end COMPU_METHOD
/begin COMPU_METHOD VBU0428Test_CM_single_Kw "Q = V" RAT_FUNC "%8.6" "Kw" COEFFS 0 1 0 0 0 1 /end COMPU_METHOD
/begin COMPU_METHOD VBU0428Test_CM_single_min "Q = V" RAT_FUNC "%8.6" "min" COEFFS 0 1 0 0 0 1 /end COMPU_METHOD
/begin COMPU_METHOD VBU0428Test_CM_single_Kohm "Q = V" RAT_FUNC "%8.6" "Kohm" COEFFS 0 1 0 0 0 1 /end COMPU_METHOD
/begin COMPU_METHOD VBU0428Test_CM_single_Kwh "Q = V" RAT_FUNC "%8.6" "Kwh" COEFFS 0 1 0 0 0 1 /end COMPU_METHOD
/begin COMPU_METHOD VBU0428Test_CM_single_flg "Q = V" RAT_FUNC "%8.6" "flg" COEFFS 0 1 0 0 0 1 /end COMPU_METHOD
/begin COMPU_METHOD VBU0428Test_CM_uint32_cnt "Q = V" RAT_FUNC "%10.0" "cnt" COEFFS 0 1 0 0 0 1 /end COMPU_METHOD
/begin COMPU_METHOD VBU0428Test_CM_uint32_n "Q = V" RAT_FUNC "%10.0" "n" COEFFS 0 1 0 0 0 1 /end COMPU_METHOD
/begin COMPU_METHOD VBU0428Test_CM_uint32 "Q = V" RAT_FUNC "%10.0" "" COEFFS 0 1 0 0 0 1 /end COMPU_METHOD
/begin COMPU_METHOD VBU0428Test_CM_uint16_ms "Q = V" RAT_FUNC "%5.0" "ms" COEFFS 0 1 0 0 0 1 /end COMPU_METHOD
/begin COMPU_METHOD VBU0428Test_CM_uint16_mV "Q = V" RAT_FUNC "%5.0" "mV" COEFFS 0 1 0 0 0 1 /end COMPU_METHOD
/begin COMPU_METHOD VBU0428Test_CM_boolean_flg "Q = V" RAT_FUNC "%1.0" "flg" COEFFS 0 1 0 0 0 1 /end COMPU_METHOD
/begin COMPU_METHOD VBU0428Test_CM_boolean_cnt "Q = V" RAT_FUNC "%1.0" "cnt" COEFFS 0 1 0 0 0 1 /end COMPU_METHOD
/begin COMPU_METHOD VBU0428Test_CM_boolean "Q = V" RAT_FUNC "%1.0" "" COEFFS 0 1 0 0 0 1 /end COMPU_METHOD
/begin COMPU_METHOD VBU0428Test_CM_int8_cnt "Q = V" RAT_FUNC "%3.0" "cnt" COEFFS 0 1 0 0 0 1 /end COMPU_METHOD
/begin COMPU_METHOD VBU0428Test_CM_int8_n "Q = V" RAT_FUNC "%3.0" "n" COEFFS 0 1 0 0 0 1 /end COMPU_METHOD
/begin COMPU_METHOD VBU0428Test_CM_uint8_cnt "Q = V" RAT_FUNC "%3.0" "cnt" COEFFS 0 1 0 0 0 1 /end COMPU_METHOD
/begin COMPU_METHOD VBU0428Test_CM_uint8_n "Q = V" RAT_FUNC "%3.0" "n" COEFFS 0 1 0 0 0 1 /end COMPU_METHOD
/begin COMPU_METHOD VBU0428Test_CM_uint8_enum "Q = V" RAT_FUNC "%3.0" "enum" COEFFS 0 1 0 0 0 1 /end COMPU_METHOD
/begin GROUP S375_MPC_Weld_Check "VBU0428Test/VBUSystem/BMS/CTD/Subsystem/Subsystem4/DiagnoseRelayWeld/MPC_Weld_Check"
 /begin SUB_GROUP S388_CONTACTOR_STATUS_OPENED S388_CONTACTOR_STATUS_OPENED1 S388_Determine_Diagnostic_Status S388_Equal_to_LOW1 S388_Equal_to_LOW2 /end SUB_GROUP
 /begin REF_CHARACTERISTIC CbCTD_MnPosContactorWeldFaultEnable_flg CcCTD_MnPosContactorCloseDeltaVoltage_V CcCTD_MnPosContactorWeldFaultFIC_n CcCTD_MnPosContactorWeldFaultPIC_n /end REF_CHARACTERISTIC
 /begin REF_MEASUREMENT CTD_MnPosContactorWeldTestEnable_flg CTD_stMnPosContactorWeldFault /end REF_MEASUREMENT
/end GROUP
/begin GROUP S377_Determine_Fail_Lockout "VBU0428Test/VBUSystem/BMS/CTD/Subsystem/Subsystem4/Lockout_Precharge_Process/Determine_Fail_Lockout"
 /begin REF_CHARACTERISTIC CTD_PRECHARGE_STATUS_CHARGING CcCTD_PrechargeFailLockoutInterval_s /end REF_CHARACTERISTIC
/end GROUP
/begin GROUP S377_Determine_Lockout_Time "VBU0428Test/VBUSystem/BMS/CTD/Subsystem/Subsystem4/Lockout_Precharge_Process/Determine_Lockout_Time" /begin REF_MEASUREMENT CTD_tisPrechargeLockoutTime /end REF_MEASUREMENT /end GROUP
/begin GROUP S377_Determine_Overload_Lockout "VBU0428Test/VBUSystem/BMS/CTD/Subsystem/Subsystem4/Lockout_Precharge_Process/Determine_Overload_Lockout"
 /begin REF_CHARACTERISTIC CbCTD_PrechargeOverEnergyLockoutEnable_flg CcCTD_PrechargeOverEnergyLockoutInterval_s /end REF_CHARACTERISTIC
/end GROUP
/begin GROUP S377_HeatProtection_Lockout "VBU0428Test/VBUSystem/BMS/CTD/Subsystem/Subsystem4/Lockout_Precharge_Process/HeatProtection_Lockout"
 /begin SUB_GROUP S428_Determine_Heat_LockTime S428_Determine_LockPoint_AvaliableHeat /end SUB_GROUP
/end GROUP
/begin GROUP S378_Determine_Diagnostic_Status "VBU0428Test/VBUSystem/BMS/CTD/Subsystem/Subsystem4/MainFuseDiagnostic/Determine_Diagnostic_Status" /begin REF_CHARACTERISTIC CcFDC_MaxCount_n CcFDC_MinCount_n DIAGNOSTIC_ON_GOING /end REF_CHARACTERISTIC /begin REF_MEASUREMENT CTD_stMainFuseBlownDiagnosticStatus /end REF_MEASUREMENT /end GROUP
/begin GROUP S379_Determine_Diagnostic_Status "VBU0428Test/VBUSystem/BMS/CTD/Subsystem/Subsystem4/Precharge_Resistance_Diagnostic/Determine_Diagnostic_Status" /begin REF_CHARACTERISTIC CcFDC_MaxCount_n CcFDC_MinCount_n DIAGNOSTIC_ON_GOING /end REF_CHARACTERISTIC /begin REF_MEASUREMENT CTD_stPrechargeRelayBlownDiagnosticStatus /end REF_MEASUREMENT /end GROUP
/begin GROUP S380_Determine_PrechargeDiag_Disable "VBU0428Test/VBUSystem/BMS/CTD/Subsystem/Subsystem4/PrechrgProcessMonitoring/Determine_PrechargeDiag_Disable" /begin REF_CHARACTERISTIC CcCTD_VehSpdPrechargeDiag_kmh /end REF_CHARACTERISTIC /begin REF_MEASUREMENT CTD_flgDisablePrechargeDiagInAbnormalPowerOff /end REF_MEASUREMENT /end GROUP
/begin GROUP S380_Determine_Precharge_Timer "VBU0428Test/VBUSystem/BMS/CTD/Subsystem/Subsystem4/PrechrgProcessMonitoring/Determine_Precharge_Timer" /begin REF_MEASUREMENT CTD_tiLastPrechargeStartTime CTD_timsPrechargeTimer /end REF_MEASUREMENT /end GROUP
/begin GROUP S380_Determine_Ratio_BusVBatV "VBU0428Test/VBUSystem/BMS/CTD/Subsystem/Subsystem4/PrechrgProcessMonitoring/Determine_Ratio_BusVBatV" /begin REF_MEASUREMENT CTD_pctBusOfBatteryVoltage /end REF_MEASUREMENT /end GROUP
/begin GROUP S380_Precharge_Thermal_Management "VBU0428Test/VBUSystem/BMS/CTD/Subsystem/Subsystem4/PrechrgProcessMonitoring/Precharge_Thermal_Management"
 /begin SUB_GROUP S454_Determine_Precharge_JouleHeat S454_Perform_OverEnergy_Diagnostic /end SUB_GROUP
/end GROUP
/begin GROUP S380_Precharge_Timeout_Diagnostic "VBU0428Test/VBUSystem/BMS/CTD/Subsystem/Subsystem4/PrechrgProcessMonitoring/Precharge_Timeout_Diagnostic"
 /begin REF_CHARACTERISTIC CbCTD_PrechargeTimeoutFaultEnable_flg CcCTD_PrechargeTimeoutFaultFIC_n CcCTD_PrechargeTimeoutFaultPIC_n /end REF_CHARACTERISTIC
 /begin REF_MEASUREMENT CTD_stPrechargeTimeoutFault /end REF_MEASUREMENT
/end GROUP
/begin GROUP S380_Precharging_Process_Monitoring "VBU0428Test/VBUSystem/BMS/CTD/Subsystem/Subsystem4/PrechrgProcessMonitoring/Precharging_Process_Monitoring"
 /begin SUB_GROUP S456_Status_Charging S456_Status_Fail S456_Status_Idle S456_Status_Success /end SUB_GROUP
 /begin REF_CHARACTERISTIC CcCTD_PrechargeSuccessMax_pct CcCTD_PrechargeSuccessMin_pct CcCTD_PrechargeTimeMax_ms /end REF_CHARACTERISTIC
 /begin REF_MEASUREMENT CTD_stPrechargeStatus /end REF_MEASUREMENT
/end GROUP
/begin GROUP S381_MNC_Stuck_Open "VBU0428Test/VBUSystem/BMS/CTD/Subsystem/Subsystem4/Stuck_Open_Diagnostic/MNC_Stuck_Open"
 /begin SUB_GROUP S476_MNC_Stuck_Open_With_VehicleSpeed S476_MNC_Stuck_Open_Without_VehicleSpeed /end SUB_GROUP
/end GROUP
/begin GROUP S381_MPC_Stuck_Open "VBU0428Test/VBUSystem/BMS/CTD/Subsystem/Subsystem4/Stuck_Open_Diagnostic/MPC_Stuck_Open"
 /begin SUB_GROUP S477_MPC_Stuck_Open_Within_VehicleSpeed S477_MPC_Stuck_Open_Without_VehicleSpeed /end SUB_GROUP
/end GROUP
/begin GROUP S381_MPR_Stuck_Open "VBU0428Test/VBUSystem/BMS/CTD/Subsystem/Subsystem4/Stuck_Open_Diagnostic/MPR_Stuck_Open"
 /begin SUB_GROUP S478_CONTACTOR_STATUS_CLOSED1 S478_Determine_Diagnostic_Status S478_Equal_to_HIGH /end SUB_GROUP
 /begin REF_CHARACTERISTIC CbCTD_PrechargeRelayStuckOpenFaultEnable_flg CcCTD_PrechargeRelayStuckOpenDeltaVoltage_V CcCTD_PrechargeRelayStuckOpenFaultFIC_n CcCTD_PrechargeRelayStuckOpenFaultPIC_n /end REF_CHARACTERISTIC
 /begin REF_MEASUREMENT CTD_stPrechargeRelayStuckOpenFault /end REF_MEASUREMENT
/end GROUP
/begin GROUP S381_StuckOpenAssistantConditons "VBU0428Test/VBUSystem/BMS/CTD/Subsystem/Subsystem4/Stuck_Open_Diagnostic/StuckOpenAssistantConditons"
 /begin REF_CHARACTERISTIC CcCTD_MessageDataValidDelay_ms CcCTD_MnCntcStuckOpenVhclSpdThreshold_kmh CcCTD_PEURDCVoltageThreshold_V /end REF_CHARACTERISTIC
/end GROUP
/begin GROUP S547_EVM_FDC_Handler1 "VBU0428Test/VBUSystem/BMS/CTM/CTM/Subsystem/Determine_CellTemp_OverDeviationFaults/EVM_FDC_Handler1" /begin SUB_GROUP S559_DetermineFault S559_DetermineFaultCounter /end SUB_GROUP /end GROUP
/begin GROUP S548_EVM_FDC_Handler "VBU0428Test/VBUSystem/BMS/CTM/CTM/Subsystem/Determine_CellTemp_OverUnderFaults/EVM_FDC_Handler" /begin SUB_GROUP S569_DetermineFault S569_DetermineFaultCounter /end SUB_GROUP /end GROUP
/begin GROUP S550_CellThermalRunaway_FaultArrayCheck "VBU0428Test/VBUSystem/BMS/CTM/CTM/Subsystem/Determine_Thermal_Runaway/CellThermalRunaway_FaultArrayCheck"
 /begin REF_CHARACTERISTIC CTM_CELL_THERMAL_RUNAWAY_FAULT CbCTM_CellThermalRunawayEnable_flg CbCTM_ThermalRunawayTestFailORF_flg CbCTM_ThermalRunawayTestFailORV_flg CcCTM_ThermalRunawayFaultFIC_n CcCTM_ThermalRunawayFaultPIC_n CcCTM_ThermalRunawayValidDelayTime_ms /end REF_CHARACTERISTIC
/end GROUP
/begin GROUP S550_DetermineCellTempOver "VBU0428Test/VBUSystem/BMS/CTM/CTM/Subsystem/Determine_Thermal_Runaway/DetermineCellTempOver"
 /begin REF_CHARACTERISTIC CcCTM_ThermalRunawayOverTemp_C CcCTM_ThermalRunawayResetTemp_C CcCTM_ThermalRunawayTempRiseDelayTime_ms /end REF_CHARACTERISTIC
/end GROUP
/begin GROUP S550_DetermineTempRiseRate "VBU0428Test/VBUSystem/BMS/CTM/CTM/Subsystem/Determine_Thermal_Runaway/DetermineTempRiseRate" /begin SUB_GROUP S593_CellTemp_ChangeRate_Calculate /end SUB_GROUP
 /begin REF_CHARACTERISTIC CcCTM_CellThermalRunawayFaultFIC_n CcCTM_CellThermalRunawayFaultPIC_n /end REF_CHARACTERISTIC
/end GROUP
/begin GROUP S550_TriggerCycle "VBU0428Test/VBUSystem/BMS/CTM/CTM/Subsystem/Determine_Thermal_Runaway/TriggerCycle" /begin REF_CHARACTERISTIC CcCTM_ThermalRunawayTriggerTime_ms /end REF_CHARACTERISTIC /end GROUP
/begin GROUP S621_Cell_DataValid_Check "VBU0428Test/VBUSystem/BMS/CTS/CTS/Subsystem/DeterminePrechargeConditions/Cell_DataValid_Check"
 /begin REF_CHARACTERISTIC CbCTS_CellDataInvalidSerialCheckEnable_flg CcSYS_NoOfInvalidCellVoltages_n /end REF_CHARACTERISTIC
 /begin REF_MEASUREMENT CTS_CellDataInvalidInhibitPrecharge_flg /end REF_MEASUREMENT
/end GROUP
/begin GROUP S621_Energy_Protection_Check "VBU0428Test/VBUSystem/BMS/CTS/CTS/Subsystem/DeterminePrechargeConditions/Energy_Protection_Check"
 /begin REF_CHARACTERISTIC CbCTS_EnergyProtectEnable_flg CcCTS_BatteryDisplaySocLimit_pct CcCTS_BatteryVoltageMinLimit_V CcCTS_CellVoltageMinLimitDelta_mV CcCTS_CellVoltageMinLimit_mV CcCTS_SocMinLimit_pct /end REF_CHARACTERISTIC
 /begin REF_MEASUREMENT CTS_flgEnergyProtectInhibitPrecharge /end REF_MEASUREMENT
/end GROUP
/begin GROUP S621_Fault_Check "VBU0428Test/VBUSystem/BMS/CTS/CTS/Subsystem/DeterminePrechargeConditions/Fault_Check" /begin REF_CHARACTERISTIC CmSYS_BatteryPowerOffFaultCat_enum /end REF_CHARACTERISTIC
 /begin REF_MEASUREMENT LbCTS_FaultAbortPrecharge_flg LbCTS_FaultInhibitPrecharge_flg /end REF_MEASUREMENT
/end GROUP
/begin GROUP S621_HV_DataValid_Check "VBU0428Test/VBUSystem/BMS/CTS/CTS/Subsystem/DeterminePrechargeConditions/HV_DataValid_Check" /begin REF_MEASUREMENT CTS_flgHVDataInvalidInhibitPrecharge /end REF_MEASUREMENT /end GROUP
/begin GROUP S621_HV_Safety_Check "VBU0428Test/VBUSystem/BMS/CTS/CTS/Subsystem/DeterminePrechargeConditions/HV_Safety_Check" /begin REF_MEASUREMENT LbCTS_HVSafetyStatusInhibitPrecharge_flg /end REF_MEASUREMENT /end GROUP
/begin GROUP S621_Precharge_Inhibit_Abort "VBU0428Test/VBUSystem/BMS/CTS/CTS/Subsystem/DeterminePrechargeConditions/Precharge_Inhibit_Abort" /begin SUB_GROUP S631_Combine_Precharge_Conditions /end SUB_GROUP /end GROUP
/begin GROUP S621_SoC_Initialization_Check "VBU0428Test/VBUSystem/BMS/CTS/CTS/Subsystem/DeterminePrechargeConditions/SoC_Initialization_Check"
 /begin REF_CHARACTERISTIC CbCTS_SocInitialInhibitEnable_flg CcCTS_SocInitialDelayTime_s /end REF_CHARACTERISTIC
 /begin REF_MEASUREMENT CTS_SocInitialInhibitPrecharge_flg /end REF_MEASUREMENT
/end GROUP
/begin GROUP S622_Close_Comamnd "VBU0428Test/VBUSystem/BMS/CTS/CTS/Subsystem/Determine_Contactor_Request/Close_Comamnd"
 /begin REF_CHARACTERISTIC BMM_STATE_POWER_SWAP CbCTS_ContactorComandBypassBMUModeEnable_flg CcCTS_ContactorRequestCloseDelay_ms /end REF_CHARACTERISTIC
/end GROUP
/begin GROUP S652_EVM_FDC_Handler "VBU0428Test/VBUSystem/BMS/CVT/CVT/Subsystem/Determine_CellVoltage_OverUnderFaults/EVM_FDC_Handler" /begin SUB_GROUP S659_DetermineFault S659_DetermineFaultCounter /end SUB_GROUP /end GROUP
/begin GROUP S652_EVM_FDC_Handler1 "VBU0428Test/VBUSystem/BMS/CVT/CVT/Subsystem/Determine_CellVoltage_OverUnderFaults/EVM_FDC_Handler1" /begin SUB_GROUP S660_DetermineFault S660_DetermineFaultCounter /end SUB_GROUP /end GROUP
/begin GROUP S652_EVM_FDC_Handler2 "VBU0428Test/VBUSystem/BMS/CVT/CVT/Subsystem/Determine_CellVoltage_OverUnderFaults/EVM_FDC_Handler2" /begin SUB_GROUP S661_DetermineFault S661_DetermineFaultCounter /end SUB_GROUP /end GROUP
/begin GROUP S654_Determine_CSCCellVoltage_DeviationDynamicBDM "VBU0428Test/VBUSystem/BMS/CVT/CVT/Subsystem/Monitor_CVT_DeviationDynamic/Determine_CSCCellVoltage_DeviationDynamicBDM" /begin REF_CHARACTERISTIC CcCVT_BdmDelayTime_ms CcCVT_BdmVoltageDeviationDynamic_mV /end REF_CHARACTERISTIC /end GROUP
/begin GROUP S655_Determine_CellVoltage_OverDeviationBDM "VBU0428Test/VBUSystem/BMS/CVT/CVT/Subsystem/Monitor_CVT_Performance/Determine_CellVoltage_OverDeviationBDM" /begin SUB_GROUP S690_BigDataMonitor_Handler1 /end SUB_GROUP
 /begin REF_CHARACTERISTIC CbCVT_BdmCellVoltageOverDeviationFaultEnable_flg CcCVT_BdmCellVoltageOverDeviationDisableCrrnt_A CcCVT_BdmCellVoltageOverDeviationFaultFIC_n CcCVT_BdmCellVoltageOverDeviationFaultPIC_n CcCVT_BdmCellVoltageOverDeviationFault_mV CcCVT_BdmDelayTime_ms /end REF_CHARACTERISTIC
/end GROUP
/begin GROUP S655_Determine_CellVoltage_OverUnderBDM "VBU0428Test/VBUSystem/BMS/CVT/CVT/Subsystem/Monitor_CVT_Performance/Determine_CellVoltage_OverUnderBDM" /begin SUB_GROUP S691_BigDataMonitor_Handler S691_BigDataMonitor_Handler2 /end SUB_GROUP
 /begin REF_CHARACTERISTIC CbCVT_BdmCellOverVoltageFaultEnable_flg CbCVT_BdmCellUnderVoltageFaultEnable_flg CcCVT_BdmCellOverVoltageFaultFIC_n CcCVT_BdmCellOverVoltageFaultPIC_n CcCVT_BdmCellOverVoltageFault_mV CcCVT_BdmCellUnderVoltageFaultFIC_n CcCVT_BdmCellUnderVoltageFaultPIC_n CcCVT_BdmCellUnderVoltageFault_mV CcCVT_BdmDelayTime_ms /end REF_CHARACTERISTIC
/end GROUP
/begin GROUP S711_For_Iterator_Subsystem "VBU0428Test/VBUSystem/BMS/DSM/Subsystem10/Subsystem/Determine_Abnormal_In_PeriodicalUpload/For_Iterator_Subsystem" /begin REF_CHARACTERISTIC CaDSM_CycleUploadAbnormalEvent_flg /end REF_CHARACTERISTIC /end GROUP
/begin GROUP S712_For_Iterator_Subsystem "VBU0428Test/VBUSystem/BMS/DSM/Subsystem10/Subsystem/Determine_CSC_Inhibit/For_Iterator_Subsystem" /begin REF_CHARACTERISTIC CaDSM_CscValueUncertainFault_flg /end REF_CHARACTERISTIC /end GROUP
/begin GROUP S714_Clear_Fault_Category "VBU0428Test/VBUSystem/BMS/DSM/Subsystem10/Subsystem/Determine_Fault_Category/Clear_Fault_Category" /begin REF_CHARACTERISTIC FAULT_CAT_NONE /end REF_CHARACTERISTIC /begin REF_MEASUREMENT DSM_stFaultCat /end REF_MEASUREMENT /end GROUP
/begin GROUP S716_Clear_MIL_Request "VBU0428Test/VBUSystem/BMS/DSM/Subsystem10/Subsystem/Determine_MIL_Request/Clear_MIL_Request" /begin REF_MEASUREMENT DSM_flgMILRequest /end REF_MEASUREMENT /end GROUP
/begin GROUP S716_Determine_Local_MILRequest "VBU0428Test/VBUSystem/BMS/DSM/Subsystem10/Subsystem/Determine_MIL_Request/Determine_Local_MILRequest" /begin REF_CHARACTERISTIC CmDSM_MILFaultCat_enum FAULT_CAT_NONE /end REF_CHARACTERISTIC /end GROUP
/begin GROUP S717_For_Iterator_Subsystem "VBU0428Test/VBUSystem/BMS/DSM/Subsystem10/Subsystem/Determine_No_Charge/For_Iterator_Subsystem" /begin REF_CHARACTERISTIC CaDSM_NoChargeFault_flg /end REF_CHARACTERISTIC /end GROUP
/begin GROUP S742_Calculate_FastChargeBaseRemainTime "VBU0428Test/VBUSystem/BMS/FCC /FCC/Subsystem/Calculate_Fastcharge_Time/Calculate_FastChargeBaseRemainTime"
 /begin REF_CHARACTERISTIC CaFCC_CurrentLimitRemainChargeTimeSocTempMapDimension_n CaFCC_CurrentLimitRemainChargeTimeSocTempMapZ_min CaFCC_IdealRemainChargeTimeSocTempMapDimension_n CaFCC_IdealRemainChargeTimeSocTempMapZ_min CcFCC_BatteryCapacityCycle1_n CcFCC_BatteryCapacityCycle2_n CcFCC_CustomSetSOCEnable_pct CcFCC_FullChargeSoc1_pct CcFCC_FullChargeSoc2_pct CcFCC_FullChargeSoc3_pct MINUTES_PER_HOUR /end REF_CHARACTERISTIC
 /begin REF_MEASUREMENT FCC_timinFastChargeBaseRemainTime /end REF_MEASUREMENT
/end GROUP
/begin GROUP S742_EightyPercentCustomSOC_CaculateChargeTime "VBU0428Test/VBUSystem/BMS/FCC /FCC/Subsystem/Calculate_Fastcharge_Time/EightyPercentCustomSOC_CaculateChargeTime"
 /begin REF_CHARACTERISTIC CaFCC_CurrentLimitRemainChargeTimeSocTempMapDimension_n CaFCC_CurrentLimitRemainChargeTimeSocTempMapZ_min CaFCC_IdealRemainChargeTimeSocTempMapDimension_n CaFCC_IdealRemainChargeTimeSocTempMapZ_min MINUTES_PER_HOUR /end REF_CHARACTERISTIC
 /begin REF_MEASUREMENT LcFCC_timinEstimatePercTime /end REF_MEASUREMENT
/end GROUP
/begin GROUP S742_EightyPercentCustomSOC_EnableInvalidChargeTimeFlag "VBU0428Test/VBUSystem/BMS/FCC /FCC/Subsystem/Calculate_Fastcharge_Time/EightyPercentCustomSOC_EnableInvalidChargeTimeFlag" /begin REF_CHARACTERISTIC CcFCC_CurrentValueCrossZeroFlagDelay_ms /end REF_CHARACTERISTIC /begin REF_MEASUREMENT LbFCC_flgInvalidEstimatedChargeTimeCFT /end REF_MEASUREMENT /end GROUP
/begin GROUP S742_EightyPercentCustomSOC_UpdateChargeTimeFlag "VBU0428Test/VBUSystem/BMS/FCC /FCC/Subsystem/Calculate_Fastcharge_Time/EightyPercentCustomSOC_UpdateChargeTimeFlag"
 /begin REF_CHARACTERISTIC CaFCC_EstimateChargingTimeDeltaMapY_min CcFCC_EstimateChargeTimeCurrent_A CcFCC_EstimateChargeTimeRefresh_s /end REF_CHARACTERISTIC
 /begin REF_MEASUREMENT FCC_flgPackCurrentUpdatePercTime /end REF_MEASUREMENT
/end GROUP
/begin GROUP S742_EstimateChargeTime_CellVoltageMax_Coefficient "VBU0428Test/VBUSystem/BMS/FCC /FCC/Subsystem/Calculate_Fastcharge_Time/EstimateChargeTime_CellVoltageMax_Coefficient"
 /begin REF_CHARACTERISTIC CcFCC_CellVoltageMaxCorrectEndDelta_mV CcFCC_CellVoltageMaxCorrectMiddleDelta_mV CcFCC_CellVoltageMaxCorrectStartDelta_mV CcFCC_CellVoltageMaxFactorEnd_nbr CcFCC_CellVoltageMaxFactorMiddle_nbr CcFCC_CellVoltageMaxFactorStart_nbr /end REF_CHARACTERISTIC
/end GROUP
/begin GROUP S742_EstimateChargeTime_CellVoltageMax_Slop "VBU0428Test/VBUSystem/BMS/FCC /FCC/Subsystem/Calculate_Fastcharge_Time/EstimateChargeTime_CellVoltageMax_Slop"
 /begin REF_CHARACTERISTIC CcFCC_CellVoltageMaxCorrectSlopMax_nbr CcFCC_CellVoltageMaxCorrectSlopMin_nbr /end REF_CHARACTERISTIC
/end GROUP
/begin GROUP S742_SOC_Mapping "VBU0428Test/VBUSystem/BMS/FCC /FCC/Subsystem/Calculate_Fastcharge_Time/SOC_Mapping"
 /begin SUB_GROUP S754_EqualPorportionMapping3 S754_EqualPorportionMapping4 S754_EqualPorportionMapping5 /end SUB_GROUP
/end GROUP
/begin GROUP S742_SendInvalidTime_flg "VBU0428Test/VBUSystem/BMS/FCC /FCC/Subsystem/Calculate_Fastcharge_Time/SendInvalidTime_flg" /begin REF_CHARACTERISTIC CcFCC_CurrentValueCrossZeroFlagDelay_ms /end REF_CHARACTERISTIC /begin REF_MEASUREMENT FCC_flgInvalidEstimatedChargeTime /end REF_MEASUREMENT /end GROUP
/begin GROUP S742_UpdateTimeTrigger "VBU0428Test/VBUSystem/BMS/FCC /FCC/Subsystem/Calculate_Fastcharge_Time/UpdateTimeTrigger"
 /begin REF_CHARACTERISTIC CaFCC_EstimateChargingTimeDeltaMapY_min CcFCC_EstimateChargeTimeCurrent_A CcFCC_EstimateChargeTimeRefresh_s /end REF_CHARACTERISTIC
/end GROUP
/begin GROUP S742_Update_CustomSOC100RemainTime "VBU0428Test/VBUSystem/BMS/FCC /FCC/Subsystem/Calculate_Fastcharge_Time/Update_CustomSOC100RemainTime" /begin REF_CHARACTERISTIC CcFCC_MaxValidChargeTime_min /end REF_CHARACTERISTIC /end GROUP
/begin GROUP S742_Update_CustomSOC80RemainTime "VBU0428Test/VBUSystem/BMS/FCC /FCC/Subsystem/Calculate_Fastcharge_Time/Update_CustomSOC80RemainTime" /begin REF_CHARACTERISTIC CcFCC_MaxValidChargeTime_min /end REF_CHARACTERISTIC /end GROUP
/begin GROUP S743_Charge_Request_Protection "VBU0428Test/VBUSystem/BMS/FCC /FCC/Subsystem/Determine_Fastcharge_Request/Charge_Request_Protection"
 /begin SUB_GROUP S798_Decrease_ChargeCurrentRequest S798_Override_Block1 S798_Override_Voltage_Request S798_Rate_Limiter /end SUB_GROUP
 /begin REF_CHARACTERISTIC CcFCC_ChargePowerDecRate_Kw CcFCC_ChargePowerIncRate_Kw CcFCC_ComputeResistanceCurrentDecRate_A CcFCC_ComputeResistanceCurrentIncRate_A CcFCC_NoChargeHighTemp_C CcFCC_NoChargeLowTemp_C /end REF_CHARACTERISTIC
 /begin REF_MEASUREMENT FCC_iAChargeCurrentRequestFnl /end REF_MEASUREMENT
/end GROUP
/begin GROUP S743_DetermineComputeResistancePulseCurrent "VBU0428Test/VBUSystem/BMS/FCC /FCC/Subsystem/Determine_Fastcharge_Request/DetermineComputeResistancePulseCurrent"
 /begin SUB_GROUP S799_Determine_ComputeResistanceCondition S799_Determine_ComputeResistancePulseRequest S799_Determine_FastChargeRequest /end SUB_GROUP
/end GROUP
/begin GROUP S743_Determine_Base_ChargeRequest "VBU0428Test/VBUSystem/BMS/FCC /FCC/Subsystem/Determine_Fastcharge_Request/Determine_Base_ChargeRequest" /begin SUB_GROUP S800_Request_At_Charging S800_Request_At_NoCharging /end SUB_GROUP
 /begin REF_MEASUREMENT FCC_iABaseChargeCurrentRequest FCC_kwBaseChargePowerRequest FCC_uBaseChargeVoltageRequest /end REF_MEASUREMENT
/end GROUP
/begin GROUP S743_Determine_DiagnosedAndLimitedChargeRequestCurrent "VBU0428Test/VBUSystem/BMS/FCC /FCC/Subsystem/Determine_Fastcharge_Request/Determine_DiagnosedAndLimitedChargeRequestCurrent"
 /begin REF_CHARACTERISTIC CcFCC_BatteryChargeCurrentFactor_n CcFCC_StandardPowerLimit_Kw CcFCC_TrickleChargeCurrent_A CcSYS_MappedCellCapacity_Ah /end REF_CHARACTERISTIC
 /begin REF_MEASUREMENT FCC_iAChargeRequestCurrentLimit /end REF_MEASUREMENT
/end GROUP
/begin GROUP S744_Condition_Categorize "VBU0428Test/VBUSystem/BMS/FCC /FCC/Subsystem/Fastcharge_Conditions_Check/Condition_Categorize"
 /begin SUB_GROUP S832_Cell_Temp_Protection S832_Full_Charge_Determination S832_Voltage_Protection /end SUB_GROUP
 /begin REF_CHARACTERISTIC CmFCC_NoChargeFaultCat_enum /end REF_CHARACTERISTIC
 /begin REF_MEASUREMENT FCC_flgChargeNoFault FCC_flgChargeProtection /end REF_MEASUREMENT
/end GROUP
/begin GROUP S744_Determine_NoCharge_Cause "VBU0428Test/VBUSystem/BMS/FCC /FCC/Subsystem/Fastcharge_Conditions_Check/Determine_NoCharge_Cause"
 /begin REF_CHARACTERISTIC CmFCC_NoChargeCellTempHigh_enum CmFCC_NoChargeCellTempLow_enum CmFCC_NoChargeFault_enum CmFCC_NoChargeVoltageHigh_enum /end REF_CHARACTERISTIC
 /begin REF_MEASUREMENT FCC_flgChargeAvailable FCC_stNoChargeCause /end REF_MEASUREMENT
/end GROUP
/begin GROUP S924_Determine_OCV_Criteria "VBU0428Test/VBUSystem/BMS/OCV/OCV/Subsystem/Determine_Criteria/Determine_OCV_Criteria" /begin REF_MEASUREMENT OCV_flgOcvCriteriaMet /end REF_MEASUREMENT /end GROUP
/begin GROUP S924_Determine_QOCV_Criteria "VBU0428Test/VBUSystem/BMS/OCV/OCV/Subsystem/Determine_Criteria/Determine_QOCV_Criteria" /begin REF_CHARACTERISTIC CaOCV_QuasiOCVCurrentDimension_n CaOCV_QuasiOCVCurrentZ_A /end REF_CHARACTERISTIC /begin REF_MEASUREMENT OCV_flgQuasiOcvCriteria /end REF_MEASUREMENT /end GROUP
/begin GROUP S961_Determine_AhIntegral_Capacity "VBU0428Test/VBUSystem/BMS/SOC/Subsystem5/Subsystem/Determine_AhIntegral_SoC/Determine_AhIntegral_Capacity" /begin SUB_GROUP S986_Determine_Cell_Balanced_Capacity /end SUB_GROUP
 /begin REF_CHARACTERISTIC CcSOC_MaxBalancedCapacity_As CcSOC_MaxCurrentIntegral_As CcSOC_MinBalancedCapacity_As CcSOC_MinCurrentIntegral_As /end REF_CHARACTERISTIC
/end GROUP
/begin GROUP S961_Determine_AhIntegral_SOC "VBU0428Test/VBUSystem/BMS/SOC/Subsystem5/Subsystem/Determine_AhIntegral_SoC/Determine_AhIntegral_SOC" /begin REF_CHARACTERISTIC CbSOC_CellCapacityOvrdFlg_flg CcSOC_CellCapacityOvrdVal_Ah /end REF_CHARACTERISTIC /begin REF_MEASUREMENT LaSOC_pctCellSocCurrentIntegral /end REF_MEASUREMENT /end GROUP
/begin GROUP S961_Determine_Module_Current "VBU0428Test/VBUSystem/BMS/SOC/Subsystem5/Subsystem/Determine_AhIntegral_SoC/Determine_Module_Current" /begin SUB_GROUP S988_CONTACTOR_STATUS_OPENED1 /end SUB_GROUP /begin REF_MEASUREMENT SOC_iAModuleCurrent /end REF_MEASUREMENT /end GROUP
/begin GROUP S966_DisplaySOC_Driving_Calculation "VBU0428Test/VBUSystem/BMS/SOC/Subsystem5/Subsystem/Determine_Display_SOC/DisplaySOC_Driving_Calculation" /begin SUB_GROUP S1021_Determine_SOC_RateLimit /end SUB_GROUP /begin REF_CHARACTERISTIC CcSOC_ChargeStateDelay_ms /end REF_CHARACTERISTIC /end GROUP
/begin GROUP S966_DisplaySOC_Startup_Calculation "VBU0428Test/VBUSystem/BMS/SOC/Subsystem5/Subsystem/Determine_Display_SOC/DisplaySOC_Startup_Calculation"
 /begin REF_CHARACTERISTIC CcSOC_BatteryDisplaySocUpdateInterval_s CcSOC_InvalidLastShutdownTime_s /end REF_CHARACTERISTIC
 /begin REF_MEASUREMENT SOC_flgRelaxationST /end REF_MEASUREMENT
/end GROUP
/begin GROUP S966_NoJumpSOC_Driving_Calculation "VBU0428Test/VBUSystem/BMS/SOC/Subsystem5/Subsystem/Determine_Display_SOC/NoJumpSOC_Driving_Calculation" /begin REF_CHARACTERISTIC CcSOC_NoJumpSocChargeRate_pct /end REF_CHARACTERISTIC /end GROUP
/begin GROUP S966_NoJumpSOC_Startup_Calculation "VBU0428Test/VBUSystem/BMS/SOC/Subsystem5/Subsystem/Determine_Display_SOC/NoJumpSOC_Startup_Calculation"
 /begin REF_CHARACTERISTIC CbSOC_ReadMemorySOCEnable_flg CcSOC_BatteryDisplaySocUpdateInterval_s CcSOC_InvalidLastShutdownTime_s /end REF_CHARACTERISTIC
/end GROUP
/begin GROUP S967_Determine_FastChargeCorrectionCellVoltage "VBU0428Test/VBUSystem/BMS/SOC/Subsystem5/Subsystem/Determine_FastChargeCorrection_Soc/Determine_FastChargeCorrectionCellVoltage"
 /begin REF_MEASUREMENT SOC_mvFastChargeCorrectionCellVoltage SOC_numFastChargeCorrectionCellVoltageID /end REF_MEASUREMENT
/end GROUP
/begin GROUP S967_Determine_FastChargeCorrectionEnable "VBU0428Test/VBUSystem/BMS/SOC/Subsystem5/Subsystem/Determine_FastChargeCorrection_Soc/Determine_FastChargeCorrectionEnable"
 /begin REF_CHARACTERISTIC CcSOC_BatteryPolarizationMaxTime_ms CcSOC_CCCorrectionDisableTem_C CcSOC_CCCorrectionEnableTem_C CcSOC_CorrectionEnableCellVoltageDeviation_mV /end REF_CHARACTERISTIC
 /begin REF_MEASUREMENT SOC_flgFastChargeCorrectionEnable /end REF_MEASUREMENT
/end GROUP
/begin GROUP S967_Determine_InternalResistanceCausedDevCellVoltage "VBU0428Test/VBUSystem/BMS/SOC/Subsystem5/Subsystem/Determine_FastChargeCorrection_Soc/Determine_InternalResistanceCausedDevCellVoltage"
 /begin REF_CHARACTERISTIC CcSOC_OneThirdRateDeviationCellVoltage_mV CcSOC_RelaxationDeviationCellVoltage_mV /end REF_CHARACTERISTIC
 /begin REF_MEASUREMENT SOC_flgInternalResistanceCausedDevCellVoltage /end REF_MEASUREMENT
/end GROUP
/begin GROUP S967_FastCharge_DynamicCorrection "VBU0428Test/VBUSystem/BMS/SOC/Subsystem5/Subsystem/Determine_FastChargeCorrection_Soc/FastCharge_DynamicCorrection" /begin SUB_GROUP S1045_FastCharge_DynamicCorrection_Enable /end SUB_GROUP /end GROUP
/begin GROUP S968_CellSOC_Startup_AbnormalPoweroff "VBU0428Test/VBUSystem/BMS/SOC/Subsystem5/Subsystem/Determine_Initial_SoC/CellSOC_Startup_AbnormalPoweroff" /begin REF_CHARACTERISTIC CbSOC_ForceOcvSocInitialize_flg CcSOC_CellSocDefault_pct /end REF_CHARACTERISTIC /end GROUP
/begin GROUP S968_CellSOC_Startup_AbnormalReset "VBU0428Test/VBUSystem/BMS/SOC/Subsystem5/Subsystem/Determine_Initial_SoC/CellSOC_Startup_AbnormalReset" /begin SUB_GROUP S1065_Battery_SOC_Calculation /end SUB_GROUP
 /begin REF_CHARACTERISTIC CbSOC_ForceOcvSocInitialize_flg CcSOC_MaxAllowSOCDeviation_pct /end REF_CHARACTERISTIC
 /begin REF_MEASUREMENT SOC_flgCellSOCArrayInvalid SOC_pctCellBatterySOCDeviation /end REF_MEASUREMENT
/end GROUP
/begin GROUP S968_CellSOC_Startup_EolFlashing "VBU0428Test/VBUSystem/BMS/SOC/Subsystem5/Subsystem/Determine_Initial_SoC/CellSOC_Startup_EolFlashing" /begin REF_CHARACTERISTIC CcSOC_CellSocDefault_pct /end REF_CHARACTERISTIC /end GROUP
/begin GROUP S968_CellSOC_Startup_Normal "VBU0428Test/VBUSystem/BMS/SOC/Subsystem5/Subsystem/Determine_Initial_SoC/CellSOC_Startup_Normal" /begin SUB_GROUP S1067_Battery_SOC_Calculation /end SUB_GROUP
 /begin REF_CHARACTERISTIC CbSOC_ForceOcvSocInitialize_flg CcSOC_CellSocDefault_pct CcSOC_MaxAllowSOCDeviation_pct /end REF_CHARACTERISTIC
/end GROUP
/begin GROUP S968_Determine_EOL_Flashing "VBU0428Test/VBUSystem/BMS/SOC/Subsystem5/Subsystem/Determine_Initial_SoC/Determine_EOL_Flashing" /begin REF_MEASUREMENT LbSOC_EolFlashingInitialize_flg /end REF_MEASUREMENT /end GROUP
/begin GROUP S968_Determine_Soc_Jump "VBU0428Test/VBUSystem/BMS/SOC/Subsystem5/Subsystem/Determine_Initial_SoC/Determine_Soc_Jump" /begin SUB_GROUP S1069_After_Startup S1069_Startup /end SUB_GROUP /begin REF_MEASUREMENT SOC_stBatterySocJump /end REF_MEASUREMENT /end GROUP
/begin GROUP S970_Replace_Invalid_CellTemperature "VBU0428Test/VBUSystem/BMS/SOC/Subsystem5/Subsystem/Determine_OcvSoc/Replace_Invalid_CellTemperature" /begin SUB_GROUP S1093_Calculate_Cell_Temperature /end SUB_GROUP /end GROUP
/begin GROUP S971_Current_Limit_Condition "VBU0428Test/VBUSystem/BMS/SOC/Subsystem5/Subsystem/Determine_ShortTimeCorrection_Condition/Current_Limit_Condition" /begin SUB_GROUP S1097_Current_Limit /end SUB_GROUP /end GROUP
/begin GROUP S974_Data_Storage "VBU0428Test/VBUSystem/BMS/SOC/Subsystem5/Subsystem/Soc_Data_Storage/Data_Storage"
 /begin REF_CHARACTERISTIC CbSOC_BatterySOCOvrdFlg_flg CcSOC_BatteryDisplaySocUpdateDelta_pct CcSOC_BatterySOCOvrdVal_pct CcSOC_BatterySocUpdateDelta_pct CcSOC_CellSocMaxOverrunLimit_pct CcSOC_CellSocMinOverrunLimit_pct /end REF_CHARACTERISTIC
/end GROUP
/begin GROUP S1119_Determine_History_Current_Data "VBU0428Test/VBUSystem/BMS/SOE/Subsystem2/Subsystem/Calculate_History_Average_Current/Determine_History_Current_Data"
 /begin REF_CHARACTERISTIC CaSOE_InvalidHistoryCurrentData_A CcSOE_HistoryAveCurrentTimeIntervalNumber_n CcSOE_HistoryAveCurrentTotalTime_s CcSOE_HistoryCurrentDataDimension_n /end REF_CHARACTERISTIC
/end GROUP
/begin GROUP S1119_Time_Counter "VBU0428Test/VBUSystem/BMS/SOE/Subsystem2/Subsystem/Calculate_History_Average_Current/Time_Counter"
 /begin REF_CHARACTERISTIC CcSOE_HistoryAveCurrentTimeIntervalNumber_n CcSOE_HistoryAveCurrentTotalTime_s /end REF_CHARACTERISTIC
/end GROUP
/begin GROUP S1120_Charge_and_Idle_Mode "VBU0428Test/VBUSystem/BMS/SOE/Subsystem2/Subsystem/Calculate_Pack_Remaining_Energy/Charge_and_Idle_Mode" /begin REF_CHARACTERISTIC CcSOE_CellEnergyBoL_Kwh /end REF_CHARACTERISTIC /end GROUP
/begin GROUP S1120_Discharge_Mode "VBU0428Test/VBUSystem/BMS/SOE/Subsystem2/Subsystem/Calculate_Pack_Remaining_Energy/Discharge_Mode"
 /begin SUB_GROUP S1131_Calculate_Energy_Retention_Factor S1131_Calculate_Remaining_Energy S1131_Predict_SOC_End /end SUB_GROUP
 /begin REF_CHARACTERISTIC CcSOE_CellSocDelta_pct CcSOE_CellSocEndPredictUpperLimit_pct /end REF_CHARACTERISTIC
/end GROUP
/begin GROUP S1123_Rate_Limiter_Reset1 "VBU0428Test/VBUSystem/BMS/SOE/Subsystem2/Subsystem/Rate_Limit_and_Output_SOC/Rate_Limiter_Reset1" /begin REF_MEASUREMENT SOE_kwhPackRemainingEnergySoc /end REF_MEASUREMENT /end GROUP
/begin GROUP S1172_Calculate_Pack_OCV "VBU0428Test/VBUSystem/BMS/SOF/Subsystem6/Subsystem/Calculate_PowerLimit/Calculate_Pack_OCV" /begin SUB_GROUP S1178_Calculate_Locked_SOC S1178_Rate_Limiter /end SUB_GROUP
 /begin REF_CHARACTERISTIC CaSOF_mvChargeOcvSocTempMap_v CaSOF_mvDischargeOcvSocTempMap_v CcSOF_DischargeOCVInLowSOCforPowerLimit_V CcSOF_PowerOnDiscOcvSloDelay_ms CcSOF_SOCLowValueForConstantOCV_pct /end REF_CHARACTERISTIC
 /begin REF_MEASUREMENT SOF_uPackChargeOcv SOF_uPackDischargeOcv /end REF_MEASUREMENT
/end GROUP
/begin GROUP S1172_Determine_Capacity_Cycle_PowerLimit "VBU0428Test/VBUSystem/BMS/SOF/Subsystem6/Subsystem/Calculate_PowerLimit/Determine_Capacity_Cycle_PowerLimit"
 /begin SUB_GROUP S1179_Power_Limit_Cycle_Level1 S1179_Power_Limit_Cycle_Level2 S1179_Power_Limit_Cycle_Level3 /end SUB_GROUP
 /begin REF_CHARACTERISTIC CcSOF_BatteryCycleLevel1_n CcSOF_BatteryCycleLevel2_n /end REF_CHARACTERISTIC
 /begin REF_MEASUREMENT LcSOF_kwChargePowerLimitCycle /end REF_MEASUREMENT
/end GROUP
/begin GROUP S1172_Determine_SOCP_PowerLimit "VBU0428Test/VBUSystem/BMS/SOF/Subsystem6/Subsystem/Calculate_PowerLimit/Determine_SOCP_PowerLimit"
 /begin SUB_GROUP S1180_Calculate_Locked_SOC S1180_Determine_ContinuousDischargePowerLimitTarget S1180_Determine_DischargePowerLimitTarget /end SUB_GROUP
 /begin REF_CHARACTERISTIC CaSOF_SocpDischargeSocMinMapY_pct /end REF_CHARACTERISTIC
/end GROUP
/begin GROUP S1174_Calculate_CurrentLimit_Target "VBU0428Test/VBUSystem/BMS/SOF/Subsystem6/Subsystem/Determine_Currentlimit_Target/Calculate_CurrentLimit_Target"
 /begin SUB_GROUP S1210_Calculate_CurrentLimit_Base S1210_Calculate_Dynamic_CurrentLimit S1210_CurrentLimit_FastCharge_Check S1210_CurrentLimit_Fault_Correct S1210_CurrentLimit_Voltage_Correct /end SUB_GROUP
/end GROUP
/begin GROUP S1174_Determine_CurrentLimitTarget_Enable "VBU0428Test/VBUSystem/BMS/SOF/Subsystem6/Subsystem/Determine_Currentlimit_Target/Determine_CurrentLimitTarget_Enable" /begin REF_MEASUREMENT SOF_flgCurrentLimitTargetCalculateEnable /end REF_MEASUREMENT /end GROUP
/begin GROUP S1398_Calculate_CellCapacity "VBU0428Test/VBUSystem/BMS/SOH/Subsystem4/Subsystem1/Calculate_Capacity/Calculate_CellCapacity"
 /begin SUB_GROUP S1404_Caculate_CellCapacity_LifeTimeQ S1404_CellCapacity_Limit S1404_Determine_CellCapacity S1404_Determine_PackSoh S1404_PackSoh_Storage /end SUB_GROUP
/end GROUP
/begin GROUP S1398_Calculate_CellCapacity_SlowCharge "VBU0428Test/VBUSystem/BMS/SOH/Subsystem4/Subsystem1/Calculate_Capacity/Calculate_CellCapacity_SlowCharge"
 /begin SUB_GROUP S1405_Caculate_CellCapacity S1405_Determine_AhIntegral_DeltaQ S1405_Determine_Soc S1405_Determine_SocEndandCondition S1405_Determine_SocStart /end SUB_GROUP
/end GROUP
/begin GROUP S1398_Calculate_MinCellCapacity274_SlowCharge "VBU0428Test/VBUSystem/BMS/SOH/Subsystem4/Subsystem1/Calculate_Capacity/Calculate_MinCellCapacity274_SlowCharge" /begin REF_CHARACTERISTIC CcSOH_NotCalculatedSoh_pct /end REF_CHARACTERISTIC /end GROUP
/begin GROUP S1398_Determine_CalculateCellCapacity_Condition "VBU0428Test/VBUSystem/BMS/SOH/Subsystem4/Subsystem1/Calculate_Capacity/Determine_CalculateCellCapacity_Condition"
 /begin SUB_GROUP S1407_Determine_SlowCharge S1407_Determine_SlowChargeEnd S1407_Determine_SlowChargeStart /end SUB_GROUP
/end GROUP
/begin GROUP S1399_BasicCellResistance_Calculation_Check "VBU0428Test/VBUSystem/BMS/SOH/Subsystem4/Subsystem1/Calculate_Resistance/BasicCellResistance_Calculation_Check"
 /begin SUB_GROUP S1473_BeforStep_DuringStep_AfterStep_Check S1473_ResistanceCalc_Check /end SUB_GROUP
/end GROUP
/begin GROUP S1399_Caculate_CellResistance "VBU0428Test/VBUSystem/BMS/SOH/Subsystem4/Subsystem1/Calculate_Resistance/Caculate_CellResistance" /begin REF_CHARACTERISTIC CcSOH_ResistanceBase_mohm /end REF_CHARACTERISTIC /end GROUP
/begin GROUP S1399_Calculate_ModuleCurrent "VBU0428Test/VBUSystem/BMS/SOH/Subsystem4/Subsystem1/Calculate_Resistance/Calculate_ModuleCurrent" /begin SUB_GROUP S1475_CONTACTOR_STATUS_CLOSED /end SUB_GROUP /end GROUP
/begin GROUP S1399_Calculate_Relaxation_Average_CurrentVoltage "VBU0428Test/VBUSystem/BMS/SOH/Subsystem4/Subsystem1/Calculate_Resistance/Calculate_Relaxation_Average_CurrentVoltage" /begin SUB_GROUP S1476_CalCurrent_Data_BeforeStep /end SUB_GROUP /end GROUP
/begin GROUP S1399_Compute_Resistance_Request "VBU0428Test/VBUSystem/BMS/SOH/Subsystem4/Subsystem1/Calculate_Resistance/Compute_Resistance_Request"
 /begin REF_CHARACTERISTIC CbSOH_ComputeResistanceRequestORF_flg CbSOH_ComputeResistanceRequestORV_flg CcSOH_CellResistanceIncRatioUpdateTime_s CcSOH_ComputeResistanceUpdateCycle_n CcSOH_FastChargeFactor_n /end REF_CHARACTERISTIC
/end GROUP
/begin GROUP S1399_Determine_Condition_Calculate_Pulse_Average_CurrentVoltage "VBU0428Test/VBUSystem/BMS/SOH/Subsystem4/Subsystem1/Calculate_Resistance/Determine_Condition_Calculate_Pulse_Average_CurrentVoltage"
 /begin SUB_GROUP S1480_Calculate_Pulse_Average_CurrentVoltage S1480_Determine_Condition /end SUB_GROUP
/end GROUP
/begin GROUP S1402_CellCapacity_Diagnostic "VBU0428Test/VBUSystem/BMS/SOH/Subsystem4/Subsystem1/SOH_Diagnositic/CellCapacity_Diagnostic"
 /begin REF_CHARACTERISTIC CbSOH_CellCapacityLowFaultEnable_flg CbSOH_CellCapacityOverDeviationFaultEnable_flg CcSOH_CellCapacityLowFaultFIC_n CcSOH_CellCapacityLowFaultPIC_n CcSOH_CellCapacityLowFault_pct CcSOH_CellCapacityOverDeviationFaultFIC_n CcSOH_CellCapacityOverDeviationFaultPIC_n CcSOH_CellCapacityOverDeviationFault_Ah SOH_CELL_CAPACITY_LOW_FAULT SOH_CELL_CAPACITY_OVER_DEVIATION_FAULT /end REF_CHARACTERISTIC
/end GROUP
/begin GROUP S1402_CellResistanceIncRto_Diagnostic "VBU0428Test/VBUSystem/BMS/SOH/Subsystem4/Subsystem1/SOH_Diagnositic/CellResistanceIncRto_Diagnostic"
 /begin REF_CHARACTERISTIC CbSOH_CellResistanceHighFaultEnable_flg CcSOH_CellResistanceHighFaultFIC_n CcSOH_CellResistanceHighFaultPIC_n CcSOH_CellResistanceHighFault_pct SOH_CELL_RESISTANCE_HIGH_FAULT /end REF_CHARACTERISTIC
/end GROUP
/begin GROUP S1402_Monitor_SOH_Performance "VBU0428Test/VBUSystem/BMS/SOH/Subsystem4/Subsystem1/SOH_Diagnositic/Monitor_SOH_Performance" /begin REF_CHARACTERISTIC CcSOH_BDMOutputDelayTime_ms /end REF_CHARACTERISTIC /end GROUP
/begin GROUP S1529_Determine_CoolantSensorTemp_Validation "VBU0428Test/VBUSystem/BMS/THM/Subsystem/Subsystem/Calculate_PipeTemperature/Determine_CoolantSensorTemp_Validation"
 /begin SUB_GROUP S1539_Determine_InletTemp_Validation S1539_Determine_OutletTemp_Validation /end SUB_GROUP
 /begin REF_MEASUREMENT THM_tInletCoolantTemp THM_tOutletCoolantTemp /end REF_MEASUREMENT
/end GROUP
/begin GROUP S1530_FCC_Temp_Request "VBU0428Test/VBUSystem/BMS/THM/Subsystem/Subsystem/Charge_Mode_Temp_Request/FCC_Temp_Request"
 /begin REF_CHARACTERISTIC CaTHM_FccHighSocRequestTempMapZ_C CaTHM_FccSohFactorMapY_n CcTHM_ChargeTempRequestHighThreshold_C CcTHM_FccChargeTempRequestLowThreshold_C CcTHM_FccSohTempLowThreshold_C CcTHM_PackSohORF_flg CcTHM_PackSohORV_pct /end REF_CHARACTERISTIC
/end GROUP
/begin GROUP S1530_Invaild_Temp_Request "VBU0428Test/VBUSystem/BMS/THM/Subsystem/Subsystem/Charge_Mode_Temp_Request/Invaild_Temp_Request" /begin REF_CHARACTERISTIC CcTHM_InvaildTempRequest_C /end REF_CHARACTERISTIC /end GROUP
/begin GROUP S1530_OBC_Temp_Request "VBU0428Test/VBUSystem/BMS/THM/Subsystem/Subsystem/Charge_Mode_Temp_Request/OBC_Temp_Request" /begin SUB_GROUP S1551_Normal_Condition /end SUB_GROUP /end GROUP
/begin GROUP S1537_Delay_FallingEdge "VBU0428Test/VBUSystem/BMS/THM/Subsystem/Subsystem/Thermal_System_Damage_Judgement/Delay_FallingEdge" /begin REF_MEASUREMENT THM_flgSystemCoolingAbilityDecrease /end REF_MEASUREMENT /end GROUP
/begin GROUP S1538_FCC_Temp_Valid "VBU0428Test/VBUSystem/BMS/THM/Subsystem/Subsystem/Valid_Condition_Determination/FCC_Temp_Valid"
 /begin SUB_GROUP S1592_SOC_Hysteretic_Determination S1592_Temp_Hysteretic_Determination /end SUB_GROUP
/end GROUP
/begin GROUP S1538_OBC_Temp_Valid "VBU0428Test/VBUSystem/BMS/THM/Subsystem/Subsystem/Valid_Condition_Determination/OBC_Temp_Valid"
 /begin SUB_GROUP S1594_Hysteretic_Determination S1594_SOC_Hysteretic_Determination /end SUB_GROUP
/end GROUP
/begin GROUP S1603_Override "VBU0428Test/VBUSystem/BMS/VCT/Subsystem/Subsystem/Determine_BMS_VCU_267/Override"
 /begin SUB_GROUP S1619_LOW_HIGH1 S1619_LOW_HIGH17 S1619_LOW_HIGH2 S1619_LOW_HIGH3 S1619_LOW_HIGH4 S1619_LOW_HIGH5 S1619_LOW_HIGH7 /end SUB_GROUP
 /begin REF_CHARACTERISTIC CbVCT_BMSChgCurrentLimitORF_flg CbVCT_BMSDCChrgCrntReqORF_flg CbVCT_BMSDCChrgVoltageReqORF_flg CbVCT_BMSPackEnergyAvailableORF_flg CbVCT_CTMCellThermalRunawayORF_flg CbVCT_CTMCellThermalRunawayValidORF_flg CbVCT_CTMCellThermalRunawayValidORV_flg CbVCT_DCChargeModeORF_flg CcVCT_BMSChgCurrentLimitORV_A CcVCT_BMSDCChrgCrntReqORV_A CcVCT_BMSDCChrgVoltageReqORV_V CcVCT_BMSPackEnergyAvailableORV_Kwh CeVCT_CTMCellThermalRunawayORV_enum CeVCT_DCChargeModeORV_enum /end REF_CHARACTERISTIC
/end GROUP
/begin GROUP S1604_Override "VBU0428Test/VBUSystem/BMS/VCT/Subsystem/Subsystem/Determine_BMS_VCU_268/Override"
 /begin SUB_GROUP S1628_LOW_HIGH1 S1628_LOW_HIGH14 S1628_LOW_HIGH2 S1628_LOW_HIGH3 /end SUB_GROUP
 /begin REF_CHARACTERISTIC CbVCT_BMSDischgPowerLimitDynamicORF_flg CbVCT_BMSDischgPowerLimitLTORF_flg CbVCT_BMSDischgPowerLimitSTORF_flg CbVCT_BMSInsulationResistanceValueORF_flg CcVCT_BMSDischgPowerLimitDynamicORV_Kw CcVCT_BMSDischgPowerLimitLTIORV_Kw CcVCT_BMSDischgPowerLimitSTORV_Kw CcVCT_BMSInsulationResistanceValueORV_Kohm /end REF_CHARACTERISTIC
/end GROUP
/begin GROUP S1605_Override "VBU0428Test/VBUSystem/BMS/VCT/Subsystem/Subsystem/Determine_BMS_VCU_269/Override"
 /begin SUB_GROUP S1636_LOW_HIGH1 S1636_LOW_HIGH17 S1636_LOW_HIGH2 S1636_LOW_HIGH3 S1636_LOW_HIGH4 S1636_LOW_HIGH5 S1636_LOW_HIGH6 /end SUB_GROUP
 /begin REF_CHARACTERISTIC CbVCT_BMSCellVoltageAveORF_flg CbVCT_BMSCellVoltageAveValidityORF_flg CbVCT_BMSCellVoltageAveValidityORV_flg CbVCT_BMSCellVoltageMaxORF_flg CbVCT_BMSCellVoltageMaxValidityORF_flg CbVCT_BMSCellVoltageMaxValidityORV_flg CbVCT_BMSCellVoltageMinORF_flg CbVCT_BMSCellVoltageMinValidityORF_flg CbVCT_BMSCellVoltageMinValidityORV_flg CbVCT_BMSEstimateChargingTimeORF_flg CcVCT_BMSCellVoltageAveORV_V CcVCT_BMSCellVoltageMaxORV_V CcVCT_BMSCellVoltageMinORV_V CcVCT_BMSEstimateChargingTimeORV_min /end REF_CHARACTERISTIC
/end GROUP
/begin GROUP S1606_Override "VBU0428Test/VBUSystem/BMS/VCT/Subsystem/Subsystem/Determine_BMS_VCU_26A/Override"
 /begin SUB_GROUP S1644_LOW_HIGH1 S1644_LOW_HIGH14 S1644_LOW_HIGH2 S1644_LOW_HIGH3 /end SUB_GROUP
 /begin REF_CHARACTERISTIC CbVCT_BMSChgPowerLimitDynamicORF_flg CbVCT_BMSChgPowerLimitLTORF_flg CbVCT_BMSChgPowerLimitSTORF_flg CbVCT_EstimatePercTimeORF_flg CcVCT_BMSChgPowerLimitDynamicORV_Kw CcVCT_BMSChgPowerLimitLTORV_Kw CcVCT_BMSChgPowerLimitSTORV_Kw CcVCT_EstimatePercTimeORV_min /end REF_CHARACTERISTIC
/end GROUP
/begin GROUP S1607_Override "VBU0428Test/VBUSystem/BMS/VCT/Subsystem/Subsystem/Determine_BMS_VCU_26F/Override"
 /begin SUB_GROUP S1649_LOW_HIGH1 S1649_LOW_HIGH14 S1649_LOW_HIGH2 S1649_LOW_HIGH3 /end SUB_GROUP
 /begin REF_CHARACTERISTIC CbVCT_BMSBatteryRatedCapacityORF_flg CbVCT_BMSBatteryTypeORF_flg CbVCT_BMSMaxPermitDCChargeVoltageORF_flg CbVCT_BMSProtocalVersionORF_flg CcVCT_BMSBatteryRatedCapacityORV_Ah CcVCT_BMSMaxPermitDCChargeVoltageORV_V CcVCT_BMSProtocalVersionORV_n CeVCT_BMSBatteryTypeORV_enum /end REF_CHARACTERISTIC
/end GROUP
/begin GROUP S1608_Override "VBU0428Test/VBUSystem/BMS/VCT/Subsystem/Subsystem/Determine_BMS_VCU_270/Override"
 /begin SUB_GROUP S1655_LOW_HIGH1 S1655_LOW_HIGH14 S1655_LOW_HIGH2 S1655_LOW_HIGH3 /end SUB_GROUP
 /begin REF_CHARACTERISTIC CbVCT_BMSBatteryRatedVoltageORF_flg CbVCT_BMSDCChargingCurrentMeasurementORF_flg CbVCT_BMSDCChargingVoltageMeasurementORF_flg CbVCT_BMSReadyDCChargingORF_flg CcVCT_BMSBatteryRatedVoltageORV_V CcVCT_BMSDCChargingCurrentMeasurementORV_A CcVCT_BMSDCChargingVoltageMeasurementORV_V CcVCT_BMSReadyDCChargingORV_enum /end REF_CHARACTERISTIC
/end GROUP
/begin GROUP S1609_Override "VBU0428Test/VBUSystem/BMS/VCT/Subsystem/Subsystem/Determine_BMS_VCU_271/Override"
 /begin SUB_GROUP S1660_LOW_HIGH1 S1660_LOW_HIGH14 S1660_LOW_HIGH2 S1660_LOW_HIGH3 S1660_LOW_HIGH4 S1660_LOW_HIGH5 /end SUB_GROUP
 /begin REF_CHARACTERISTIC CbVCT_BMSDCChrgFinalSOCORF_flg CbVCT_BMSMaximumCellTempORF_flg CbVCT_BMSMaximumCellVoltageNumberORF_flg CbVCT_BMSMaximumTempNumberORF_flg CbVCT_BMSMinimumCellTempORF_flg CbVCT_BMSMinimumTempNumberORF_flg CcVCT_BMSDCChrgFinalSOCORV_pct CcVCT_BMSMaximumCellTempORV_C CcVCT_BMSMaximumCellVoltageNumberORV_n CcVCT_BMSMaximumTempNumberORV_n CcVCT_BMSMinimumCellTempORV_C CcVCT_BMSMinimumTempNumberORV_n /end REF_CHARACTERISTIC
/end GROUP
/begin GROUP S1610_Override "VBU0428Test/VBUSystem/BMS/VCT/Subsystem/Subsystem/Determine_BMS_VCU_272/Override"
 /begin SUB_GROUP S1668_LOW_HIGH1 S1668_LOW_HIGH10 S1668_LOW_HIGH11 S1668_LOW_HIGH12 S1668_LOW_HIGH13 S1668_LOW_HIGH14 S1668_LOW_HIGH16 S1668_LOW_HIGH17 S1668_LOW_HIGH18 S1668_LOW_HIGH2 S1668_LOW_HIGH3 S1668_LOW_HIGH4 S1668_LOW_HIGH5 S1668_LOW_HIGH6 S1668_LOW_HIGH7 S1668_LOW_HIGH8 S1668_LOW_HIGH9 /end SUB_GROUP
 /begin REF_CHARACTERISTIC CbVCT_BMSCellVoltageOverUnderORF_flg CbVCT_BMSDCChargeCurrentOverUnderORF_flg CbVCT_BMSSOCOverUnderORF_flg CbVCT_BatteryAbnormalAlarm1ORF_flg CbVCT_BatteryAbnormalAlarm1ORV_flg CbVCT_BatteryAbnormalAlarm2ORF_flg CbVCT_BatteryAbnormalAlarm2ORV_flg CbVCT_BatteryAbnormalAlarm3ORF_flg CbVCT_BatteryAbnormalAlarm3ORV_flg CbVCT_BatteryConsistencyAlarmORF_flg CbVCT_BatteryOutputConnectorStateORF_flg CbVCT_BatteryTempDifferAlarmORF_flg CbVCT_BatteryTempOverORF_flg CbVCT_BatteryTypeDismatchAlarmORF_flg CbVCT_BetteryCellTempHighAlarmORF_flg CbVCT_BetteryCellTempLowAlarmORF_flg CbVCT_BetteryCellVolHighAlarmORF_flg CbVCT_BetteryCellVolLowAlarmORF_flg CbVCT_BetteryPckVoltOverAlarmORF_flg CbVCT_BetteryPckVoltUnderAlarmORF_flg CbVCT_CTDMnNegContactorWeldORF_flg CbVCT_CTDMnPosContactorWeldORF_flg CbVCT_CTDPrechargeEnergyHighORF_flg CbVCT_CTDPrechargeRelayBlownORF_flg CbVCT_CTDPrechargeRelayStuckOpenORF_flg CbVCT_CTDPrechargeTimeoutORF_flg CbVCT_DCChargingPermitStatusORF_flg CbVCT_SOCJumpAlarmORF_flg CbVCT_SOCJumpReasonORF_flg CeVCT_BMSCellVoltageOverUnderORV_enum CeVCT_BMSDCChargeCurrentOverUnderORV_enum CeVCT_BMSSOCOverUnderORV_enum CeVCT_BatteryConsistencyAlarmORV_enum CeVCT_BatteryOutputConnectorStateORV_enum CeVCT_BatteryTempDifferAlarmORV_enum CeVCT_BatteryTempOverORV_enum CeVCT_BatteryTypeDismatchAlarmORV_enum CeVCT_BetteryCellTempHighAlarmORV_enum CeVCT_BetteryCellTempLowAlarmORV_enum CeVCT_BetteryCellVolHighAlarmORV_enum CeVCT_BetteryCellVolLowAlarmORV_enum CeVCT_BetteryPckVoltOverAlarmORV_enum CeVCT_BetteryPckVoltUnderAlarmORV_enum CeVCT_CTDMnNegContactorWeldORV_enum CeVCT_CTDMnPosContactorWeldORV_enum CeVCT_CTDPrechargeEnergyHighORV_enum CeVCT_CTDPrechargeRelayBlownORV_enum CeVCT_CTDPrechargeRelayStuckOpenORV_enum CeVCT_CTDPrechargeTimeoutORV_enum CeVCT_DCChargingPermitStatusORV_enum CeVCT_SOCJumpAlarmORV_enum CeVCT_SOCJumpReasonORV_enum /end REF_CHARACTERISTIC
 /begin REF_MEASUREMENT VCT_stBatteryAbnormalAlarm1 VCT_stBatteryAbnormalAlarm2 VCT_stBatteryAbnormalAlarm3 VCT_stCTDMnNegContactorWeld VCT_stCTDMnPosContactorWeld VCT_stCTDPrechargeEnergyHigh VCT_stCTDPrechargeRelayBlown VCT_stCTDPrechargeRelayStuckOpen VCT_stCTDPrechargeTimeout /end REF_MEASUREMENT
/end GROUP
/begin GROUP S1611_Override "VBU0428Test/VBUSystem/BMS/VCT/Subsystem/Subsystem/Determine_BMS_VCU_273/Override"
 /begin SUB_GROUP S1713_LOW_HIGH1 S1713_LOW_HIGH2 S1713_LOW_HIGH3 S1713_LOW_HIGH4 S1713_LOW_HIGH5 /end SUB_GROUP
 /begin REF_CHARACTERISTIC CbVCT_BMSMaxTempSubSysNumberORF_flg CbVCT_BMSMaxVoltageSubSysNumberORF_flg CbVCT_BMSMinTempSubSysNumberORF_flg CbVCT_BMSMinVoltageSubSysNumberORF_flg CbVCT_BMSMinimumCellVoltageNumberORF_flg CcVCT_BMSMaxTempSubSysNumberORV_n CcVCT_BMSMaxVoltageSubSysNumberORV_n CcVCT_BMSMinTempSubSysNumberORV_n CcVCT_BMSMinVoltageSubSysNumberORV_n CcVCT_BMSMinimumCellVoltageNumberORV_n /end REF_CHARACTERISTIC
/end GROUP
/begin GROUP S1612_Override "VBU0428Test/VBUSystem/BMS/VCT/Subsystem/Subsystem/Determine_BMS_VCU_34/Override"
 /begin SUB_GROUP S1724_LOW_HIGH1 S1724_LOW_HIGH2 S1724_LOW_HIGH3 S1724_LOW_HIGH5 /end SUB_GROUP
 /begin REF_CHARACTERISTIC CbVCT_AbortPrechargeCauseORF_flg CbVCT_BMSBMSRollingCounterORF_flg CbVCT_BMSContactorStateORF_flg CbVCT_BMSStsORF_flg CbVCT_InhibitPrechargeCauseORF_flg CeVCT_AbortPrechargeCauseORV_enum CeVCT_BMSBMSRollingCounterORV_enum CeVCT_BMSContactorStateORV_enum CeVCT_BMSStsORV_enum CeVCT_InhibitPrechargeCauseORV_enum /end REF_CHARACTERISTIC
/end GROUP
/begin GROUP S1613_Override "VBU0428Test/VBUSystem/BMS/VCT/Subsystem/Subsystem/Determine_BMS_VCU_372/Override"
 /begin SUB_GROUP S1730_LOW_HIGH1 S1730_LOW_HIGH16 S1730_LOW_HIGH2 S1730_LOW_HIGH3 S1730_LOW_HIGH4 /end SUB_GROUP
 /begin REF_CHARACTERISTIC CbVCT_BatteryNomalCapacityORF_flg CbVCT_HVBattStopDchaThdORF_flg CbVCT_MaximumChargingCurrentORF_flg CbVCT_MaximumChargingVoltageORF_flg CbVCT_MaximumPermitTempORF_flg CcVCT_BatteryNomalCapacityORV_Kwh CcVCT_HVBattStopDchaThdORV_pct CcVCT_MaximumChargingCurrentORV_A CcVCT_MaximumChargingVoltageORV_V CcVCT_MaximumPermitTempORV_C /end REF_CHARACTERISTIC
/end GROUP
/begin GROUP S1614_Override "VBU0428Test/VBUSystem/BMS/VCT/Subsystem/Subsystem/Determine_BMS_VCU_373/Override"
 /begin SUB_GROUP S1739_LOW_HIGH1 S1739_LOW_HIGH10 S1739_LOW_HIGH11 S1739_LOW_HIGH12 S1739_LOW_HIGH13 S1739_LOW_HIGH14 S1739_LOW_HIGH15 S1739_LOW_HIGH17 S1739_LOW_HIGH2 S1739_LOW_HIGH3 S1739_LOW_HIGH4 S1739_LOW_HIGH5 S1739_LOW_HIGH6 S1739_LOW_HIGH7 S1739_LOW_HIGH8 S1739_LOW_HIGH9 /end SUB_GROUP
 /begin REF_CHARACTERISTIC CbVCT_BMSCellTempStandardDeviationORF_flg CbVCT_BMSESSInletTempMaskORF_flg CbVCT_BMSESSInletTempMaskORV_flg CbVCT_BMSESSInletTempValidityORF_flg CbVCT_BMSESSInletTempValidityORV_flg CbVCT_BMSESSOutletTempMaskORF_flg CbVCT_BMSESSOutletTempMaskORV_flg CbVCT_BMSESSOutletTempValidityORF_flg CbVCT_BMSESSOutletTempValidityORV_flg CbVCT_BMSHVShutdownReqORF_flg CbVCT_BMSHVShutdownReqORV_flg CbVCT_BMSInletTempRequestORF_flg CbVCT_BMSInletWaterTempORF_flg CbVCT_BMSOutletWaterTempORF_flg CbVCT_BMSTempAverageValidityORF_flg CbVCT_BMSTempAverageValidityORV_flg CbVCT_BMSTempMaxValidityORF_flg CbVCT_BMSTempMaxValidityORV_flg CbVCT_BMSTempMinValidityORF_flg CbVCT_BMSTempMinValidityORV_flg CbVCT_BMSTempRequestValidORF_flg CbVCT_BMSTempRequestValidORV_flg CbVCT_BMSTemperatureAverageORF_flg CbVCT_BMSTemperatureMaxORF_flg CcVCT_BMSCellTempStandardDeviationORV_C CcVCT_BMSInletTempRequestORV_C CcVCT_BMSInletWaterTempORV_C CcVCT_BMSOutletWaterTempORV_C CcVCT_BMSTemperatureAverageORV_C CcVCT_BMSTemperatureMaxORV_C CcVCT_BMSTemperatureMinORF_flg CcVCT_BMSTemperatureMinORV_C /end REF_CHARACTERISTIC
/end GROUP
/begin GROUP S1615_Override "VBU0428Test/VBUSystem/BMS/VCT/Subsystem/Subsystem/Determine_BMS_VCU_AC/Override"
 /begin SUB_GROUP S1758_LOW_HIGH1 S1758_LOW_HIGH10 S1758_LOW_HIGH17 S1758_LOW_HIGH2 S1758_LOW_HIGH3 S1758_LOW_HIGH4 S1758_LOW_HIGH5 S1758_LOW_HIGH7 S1758_LOW_HIGH8 S1758_LOW_HIGH9 /end SUB_GROUP
 /begin REF_CHARACTERISTIC CbVCT_BMSCustomerUsageSOCORF_flg CbVCT_BMSFaultCatORF_flg CbVCT_BMSFaultLvlORF_flg CbVCT_BMSPackCrntORF_flg CbVCT_BMSPackVoltageORF_flg CbVCT_BMSRollingCounter225ORF_flg CbVCT_BMSSOCORF_flg CbVCT_ChargeAvailableORF_flg CbVCT_ChargeAvailableORV_flg CbVCT_HVBattSOCLowCritORF_flg CbVCT_HVBattSOCLowCritORV_flg CbVCT_HVBattSOCLowWarnORF_flg CbVCT_HVBattSOCLowWarnORV_flg CcVCT_BMSCustomerUsageSOCORV_pct CcVCT_BMSPackCrntORV_A CcVCT_BMSPackVoltageORV_V CcVCT_BMSRollingCounter225ORV_n CcVCT_BMSSOCORV_pct CeVCT_BMSFaultCatORV_enum CeVCT_BMSFaultLvlORV_enum /end REF_CHARACTERISTIC
/end GROUP
/begin GROUP S1616_Override "VBU0428Test/VBUSystem/BMS/VCT/Subsystem/Subsystem/Determine_BMS_VCU_AD/Override"
 /begin SUB_GROUP S1771_LOW_HIGH17 S1771_LOW_HIGH2 S1771_LOW_HIGH3 S1771_LOW_HIGH4 S1771_LOW_HIGH5 S1771_LOW_HIGH6 S1771_LOW_HIGH7 /end SUB_GROUP
 /begin REF_CHARACTERISTIC CbVCT_BMSBalanceStatusORF_flg CbVCT_BMSChargeStateORF_flg CbVCT_BMSDischgCurrentLimitORF_flg CbVCT_BMSInterlockStatusORF_flg CbVCT_BMSIsolationLevelORF_flg CbVCT_BMSVoltageLimitMaxORF_flg CbVCT_BMSVoltageLimitMinORF_flg CbVCT_ChargeCurrentDerateORF_flg CbVCT_ChargeCurrentDerateORV_flg CcVCT_BMSDischgCurrentLimitORV_A CcVCT_BMSVoltageLimitMaxORV_V CcVCT_BMSVoltageLimitMinORV_V CeVCT_BMSBalanceStatusORV_enum CeVCT_BMSChargeStateORV_enum CeVCT_BMSInterlockStatusORV_enum CeVCT_BMSIsolationLevelORV_enum /end REF_CHARACTERISTIC
/end GROUP
/begin GROUP S1617_Override "VBU0428Test/VBUSystem/BMS/VCT/Subsystem/Subsystem/Determine_BMS_VCU_AE/Override"
 /begin SUB_GROUP S1783_LOW_HIGH1 S1783_LOW_HIGH10 S1783_LOW_HIGH11 S1783_LOW_HIGH12 S1783_LOW_HIGH17 S1783_LOW_HIGH2 S1783_LOW_HIGH3 S1783_LOW_HIGH4 S1783_LOW_HIGH5 S1783_LOW_HIGH6 S1783_LOW_HIGH7 S1783_LOW_HIGH8 S1783_LOW_HIGH9 /end SUB_GROUP
 /begin REF_CHARACTERISTIC CbVCT_BMSChrgConnErrorORF_flg CbVCT_BMSChrgConnOvertempORF_flg CbVCT_BMSConnectorOvertempORF_flg CbVCT_BMSHvConectorErrorORF_flg CbVCT_BMSHvIsolationORF_flg CbVCT_BMSIfBmsSocSetORF_flg CbVCT_BMSIfCellVoltageSetORF_flg CbVCT_BMSIfPackVoltageSetORF_flg CbVCT_BMSOtherErrorORF_flg CbVCT_BMSOverCurrentORF_flg CbVCT_BMSPackOverTempORF_flg CbVCT_BMSVolMismatchORF_flg CbVCT_MaximumPermitChargeCellVoltageORF_flg CcVCT_MaximumPermitChargeCellVoltageORV_V CeVCT_BMSChrgConnErrorORV_enum CeVCT_BMSChrgConnOvertempORV_enum CeVCT_BMSConnectorOvertempORV_enum CeVCT_BMSHvConectorErrorORV_enum CeVCT_BMSHvIsolationORV_enum CeVCT_BMSIfBmsSocSetORV_enum CeVCT_BMSIfCellVoltageSetORV_enum CeVCT_BMSIfPackVoltageSetORV_enum CeVCT_BMSOtherErrorORV_enum CeVCT_BMSOverCurrentORV_enum CeVCT_BMSPackOverTempORV_enum CeVCT_BMSVolMismatchORV_enum /end REF_CHARACTERISTIC
/end GROUP
/begin GROUP S2002_Input_CAN_Signal_No_Range_Check "VBU0428Test/VBUSystem/HALIn/PTCAN/Subsystem/20ms/ABS_0x068/Input_CAN_Signal_No_Range_Check" /begin REF_CHARACTERISTIC BCU_flgABSFailOvrdVal_C BCU_flgFlgABSFailOvrd_C /end REF_CHARACTERISTIC /end GROUP
/begin GROUP S2002_Input_CAN_Signal_No_Range_Check1 "VBU0428Test/VBUSystem/HALIn/PTCAN/Subsystem/20ms/ABS_0x068/Input_CAN_Signal_No_Range_Check1" /begin REF_CHARACTERISTIC BCU_flgEBDFailOvrdVal_C BCU_flgFlgEBDFailOvrd_C /end REF_CHARACTERISTIC /end GROUP
/begin GROUP S2002_Input_CAN_Signal_No_Range_Check2 "VBU0428Test/VBUSystem/HALIn/PTCAN/Subsystem/20ms/ABS_0x068/Input_CAN_Signal_No_Range_Check2" /begin REF_CHARACTERISTIC BCU_flgEBDActiveOvrdVal_C BCU_flgFlgEBDActiveOvrd_C /end REF_CHARACTERISTIC /end GROUP
/begin GROUP S2002_Input_CAN_Signal_No_Range_Check3 "VBU0428Test/VBUSystem/HALIn/PTCAN/Subsystem/20ms/ABS_0x068/Input_CAN_Signal_No_Range_Check3" /begin REF_CHARACTERISTIC BCU_flgABSActvOvrdVal_C BCU_flgFlgABSActvOvrd_C /end REF_CHARACTERISTIC /end GROUP
/begin GROUP S2002_Input_CAN_Signal_No_Range_Check4 "VBU0428Test/VBUSystem/HALIn/PTCAN/Subsystem/20ms/ABS_0x068/Input_CAN_Signal_No_Range_Check4" /begin REF_CHARACTERISTIC BCU_flgVVehicleSpeedOvrd_C BCU_vVehicleSpeedOvrdVal_C /end REF_CHARACTERISTIC /end GROUP
/begin GROUP S2002_Input_CAN_Signal_No_Range_Check5 "VBU0428Test/VBUSystem/HALIn/PTCAN/Subsystem/20ms/ABS_0x068/Input_CAN_Signal_No_Range_Check5"
 /begin REF_CHARACTERISTIC BCU_flgFlgVehicleSpeedValidOvrd_C BCU_flgVehicleSpeedValidOvrdVal_C /end REF_CHARACTERISTIC
/end GROUP
/begin GROUP S2003_Input_CAN_Signal_No_Range_Check "VBU0428Test/VBUSystem/HALIn/PTCAN/Subsystem/20ms/ABS_0x115/Input_CAN_Signal_No_Range_Check"
 /begin REF_CHARACTERISTIC BCU_cntFLWhlSpdPlusCntOvrdVal_C BCU_flgCntFLWhlSpdPlusCntOvrd_C /end REF_CHARACTERISTIC
/end GROUP
/begin GROUP S2003_Input_CAN_Signal_No_Range_Check1 "VBU0428Test/VBUSystem/HALIn/PTCAN/Subsystem/20ms/ABS_0x115/Input_CAN_Signal_No_Range_Check1"
 /begin REF_CHARACTERISTIC BCU_cntFRWhlSpdPlusCntOvrdVal_C BCU_flgCntFRWhlSpdPlusCntOvrd_C /end REF_CHARACTERISTIC
/end GROUP
/begin GROUP S2003_Input_CAN_Signal_No_Range_Check2 "VBU0428Test/VBUSystem/HALIn/PTCAN/Subsystem/20ms/ABS_0x115/Input_CAN_Signal_No_Range_Check2"
 /begin REF_CHARACTERISTIC BCU_flgFLWhlSpdPlusCntOvrdVal_C BCU_flgFlgFLWhlSpdPlusCntOvrd_C /end REF_CHARACTERISTIC
/end GROUP
/begin GROUP S2003_Input_CAN_Signal_No_Range_Check3 "VBU0428Test/VBUSystem/HALIn/PTCAN/Subsystem/20ms/ABS_0x115/Input_CAN_Signal_No_Range_Check3"
 /begin REF_CHARACTERISTIC BCU_flgFRWhlSpdPlusCntOvrdVal_C BCU_flgFlgFRWhlSpdPlusCntOvrd_C /end REF_CHARACTERISTIC
/end GROUP
/begin GROUP S2003_Input_CAN_Signal_No_Range_Check4 "VBU0428Test/VBUSystem/HALIn/PTCAN/Subsystem/20ms/ABS_0x115/Input_CAN_Signal_No_Range_Check4"
 /begin REF_CHARACTERISTIC BCU_cntRLWhlSpdPlusCntOvrdVal_C BCU_flgCntRLWhlSpdPlusCntOvrd_C /end REF_CHARACTERISTIC
/end GROUP
/begin GROUP S2003_Input_CAN_Signal_No_Range_Check5 "VBU0428Test/VBUSystem/HALIn/PTCAN/Subsystem/20ms/ABS_0x115/Input_CAN_Signal_No_Range_Check5"
 /begin REF_CHARACTERISTIC BCU_cntRRWhlSpdPlusCntOvrdVal_C BCU_flgCntRRWhlSpdPlusCntOvrd_C /end REF_CHARACTERISTIC
/end GROUP
/begin GROUP S2003_Input_CAN_Signal_No_Range_Check6 "VBU0428Test/VBUSystem/HALIn/PTCAN/Subsystem/20ms/ABS_0x115/Input_CAN_Signal_No_Range_Check6"
 /begin REF_CHARACTERISTIC BCU_flgFlgRLWhlSpdPlusCntOvrd_C BCU_flgRLWhlSpdPlusCntOvrdVal_C /end REF_CHARACTERISTIC
/end GROUP
/begin GROUP S2003_Input_CAN_Signal_No_Range_Check7 "VBU0428Test/VBUSystem/HALIn/PTCAN/Subsystem/20ms/ABS_0x115/Input_CAN_Signal_No_Range_Check7"
 /begin REF_CHARACTERISTIC BCU_flgFlgRRWhlSpdPlusCntOvrd_C BCU_flgRRWhlSpdPlusCntOvrdVal_C /end REF_CHARACTERISTIC
/end GROUP
/begin GROUP S2004_Input_CAN_Signal_No_Range_Check "VBU0428Test/VBUSystem/HALIn/PTCAN/Subsystem/20ms/ABS_0x75/Input_CAN_Signal_No_Range_Check" /begin REF_CHARACTERISTIC BCU_flgVWhlFLOvrd_C BCU_vWhlFLOvrdVal_C /end REF_CHARACTERISTIC /end GROUP
/begin GROUP S2004_Input_CAN_Signal_No_Range_Check1 "VBU0428Test/VBUSystem/HALIn/PTCAN/Subsystem/20ms/ABS_0x75/Input_CAN_Signal_No_Range_Check1" /begin REF_CHARACTERISTIC BCU_flgStWhlFLOvrd_C BCU_stWhlFLOvrdVal_C /end REF_CHARACTERISTIC /end GROUP
/begin GROUP S2004_Input_CAN_Signal_No_Range_Check2 "VBU0428Test/VBUSystem/HALIn/PTCAN/Subsystem/20ms/ABS_0x75/Input_CAN_Signal_No_Range_Check2" /begin REF_CHARACTERISTIC BCU_flgVWhlFROvrd_C BCU_vWhlFROvrdVal_C /end REF_CHARACTERISTIC /end GROUP
/begin GROUP S2004_Input_CAN_Signal_No_Range_Check3 "VBU0428Test/VBUSystem/HALIn/PTCAN/Subsystem/20ms/ABS_0x75/Input_CAN_Signal_No_Range_Check3" /begin REF_CHARACTERISTIC BCU_flgStWhlFROvrd_C BCU_stWhlFROvrdVal_C /end REF_CHARACTERISTIC /end GROUP
/begin GROUP S2005_Input_CAN_Signal_No_Range_Check "VBU0428Test/VBUSystem/HALIn/PTCAN/Subsystem/20ms/ABS_0x79/Input_CAN_Signal_No_Range_Check" /begin SUB_GROUP S2085_override_signal /end SUB_GROUP /begin REF_CHARACTERISTIC BCU_flgVWhlRLOvrd_C BCU_vWhlRLOvrdVal_C /end REF_CHARACTERISTIC /end GROUP
/begin GROUP S2005_Input_CAN_Signal_No_Range_Check1 "VBU0428Test/VBUSystem/HALIn/PTCAN/Subsystem/20ms/ABS_0x79/Input_CAN_Signal_No_Range_Check1" /begin REF_CHARACTERISTIC BCU_flgStWhlRLOvrd_C BCU_stWhlRLOvrdVal_C /end REF_CHARACTERISTIC /end GROUP
/begin GROUP S2005_Input_CAN_Signal_No_Range_Check2 "VBU0428Test/VBUSystem/HALIn/PTCAN/Subsystem/20ms/ABS_0x79/Input_CAN_Signal_No_Range_Check2" /begin SUB_GROUP S2087_override_signal /end SUB_GROUP /begin REF_CHARACTERISTIC BCU_flgVWhlRROvrd_C BCU_vWhlRROvrdVal_C /end REF_CHARACTERISTIC /end GROUP
/begin GROUP S2005_Input_CAN_Signal_No_Range_Check3 "VBU0428Test/VBUSystem/HALIn/PTCAN/Subsystem/20ms/ABS_0x79/Input_CAN_Signal_No_Range_Check3" /begin REF_CHARACTERISTIC BCU_flgStWhlRROvrd_C BCU_stWhlRROvrdVal_C /end REF_CHARACTERISTIC /end GROUP
/begin GROUP S2006_Input_CAN_Signal_No_Range_Check1 "VBU0428Test/VBUSystem/HALIn/PTCAN/Subsystem/20ms/EPB_0x80/Input_CAN_Signal_No_Range_Check1" /begin REF_CHARACTERISTIC EPB_flgStStateOvrd_C EPB_stStateOvrdVal_C /end REF_CHARACTERISTIC /end GROUP
/begin GROUP S2006_Input_CAN_Signal_No_Range_Check10 "VBU0428Test/VBUSystem/HALIn/PTCAN/Subsystem/20ms/EPB_0x80/Input_CAN_Signal_No_Range_Check10" /begin REF_CHARACTERISTIC EPB_flgStSwitchOvrd_C EPB_stSwitchOvrdVal_C /end REF_CHARACTERISTIC /end GROUP
/begin GROUP S2006_Input_CAN_Signal_No_Range_Check2 "VBU0428Test/VBUSystem/HALIn/PTCAN/Subsystem/20ms/EPB_0x80/Input_CAN_Signal_No_Range_Check2" /begin REF_CHARACTERISTIC EPB_flgFlgShutDownOvrd_C EPB_flgShutDownOvrdVal_C /end REF_CHARACTERISTIC /end GROUP
/begin GROUP S2006_Input_CAN_Signal_No_Range_Check3 "VBU0428Test/VBUSystem/HALIn/PTCAN/Subsystem/20ms/EPB_0x80/Input_CAN_Signal_No_Range_Check3" /begin REF_CHARACTERISTIC EPB_flgStParkLampOvrd_C EPB_stParkLampOvrdVal_C /end REF_CHARACTERISTIC /end GROUP
/begin GROUP S2006_Input_CAN_Signal_No_Range_Check4 "VBU0428Test/VBUSystem/HALIn/PTCAN/Subsystem/20ms/EPB_0x80/Input_CAN_Signal_No_Range_Check4" /begin REF_CHARACTERISTIC EPB_flgStFaultLevelOvrd_C EPB_stFaultLevelOvrdVal_C /end REF_CHARACTERISTIC /end GROUP
/begin GROUP S2006_Input_CAN_Signal_No_Range_Check5 "VBU0428Test/VBUSystem/HALIn/PTCAN/Subsystem/20ms/EPB_0x80/Input_CAN_Signal_No_Range_Check5" /begin REF_CHARACTERISTIC EPB_flgStCtlModeOvrd_C EPB_stCtlModeOvrdVal_C /end REF_CHARACTERISTIC /end GROUP
/begin GROUP S2006_Input_CAN_Signal_No_Range_Check6 "VBU0428Test/VBUSystem/HALIn/PTCAN/Subsystem/20ms/EPB_0x80/Input_CAN_Signal_No_Range_Check6" /begin REF_CHARACTERISTIC EPB_flgFrDragForceOvrd_C EPB_frDragForceOvrdVal_C /end REF_CHARACTERISTIC /end GROUP
/begin GROUP S2006_Input_CAN_Signal_No_Range_Check7 "VBU0428Test/VBUSystem/HALIn/PTCAN/Subsystem/20ms/EPB_0x80/Input_CAN_Signal_No_Range_Check7" /begin REF_CHARACTERISTIC EPB_flgFlgIGNOvrd_C EPB_flgIGNOvrdVal_C /end REF_CHARACTERISTIC /end GROUP
/begin GROUP S2006_Input_CAN_Signal_No_Range_Check9 "VBU0428Test/VBUSystem/HALIn/PTCAN/Subsystem/20ms/EPB_0x80/Input_CAN_Signal_No_Range_Check9" /begin REF_CHARACTERISTIC EPB_flgStSwitchFaultOvrd_C EPB_stSwitchFaultOvrdVal_C /end REF_CHARACTERISTIC /end GROUP
/begin GROUP S2007_Input_CAN_Signal_No_Range_Check1 "VBU0428Test/VBUSystem/HALIn/PTCAN/Subsystem/20ms/EPS_0x70/Input_CAN_Signal_No_Range_Check1" /begin REF_CHARACTERISTIC EPS_degStrngAgSpdOvrdVal_C EPS_flgDegStrngAgSpdOvrd_C /end REF_CHARACTERISTIC /end GROUP
/begin GROUP S2007_Input_CAN_Signal_No_Range_Check2 "VBU0428Test/VBUSystem/HALIn/PTCAN/Subsystem/20ms/EPS_0x70/Input_CAN_Signal_No_Range_Check2" /begin REF_CHARACTERISTIC EPS_flgTrqTrqStrngOvrd_C EPS_trqTrqStrngOvrdVal_C /end REF_CHARACTERISTIC /end GROUP
/begin GROUP S2007_Input_CAN_Signal_No_Range_Check3 "VBU0428Test/VBUSystem/HALIn/PTCAN/Subsystem/20ms/EPS_0x70/Input_CAN_Signal_No_Range_Check3" /begin REF_CHARACTERISTIC EPS_flgTrqTrqMotrOvrd_C EPS_trqTrqMotrOvrdVal_C /end REF_CHARACTERISTIC /end GROUP
/begin GROUP S2007_Input_CAN_Signal_No_Range_Check4 "VBU0428Test/VBUSystem/HALIn/PTCAN/Subsystem/20ms/EPS_0x70/Input_CAN_Signal_No_Range_Check4" /begin REF_CHARACTERISTIC EPS_flgStECUModeCntOvrd_C EPS_stECUModeCntOvrdVal_C /end REF_CHARACTERISTIC /end GROUP
/begin GROUP S387_Determine_Diagnostic_Status "VBU0428Test/VBUSystem/BMS/CTD/Subsystem/Subsystem4/DiagnoseRelayWeld/MNC_Weld_Check/Determine_Diagnostic_Status" /begin REF_CHARACTERISTIC CcFDC_MaxCount_n CcFDC_MinCount_n DIAGNOSTIC_ON_GOING /end REF_CHARACTERISTIC /end GROUP
/begin GROUP S388_Determine_Diagnostic_Status "VBU0428Test/VBUSystem/BMS/CTD/Subsystem/Subsystem4/DiagnoseRelayWeld/MPC_Weld_Check/Determine_Diagnostic_Status" /begin REF_CHARACTERISTIC CcFDC_MaxCount_n CcFDC_MinCount_n DIAGNOSTIC_ON_GOING /end REF_CHARACTERISTIC /end GROUP
/begin GROUP S456_Status_Charging "VBU0428Test/VBUSystem/BMS/CTD/Subsystem/Subsystem4/PrechrgProcessMonitoring/Precharging_Process_Monitoring/Status_Charging" /begin REF_CHARACTERISTIC CTD_PRECHARGE_STATUS_CHARGING /end REF_CHARACTERISTIC /end GROUP
/begin GROUP S478_Determine_Diagnostic_Status "VBU0428Test/VBUSystem/BMS/CTD/Subsystem/Subsystem4/Stuck_Open_Diagnostic/MPR_Stuck_Open/Determine_Diagnostic_Status" /begin REF_CHARACTERISTIC CcFDC_MaxCount_n CcFDC_MinCount_n DIAGNOSTIC_ON_GOING /end REF_CHARACTERISTIC /end GROUP
/begin GROUP S559_DetermineFault "VBU0428Test/VBUSystem/BMS/CTM/CTM/Subsystem/Determine_CellTemp_OverDeviationFaults/EVM_FDC_Handler1/DetermineFault" /begin REF_CHARACTERISTIC CcFDC_MaxCount_n CcFDC_MinCount_n /end REF_CHARACTERISTIC /end GROUP
/begin GROUP S559_DetermineFaultCounter "VBU0428Test/VBUSystem/BMS/CTM/CTM/Subsystem/Determine_CellTemp_OverDeviationFaults/EVM_FDC_Handler1/DetermineFaultCounter" /begin REF_CHARACTERISTIC CcFDC_MaxCount_n CcFDC_MinCount_n /end REF_CHARACTERISTIC /end GROUP
/begin GROUP S569_DetermineFault "VBU0428Test/VBUSystem/BMS/CTM/CTM/Subsystem/Determine_CellTemp_OverUnderFaults/EVM_FDC_Handler/DetermineFault" /begin REF_CHARACTERISTIC CcFDC_MaxCount_n CcFDC_MinCount_n /end REF_CHARACTERISTIC /end GROUP
/begin GROUP S569_DetermineFaultCounter "VBU0428Test/VBUSystem/BMS/CTM/CTM/Subsystem/Determine_CellTemp_OverUnderFaults/EVM_FDC_Handler/DetermineFaultCounter" /begin REF_CHARACTERISTIC CcFDC_MaxCount_n CcFDC_MinCount_n /end REF_CHARACTERISTIC /end GROUP
/begin GROUP S593_CellTemp_ChangeRate_Calculate "VBU0428Test/VBUSystem/BMS/CTM/CTM/Subsystem/Determine_Thermal_Runaway/DetermineTempRiseRate/CellTemp_ChangeRate_Calculate"
 /begin REF_CHARACTERISTIC CbCTM_CellThermalRunawayEnable_flg CcCTM_ThermalRunawayTriggerTime_ms /end REF_CHARACTERISTIC
/end GROUP
/begin GROUP S659_DetermineFault "VBU0428Test/VBUSystem/BMS/CVT/CVT/Subsystem/Determine_CellVoltage_OverUnderFaults/EVM_FDC_Handler/DetermineFault" /begin REF_CHARACTERISTIC CcFDC_MaxCount_n CcFDC_MinCount_n /end REF_CHARACTERISTIC /end GROUP
/begin GROUP S659_DetermineFaultCounter "VBU0428Test/VBUSystem/BMS/CVT/CVT/Subsystem/Determine_CellVoltage_OverUnderFaults/EVM_FDC_Handler/DetermineFaultCounter" /begin REF_CHARACTERISTIC CcFDC_MaxCount_n CcFDC_MinCount_n /end REF_CHARACTERISTIC /end GROUP
/begin GROUP S660_DetermineFault "VBU0428Test/VBUSystem/BMS/CVT/CVT/Subsystem/Determine_CellVoltage_OverUnderFaults/EVM_FDC_Handler1/DetermineFault" /begin REF_CHARACTERISTIC CcFDC_MaxCount_n CcFDC_MinCount_n /end REF_CHARACTERISTIC /end GROUP
/begin GROUP S660_DetermineFaultCounter "VBU0428Test/VBUSystem/BMS/CVT/CVT/Subsystem/Determine_CellVoltage_OverUnderFaults/EVM_FDC_Handler1/DetermineFaultCounter" /begin REF_CHARACTERISTIC CcFDC_MaxCount_n CcFDC_MinCount_n /end REF_CHARACTERISTIC /end GROUP
/begin GROUP S661_DetermineFault "VBU0428Test/VBUSystem/BMS/CVT/CVT/Subsystem/Determine_CellVoltage_OverUnderFaults/EVM_FDC_Handler2/DetermineFault" /begin REF_CHARACTERISTIC CcFDC_MaxCount_n CcFDC_MinCount_n /end REF_CHARACTERISTIC /end GROUP
/begin GROUP S661_DetermineFaultCounter "VBU0428Test/VBUSystem/BMS/CVT/CVT/Subsystem/Determine_CellVoltage_OverUnderFaults/EVM_FDC_Handler2/DetermineFaultCounter" /begin REF_CHARACTERISTIC CcFDC_MaxCount_n CcFDC_MinCount_n /end REF_CHARACTERISTIC /end GROUP
/begin GROUP S798_Decrease_ChargeCurrentRequest "VBU0428Test/VBUSystem/BMS/FCC /FCC/Subsystem/Determine_Fastcharge_Request/Charge_Request_Protection/Decrease_ChargeCurrentRequest"
 /begin REF_CHARACTERISTIC CcFCC_BatteryChargeCurrentFactor_n CcFCC_TrickleChargeCurrent_A CcSYS_MappedCellCapacity_Ah /end REF_CHARACTERISTIC
/end GROUP
/begin GROUP S799_Determine_ComputeResistancePulseRequest "VBU0428Test/VBUSystem/BMS/FCC /FCC/Subsystem/Determine_Fastcharge_Request/DetermineComputeResistancePulseCurrent/Determine_ComputeResistancePulseRequest"
 /begin REF_CHARACTERISTIC CcFCC_BatteryChargeCurrentFactor_n CcFCC_StandardPowerLimit_Kw CcFCC_TrickleChargeCurrent_A CcSYS_MappedCellCapacity_Ah /end REF_CHARACTERISTIC
/end GROUP
/begin GROUP S800_Request_At_Charging "VBU0428Test/VBUSystem/BMS/FCC /FCC/Subsystem/Determine_Fastcharge_Request/Determine_Base_ChargeRequest/Request_At_Charging"
 /begin REF_CHARACTERISTIC CcFCC_BatteryChargeCurrentFactor_n CcFCC_StandardPowerLimit_Kw CcFCC_TrickleChargeCurrent_A CcSYS_MappedCellCapacity_Ah /end REF_CHARACTERISTIC
/end GROUP
/begin GROUP S832_Cell_Temp_Protection "VBU0428Test/VBUSystem/BMS/FCC /FCC/Subsystem/Fastcharge_Conditions_Check/Condition_Categorize/Cell_Temp_Protection" /begin REF_CHARACTERISTIC CcFCC_NoChargeHighTemp_C CcFCC_NoChargeLowTemp_C /end REF_CHARACTERISTIC /end GROUP
/begin GROUP S1131_Calculate_Remaining_Energy "VBU0428Test/VBUSystem/BMS/SOE/Subsystem2/Subsystem/Calculate_Pack_Remaining_Energy/Discharge_Mode/Calculate_Remaining_Energy" /begin REF_CHARACTERISTIC CcSOE_CellEnergyBoL_Kwh /end REF_CHARACTERISTIC /end GROUP
/begin GROUP S1131_Predict_SOC_End "VBU0428Test/VBUSystem/BMS/SOE/Subsystem2/Subsystem/Calculate_Pack_Remaining_Energy/Discharge_Mode/Predict_SOC_End" /begin REF_CHARACTERISTIC CcSOE_CellSocDelta_pct /end REF_CHARACTERISTIC /end GROUP
/begin GROUP S1407_Determine_SlowCharge "VBU0428Test/VBUSystem/BMS/SOH/Subsystem4/Subsystem1/Calculate_Capacity/Determine_CalculateCellCapacity_Condition/Determine_SlowCharge" /begin REF_CHARACTERISTIC CcSYS_NoOfInvalidCellVoltages_n /end REF_CHARACTERISTIC /end GROUP
/begin GROUP S1407_Determine_SlowChargeEnd "VBU0428Test/VBUSystem/BMS/SOH/Subsystem4/Subsystem1/Calculate_Capacity/Determine_CalculateCellCapacity_Condition/Determine_SlowChargeEnd" /begin REF_CHARACTERISTIC CcSYS_NoOfInvalidCellVoltages_n /end REF_CHARACTERISTIC /end GROUP
/begin GROUP S1407_Determine_SlowChargeStart "VBU0428Test/VBUSystem/BMS/SOH/Subsystem4/Subsystem1/Calculate_Capacity/Determine_CalculateCellCapacity_Condition/Determine_SlowChargeStart" /begin REF_CHARACTERISTIC CcSYS_NoOfInvalidCellVoltages_n /end REF_CHARACTERISTIC /end GROUP
/begin GROUP S1473_ResistanceCalc_Check "VBU0428Test/VBUSystem/BMS/SOH/Subsystem4/Subsystem1/Calculate_Resistance/BasicCellResistance_Calculation_Check/ResistanceCalc_Check" /begin REF_CHARACTERISTIC CcSYS_NoOfInvalidCellVoltages_n /end REF_CHARACTERISTIC /end GROUP
/begin GROUP S1551_Normal_Condition "VBU0428Test/VBUSystem/BMS/THM/Subsystem/Subsystem/Charge_Mode_Temp_Request/OBC_Temp_Request/Normal_Condition"
 /begin REF_CHARACTERISTIC CcTHM_ChargeTempRequestHighThreshold_C CcTHM_PackSohORF_flg CcTHM_PackSohORV_pct /end REF_CHARACTERISTIC
/end GROUP
/begin GROUP S143_DetermineFault "VBU0428Test/VBUSystem/BMS/BCV/BCV/Subsystem/Diagnose_BCV_Data_Fault/Diagnose_VoltageCurrent_Fault/EVM_FDC_Handler/DetermineFault" /begin REF_CHARACTERISTIC CcFDC_MaxCount_n CcFDC_MinCount_n /end REF_CHARACTERISTIC /end GROUP
/begin GROUP S143_DetermineFaultCounter "VBU0428Test/VBUSystem/BMS/BCV/BCV/Subsystem/Diagnose_BCV_Data_Fault/Diagnose_VoltageCurrent_Fault/EVM_FDC_Handler/DetermineFaultCounter" /begin REF_CHARACTERISTIC CcFDC_MaxCount_n CcFDC_MinCount_n /end REF_CHARACTERISTIC /end GROUP
/begin GROUP S144_DetermineFault "VBU0428Test/VBUSystem/BMS/BCV/BCV/Subsystem/Diagnose_BCV_Data_Fault/Diagnose_VoltageCurrent_Fault/EVM_FDC_Handler1/DetermineFault" /begin REF_CHARACTERISTIC CcFDC_MaxCount_n CcFDC_MinCount_n /end REF_CHARACTERISTIC /end GROUP
/begin GROUP S144_DetermineFaultCounter "VBU0428Test/VBUSystem/BMS/BCV/BCV/Subsystem/Diagnose_BCV_Data_Fault/Diagnose_VoltageCurrent_Fault/EVM_FDC_Handler1/DetermineFaultCounter" /begin REF_CHARACTERISTIC CcFDC_MaxCount_n CcFDC_MinCount_n /end REF_CHARACTERISTIC /end GROUP
/begin GROUP S145_DetermineFault "VBU0428Test/VBUSystem/BMS/BCV/BCV/Subsystem/Diagnose_BCV_Data_Fault/Diagnose_VoltageCurrent_Fault/EVM_FDC_Handler2/DetermineFault" /begin REF_CHARACTERISTIC CcFDC_MaxCount_n CcFDC_MinCount_n /end REF_CHARACTERISTIC /end GROUP
/begin GROUP S145_DetermineFaultCounter "VBU0428Test/VBUSystem/BMS/BCV/BCV/Subsystem/Diagnose_BCV_Data_Fault/Diagnose_VoltageCurrent_Fault/EVM_FDC_Handler2/DetermineFaultCounter" /begin REF_CHARACTERISTIC CcFDC_MaxCount_n CcFDC_MinCount_n /end REF_CHARACTERISTIC /end GROUP
/begin GROUP S324_Determine_CellBlanceTime "VBU0428Test/VBUSystem/BMS/CBL/Subsystem8/Subsystem/Determine_CSCCellBalanceRequest/Determine_CellBalanceRequest/Cell0/Determine_CellBlanceTime" /begin REF_CHARACTERISTIC MINUTES_PER_HOUR /end REF_CHARACTERISTIC /end GROUP
/begin GROUP S480_Determine_Diagnostic_Status "VBU0428Test/VBUSystem/BMS/CTD/Subsystem/Subsystem4/Stuck_Open_Diagnostic/MNC_Stuck_Open/MNC_Stuck_Open_With_VehicleSpeed/Determine_Diagnostic_Status" /begin REF_CHARACTERISTIC CcFDC_MaxCount_n CcFDC_MinCount_n DIAGNOSTIC_ON_GOING /end REF_CHARACTERISTIC /end GROUP
/begin GROUP S504_Determine_Diagnostic_Status "VBU0428Test/VBUSystem/BMS/CTD/Subsystem/Subsystem4/Stuck_Open_Diagnostic/MPC_Stuck_Open/MPC_Stuck_Open_Without_VehicleSpeed/Determine_Diagnostic_Status" /begin REF_CHARACTERISTIC CcFDC_MaxCount_n CcFDC_MinCount_n DIAGNOSTIC_ON_GOING /end REF_CHARACTERISTIC /end GROUP
/begin GROUP S693_DetermineFault "VBU0428Test/VBUSystem/BMS/CVT/CVT/Subsystem/Monitor_CVT_Performance/Determine_CellVoltage_OverDeviationBDM/BigDataMonitor_Handler1/DetermineFault" /begin REF_CHARACTERISTIC CcFDC_MaxCount_n CcFDC_MinCount_n /end REF_CHARACTERISTIC /end GROUP
/begin GROUP S693_DetermineFaultCounter "VBU0428Test/VBUSystem/BMS/CVT/CVT/Subsystem/Monitor_CVT_Performance/Determine_CellVoltage_OverDeviationBDM/BigDataMonitor_Handler1/DetermineFaultCounter" /begin REF_CHARACTERISTIC CcFDC_MaxCount_n CcFDC_MinCount_n /end REF_CHARACTERISTIC /end GROUP
/begin GROUP S698_DetermineFault "VBU0428Test/VBUSystem/BMS/CVT/CVT/Subsystem/Monitor_CVT_Performance/Determine_CellVoltage_OverUnderBDM/BigDataMonitor_Handler/DetermineFault" /begin REF_CHARACTERISTIC CcFDC_MaxCount_n CcFDC_MinCount_n /end REF_CHARACTERISTIC /end GROUP
/begin GROUP S698_DetermineFaultCounter "VBU0428Test/VBUSystem/BMS/CVT/CVT/Subsystem/Monitor_CVT_Performance/Determine_CellVoltage_OverUnderBDM/BigDataMonitor_Handler/DetermineFaultCounter" /begin REF_CHARACTERISTIC CcFDC_MaxCount_n CcFDC_MinCount_n /end REF_CHARACTERISTIC /end GROUP
/begin GROUP S699_DetermineFault "VBU0428Test/VBUSystem/BMS/CVT/CVT/Subsystem/Monitor_CVT_Performance/Determine_CellVoltage_OverUnderBDM/BigDataMonitor_Handler2/DetermineFault" /begin REF_CHARACTERISTIC CcFDC_MaxCount_n CcFDC_MinCount_n /end REF_CHARACTERISTIC /end GROUP
/begin GROUP S699_DetermineFaultCounter "VBU0428Test/VBUSystem/BMS/CVT/CVT/Subsystem/Monitor_CVT_Performance/Determine_CellVoltage_OverUnderBDM/BigDataMonitor_Handler2/DetermineFaultCounter" /begin REF_CHARACTERISTIC CcFDC_MaxCount_n CcFDC_MinCount_n /end REF_CHARACTERISTIC /end GROUP
/begin GROUP S841_FullCharge_criteria4 "VBU0428Test/VBUSystem/BMS/FCC /FCC/Subsystem/Fastcharge_Conditions_Check/Condition_Categorize/Full_Charge_Determination/FullCharge_criteria4"
 /begin REF_CHARACTERISTIC CcFCC_BatteryCapacityCycle1_n CcFCC_BatteryCapacityCycle2_n CcFCC_CustomSetSOCEnable_pct CcFCC_FullChargeSoc1_pct CcFCC_FullChargeSoc2_pct CcFCC_FullChargeSoc3_pct /end REF_CHARACTERISTIC
/end GROUP
/begin GROUP S1216_Enable_Voltage_Correction "VBU0428Test/VBUSystem/BMS/SOF/Subsystem6/Subsystem/Determine_Currentlimit_Target/Calculate_CurrentLimit_Target/CurrentLimit_Voltage_Correct/Enable_Voltage_Correction" /begin REF_CHARACTERISTIC CcSYS_NoOfInvalidCellVoltages_n /end REF_CHARACTERISTIC /end GROUP
/begin GROUP S193_DetermineFault "VBU0428Test/VBUSystem/BMS/BCV/BCV/Subsystem/Monitor_BCV_Performance/Diagnose_BDM_BCV_Communication_Fault/Diagnose_BdmOutOfRange_Fault/BigDataMonitor_Handler/DetermineFault" /begin REF_CHARACTERISTIC CcFDC_MaxCount_n CcFDC_MinCount_n /end REF_CHARACTERISTIC /end GROUP
/begin GROUP S193_DetermineFaultCounter "VBU0428Test/VBUSystem/BMS/BCV/BCV/Subsystem/Monitor_BCV_Performance/Diagnose_BDM_BCV_Communication_Fault/Diagnose_BdmOutOfRange_Fault/BigDataMonitor_Handler/DetermineFaultCounter" /begin REF_CHARACTERISTIC CcFDC_MaxCount_n CcFDC_MinCount_n /end REF_CHARACTERISTIC /end GROUP
/begin GROUP S194_DetermineFault "VBU0428Test/VBUSystem/BMS/BCV/BCV/Subsystem/Monitor_BCV_Performance/Diagnose_BDM_BCV_Communication_Fault/Diagnose_BdmOutOfRange_Fault/BigDataMonitor_Handler1/DetermineFault" /begin REF_CHARACTERISTIC CcFDC_MaxCount_n CcFDC_MinCount_n /end REF_CHARACTERISTIC /end GROUP
/begin GROUP S194_DetermineFaultCounter "VBU0428Test/VBUSystem/BMS/BCV/BCV/Subsystem/Monitor_BCV_Performance/Diagnose_BDM_BCV_Communication_Fault/Diagnose_BdmOutOfRange_Fault/BigDataMonitor_Handler1/DetermineFaultCounter" /begin REF_CHARACTERISTIC CcFDC_MaxCount_n CcFDC_MinCount_n /end REF_CHARACTERISTIC /end GROUP
/begin GROUP S205_DetermineFault "VBU0428Test/VBUSystem/BMS/BCV/BCV/Subsystem/Monitor_BCV_Performance/Diagnose_BDM_BCV_Data_Fault/Diagnose_BdmBatteryBusVoltageMismatch_Fault/BigDataMonitor_Handler1/DetermineFault" /begin REF_CHARACTERISTIC CcFDC_MaxCount_n CcFDC_MinCount_n /end REF_CHARACTERISTIC /end GROUP
/begin GROUP S205_DetermineFaultCounter "VBU0428Test/VBUSystem/BMS/BCV/BCV/Subsystem/Monitor_BCV_Performance/Diagnose_BDM_BCV_Data_Fault/Diagnose_BdmBatteryBusVoltageMismatch_Fault/BigDataMonitor_Handler1/DetermineFaultCounter" /begin REF_CHARACTERISTIC CcFDC_MaxCount_n CcFDC_MinCount_n /end REF_CHARACTERISTIC /end GROUP
/begin GROUP S211_DetermineFault "VBU0428Test/VBUSystem/BMS/BCV/BCV/Subsystem/Monitor_BCV_Performance/Diagnose_BDM_BCV_Data_Fault/Diagnose_BdmVoltageCurrent_Fault/BigDataMonitor_Handler/DetermineFault" /begin REF_CHARACTERISTIC CcFDC_MaxCount_n CcFDC_MinCount_n /end REF_CHARACTERISTIC /end GROUP
/begin GROUP S211_DetermineFaultCounter "VBU0428Test/VBUSystem/BMS/BCV/BCV/Subsystem/Monitor_BCV_Performance/Diagnose_BDM_BCV_Data_Fault/Diagnose_BdmVoltageCurrent_Fault/BigDataMonitor_Handler/DetermineFaultCounter" /begin REF_CHARACTERISTIC CcFDC_MaxCount_n CcFDC_MinCount_n /end REF_CHARACTERISTIC /end GROUP
/begin GROUP S212_DetermineFault "VBU0428Test/VBUSystem/BMS/BCV/BCV/Subsystem/Monitor_BCV_Performance/Diagnose_BDM_BCV_Data_Fault/Diagnose_BdmVoltageCurrent_Fault/BigDataMonitor_Handler1/DetermineFault" /begin REF_CHARACTERISTIC CcFDC_MaxCount_n CcFDC_MinCount_n /end REF_CHARACTERISTIC /end GROUP
/begin GROUP S212_DetermineFaultCounter "VBU0428Test/VBUSystem/BMS/BCV/BCV/Subsystem/Monitor_BCV_Performance/Diagnose_BDM_BCV_Data_Fault/Diagnose_BdmVoltageCurrent_Fault/BigDataMonitor_Handler1/DetermineFaultCounter" /begin REF_CHARACTERISTIC CcFDC_MaxCount_n CcFDC_MinCount_n /end REF_CHARACTERISTIC /end GROUP
/begin GROUP S213_DetermineFault "VBU0428Test/VBUSystem/BMS/BCV/BCV/Subsystem/Monitor_BCV_Performance/Diagnose_BDM_BCV_Data_Fault/Diagnose_BdmVoltageCurrent_Fault/BigDataMonitor_Handler2/DetermineFault" /begin REF_CHARACTERISTIC CcFDC_MaxCount_n CcFDC_MinCount_n /end REF_CHARACTERISTIC /end GROUP
/begin GROUP S213_DetermineFaultCounter "VBU0428Test/VBUSystem/BMS/BCV/BCV/Subsystem/Monitor_BCV_Performance/Diagnose_BDM_BCV_Data_Fault/Diagnose_BdmVoltageCurrent_Fault/BigDataMonitor_Handler2/DetermineFaultCounter" /begin REF_CHARACTERISTIC CcFDC_MaxCount_n CcFDC_MinCount_n /end REF_CHARACTERISTIC /end GROUP
/end MODULE
/end PROJECT
