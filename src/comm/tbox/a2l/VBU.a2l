ASAP2_VERSION 1 31
/begin PROJECT ProjectName "Project Comment Goes Here"
/begin HEADER "Header Comments go here" /end HEADER
/begin MODULE ModuleName "Module Comment Goes Here"
/begin MOD_COMMON "Mod Common Comment Here" BYTE_ORDER MSB_LAST /end MOD_COMMON
/begin RECORD_LAYOUT Scalar_BOOLEAN FNC_VALUES 1 UBYTE COLUMN_DIR DIRECT /end RECORD_LAYOUT
/begin RECORD_LAYOUT Scalar_UBYTE FNC_VALUES 1 UBYTE COLUMN_DIR DIRECT /end RECORD_LAYOUT
/begin RECORD_LAYOUT Scalar_UWORD FNC_VALUES 1 UWORD COLUMN_DIR DIRECT /end RECORD_LAYOUT
/begin RECORD_LAYOUT Scalar_ULONG FNC_VALUES 1 ULONG COLUMN_DIR DIRECT /end RECORD_LAYOUT
/begin RECORD_LAYOUT Scalar_FLOAT32_IEEE FNC_VALUES 1 FLOAT32_IEEE COLUMN_DIR DIRECT /end RECORD_LAYOUT
/begin RECORD_LAYOUT Lookup1D_X_UWORD AXIS_PTS_X 1 UWORD INDEX_INCR DIRECT /end RECORD_LAYOUT
/begin RECORD_LAYOUT Lookup1D_FLOAT32_IEEE FNC_VALUES 1 FLOAT32_IEEE COLUMN_DIR DIRECT /end RECORD_LAYOUT
/begin RECORD_LAYOUT Lookup1D_X_FLOAT32_IEEE AXIS_PTS_X 1 FLOAT32_IEEE INDEX_INCR DIRECT /end RECORD_LAYOUT
/begin RECORD_LAYOUT Lookup2D_UWORD FNC_VALUES 1 UWORD COLUMN_DIR DIRECT /end RECORD_LAYOUT
/begin RECORD_LAYOUT Lookup2D_X_UWORD AXIS_PTS_X 1 UWORD INDEX_INCR DIRECT /end RECORD_LAYOUT
/begin RECORD_LAYOUT Lookup2D_X_LONG AXIS_PTS_X 1 SLONG INDEX_INCR DIRECT /end RECORD_LAYOUT
/begin RECORD_LAYOUT Lookup2D_FLOAT32_IEEE FNC_VALUES 1 FLOAT32_IEEE COLUMN_DIR DIRECT /end RECORD_LAYOUT
/begin RECORD_LAYOUT Lookup2D_X_FLOAT32_IEEE AXIS_PTS_X 1 FLOAT32_IEEE INDEX_INCR DIRECT /end RECORD_LAYOUT
/begin RECORD_LAYOUT Lookup2D_FLOAT64_IEEE FNC_VALUES 1 FLOAT64_IEEE COLUMN_DIR DIRECT /end RECORD_LAYOUT
/begin RECORD_LAYOUT Lookup2D_X_FLOAT64_IEEE AXIS_PTS_X 1 FLOAT64_IEEE INDEX_INCR DIRECT /end RECORD_LAYOUT
/begin CHARACTERISTIC CaSOF_ContinuousChargeMap_v "" MAP 0x70021768 Lookup2D_FLOAT32_IEEE 0 VBU0428Test_CM_single_i 0.0 200.0
 /begin AXIS_DESCR COM_AXIS SOC_pctCellSocMax VBU0428Test_CM_single_pct 22 0.0 100.0 AXIS_PTS_REF CaSOF_ContinuousChargeSocMap_y /end AXIS_DESCR
 /begin AXIS_DESCR COM_AXIS NO_INPUT_QUANTITY VBU0428Test_CM_single_t 22 -40.0 120.0 AXIS_PTS_REF CaSOF_ContinuousChargeTempMap_x /end AXIS_DESCR
/end CHARACTERISTIC
/begin AXIS_PTS CaSOF_ContinuousChargeTempMap_x "" 0x700149ca NO_INPUT_QUANTITY Lookup2D_X_FLOAT32_IEEE 0 VBU0428Test_CM_single_t 22 -40.0 120.0 /end AXIS_PTS
/begin AXIS_PTS CaSOF_ContinuousChargeSocMap_y "" 0x7001491a SOC_pctCellSocMax Lookup2D_X_FLOAT32_IEEE 0 VBU0428Test_CM_single_pct 22 0.0 100.0 /end AXIS_PTS
/begin CHARACTERISTIC CaSOF_ContinuousChargeLockedMap_v "" MAP 0x70020fd8 Lookup2D_FLOAT32_IEEE 0 VBU0428Test_CM_single_i 0.0 200.0
 /begin AXIS_DESCR COM_AXIS NO_INPUT_QUANTITY VBU0428Test_CM_single_pct 22 0.0 100.0 AXIS_PTS_REF CaSOF_ContinuousChargeSocMap_y /end AXIS_DESCR
 /begin AXIS_DESCR COM_AXIS NO_INPUT_QUANTITY VBU0428Test_CM_single_t 22 -40.0 120.0 AXIS_PTS_REF CaSOF_ContinuousChargeTempMap_x /end AXIS_DESCR
/end CHARACTERISTIC
/begin CHARACTERISTIC CaSOF_ContinuousChargeEolMap_v "" MAP 0x7001f928 Lookup2D_FLOAT32_IEEE 0 VBU0428Test_CM_single_i 0.0 200.0
 /begin AXIS_DESCR COM_AXIS NO_INPUT_QUANTITY VBU0428Test_CM_single_pct 22 0.0 100.0 AXIS_PTS_REF CaSOF_ContinuousChargeSocMap_y /end AXIS_DESCR
 /begin AXIS_DESCR COM_AXIS NO_INPUT_QUANTITY VBU0428Test_CM_single_t 22 -40.0 120.0 AXIS_PTS_REF CaSOF_ContinuousChargeTempMap_x /end AXIS_DESCR
/end CHARACTERISTIC
/begin CHARACTERISTIC CaSOF_ContinuousChargeHomoMap_v "" MAP 0x700200b8 Lookup2D_FLOAT32_IEEE 0 VBU0428Test_CM_single_i 0.0 200.0
 /begin AXIS_DESCR COM_AXIS SOC_pctCellSocMax VBU0428Test_CM_single_pct 22 0.0 100.0 AXIS_PTS_REF CaSOF_ContinuousChargeSocMap_y /end AXIS_DESCR
 /begin AXIS_DESCR COM_AXIS NO_INPUT_QUANTITY VBU0428Test_CM_single_t 22 -40.0 120.0 AXIS_PTS_REF CaSOF_ContinuousChargeTempMap_x /end AXIS_DESCR
/end CHARACTERISTIC
/begin CHARACTERISTIC CaSOF_ContinuousChargeLockedHomoMap_v "" MAP 0x70020848 Lookup2D_FLOAT32_IEEE 0 VBU0428Test_CM_single_i 0.0 200.0
 /begin AXIS_DESCR COM_AXIS NO_INPUT_QUANTITY VBU0428Test_CM_single_pct 22 0.0 100.0 AXIS_PTS_REF CaSOF_ContinuousChargeSocMap_y /end AXIS_DESCR
 /begin AXIS_DESCR COM_AXIS NO_INPUT_QUANTITY VBU0428Test_CM_single_t 22 -40.0 120.0 AXIS_PTS_REF CaSOF_ContinuousChargeTempMap_x /end AXIS_DESCR
/end CHARACTERISTIC
/begin CHARACTERISTIC CaSOF_ContinuousChargeFactorMap_v "" MAP 0x70017d28 Lookup2D_FLOAT32_IEEE 0 VBU0428Test_CM_single_i 0.0 1.0
 /begin AXIS_DESCR COM_AXIS SOC_pctCellSocMax VBU0428Test_CM_single_pct 22 0.0 100.0 AXIS_PTS_REF CaSOF_ContinuousChargeSocMap_y /end AXIS_DESCR
 /begin AXIS_DESCR FIX_AXIS NO_INPUT_QUANTITY VBU0428Test_CM_uint16 7 0 500 /begin FIX_AXIS_PAR_LIST 0 50 100 200 300 400 500 /end FIX_AXIS_PAR_LIST /end AXIS_DESCR
/end CHARACTERISTIC
/begin CHARACTERISTIC CaSOF_ContinuousDischargeSocTempMapZ_A "" MAP 0x70019290 Lookup2D_FLOAT32_IEEE 0 VBU0428Test_CM_single_cnt -3.4028234663852886E+38 3.4028234663852886E+38
 /begin AXIS_DESCR COM_AXIS SOC_pctCellSocMin VBU0428Test_CM_single_cnt 13 -3.4028234663852886E+38 3.4028234663852886E+38 AXIS_PTS_REF CaSOF_ContinuousDischargeSocTempMapY_pct /end AXIS_DESCR
 /begin AXIS_DESCR COM_AXIS NO_INPUT_QUANTITY VBU0428Test_CM_single_cnt 14 -3.4028234663852886E+38 3.4028234663852886E+38 AXIS_PTS_REF CaSOF_ContinuousDischargeSocTempMapX_C /end AXIS_DESCR
/end CHARACTERISTIC
/begin AXIS_PTS CaSOF_ContinuousDischargeSocTempMapX_C "" 0x7001392e NO_INPUT_QUANTITY Lookup2D_X_FLOAT32_IEEE 0 VBU0428Test_CM_single_cnt 14 -3.4028234663852886E+38 3.4028234663852886E+38 /end AXIS_PTS
/begin AXIS_PTS CaSOF_ContinuousDischargeSocTempMapY_pct "" 0x70013472 SOC_pctCellSocMin Lookup2D_X_FLOAT32_IEEE 0 VBU0428Test_CM_single_cnt 13 -3.4028234663852886E+38 3.4028234663852886E+38 /end AXIS_PTS
/begin CHARACTERISTIC CaSOF_ContinuousDischargeLockedSocTempMapZ_A "" MAP 0x70018fb8 Lookup2D_FLOAT32_IEEE 0 VBU0428Test_CM_single_cnt -3.4028234663852886E+38 3.4028234663852886E+38
 /begin AXIS_DESCR COM_AXIS NO_INPUT_QUANTITY VBU0428Test_CM_single_cnt 13 -3.4028234663852886E+38 3.4028234663852886E+38 AXIS_PTS_REF CaSOF_ContinuousDischargeLockedSocTempMapY_pct /end AXIS_DESCR
 /begin AXIS_DESCR COM_AXIS NO_INPUT_QUANTITY VBU0428Test_CM_single_cnt 14 -3.4028234663852886E+38 3.4028234663852886E+38 AXIS_PTS_REF CaSOF_ContinuousDischargeLockedSocTempMapX_C /end AXIS_DESCR
/end CHARACTERISTIC
/begin AXIS_PTS CaSOF_ContinuousDischargeLockedSocTempMapX_C "" 0x700138f6 NO_INPUT_QUANTITY Lookup2D_X_FLOAT32_IEEE 0 VBU0428Test_CM_single_cnt 14 -3.4028234663852886E+38 3.4028234663852886E+38 /end AXIS_PTS
/begin AXIS_PTS CaSOF_ContinuousDischargeLockedSocTempMapY_pct "" 0x7001343e NO_INPUT_QUANTITY Lookup2D_X_FLOAT32_IEEE 0 VBU0428Test_CM_single_cnt 13 -3.4028234663852886E+38 3.4028234663852886E+38 /end AXIS_PTS
/begin CHARACTERISTIC CaSOF_ContinuousDischargeEolSocTempMapZ_A "" MAP 0x70018ce0 Lookup2D_FLOAT32_IEEE 0 VBU0428Test_CM_single_cnt -3.4028234663852886E+38 3.4028234663852886E+38
 /begin AXIS_DESCR COM_AXIS NO_INPUT_QUANTITY VBU0428Test_CM_single_cnt 13 -3.4028234663852886E+38 3.4028234663852886E+38 AXIS_PTS_REF CaSOF_ContinuousDischargeEolSocTempMapY_pct /end AXIS_DESCR
 /begin AXIS_DESCR COM_AXIS NO_INPUT_QUANTITY VBU0428Test_CM_single_cnt 14 -3.4028234663852886E+38 3.4028234663852886E+38 AXIS_PTS_REF CaSOF_ContinuousDischargeEolSocTempMapX_C /end AXIS_DESCR
/end CHARACTERISTIC
/begin AXIS_PTS CaSOF_ContinuousDischargeEolSocTempMapX_C "" 0x700138be NO_INPUT_QUANTITY Lookup2D_X_FLOAT32_IEEE 0 VBU0428Test_CM_single_cnt 14 -3.4028234663852886E+38 3.4028234663852886E+38 /end AXIS_PTS
/begin AXIS_PTS CaSOF_ContinuousDischargeEolSocTempMapY_pct "" 0x7001340a NO_INPUT_QUANTITY Lookup2D_X_FLOAT32_IEEE 0 VBU0428Test_CM_single_cnt 13 -3.4028234663852886E+38 3.4028234663852886E+38 /end AXIS_PTS
/begin CHARACTERISTIC CaSOF_ShortPulseChargeEolSocTempMapZ_A "" MAP 0x7001848c Lookup2D_FLOAT32_IEEE 0 VBU0428Test_CM_single_cnt -3.4028234663852886E+38 3.4028234663852886E+38
 /begin AXIS_DESCR COM_AXIS NO_INPUT_QUANTITY VBU0428Test_CM_single_cnt 13 -3.4028234663852886E+38 3.4028234663852886E+38 AXIS_PTS_REF CaSOF_ShortPulseChargeEolSocTempMapY_pct /end AXIS_DESCR
 /begin AXIS_DESCR COM_AXIS NO_INPUT_QUANTITY VBU0428Test_CM_single_cnt 13 -3.4028234663852886E+38 3.4028234663852886E+38 AXIS_PTS_REF CaSOF_ShortPulseChargeEolSocTempMapX_C /end AXIS_DESCR
/end CHARACTERISTIC
/begin AXIS_PTS CaSOF_ShortPulseChargeEolSocTempMapX_C "" 0x7001350e NO_INPUT_QUANTITY Lookup2D_X_FLOAT32_IEEE 0 VBU0428Test_CM_single_cnt 13 -3.4028234663852886E+38 3.4028234663852886E+38 /end AXIS_PTS
/begin AXIS_PTS CaSOF_ShortPulseChargeEolSocTempMapY_pct "" 0x70013542 NO_INPUT_QUANTITY Lookup2D_X_FLOAT32_IEEE 0 VBU0428Test_CM_single_cnt 13 -3.4028234663852886E+38 3.4028234663852886E+38 /end AXIS_PTS
/begin CHARACTERISTIC CaSOF_ShortPulseDischargeSocTempMapZ_A "" MAP 0x7001a0c8 Lookup2D_FLOAT32_IEEE 0 VBU0428Test_CM_single_cnt -3.4028234663852886E+38 3.4028234663852886E+38
 /begin AXIS_DESCR COM_AXIS SOC_pctCellSocMin VBU0428Test_CM_single_cnt 13 -3.4028234663852886E+38 3.4028234663852886E+38 AXIS_PTS_REF CaSOF_ShortPulseDischargeSocTempMapY_pct /end AXIS_DESCR
 /begin AXIS_DESCR COM_AXIS NO_INPUT_QUANTITY VBU0428Test_CM_single_cnt 14 -3.4028234663852886E+38 3.4028234663852886E+38 AXIS_PTS_REF CaSOF_ShortPulseDischargeSocTempMapX_C /end AXIS_DESCR
/end CHARACTERISTIC
/begin AXIS_PTS CaSOF_ShortPulseDischargeSocTempMapX_C "" 0x70013a46 NO_INPUT_QUANTITY Lookup2D_X_FLOAT32_IEEE 0 VBU0428Test_CM_single_cnt 14 -3.4028234663852886E+38 3.4028234663852886E+38 /end AXIS_PTS
/begin AXIS_PTS CaSOF_ShortPulseDischargeSocTempMapY_pct "" 0x700135de SOC_pctCellSocMin Lookup2D_X_FLOAT32_IEEE 0 VBU0428Test_CM_single_cnt 13 -3.4028234663852886E+38 3.4028234663852886E+38 /end AXIS_PTS
/begin CHARACTERISTIC CaSOF_ShortPulseDischargeLockedSocTempMapZ_A "" MAP 0x70019df0 Lookup2D_FLOAT32_IEEE 0 VBU0428Test_CM_single_cnt -3.4028234663852886E+38 3.4028234663852886E+38
 /begin AXIS_DESCR COM_AXIS NO_INPUT_QUANTITY VBU0428Test_CM_single_cnt 13 -3.4028234663852886E+38 3.4028234663852886E+38 AXIS_PTS_REF CaSOF_ShortPulseDischargeLockedSocTempMapY_pct /end AXIS_DESCR
 /begin AXIS_DESCR COM_AXIS NO_INPUT_QUANTITY VBU0428Test_CM_single_cnt 14 -3.4028234663852886E+38 3.4028234663852886E+38 AXIS_PTS_REF CaSOF_ShortPulseDischargeLockedSocTempMapX_C /end AXIS_DESCR
/end CHARACTERISTIC
/begin AXIS_PTS CaSOF_ShortPulseDischargeLockedSocTempMapX_C "" 0x70013a0e NO_INPUT_QUANTITY Lookup2D_X_FLOAT32_IEEE 0 VBU0428Test_CM_single_cnt 14 -3.4028234663852886E+38 3.4028234663852886E+38 /end AXIS_PTS
/begin AXIS_PTS CaSOF_ShortPulseDischargeLockedSocTempMapY_pct "" 0x700135aa NO_INPUT_QUANTITY Lookup2D_X_FLOAT32_IEEE 0 VBU0428Test_CM_single_cnt 13 -3.4028234663852886E+38 3.4028234663852886E+38 /end AXIS_PTS
/begin CHARACTERISTIC CaSOF_ShortPulseDischargeEolSocTempMapZ_A "" MAP 0x70019b18 Lookup2D_FLOAT32_IEEE 0 VBU0428Test_CM_single_cnt -3.4028234663852886E+38 3.4028234663852886E+38
 /begin AXIS_DESCR COM_AXIS NO_INPUT_QUANTITY VBU0428Test_CM_single_cnt 13 -3.4028234663852886E+38 3.4028234663852886E+38 AXIS_PTS_REF CaSOF_ShortPulseDischargeEolSocTempMapY_pct /end AXIS_DESCR
 /begin AXIS_DESCR COM_AXIS NO_INPUT_QUANTITY VBU0428Test_CM_single_cnt 14 -3.4028234663852886E+38 3.4028234663852886E+38 AXIS_PTS_REF CaSOF_ShortPulseDischargeEolSocTempMapX_C /end AXIS_DESCR
/end CHARACTERISTIC
/begin AXIS_PTS CaSOF_ShortPulseDischargeEolSocTempMapX_C "" 0x700139d6 NO_INPUT_QUANTITY Lookup2D_X_FLOAT32_IEEE 0 VBU0428Test_CM_single_cnt 14 -3.4028234663852886E+38 3.4028234663852886E+38 /end AXIS_PTS
/begin AXIS_PTS CaSOF_ShortPulseDischargeEolSocTempMapY_pct "" 0x70013576 NO_INPUT_QUANTITY Lookup2D_X_FLOAT32_IEEE 0 VBU0428Test_CM_single_cnt 13 -3.4028234663852886E+38 3.4028234663852886E+38 /end AXIS_PTS
/begin CHARACTERISTIC CaSOF_ContinuousChargeSocTempMapZ_A "" MAP 0x7001e368 Lookup2D_FLOAT32_IEEE 0 VBU0428Test_CM_single_A 0.0 200.0
 /begin AXIS_DESCR COM_AXIS NO_INPUT_QUANTITY VBU0428Test_CM_single_pct 22 0.0 100.0 AXIS_PTS_REF CaSOF_ContinuousChargeSocTempMapY_pct /end AXIS_DESCR
 /begin AXIS_DESCR COM_AXIS NO_INPUT_QUANTITY VBU0428Test_CM_single_t 21 -40.0 120.0 AXIS_PTS_REF CaSOF_ContinuousChargeSocTempMapX_C /end AXIS_DESCR
/end CHARACTERISTIC
/begin AXIS_PTS CaSOF_ContinuousChargeSocTempMapX_C "" 0x700143da NO_INPUT_QUANTITY Lookup2D_X_FLOAT32_IEEE 0 VBU0428Test_CM_single_t 21 -40.0 120.0 /end AXIS_PTS
/begin AXIS_PTS CaSOF_ContinuousChargeSocTempMapY_pct "" 0x70014972 NO_INPUT_QUANTITY Lookup2D_X_FLOAT32_IEEE 0 VBU0428Test_CM_single_pct 22 0.0 100.0 /end AXIS_PTS
/begin CHARACTERISTIC CaSOF_FastChargeCurrentDropEOLCellVoltageMapZ_mV "" MAP 0x70014b2c Lookup2D_UWORD 0 VBU0428Test_CM_uint16_cnt 0.0 65535.0
 /begin AXIS_DESCR COM_AXIS NO_INPUT_QUANTITY VBU0428Test_CM_single_cnt 5 -3.4028234663852886E+38 3.4028234663852886E+38 AXIS_PTS_REF CaSOF_FastChargeCurrentDropEOLCellVoltageMapY_pct /end AXIS_DESCR
 /begin AXIS_DESCR COM_AXIS NO_INPUT_QUANTITY VBU0428Test_CM_single_cnt 9 -3.4028234663852886E+38 3.4028234663852886E+38 AXIS_PTS_REF CaSOF_FastChargeCurrentDropEOLCellVoltageMapX_C /end AXIS_DESCR
/end CHARACTERISTIC
/begin AXIS_PTS CaSOF_FastChargeCurrentDropEOLCellVoltageMapX_C "" 0x7001279a NO_INPUT_QUANTITY Lookup2D_X_FLOAT32_IEEE 0 VBU0428Test_CM_single_cnt 9 -3.4028234663852886E+38 3.4028234663852886E+38 /end AXIS_PTS
/begin AXIS_PTS CaSOF_FastChargeCurrentDropEOLCellVoltageMapY_pct "" 0x70011e52 NO_INPUT_QUANTITY Lookup2D_X_FLOAT32_IEEE 0 VBU0428Test_CM_single_cnt 5 -3.4028234663852886E+38 3.4028234663852886E+38 /end AXIS_PTS
/begin CHARACTERISTIC CaSOF_FastChargeCurrentDropBOLCellVoltageMapZ_mV "" MAP 0x70014ad2 Lookup2D_UWORD 0 VBU0428Test_CM_uint16_cnt 0.0 65535.0
 /begin AXIS_DESCR COM_AXIS NO_INPUT_QUANTITY VBU0428Test_CM_single_cnt 5 -3.4028234663852886E+38 3.4028234663852886E+38 AXIS_PTS_REF CaSOF_FastChargeCurrentDropBOLCellVoltageMapY_pct /end AXIS_DESCR
 /begin AXIS_DESCR COM_AXIS NO_INPUT_QUANTITY VBU0428Test_CM_single_cnt 9 -3.4028234663852886E+38 3.4028234663852886E+38 AXIS_PTS_REF CaSOF_FastChargeCurrentDropBOLCellVoltageMapX_C /end AXIS_DESCR
/end CHARACTERISTIC
/begin AXIS_PTS CaSOF_FastChargeCurrentDropBOLCellVoltageMapX_C "" 0x70012776 NO_INPUT_QUANTITY Lookup2D_X_FLOAT32_IEEE 0 VBU0428Test_CM_single_cnt 9 -3.4028234663852886E+38 3.4028234663852886E+38 /end AXIS_PTS
/begin AXIS_PTS CaSOF_FastChargeCurrentDropBOLCellVoltageMapY_pct "" 0x70011e3e NO_INPUT_QUANTITY Lookup2D_X_FLOAT32_IEEE 0 VBU0428Test_CM_single_cnt 5 -3.4028234663852886E+38 3.4028234663852886E+38 /end AXIS_PTS
/begin CHARACTERISTIC CaSOH_DecreaseCapacityMapY_pct "" CURVE 0x70011eb6 Lookup1D_FLOAT32_IEEE 0 VBU0428Test_CM_single_cnt -3.4028234663852886E+38 3.4028234663852886E+38
 /begin AXIS_DESCR COM_AXIS NO_INPUT_QUANTITY VBU0428Test_CM_single_cnt 5 -3.4028234663852886E+38 3.4028234663852886E+38 AXIS_PTS_REF CaSOH_DecreaseCapacityMapX_Ah /end AXIS_DESCR
/end CHARACTERISTIC
/begin AXIS_PTS CaSOH_DecreaseCapacityMapX_Ah "" 0x70011ea2 NO_INPUT_QUANTITY Lookup1D_X_FLOAT32_IEEE 0 VBU0428Test_CM_single_cnt 5 -3.4028234663852886E+38 3.4028234663852886E+38 /end AXIS_PTS
/begin CHARACTERISTIC DSPL_facEnergyFactorSOCUpdate_CUR_v "" CURVE 0x70011f6a Lookup1D_FLOAT32_IEEE 0 VBU0428Test_CM_single_fac 0.0 1.0
 /begin AXIS_DESCR COM_AXIS NO_INPUT_QUANTITY VBU0428Test_CM_single_fac 5 0.0 1.0 AXIS_PTS_REF DSPL_facEnergyFactorSOCUpdate_CUR_x /end AXIS_DESCR
/end CHARACTERISTIC
/begin AXIS_PTS DSPL_facEnergyFactorSOCUpdate_CUR_x "" 0x70011f7e NO_INPUT_QUANTITY Lookup1D_X_FLOAT32_IEEE 0 VBU0428Test_CM_single_fac 5 0.0 1.0 /end AXIS_PTS
/begin CHARACTERISTIC EDIS_pwrDecGradSprt_MAP_v "" MAP 0x7001b6b0 Lookup2D_FLOAT32_IEEE 0 VBU0428Test_CM_single_cnt -3.4028234663852886E+38 3.4028234663852886E+38
 /begin AXIS_DESCR COM_AXIS TQO_trqRMotr VBU0428Test_CM_single_cnt 13 -3.4028234663852886E+38 3.4028234663852886E+38 AXIS_PTS_REF EDIS_trqDecGradSprt_MAP_y /end AXIS_DESCR
 /begin AXIS_DESCR COM_AXIS SPD_vVehSpd VBU0428Test_CM_single_cnt 17 -3.4028234663852886E+38 3.4028234663852886E+38 AXIS_PTS_REF EDIS_vDecGradSprt_MAP_x /end AXIS_DESCR
/end CHARACTERISTIC
/begin AXIS_PTS EDIS_vDecGradSprt_MAP_x "" 0x70013d8e SPD_vVehSpd Lookup2D_X_FLOAT32_IEEE 0 VBU0428Test_CM_single_cnt 17 -3.4028234663852886E+38 3.4028234663852886E+38 /end AXIS_PTS
/begin AXIS_PTS EDIS_trqDecGradSprt_MAP_y "" 0x70013716 TQO_trqRMotr Lookup2D_X_FLOAT32_IEEE 0 VBU0428Test_CM_single_cnt 13 -3.4028234663852886E+38 3.4028234663852886E+38 /end AXIS_PTS
/begin CHARACTERISTIC EDIS_facMaxBMSDisCh_CUR_v "" CURVE 0x70012aaa Lookup1D_FLOAT32_IEEE 0 VBU0428Test_CM_single_cnt -3.4028234663852886E+38 3.4028234663852886E+38
 /begin AXIS_DESCR COM_AXIS NO_INPUT_QUANTITY VBU0428Test_CM_single_cnt 10 -3.4028234663852886E+38 3.4028234663852886E+38 AXIS_PTS_REF EDIS_tMaxBMSDisCh_CUR_x /end AXIS_DESCR
/end CHARACTERISTIC
/begin AXIS_PTS EDIS_tMaxBMSDisCh_CUR_x "" 0x70012b4a NO_INPUT_QUANTITY Lookup1D_X_FLOAT32_IEEE 0 VBU0428Test_CM_single_cnt 10 -3.4028234663852886E+38 3.4028234663852886E+38 /end AXIS_PTS
/begin CHARACTERISTIC EDIS_facMinBMSDisCh_CUR_v "" CURVE 0x70012afa Lookup1D_FLOAT32_IEEE 0 VBU0428Test_CM_single_cnt -3.4028234663852886E+38 3.4028234663852886E+38
 /begin AXIS_DESCR COM_AXIS NO_INPUT_QUANTITY VBU0428Test_CM_single_cnt 10 -3.4028234663852886E+38 3.4028234663852886E+38 AXIS_PTS_REF EDIS_tMinBMSDisCh_CUR_x /end AXIS_DESCR
/end CHARACTERISTIC
/begin AXIS_PTS EDIS_tMinBMSDisCh_CUR_x "" 0x70012b9a NO_INPUT_QUANTITY Lookup1D_X_FLOAT32_IEEE 0 VBU0428Test_CM_single_cnt 10 -3.4028234663852886E+38 3.4028234663852886E+38 /end AXIS_PTS
/begin CHARACTERISTIC EDIS_facBMSSOCDisCh_CUR_v "" CURVE 0x70012d22 Lookup1D_FLOAT32_IEEE 0 VBU0428Test_CM_single_cnt -3.4028234663852886E+38 3.4028234663852886E+38
 /begin AXIS_DESCR COM_AXIS NO_INPUT_QUANTITY VBU0428Test_CM_single_cnt 11 -3.4028234663852886E+38 3.4028234663852886E+38 AXIS_PTS_REF EDIS_pctBMSSOCDisCh_CUR_x /end AXIS_DESCR
/end CHARACTERISTIC
/begin AXIS_PTS EDIS_pctBMSSOCDisCh_CUR_x "" 0x70012dfe NO_INPUT_QUANTITY Lookup1D_X_FLOAT32_IEEE 0 VBU0428Test_CM_single_cnt 11 -3.4028234663852886E+38 3.4028234663852886E+38 /end AXIS_PTS
/begin CHARACTERISTIC EDIS_facDisChPwrDeltaBaseDiff_CUR_v "" CURVE 0x70014166 Lookup1D_FLOAT32_IEEE 0 VBU0428Test_CM_single_cnt -3.4028234663852886E+38 3.4028234663852886E+38
 /begin AXIS_DESCR COM_AXIS NO_INPUT_QUANTITY VBU0428Test_CM_single_cnt 19 -3.4028234663852886E+38 3.4028234663852886E+38 AXIS_PTS_REF EDIS_pwrDisChPwrDeltaBaseDiff_CUR_x /end AXIS_DESCR
/end CHARACTERISTIC
/begin AXIS_PTS EDIS_pwrDisChPwrDeltaBaseDiff_CUR_x "" 0x700141fe NO_INPUT_QUANTITY Lookup1D_X_FLOAT32_IEEE 0 VBU0428Test_CM_single_cnt 19 -3.4028234663852886E+38 3.4028234663852886E+38 /end AXIS_PTS
/begin CHARACTERISTIC EDIS_pwrSpBaseDchDyn_CUR_v "" CURVE 0x70011d4a Lookup1D_FLOAT32_IEEE 0 VBU0428Test_CM_single_cnt -3.4028234663852886E+38 3.4028234663852886E+38
 /begin AXIS_DESCR COM_AXIS EDIS_pwrDisChLimDynST VBU0428Test_CM_single_cnt 4 -3.4028234663852886E+38 3.4028234663852886E+38 AXIS_PTS_REF EDIS_pwrSpBaseDchDyn_CUR_x /end AXIS_DESCR
/end CHARACTERISTIC
/begin AXIS_PTS EDIS_pwrSpBaseDchDyn_CUR_x "" 0x70011d5a EDIS_pwrDisChLimDynST Lookup1D_X_FLOAT32_IEEE 0 VBU0428Test_CM_single_cnt 4 -3.4028234663852886E+38 3.4028234663852886E+38 /end AXIS_PTS
/begin CHARACTERISTIC TQDMP_facDeltaRPMFAC1_CUR_v "" CURVE 0x70012096 Lookup1D_FLOAT32_IEEE 0 VBU0428Test_CM_single_cnt -3.4028234663852886E+38 3.4028234663852886E+38
 /begin AXIS_DESCR COM_AXIS NO_INPUT_QUANTITY VBU0428Test_CM_single_cnt 5 -3.4028234663852886E+38 3.4028234663852886E+38 AXIS_PTS_REF TQDMP_facDeltaRPMFAC1_CUR_x /end AXIS_DESCR
/end CHARACTERISTIC
/begin AXIS_PTS TQDMP_facDeltaRPMFAC1_CUR_x "" 0x700120aa NO_INPUT_QUANTITY Lookup1D_X_FLOAT32_IEEE 0 VBU0428Test_CM_single_cnt 5 -3.4028234663852886E+38 3.4028234663852886E+38 /end AXIS_PTS
/begin CHARACTERISTIC TQDIS_pctShftChngLimThres_CUR_v "" CURVE 0x70012282 Lookup1D_FLOAT32_IEEE 0 VBU0428Test_CM_single_cnt -3.4028234663852886E+38 3.4028234663852886E+38
 /begin AXIS_DESCR COM_AXIS SPD_vVehSpd VBU0428Test_CM_single_cnt 6 -3.4028234663852886E+38 3.4028234663852886E+38 AXIS_PTS_REF TQDIS_vShftChngLimThres_CUR_x /end AXIS_DESCR
/end CHARACTERISTIC
/begin AXIS_PTS TQDIS_vShftChngLimThres_CUR_x "" 0x7001229a SPD_vVehSpd Lookup1D_X_FLOAT32_IEEE 0 VBU0428Test_CM_single_cnt 6 -3.4028234663852886E+38 3.4028234663852886E+38 /end AXIS_PTS
/begin CHARACTERISTIC TQDIS_facShftChngLim_CUR_v "" CURVE 0x7001226a Lookup1D_FLOAT32_IEEE 0 VBU0428Test_CM_single_cnt -3.4028234663852886E+38 3.4028234663852886E+38
 /begin AXIS_DESCR COM_AXIS SPD_vVehSpd VBU0428Test_CM_single_cnt 6 -3.4028234663852886E+38 3.4028234663852886E+38 AXIS_PTS_REF TQDIS_vShftChngLim_CUR_x /end AXIS_DESCR
/end CHARACTERISTIC
/begin AXIS_PTS TQDIS_vShftChngLim_CUR_x "" 0x700122b2 SPD_vVehSpd Lookup1D_X_FLOAT32_IEEE 0 VBU0428Test_CM_single_cnt 6 -3.4028234663852886E+38 3.4028234663852886E+38 /end AXIS_PTS
/begin CHARACTERISTIC TQDIS_facShftDR_CUR_v "" CURVE 0x700131b6 Lookup1D_FLOAT32_IEEE 0 VBU0428Test_CM_single_pct 0.0 20.0
 /begin AXIS_DESCR COM_AXIS NO_INPUT_QUANTITY VBU0428Test_CM_single_Nm 12 0.0 1000.0 AXIS_PTS_REF TQDIS_trqShftDR_CUR_x /end AXIS_DESCR
/end CHARACTERISTIC
/begin AXIS_PTS TQDIS_trqShftDR_CUR_x "" 0x70013246 NO_INPUT_QUANTITY Lookup1D_X_FLOAT32_IEEE 0 VBU0428Test_CM_single_Nm 12 0.0 1000.0 /end AXIS_PTS
/begin CHARACTERISTIC TQDIS_facAccPedFilter_CUR_v "" CURVE 0x70012046 Lookup1D_FLOAT32_IEEE 0 VBU0428Test_CM_single_cnt -3.4028234663852886E+38 3.4028234663852886E+38
 /begin AXIS_DESCR COM_AXIS APD_pctAccPedPos VBU0428Test_CM_single_cnt 5 -3.4028234663852886E+38 3.4028234663852886E+38 AXIS_PTS_REF TQDIS_pctAccPedFilter_CUR_x /end AXIS_DESCR
/end CHARACTERISTIC
/begin AXIS_PTS TQDIS_pctAccPedFilter_CUR_x "" 0x7001205a APD_pctAccPedPos Lookup1D_X_FLOAT32_IEEE 0 VBU0428Test_CM_single_cnt 5 -3.4028234663852886E+38 3.4028234663852886E+38 /end AXIS_PTS
/begin CHARACTERISTIC TQDIS_facDrvLo_CUR_y "" CURVE 0x70011d6a Lookup1D_FLOAT32_IEEE 0 VBU0428Test_CM_single_pct 0.0 1.0
 /begin AXIS_DESCR COM_AXIS NO_INPUT_QUANTITY VBU0428Test_CM_single_kw 4 0.0 150.0 AXIS_PTS_REF TQDIS_pwrDrvLo_CUR_x /end AXIS_DESCR
/end CHARACTERISTIC
/begin AXIS_PTS TQDIS_pwrDrvLo_CUR_x "" 0x70011d9a NO_INPUT_QUANTITY Lookup1D_X_FLOAT32_IEEE 0 VBU0428Test_CM_single_kw 4 0.0 150.0 /end AXIS_PTS
/begin CHARACTERISTIC TQDIS_facRgnLo_CUR_y "" CURVE 0x70011d7a Lookup1D_FLOAT32_IEEE 0 VBU0428Test_CM_single_pct 0.0 1.0
 /begin AXIS_DESCR COM_AXIS NO_INPUT_QUANTITY VBU0428Test_CM_single_kw 4 0.0 150.0 AXIS_PTS_REF TQDIS_pwrRgnLo_CUR_x /end AXIS_DESCR
/end CHARACTERISTIC
/begin AXIS_PTS TQDIS_pwrRgnLo_CUR_x "" 0x70011daa NO_INPUT_QUANTITY Lookup1D_X_FLOAT32_IEEE 0 VBU0428Test_CM_single_kw 4 0.0 150.0 /end AXIS_PTS
/begin CHARACTERISTIC TQDIS_facBrkSlpCrp_MAP_v "" MAP 0x70013186 Lookup2D_FLOAT32_IEEE 0 VBU0428Test_CM_single_cnt -3.4028234663852886E+38 3.4028234663852886E+38
 /begin AXIS_DESCR COM_AXIS SPD_pctSlope VBU0428Test_CM_single_cnt 3 -3.4028234663852886E+38 3.4028234663852886E+38 AXIS_PTS_REF TQDIS_facSlpCrp_MAP_y /end AXIS_DESCR
 /begin AXIS_DESCR COM_AXIS BPD_pctBrkPos VBU0428Test_CM_single_cnt 4 -3.4028234663852886E+38 3.4028234663852886E+38 AXIS_PTS_REF TQDIS_pctBrkCrp_MAP_x /end AXIS_DESCR
/end CHARACTERISTIC
/begin AXIS_PTS TQDIS_pctBrkCrp_MAP_x "" 0x70011d8a BPD_pctBrkPos Lookup2D_X_FLOAT32_IEEE 0 VBU0428Test_CM_single_cnt 4 -3.4028234663852886E+38 3.4028234663852886E+38 /end AXIS_PTS
/begin AXIS_PTS TQDIS_facSlpCrp_MAP_y "" 0x70011bec SPD_pctSlope Lookup2D_X_FLOAT32_IEEE 0 VBU0428Test_CM_single_cnt 3 -3.4028234663852886E+38 3.4028234663852886E+38 /end AXIS_PTS
/begin CHARACTERISTIC TQDIS_facBrkDec_MAP_v "" MAP 0x700178b0 Lookup2D_FLOAT32_IEEE 0 VBU0428Test_CM_single_cnt -3.4028234663852886E+38 3.4028234663852886E+38
 /begin AXIS_DESCR COM_AXIS SPD_vVehSpd VBU0428Test_CM_single_cnt 13 -3.4028234663852886E+38 3.4028234663852886E+38 AXIS_PTS_REF TQDIS_vBrkDec_MAP_y /end AXIS_DESCR
 /begin AXIS_DESCR COM_AXIS BPD_pctBrkPos VBU0428Test_CM_single_cnt 11 -3.4028234663852886E+38 3.4028234663852886E+38 AXIS_PTS_REF TQDIS_pctBrkDec_MAP_x /end AXIS_DESCR
/end CHARACTERISTIC
/begin AXIS_PTS TQDIS_pctBrkDec_MAP_x "" 0x70012e2a BPD_pctBrkPos Lookup2D_X_FLOAT32_IEEE 0 VBU0428Test_CM_single_cnt 11 -3.4028234663852886E+38 3.4028234663852886E+38 /end AXIS_PTS
/begin AXIS_PTS TQDIS_vBrkDec_MAP_y "" 0x7001374a SPD_vVehSpd Lookup2D_X_FLOAT32_IEEE 0 VBU0428Test_CM_single_cnt 13 -3.4028234663852886E+38 3.4028234663852886E+38 /end AXIS_PTS
/begin CHARACTERISTIC TQDIS_trqCrpBase_MAP_v "" MAP 0x700131e6 Lookup2D_FLOAT32_IEEE 0 VBU0428Test_CM_single_cnt -3.4028234663852886E+38 3.4028234663852886E+38
 /begin AXIS_DESCR COM_AXIS NO_INPUT_QUANTITY VBU0428Test_CM_single_cnt 3 -3.4028234663852886E+38 3.4028234663852886E+38 AXIS_PTS_REF TQDIS_stCrpBase_MAP_y /end AXIS_DESCR
 /begin AXIS_DESCR COM_AXIS SPD_vVehSpd VBU0428Test_CM_single_cnt 4 -3.4028234663852886E+38 3.4028234663852886E+38 AXIS_PTS_REF TQDIS_vCrpBase_MAP_x /end AXIS_DESCR
/end CHARACTERISTIC
/begin AXIS_PTS TQDIS_vCrpBase_MAP_x "" 0x70011dca SPD_vVehSpd Lookup2D_X_FLOAT32_IEEE 0 VBU0428Test_CM_single_cnt 4 -3.4028234663852886E+38 3.4028234663852886E+38 /end AXIS_PTS
/begin AXIS_PTS TQDIS_stCrpBase_MAP_y "" 0x70011bf8 NO_INPUT_QUANTITY Lookup2D_X_FLOAT32_IEEE 0 VBU0428Test_CM_single_cnt 3 -3.4028234663852886E+38 3.4028234663852886E+38 /end AXIS_PTS
/begin CHARACTERISTIC TQDIS_trqDecGradRA_MAP_v "" MAP 0x70015984 Lookup2D_FLOAT32_IEEE 0 VBU0428Test_CM_single_Nm -500.0 500.0
 /begin AXIS_DESCR COM_AXIS NO_INPUT_QUANTITY VBU0428Test_CM_single_Nm 12 -3000.0 5000.0 AXIS_PTS_REF TQDIS_trqDecGrad_MAP_y /end AXIS_DESCR
 /begin AXIS_DESCR COM_AXIS SPD_vVehSpd VBU0428Test_CM_single_kph 7 0.0 140.0 AXIS_PTS_REF TQDIS_vDecGrad_MAP_x /end AXIS_DESCR
/end CHARACTERISTIC
/begin AXIS_PTS TQDIS_vDecGrad_MAP_x "" 0x70012482 SPD_vVehSpd Lookup2D_X_FLOAT32_IEEE 0 VBU0428Test_CM_single_kph 7 0.0 140.0 /end AXIS_PTS
/begin AXIS_PTS TQDIS_trqDecGrad_MAP_y "" 0x70013216 NO_INPUT_QUANTITY Lookup2D_X_FLOAT32_IEEE 0 VBU0428Test_CM_single_Nm 12 -3000.0 5000.0 /end AXIS_PTS
/begin CHARACTERISTIC TQDIS_trqDecGradECORA_MAP_v "" MAP 0x70015834 Lookup2D_FLOAT32_IEEE 0 VBU0428Test_CM_single_Nm -500.0 500.0
 /begin AXIS_DESCR COM_AXIS NO_INPUT_QUANTITY VBU0428Test_CM_single_Nm 12 -3000.0 5000.0 AXIS_PTS_REF TQDIS_trqDecGrad_MAP_y /end AXIS_DESCR
 /begin AXIS_DESCR COM_AXIS SPD_vVehSpd VBU0428Test_CM_single_kph 7 0.0 140.0 AXIS_PTS_REF TQDIS_vDecGrad_MAP_x /end AXIS_DESCR
/end CHARACTERISTIC
/begin CHARACTERISTIC TQDIS_trqIncGradRA_MAP_v "" MAP 0x7001d768 Lookup2D_FLOAT32_IEEE 0 VBU0428Test_CM_single_cnt -3.4028234663852886E+38 3.4028234663852886E+38
 /begin AXIS_DESCR COM_AXIS NO_INPUT_QUANTITY VBU0428Test_CM_single_cnt 41 -3.4028234663852886E+38 3.4028234663852886E+38 AXIS_PTS_REF TQDIS_trqIncGrad_MAP_y /end AXIS_DESCR
 /begin AXIS_DESCR COM_AXIS SPD_vVehSpd VBU0428Test_CM_single_cnt 9 -3.4028234663852886E+38 3.4028234663852886E+38 AXIS_PTS_REF TQDIS_vIncGrad_MAP_x /end AXIS_DESCR
/end CHARACTERISTIC
/begin AXIS_PTS TQDIS_vIncGrad_MAP_x "" 0x70012896 SPD_vVehSpd Lookup2D_X_FLOAT32_IEEE 0 VBU0428Test_CM_single_cnt 9 -3.4028234663852886E+38 3.4028234663852886E+38 /end AXIS_PTS
/begin AXIS_PTS TQDIS_trqIncGrad_MAP_y "" 0x70014fee NO_INPUT_QUANTITY Lookup2D_X_FLOAT32_IEEE 0 VBU0428Test_CM_single_cnt 41 -3.4028234663852886E+38 3.4028234663852886E+38 /end AXIS_PTS
/begin CHARACTERISTIC TQDIS_facAccPdlECORA_MAP_v "" MAP 0x7001ba24 Lookup2D_FLOAT32_IEEE 0 VBU0428Test_CM_single_cnt -3.4028234663852886E+38 3.4028234663852886E+38
 /begin AXIS_DESCR COM_AXIS SPD_vVehSpd VBU0428Test_CM_single_cnt 15 -3.4028234663852886E+38 3.4028234663852886E+38 AXIS_PTS_REF TQDIS_vVehAccPdl_MAP_y /end AXIS_DESCR
 /begin AXIS_DESCR COM_AXIS APD_pctAccPedPos VBU0428Test_CM_single_cnt 15 -3.4028234663852886E+38 3.4028234663852886E+38 AXIS_PTS_REF TQDIS_pctAccPdl_MAP_x /end AXIS_DESCR
/end CHARACTERISTIC
/begin AXIS_PTS TQDIS_pctAccPdl_MAP_x "" 0x70013c0e APD_pctAccPedPos Lookup2D_X_FLOAT32_IEEE 0 VBU0428Test_CM_single_cnt 15 -3.4028234663852886E+38 3.4028234663852886E+38 /end AXIS_PTS
/begin AXIS_PTS TQDIS_vVehAccPdl_MAP_y "" 0x70013c4a SPD_vVehSpd Lookup2D_X_FLOAT32_IEEE 0 VBU0428Test_CM_single_cnt 15 -3.4028234663852886E+38 3.4028234663852886E+38 /end AXIS_PTS
/begin CHARACTERISTIC TQDIS_facAccPdlNrmRA_MAP_v "" MAP 0x7001bda8 Lookup2D_FLOAT32_IEEE 0 VBU0428Test_CM_single_cnt -3.4028234663852886E+38 3.4028234663852886E+38
 /begin AXIS_DESCR COM_AXIS SPD_vVehSpd VBU0428Test_CM_single_cnt 15 -3.4028234663852886E+38 3.4028234663852886E+38 AXIS_PTS_REF TQDIS_vVehAccPdl_MAP_y /end AXIS_DESCR
 /begin AXIS_DESCR COM_AXIS APD_pctAccPedPos VBU0428Test_CM_single_cnt 15 -3.4028234663852886E+38 3.4028234663852886E+38 AXIS_PTS_REF TQDIS_pctAccPdl_MAP_x /end AXIS_DESCR
/end CHARACTERISTIC
/begin CHARACTERISTIC TQDIS_facAPDTrqNrmRA_MAP_v "" MAP 0x7001f1e4 Lookup2D_FLOAT32_IEEE 0 VBU0428Test_CM_single_cnt -3.4028234663852886E+38 3.4028234663852886E+38
 /begin AXIS_DESCR COM_AXIS APD_pctAccPedPos VBU0428Test_CM_single_cnt 15 -3.4028234663852886E+38 3.4028234663852886E+38 AXIS_PTS_REF TQDIS_pctAPDTrq_MAP_y /end AXIS_DESCR
 /begin AXIS_DESCR COM_AXIS NO_INPUT_QUANTITY VBU0428Test_CM_single_cnt 31 -3.4028234663852886E+38 3.4028234663852886E+38 AXIS_PTS_REF TQDIS_trqAPDTrq_MAP_x /end AXIS_DESCR
/end CHARACTERISTIC
/begin AXIS_PTS TQDIS_trqAPDTrq_MAP_x "" 0x70014e56 NO_INPUT_QUANTITY Lookup2D_X_FLOAT32_IEEE 0 VBU0428Test_CM_single_cnt 31 -3.4028234663852886E+38 3.4028234663852886E+38 /end AXIS_PTS
/begin AXIS_PTS TQDIS_pctAPDTrq_MAP_y "" 0x70013bd2 APD_pctAccPedPos Lookup2D_X_FLOAT32_IEEE 0 VBU0428Test_CM_single_cnt 15 -3.4028234663852886E+38 3.4028234663852886E+38 /end AXIS_PTS
/begin CHARACTERISTIC TQDIS_facAPDTrqECORA_MAP_v "" MAP 0x7001eaa0 Lookup2D_FLOAT32_IEEE 0 VBU0428Test_CM_single_cnt -3.4028234663852886E+38 3.4028234663852886E+38
 /begin AXIS_DESCR COM_AXIS APD_pctAccPedPos VBU0428Test_CM_single_cnt 15 -3.4028234663852886E+38 3.4028234663852886E+38 AXIS_PTS_REF TQDIS_pctAPDTrq_MAP_y /end AXIS_DESCR
 /begin AXIS_DESCR COM_AXIS NO_INPUT_QUANTITY VBU0428Test_CM_single_cnt 31 -3.4028234663852886E+38 3.4028234663852886E+38 AXIS_PTS_REF TQDIS_trqAPDTrq_MAP_x /end AXIS_DESCR
/end CHARACTERISTIC
/begin CHARACTERISTIC TQDIS_trqIncGradECORA_MAP_v "" MAP 0x7001d1a4 Lookup2D_FLOAT32_IEEE 0 VBU0428Test_CM_single_cnt -3.4028234663852886E+38 3.4028234663852886E+38
 /begin AXIS_DESCR COM_AXIS NO_INPUT_QUANTITY VBU0428Test_CM_single_cnt 41 -3.4028234663852886E+38 3.4028234663852886E+38 AXIS_PTS_REF TQDIS_trqIncGrad_MAP_y /end AXIS_DESCR
 /begin AXIS_DESCR COM_AXIS SPD_vVehSpd VBU0428Test_CM_single_cnt 9 -3.4028234663852886E+38 3.4028234663852886E+38 AXIS_PTS_REF TQDIS_vIncGrad_MAP_x /end AXIS_DESCR
/end CHARACTERISTIC
/begin CHARACTERISTIC CaSOF_VoltageCorrectFactorRegenMapY_n "" CURVE 0x70011e8e Lookup1D_FLOAT32_IEEE 0 VBU0428Test_CM_single_cnt -3.4028234663852886E+38 3.4028234663852886E+38
 /begin AXIS_DESCR COM_AXIS NO_INPUT_QUANTITY VBU0428Test_CM_uint16_cnt 5 0.0 65535.0 AXIS_PTS_REF CaSOF_VoltageCorrectFactorRegenMapX_mV /end AXIS_DESCR
/end CHARACTERISTIC
/begin AXIS_PTS CaSOF_VoltageCorrectFactorRegenMapX_mV "" 0x70011b5e NO_INPUT_QUANTITY Lookup1D_X_UWORD 0 VBU0428Test_CM_uint16_cnt 5 0.0 65535.0 /end AXIS_PTS
/begin CHARACTERISTIC CaSOF_VoltageCorrectFactorDischargeMapY_n "" CURVE 0x70011e7a Lookup1D_FLOAT32_IEEE 0 VBU0428Test_CM_single_cnt -3.4028234663852886E+38 3.4028234663852886E+38
 /begin AXIS_DESCR COM_AXIS NO_INPUT_QUANTITY VBU0428Test_CM_uint16_cnt 5 0.0 65535.0 AXIS_PTS_REF CaSOF_VoltageCorrectFactorDischargeMapX_mV /end AXIS_DESCR
/end CHARACTERISTIC
/begin AXIS_PTS CaSOF_VoltageCorrectFactorDischargeMapX_mV "" 0x70011b54 NO_INPUT_QUANTITY Lookup1D_X_UWORD 0 VBU0428Test_CM_uint16_cnt 5 0.0 65535.0 /end AXIS_PTS
/begin CHARACTERISTIC CaSOF_LowTempDischargeVoltageCorrectFactorMapY_n "" CURVE 0x70011ad2 Lookup1D_FLOAT32_IEEE 0 VBU0428Test_CM_single_cnt -3.4028234663852886E+38 3.4028234663852886E+38
 /begin AXIS_DESCR COM_AXIS CTM_tCellTempMin VBU0428Test_CM_single_cnt 2 -3.4028234663852886E+38 3.4028234663852886E+38 AXIS_PTS_REF CaSOF_LowTempDischargeVoltageCorrectFactorMapX_C /end AXIS_DESCR
/end CHARACTERISTIC
/begin AXIS_PTS CaSOF_LowTempDischargeVoltageCorrectFactorMapX_C "" 0x70011aca CTM_tCellTempMin Lookup1D_X_FLOAT32_IEEE 0 VBU0428Test_CM_single_cnt 2 -3.4028234663852886E+38 3.4028234663852886E+38 /end AXIS_PTS
/begin CHARACTERISTIC CaSOF_VoltageCorrectFactorChargeMapY_n "" CURVE 0x70011e66 Lookup1D_FLOAT32_IEEE 0 VBU0428Test_CM_single_cnt -3.4028234663852886E+38 3.4028234663852886E+38
 /begin AXIS_DESCR COM_AXIS NO_INPUT_QUANTITY VBU0428Test_CM_uint16_cnt 5 0.0 65535.0 AXIS_PTS_REF CaSOF_VoltageCorrectFactorChargeMapX_mV /end AXIS_DESCR
/end CHARACTERISTIC
/begin AXIS_PTS CaSOF_VoltageCorrectFactorChargeMapX_mV "" 0x70011b4a NO_INPUT_QUANTITY Lookup1D_X_UWORD 0 VBU0428Test_CM_uint16_cnt 5 0.0 65535.0 /end AXIS_PTS
/begin CHARACTERISTIC CaSOF_VoltageCorrectCellVoltMinMapY_V "" CURVE 0x70011cfa Lookup1D_FLOAT32_IEEE 0 VBU0428Test_CM_single_cnt -3.4028234663852886E+38 3.4028234663852886E+38
 /begin AXIS_DESCR COM_AXIS CTM_tCellTempMin VBU0428Test_CM_single_cnt 4 -3.4028234663852886E+38 3.4028234663852886E+38 AXIS_PTS_REF CaSOF_VoltageCorrectCellVoltMinMapX_C /end AXIS_DESCR
/end CHARACTERISTIC
/begin AXIS_PTS CaSOF_VoltageCorrectCellVoltMinMapX_C "" 0x70011cea CTM_tCellTempMin Lookup1D_X_FLOAT32_IEEE 0 VBU0428Test_CM_single_cnt 4 -3.4028234663852886E+38 3.4028234663852886E+38 /end AXIS_PTS
/begin CHARACTERISTIC CaSOF_DischargeOcvSocTempMapZ_V "" MAP 0x7001a3a0 Lookup2D_FLOAT32_IEEE 0 VBU0428Test_CM_single_cnt -3.4028234663852886E+38 3.4028234663852886E+38
 /begin AXIS_DESCR COM_AXIS SOC_pctCellSocMin VBU0428Test_CM_single_cnt 21 -3.4028234663852886E+38 3.4028234663852886E+38 AXIS_PTS_REF CaSOF_DischargeOcvSocTempMapY_pct /end AXIS_DESCR
 /begin AXIS_DESCR COM_AXIS CTM_tCellTempMin VBU0428Test_CM_single_cnt 9 -3.4028234663852886E+38 3.4028234663852886E+38 AXIS_PTS_REF CaSOF_DischargeOcvSocTempMapX_C /end AXIS_DESCR
/end CHARACTERISTIC
/begin AXIS_PTS CaSOF_DischargeOcvSocTempMapX_C "" 0x70012752 CTM_tCellTempMin Lookup2D_X_FLOAT32_IEEE 0 VBU0428Test_CM_single_cnt 9 -3.4028234663852886E+38 3.4028234663852886E+38 /end AXIS_PTS
/begin AXIS_PTS CaSOF_DischargeOcvSocTempMapY_pct "" 0x7001442e SOC_pctCellSocMin Lookup2D_X_FLOAT32_IEEE 0 VBU0428Test_CM_single_cnt 21 -3.4028234663852886E+38 3.4028234663852886E+38 /end AXIS_PTS
/begin CHARACTERISTIC CaSOF_DischargeDcirSocTempMapZ_mOhm "" MAP 0x7001572c Lookup2D_FLOAT32_IEEE 0 VBU0428Test_CM_single_cnt -3.4028234663852886E+38 3.4028234663852886E+38
 /begin AXIS_DESCR COM_AXIS SOC_pctCellSocMin VBU0428Test_CM_single_cnt 11 -3.4028234663852886E+38 3.4028234663852886E+38 AXIS_PTS_REF CaSOF_DischargeDcirSocTempMapY_pct /end AXIS_DESCR
 /begin AXIS_DESCR COM_AXIS CTM_tCellTempMin VBU0428Test_CM_single_cnt 6 -3.4028234663852886E+38 3.4028234663852886E+38 AXIS_PTS_REF CaSOF_DischargeDcirSocTempMapX_C /end AXIS_DESCR
/end CHARACTERISTIC
/begin AXIS_PTS CaSOF_DischargeDcirSocTempMapX_C "" 0x7001217a CTM_tCellTempMin Lookup2D_X_FLOAT32_IEEE 0 VBU0428Test_CM_single_cnt 6 -3.4028234663852886E+38 3.4028234663852886E+38 /end AXIS_PTS
/begin AXIS_PTS CaSOF_DischargeDcirSocTempMapY_pct "" 0x70012cca SOC_pctCellSocMin Lookup2D_X_FLOAT32_IEEE 0 VBU0428Test_CM_single_cnt 11 -3.4028234663852886E+38 3.4028234663852886E+38 /end AXIS_PTS
/begin CHARACTERISTIC CaSOH_UdResisMapZ_mohm "" MAP 0x70017208 Lookup2D_FLOAT32_IEEE 0 VBU0428Test_CM_single_cnt -3.4028234663852886E+38 3.4028234663852886E+38
 /begin AXIS_DESCR COM_AXIS NO_INPUT_QUANTITY VBU0428Test_CM_uint16_cnt 20 0.0 65535.0 AXIS_PTS_REF CaSOH_UdResisMapY_mV /end AXIS_DESCR
 /begin AXIS_DESCR COM_AXIS NO_INPUT_QUANTITY VBU0428Test_CM_single_cnt 7 -3.4028234663852886E+38 3.4028234663852886E+38 AXIS_PTS_REF CaSOH_UdResisMapX_C /end AXIS_DESCR
/end CHARACTERISTIC
/begin AXIS_PTS CaSOH_UdResisMapX_C "" 0x700123da NO_INPUT_QUANTITY Lookup2D_X_FLOAT32_IEEE 0 VBU0428Test_CM_single_cnt 7 -3.4028234663852886E+38 3.4028234663852886E+38 /end AXIS_PTS
/begin AXIS_PTS CaSOH_UdResisMapY_mV "" 0x700129ba NO_INPUT_QUANTITY Lookup2D_X_UWORD 0 VBU0428Test_CM_uint16_cnt 20 0.0 65535.0 /end AXIS_PTS
/begin CHARACTERISTIC CaSOH_OcvSocMapZ_pct "" MAP 0x7001b000 Lookup2D_FLOAT32_IEEE 0 VBU0428Test_CM_single_cnt -3.4028234663852886E+38 3.4028234663852886E+38
 /begin AXIS_DESCR COM_AXIS NO_INPUT_QUANTITY VBU0428Test_CM_uint16_cnt 23 0.0 65535.0 AXIS_PTS_REF CaSOH_OcvSocMapY_mV /end AXIS_DESCR
 /begin AXIS_DESCR COM_AXIS NO_INPUT_QUANTITY VBU0428Test_CM_single_cnt 9 -3.4028234663852886E+38 3.4028234663852886E+38 AXIS_PTS_REF CaSOH_OcvSocMapX_C /end AXIS_DESCR
/end CHARACTERISTIC
/begin AXIS_PTS CaSOH_OcvSocMapX_C "" 0x700127be NO_INPUT_QUANTITY Lookup2D_X_FLOAT32_IEEE 0 VBU0428Test_CM_single_cnt 9 -3.4028234663852886E+38 3.4028234663852886E+38 /end AXIS_PTS
/begin AXIS_PTS CaSOH_OcvSocMapY_mV "" 0x70013068 NO_INPUT_QUANTITY Lookup2D_X_UWORD 0 VBU0428Test_CM_uint16_cnt 23 0.0 65535.0 /end AXIS_PTS
/begin CHARACTERISTIC CaSOF_ChargeCurrentLimitBufferTimeSocTempMapZ_s "" MAP 0x70018730 Lookup2D_FLOAT32_IEEE 0 VBU0428Test_CM_single_cnt -3.4028234663852886E+38 3.4028234663852886E+38
 /begin AXIS_DESCR COM_AXIS SOC_pctCellSocMax VBU0428Test_CM_single_cnt 13 -3.4028234663852886E+38 3.4028234663852886E+38 AXIS_PTS_REF CaSOF_ChargeCurrentLimitBufferTimeSocTempMapY_pct /end AXIS_DESCR
 /begin AXIS_DESCR COM_AXIS NO_INPUT_QUANTITY VBU0428Test_CM_single_cnt 14 -3.4028234663852886E+38 3.4028234663852886E+38 AXIS_PTS_REF CaSOF_ChargeCurrentLimitBufferTimeSocTempMapX_C /end AXIS_DESCR
/end CHARACTERISTIC
/begin AXIS_PTS CaSOF_ChargeCurrentLimitBufferTimeSocTempMapX_C "" 0x7001384e NO_INPUT_QUANTITY Lookup2D_X_FLOAT32_IEEE 0 VBU0428Test_CM_single_cnt 14 -3.4028234663852886E+38 3.4028234663852886E+38 /end AXIS_PTS
/begin AXIS_PTS CaSOF_ChargeCurrentLimitBufferTimeSocTempMapY_pct "" 0x700133a2 SOC_pctCellSocMax Lookup2D_X_FLOAT32_IEEE 0 VBU0428Test_CM_single_cnt 13 -3.4028234663852886E+38 3.4028234663852886E+38 /end AXIS_PTS
/begin CHARACTERISTIC CaSOF_DischargeCurrentLimitBufferTimeSocTempMapZ_s "" MAP 0x70019568 Lookup2D_FLOAT32_IEEE 0 VBU0428Test_CM_single_cnt -3.4028234663852886E+38 3.4028234663852886E+38
 /begin AXIS_DESCR COM_AXIS SOC_pctCellSocMin VBU0428Test_CM_single_cnt 13 -3.4028234663852886E+38 3.4028234663852886E+38 AXIS_PTS_REF CaSOF_DischargeCurrentLimitBufferTimeSocTempMapY_pct /end AXIS_DESCR
 /begin AXIS_DESCR COM_AXIS NO_INPUT_QUANTITY VBU0428Test_CM_single_cnt 14 -3.4028234663852886E+38 3.4028234663852886E+38 AXIS_PTS_REF CaSOF_DischargeCurrentLimitBufferTimeSocTempMapX_C /end AXIS_DESCR
/end CHARACTERISTIC
/begin AXIS_PTS CaSOF_DischargeCurrentLimitBufferTimeSocTempMapX_C "" 0x70013966 NO_INPUT_QUANTITY Lookup2D_X_FLOAT32_IEEE 0 VBU0428Test_CM_single_cnt 14 -3.4028234663852886E+38 3.4028234663852886E+38 /end AXIS_PTS
/begin AXIS_PTS CaSOF_DischargeCurrentLimitBufferTimeSocTempMapY_pct "" 0x700134a6 SOC_pctCellSocMin Lookup2D_X_FLOAT32_IEEE 0 VBU0428Test_CM_single_cnt 13 -3.4028234663852886E+38 3.4028234663852886E+38 /end AXIS_PTS
/begin CHARACTERISTIC CaSOF_BuffUseFactorCurrtLTCurrtMapZ_n "" MAP 0x700181f8 Lookup2D_FLOAT32_IEEE 0 VBU0428Test_CM_single_cnt -3.4028234663852886E+38 3.4028234663852886E+38
 /begin AXIS_DESCR COM_AXIS NO_INPUT_QUANTITY VBU0428Test_CM_single_cnt 11 -3.4028234663852886E+38 3.4028234663852886E+38 AXIS_PTS_REF CaSOF_BuffUseFactorCurrtLTCurrtMapY_A /end AXIS_DESCR
 /begin AXIS_DESCR COM_AXIS NO_INPUT_QUANTITY VBU0428Test_CM_single_cnt 15 -3.4028234663852886E+38 3.4028234663852886E+38 AXIS_PTS_REF CaSOF_BuffUseFactorCurrtLTCurrtMapX_A /end AXIS_DESCR
/end CHARACTERISTIC
/begin AXIS_PTS CaSOF_BuffUseFactorCurrtLTCurrtMapX_A "" 0x70013b96 NO_INPUT_QUANTITY Lookup2D_X_FLOAT32_IEEE 0 VBU0428Test_CM_single_cnt 15 -3.4028234663852886E+38 3.4028234663852886E+38 /end AXIS_PTS
/begin AXIS_PTS CaSOF_BuffUseFactorCurrtLTCurrtMapY_A "" 0x70012c9e NO_INPUT_QUANTITY Lookup2D_X_FLOAT32_IEEE 0 VBU0428Test_CM_single_cnt 11 -3.4028234663852886E+38 3.4028234663852886E+38 /end AXIS_PTS
/begin CHARACTERISTIC CaSOF_BuffUseFactorSocTempMapZ_n "" MAP 0x70016e50 Lookup2D_FLOAT32_IEEE 0 VBU0428Test_CM_single_cnt -3.4028234663852886E+38 3.4028234663852886E+38
 /begin AXIS_DESCR COM_AXIS SOC_pctCellSocMin VBU0428Test_CM_single_cnt 13 -3.4028234663852886E+38 3.4028234663852886E+38 AXIS_PTS_REF CaSOF_BuffUseFactorSocTempMapY_pct /end AXIS_DESCR
 /begin AXIS_DESCR COM_AXIS NO_INPUT_QUANTITY VBU0428Test_CM_single_cnt 9 -3.4028234663852886E+38 3.4028234663852886E+38 AXIS_PTS_REF CaSOF_BuffUseFactorSocTempMapX_C /end AXIS_DESCR
/end CHARACTERISTIC
/begin AXIS_PTS CaSOF_BuffUseFactorSocTempMapX_C "" 0x7001272e NO_INPUT_QUANTITY Lookup2D_X_FLOAT32_IEEE 0 VBU0428Test_CM_single_cnt 9 -3.4028234663852886E+38 3.4028234663852886E+38 /end AXIS_PTS
/begin AXIS_PTS CaSOF_BuffUseFactorSocTempMapY_pct "" 0x7001336e SOC_pctCellSocMin Lookup2D_X_FLOAT32_IEEE 0 VBU0428Test_CM_single_cnt 13 -3.4028234663852886E+38 3.4028234663852886E+38 /end AXIS_PTS
/begin CHARACTERISTIC CaSOF_ShortPulseChargeLockedSocTempMapX_C "" VAL_BLK 0x7001424a Scalar_FLOAT32_IEEE 0 VBU0428Test_CM_single_C -40.0 120.0 NUMBER 20 /end CHARACTERISTIC
/begin CHARACTERISTIC CaSOF_ShortPulseChargeLockedSocTempMapY_pct "" VAL_BLK 0x70014a22 Scalar_FLOAT32_IEEE 0 VBU0428Test_CM_single_pct 0.0 100.0 NUMBER 22 /end CHARACTERISTIC
/begin CHARACTERISTIC CaSOF_ShortPulseChargeSocTempMapX_C "" VAL_BLK 0x7001429a Scalar_FLOAT32_IEEE 0 VBU0428Test_CM_single_t -40.0 120.0 NUMBER 20 /end CHARACTERISTIC
/begin CHARACTERISTIC CaSOF_ShortPulseChargeSocTempMapY_pct "" VAL_BLK 0x70014a7a Scalar_FLOAT32_IEEE 0 VBU0428Test_CM_single_pct 0.0 100.0 NUMBER 22 /end CHARACTERISTIC
/begin CHARACTERISTIC CcCTD_MaxAccumulatedHeadLoad_J "" VALUE 0x700105c8 Scalar_FLOAT32_IEEE 0 VBU0428Test_CM_single_cnt -3.4028234663852886E+38 3.4028234663852886E+38 /end CHARACTERISTIC
/begin CHARACTERISTIC CcFCC_FullChargeSocDelta_pct "" VALUE 0x70010750 Scalar_FLOAT32_IEEE 0 VBU0428Test_CM_single_cnt -3.4028234663852886E+38 3.4028234663852886E+38 /end CHARACTERISTIC
/begin CHARACTERISTIC CcFCC_HomoFullChargeSoc_pct "" VALUE 0x70010754 Scalar_FLOAT32_IEEE 0 VBU0428Test_CM_single_cnt -3.4028234663852886E+38 3.4028234663852886E+38 /end CHARACTERISTIC
/begin CHARACTERISTIC CcSOC_CurrentStableThresholdRate_pct "" VALUE 0x70010840 Scalar_FLOAT32_IEEE 0 VBU0428Test_CM_single_cnt -3.4028234663852886E+38 3.4028234663852886E+38 /end CHARACTERISTIC
/begin CHARACTERISTIC CcSOC_CurrentWinAvePeriodTime_ms "" VALUE 0x70010844 Scalar_FLOAT32_IEEE 0 VBU0428Test_CM_single_cnt -3.4028234663852886E+38 3.4028234663852886E+38 /end CHARACTERISTIC
/begin CHARACTERISTIC CcSOF_BaseCurrentLimitFactor_pct "" VALUE 0x70010898 Scalar_FLOAT32_IEEE 0 VBU0428Test_CM_single_cnt -3.4028234663852886E+38 3.4028234663852886E+38 /end CHARACTERISTIC
/begin CHARACTERISTIC CcSOF_BatteryCurrentLow_A "" VALUE 0x7001089c Scalar_FLOAT32_IEEE 0 VBU0428Test_CM_single_cnt -3.4028234663852886E+38 3.4028234663852886E+38 /end CHARACTERISTIC
/begin CHARACTERISTIC CcSOF_BolSoh_pct "" VALUE 0x700108ac Scalar_FLOAT32_IEEE 0 VBU0428Test_CM_single_cnt -3.4028234663852886E+38 3.4028234663852886E+38 /end CHARACTERISTIC
/begin CHARACTERISTIC CcSOF_CellDischargeDcirMax_mOhm "" VALUE 0x700108b4 Scalar_FLOAT32_IEEE 0 VBU0428Test_CM_single_cnt -3.4028234663852886E+38 3.4028234663852886E+38 /end CHARACTERISTIC
/begin CHARACTERISTIC CcSOF_CellDischargeDcirMin_mOhm "" VALUE 0x700108b8 Scalar_FLOAT32_IEEE 0 VBU0428Test_CM_single_cnt -3.4028234663852886E+38 3.4028234663852886E+38 /end CHARACTERISTIC
/begin CHARACTERISTIC CcSOF_ChargeCurrentLimitViolateBuffer_A "" VALUE 0x700108bc Scalar_FLOAT32_IEEE 0 VBU0428Test_CM_single_cnt -3.4028234663852886E+38 3.4028234663852886E+38 /end CHARACTERISTIC
/begin CHARACTERISTIC CcSOF_ChargeVoltageCorrectSlope_n "" VALUE 0x700108cc Scalar_FLOAT32_IEEE 0 VBU0428Test_CM_single_cnt -3.4028234663852886E+38 3.4028234663852886E+38 /end CHARACTERISTIC
/begin CHARACTERISTIC CcSOF_ContinuousChargeCurrentLimp_A "" VALUE 0x700108d0 Scalar_FLOAT32_IEEE 0 VBU0428Test_CM_single_cnt -3.4028234663852886E+38 3.4028234663852886E+38 /end CHARACTERISTIC
/begin CHARACTERISTIC CcSOF_ContinuousDischargeCurrentLimp_A "" VALUE 0x700108d4 Scalar_FLOAT32_IEEE 0 VBU0428Test_CM_single_cnt -3.4028234663852886E+38 3.4028234663852886E+38 /end CHARACTERISTIC
/begin CHARACTERISTIC CcSOF_CyclePowerLimitCharge_Kw "" VALUE 0x700108d8 Scalar_FLOAT32_IEEE 0 VBU0428Test_CM_single_cnt -3.4028234663852886E+38 3.4028234663852886E+38 /end CHARACTERISTIC
/begin CHARACTERISTIC CcSOF_CyclePowerLimitLevel1Discharge_Kw "" VALUE 0x700108dc Scalar_FLOAT32_IEEE 0 VBU0428Test_CM_single_cnt -3.4028234663852886E+38 3.4028234663852886E+38 /end CHARACTERISTIC
/begin CHARACTERISTIC CcSOF_CyclePowerLimitLevel1SOCMax_pct "" VALUE 0x700108e0 Scalar_FLOAT32_IEEE 0 VBU0428Test_CM_single_cnt -3.4028234663852886E+38 3.4028234663852886E+38 /end CHARACTERISTIC
/begin CHARACTERISTIC CcSOF_CyclePowerLimitLevel1SOCMin_pct "" VALUE 0x700108e4 Scalar_FLOAT32_IEEE 0 VBU0428Test_CM_single_cnt -3.4028234663852886E+38 3.4028234663852886E+38 /end CHARACTERISTIC
/begin CHARACTERISTIC CcSOF_CyclePowerLimitLevel2Discharge_Kw "" VALUE 0x700108e8 Scalar_FLOAT32_IEEE 0 VBU0428Test_CM_single_cnt -3.4028234663852886E+38 3.4028234663852886E+38 /end CHARACTERISTIC
/begin CHARACTERISTIC CcSOF_CyclePowerLimitLevel2SOCMax_pct "" VALUE 0x700108ec Scalar_FLOAT32_IEEE 0 VBU0428Test_CM_single_cnt -3.4028234663852886E+38 3.4028234663852886E+38 /end CHARACTERISTIC
/begin CHARACTERISTIC CcSOF_CyclePowerLimitLevel2SOCMin_pct "" VALUE 0x700108f0 Scalar_FLOAT32_IEEE 0 VBU0428Test_CM_single_cnt -3.4028234663852886E+38 3.4028234663852886E+38 /end CHARACTERISTIC
/begin CHARACTERISTIC CcSOF_CyclePowerLimitLevel3Discharge1_Kw "" VALUE 0x700108f4 Scalar_FLOAT32_IEEE 0 VBU0428Test_CM_single_cnt -3.4028234663852886E+38 3.4028234663852886E+38 /end CHARACTERISTIC
/begin CHARACTERISTIC CcSOF_CyclePowerLimitLevel3Discharge2_Kw "" VALUE 0x700108f8 Scalar_FLOAT32_IEEE 0 VBU0428Test_CM_single_cnt -3.4028234663852886E+38 3.4028234663852886E+38 /end CHARACTERISTIC
/begin CHARACTERISTIC CcSOF_CyclePowerLimitLevel3SOCMax_pct "" VALUE 0x700108fc Scalar_FLOAT32_IEEE 0 VBU0428Test_CM_single_cnt -3.4028234663852886E+38 3.4028234663852886E+38 /end CHARACTERISTIC
/begin CHARACTERISTIC CcSOF_CyclePowerLimitLevel3SOCMin_pct "" VALUE 0x70010900 Scalar_FLOAT32_IEEE 0 VBU0428Test_CM_single_cnt -3.4028234663852886E+38 3.4028234663852886E+38 /end CHARACTERISTIC
/begin CHARACTERISTIC CcSOF_CyclePowerLimitMax_Kw "" VALUE 0x70010904 Scalar_FLOAT32_IEEE 0 VBU0428Test_CM_single_cnt -3.4028234663852886E+38 3.4028234663852886E+38 /end CHARACTERISTIC
/begin CHARACTERISTIC CcSOF_DcirDeltaCurrentMin_A "" VALUE 0x70010908 Scalar_FLOAT32_IEEE 0 VBU0428Test_CM_single_cnt -3.4028234663852886E+38 3.4028234663852886E+38 /end CHARACTERISTIC
/begin CHARACTERISTIC CcSOF_DischaOverCurFactorSlopeDec_n "" VALUE 0x7001090c Scalar_FLOAT32_IEEE 0 VBU0428Test_CM_single_cnt -3.4028234663852886E+38 3.4028234663852886E+38 /end CHARACTERISTIC
/begin CHARACTERISTIC CcSOF_DischaOverCurFactorSlopeInc_n "" VALUE 0x70010910 Scalar_FLOAT32_IEEE 0 VBU0428Test_CM_single_cnt -3.4028234663852886E+38 3.4028234663852886E+38 /end CHARACTERISTIC
/begin CHARACTERISTIC CcSOF_DischargeOverCurrentLimitFactor_n "" VALUE 0x70010920 Scalar_FLOAT32_IEEE 0 VBU0428Test_CM_single_cnt -3.4028234663852886E+38 3.4028234663852886E+38 /end CHARACTERISTIC
/begin CHARACTERISTIC CcSOF_DischargeOverCurrentThresholdDec_As "" VALUE 0x70010924 Scalar_FLOAT32_IEEE 0 VBU0428Test_CM_single_cnt -3.4028234663852886E+38 3.4028234663852886E+38 /end CHARACTERISTIC
/begin CHARACTERISTIC CcSOF_DischargeOverCurrentThresholdInc_As "" VALUE 0x70010928 Scalar_FLOAT32_IEEE 0 VBU0428Test_CM_single_cnt -3.4028234663852886E+38 3.4028234663852886E+38 /end CHARACTERISTIC
/begin CHARACTERISTIC CcSOF_DischargeVolCorCurrentSlopeDec_A "" VALUE 0x70010930 Scalar_FLOAT32_IEEE 0 VBU0428Test_CM_single_cnt -3.4028234663852886E+38 3.4028234663852886E+38 /end CHARACTERISTIC
/begin CHARACTERISTIC CcSOF_DischargeVolCorCurrentSlopeInc_A "" VALUE 0x70010934 Scalar_FLOAT32_IEEE 0 VBU0428Test_CM_single_cnt -3.4028234663852886E+38 3.4028234663852886E+38 /end CHARACTERISTIC
/begin CHARACTERISTIC CcSOF_DischargeVoltageCorrectSlopeDec_n "" VALUE 0x70010938 Scalar_FLOAT32_IEEE 0 VBU0428Test_CM_single_cnt -3.4028234663852886E+38 3.4028234663852886E+38 /end CHARACTERISTIC
/begin CHARACTERISTIC CcSOF_DischargeVoltageCorrectSlopeInc_n "" VALUE 0x7001093c Scalar_FLOAT32_IEEE 0 VBU0428Test_CM_single_cnt -3.4028234663852886E+38 3.4028234663852886E+38 /end CHARACTERISTIC
/begin CHARACTERISTIC CcSOF_DischargeVoltageCorrectSlope_n "" VALUE 0x70010940 Scalar_FLOAT32_IEEE 0 VBU0428Test_CM_single_cnt -3.4028234663852886E+38 3.4028234663852886E+38 /end CHARACTERISTIC
/begin CHARACTERISTIC CcSOF_DynamicChargeCurrentLimp_A "" VALUE 0x70010944 Scalar_FLOAT32_IEEE 0 VBU0428Test_CM_single_cnt -3.4028234663852886E+38 3.4028234663852886E+38 /end CHARACTERISTIC
/begin CHARACTERISTIC CcSOF_DynamicDischargeCurrentLimp_A "" VALUE 0x70010948 Scalar_FLOAT32_IEEE 0 VBU0428Test_CM_single_cnt -3.4028234663852886E+38 3.4028234663852886E+38 /end CHARACTERISTIC
/begin CHARACTERISTIC CcSOF_EolSoh_pct "" VALUE 0x7001094c Scalar_FLOAT32_IEEE 0 VBU0428Test_CM_single_cnt -3.4028234663852886E+38 3.4028234663852886E+38 /end CHARACTERISTIC
/begin CHARACTERISTIC CcSOF_FastChargeCellVoltageSOCLimit_pct "" VALUE 0x70010950 Scalar_FLOAT32_IEEE 0 VBU0428Test_CM_single_cnt -3.4028234663852886E+38 3.4028234663852886E+38 /end CHARACTERISTIC
/begin CHARACTERISTIC CcSOF_FastChargeCurrentStep1_A "" VALUE 0x70010954 Scalar_FLOAT32_IEEE 0 VBU0428Test_CM_single_cnt -3.4028234663852886E+38 3.4028234663852886E+38 /end CHARACTERISTIC
/begin CHARACTERISTIC CcSOF_FastChargeCurrentStep2_A "" VALUE 0x70010958 Scalar_FLOAT32_IEEE 0 VBU0428Test_CM_single_cnt -3.4028234663852886E+38 3.4028234663852886E+38 /end CHARACTERISTIC
/begin CHARACTERISTIC CcSOF_FastChargeDisableTempLowerLimit_C "" VALUE 0x7001095c Scalar_FLOAT32_IEEE 0 VBU0428Test_CM_single_cnt -3.4028234663852886E+38 3.4028234663852886E+38 /end CHARACTERISTIC
/begin CHARACTERISTIC CcSOF_FastChargeDisableTempUpperLimit_C "" VALUE 0x70010960 Scalar_FLOAT32_IEEE 0 VBU0428Test_CM_single_cnt -3.4028234663852886E+38 3.4028234663852886E+38 /end CHARACTERISTIC
/begin CHARACTERISTIC CcSOF_FastChargeEnableSocLowerLimit_pct "" VALUE 0x70010964 Scalar_FLOAT32_IEEE 0 VBU0428Test_CM_single_cnt -3.4028234663852886E+38 3.4028234663852886E+38 /end CHARACTERISTIC
/begin CHARACTERISTIC CcSOF_FastChargeEnableSocUpperLimit_pct "" VALUE 0x70010968 Scalar_FLOAT32_IEEE 0 VBU0428Test_CM_single_cnt -3.4028234663852886E+38 3.4028234663852886E+38 /end CHARACTERISTIC
/begin CHARACTERISTIC CcSOF_FastChargeEnableTempLowerLimit_C "" VALUE 0x7001096c Scalar_FLOAT32_IEEE 0 VBU0428Test_CM_single_cnt -3.4028234663852886E+38 3.4028234663852886E+38 /end CHARACTERISTIC
/begin CHARACTERISTIC CcSOF_FastChargeRecoverTempUpperLimit_C "" VALUE 0x70010970 Scalar_FLOAT32_IEEE 0 VBU0428Test_CM_single_cnt -3.4028234663852886E+38 3.4028234663852886E+38 /end CHARACTERISTIC
/begin CHARACTERISTIC CcSOF_FastChargeSOCLimit_pct "" VALUE 0x70010974 Scalar_FLOAT32_IEEE 0 VBU0428Test_CM_single_cnt -3.4028234663852886E+38 3.4028234663852886E+38 /end CHARACTERISTIC
/begin CHARACTERISTIC CcSOF_FastChargeSocStep1_pct "" VALUE 0x70010978 Scalar_FLOAT32_IEEE 0 VBU0428Test_CM_single_cnt -3.4028234663852886E+38 3.4028234663852886E+38 /end CHARACTERISTIC
/begin CHARACTERISTIC CcSOF_FccOneThirdRateCurtSlope_A "" VALUE 0x7001097c Scalar_FLOAT32_IEEE 0 VBU0428Test_CM_single_cnt -3.4028234663852886E+38 3.4028234663852886E+38 /end CHARACTERISTIC
/begin CHARACTERISTIC CcSOF_LowVoltageResetSOC_pct "" VALUE 0x70010994 Scalar_FLOAT32_IEEE 0 VBU0428Test_CM_single_cnt -3.4028234663852886E+38 3.4028234663852886E+38 /end CHARACTERISTIC
/begin CHARACTERISTIC CcSOF_LowVoltageSetCurrent_A "" VALUE 0x70010998 Scalar_FLOAT32_IEEE 0 VBU0428Test_CM_single_cnt -3.4028234663852886E+38 3.4028234663852886E+38 /end CHARACTERISTIC
/begin CHARACTERISTIC CcSOF_LowVoltageSetSOC_pct "" VALUE 0x7001099c Scalar_FLOAT32_IEEE 0 VBU0428Test_CM_single_cnt -3.4028234663852886E+38 3.4028234663852886E+38 /end CHARACTERISTIC
/begin CHARACTERISTIC CcSOF_LowVoltageSetVolt2Delta_mV "" VALUE 0x700109a4 Scalar_FLOAT32_IEEE 0 VBU0428Test_CM_single_cnt -3.4028234663852886E+38 3.4028234663852886E+38 /end CHARACTERISTIC
/begin CHARACTERISTIC CcSOF_LowVoltageSetVolt2_mV "" VALUE 0x700109a8 Scalar_FLOAT32_IEEE 0 VBU0428Test_CM_single_cnt -3.4028234663852886E+38 3.4028234663852886E+38 /end CHARACTERISTIC
/begin CHARACTERISTIC CcSOF_LowVoltageSetVolt_mV "" VALUE 0x700109ac Scalar_FLOAT32_IEEE 0 VBU0428Test_CM_single_cnt -3.4028234663852886E+38 3.4028234663852886E+38 /end CHARACTERISTIC
/begin CHARACTERISTIC CcSOF_OriginalDcirDispersion_pct "" VALUE 0x700109b0 Scalar_FLOAT32_IEEE 0 VBU0428Test_CM_single_cnt -3.4028234663852886E+38 3.4028234663852886E+38 /end CHARACTERISTIC
/begin CHARACTERISTIC CcSOF_ShortPulseChargeCurrentLimp_A "" VALUE 0x700109b8 Scalar_FLOAT32_IEEE 0 VBU0428Test_CM_single_cnt -3.4028234663852886E+38 3.4028234663852886E+38 /end CHARACTERISTIC
/begin CHARACTERISTIC CcSOF_ShortPulseDischargeCurrentLimp_A "" VALUE 0x700109bc Scalar_FLOAT32_IEEE 0 VBU0428Test_CM_single_cnt -3.4028234663852886E+38 3.4028234663852886E+38 /end CHARACTERISTIC
/begin CHARACTERISTIC CcSOF_SocpDischargeSocDebounce_pct "" VALUE 0x700109c8 Scalar_FLOAT32_IEEE 0 VBU0428Test_CM_single_cnt -3.4028234663852886E+38 3.4028234663852886E+38 /end CHARACTERISTIC
/begin CHARACTERISTIC CcSOF_StopChargeBattVolt_V "" VALUE 0x700109cc Scalar_FLOAT32_IEEE 0 VBU0428Test_CM_single_cnt -3.4028234663852886E+38 3.4028234663852886E+38 /end CHARACTERISTIC
/begin CHARACTERISTIC CcSOF_StopChargeDeltaBattVolt_V "" VALUE 0x700109d0 Scalar_FLOAT32_IEEE 0 VBU0428Test_CM_single_cnt -3.4028234663852886E+38 3.4028234663852886E+38 /end CHARACTERISTIC
/begin CHARACTERISTIC CcSOF_StopChargeDeltaSOC_pct "" VALUE 0x700109d4 Scalar_FLOAT32_IEEE 0 VBU0428Test_CM_single_cnt -3.4028234663852886E+38 3.4028234663852886E+38 /end CHARACTERISTIC
/begin CHARACTERISTIC CcSOF_StopChargeSOC_pct "" VALUE 0x700109d8 Scalar_FLOAT32_IEEE 0 VBU0428Test_CM_single_cnt -3.4028234663852886E+38 3.4028234663852886E+38 /end CHARACTERISTIC
/begin CHARACTERISTIC CcSOF_UseCalculatedDcirTemp_C "" VALUE 0x700109dc Scalar_FLOAT32_IEEE 0 VBU0428Test_CM_single_cnt -3.4028234663852886E+38 3.4028234663852886E+38 /end CHARACTERISTIC
/begin CHARACTERISTIC CcSOF_VoltageCorrectFactor0_n "" VALUE 0x70010a00 Scalar_FLOAT32_IEEE 0 VBU0428Test_CM_single_cnt -3.4028234663852886E+38 3.4028234663852886E+38 /end CHARACTERISTIC
/begin CHARACTERISTIC CcSOF_VoltageCorrectFactor1_n "" VALUE 0x70010a04 Scalar_FLOAT32_IEEE 0 VBU0428Test_CM_single_cnt -3.4028234663852886E+38 3.4028234663852886E+38 /end CHARACTERISTIC
/begin CHARACTERISTIC CcSOF_VoltageCorrectFactor2_n "" VALUE 0x70010a08 Scalar_FLOAT32_IEEE 0 VBU0428Test_CM_single_cnt -3.4028234663852886E+38 3.4028234663852886E+38 /end CHARACTERISTIC
/begin CHARACTERISTIC CcSOF_VoltageCorrectFactor3_n "" VALUE 0x70010a0c Scalar_FLOAT32_IEEE 0 VBU0428Test_CM_single_cnt -3.4028234663852886E+38 3.4028234663852886E+38 /end CHARACTERISTIC
/begin CHARACTERISTIC CcSOF_VoltageCorrectFactor4_n "" VALUE 0x70010a10 Scalar_FLOAT32_IEEE 0 VBU0428Test_CM_single_cnt -3.4028234663852886E+38 3.4028234663852886E+38 /end CHARACTERISTIC
/begin CHARACTERISTIC CcSOH_ChargeResisLowerLimit_mohm "" VALUE 0x70010a38 Scalar_FLOAT32_IEEE 0 VBU0428Test_CM_single_cnt -3.4028234663852886E+38 3.4028234663852886E+38 /end CHARACTERISTIC
/begin CHARACTERISTIC CcSOH_FastChargeWeighting_pct "" VALUE 0x70010a5c Scalar_FLOAT32_IEEE 0 VBU0428Test_CM_single_cnt -3.4028234663852886E+38 3.4028234663852886E+38 /end CHARACTERISTIC
/begin CHARACTERISTIC CcSOH_MaxBalancedCapacity_As "" VALUE 0x70010a64 Scalar_FLOAT32_IEEE 0 VBU0428Test_CM_single_cnt -3.4028234663852886E+38 3.4028234663852886E+38 /end CHARACTERISTIC
/begin CHARACTERISTIC CcSOH_MaxCurrentIntegral_As "" VALUE 0x70010a68 Scalar_FLOAT32_IEEE 0 VBU0428Test_CM_single_cnt -3.4028234663852886E+38 3.4028234663852886E+38 /end CHARACTERISTIC
/begin CHARACTERISTIC CcSOH_MinBalancedCapacity_As "" VALUE 0x70010a6c Scalar_FLOAT32_IEEE 0 VBU0428Test_CM_single_cnt -3.4028234663852886E+38 3.4028234663852886E+38 /end CHARACTERISTIC
/begin CHARACTERISTIC CcSOH_MinCurrentIntegral_As "" VALUE 0x70010a70 Scalar_FLOAT32_IEEE 0 VBU0428Test_CM_single_cnt -3.4028234663852886E+38 3.4028234663852886E+38 /end CHARACTERISTIC
/begin CHARACTERISTIC CcSOH_PulseCurrentThreshold_pct "" VALUE 0x70010a78 Scalar_FLOAT32_IEEE 0 VBU0428Test_CM_single_cnt -3.4028234663852886E+38 3.4028234663852886E+38 /end CHARACTERISTIC
/begin CHARACTERISTIC DSPL_facDecRateVldHi_C_Md_Default "" VALUE 0x70010e70 Scalar_FLOAT32_IEEE 0 VBU0428Test_CM_single_fac 0.0 1.0 /end CHARACTERISTIC
/begin CHARACTERISTIC DSPL_facDecRateVldHi_C_Md_Type1 "" VALUE 0x70010e74 Scalar_FLOAT32_IEEE 0 VBU0428Test_CM_single_fac 0.0 1.0 /end CHARACTERISTIC
/begin CHARACTERISTIC DSPL_facDecRateVldHi_C_Md_Type2 "" VALUE 0x70010e78 Scalar_FLOAT32_IEEE 0 VBU0428Test_CM_single_fac 0.0 1.0 /end CHARACTERISTIC
/begin CHARACTERISTIC DSPL_facDecRateVldHi_C_Md_Type3 "" VALUE 0x70010e7c Scalar_FLOAT32_IEEE 0 VBU0428Test_CM_single_fac 0.0 1.0 /end CHARACTERISTIC
/begin CHARACTERISTIC DSPL_facDecRateVldHi_C_Md_Type4 "" VALUE 0x70010e80 Scalar_FLOAT32_IEEE 0 VBU0428Test_CM_single_fac 0.0 1.0 /end CHARACTERISTIC
/begin CHARACTERISTIC DSPL_facDecRateVldLo_C_Md_Default "" VALUE 0x70010e84 Scalar_FLOAT32_IEEE 0 VBU0428Test_CM_single_fac 0.0 1.0 /end CHARACTERISTIC
/begin CHARACTERISTIC DSPL_facDecRateVldLo_C_Md_Type1 "" VALUE 0x70010e88 Scalar_FLOAT32_IEEE 0 VBU0428Test_CM_single_fac 0.0 1.0 /end CHARACTERISTIC
/begin CHARACTERISTIC DSPL_facDecRateVldLo_C_Md_Type2 "" VALUE 0x70010e8c Scalar_FLOAT32_IEEE 0 VBU0428Test_CM_single_fac 0.0 1.0 /end CHARACTERISTIC
/begin CHARACTERISTIC DSPL_facDecRateVldLo_C_Md_Type3 "" VALUE 0x70010e90 Scalar_FLOAT32_IEEE 0 VBU0428Test_CM_single_fac 0.0 1.0 /end CHARACTERISTIC
/begin CHARACTERISTIC DSPL_facDecRateVldLo_C_Md_Type4 "" VALUE 0x70010e94 Scalar_FLOAT32_IEEE 0 VBU0428Test_CM_single_fac 0.0 1.0 /end CHARACTERISTIC
/begin CHARACTERISTIC DSPL_facEnergyFactorInitHigh_C "" VALUE 0x70010f34 Scalar_FLOAT32_IEEE 0 VBU0428Test_CM_single_fac 0.0 1.0 /end CHARACTERISTIC
/begin CHARACTERISTIC DSPL_facEnergyFactorInitLow_C "" VALUE 0x70010f38 Scalar_FLOAT32_IEEE 0 VBU0428Test_CM_single_fac 0.0 1.0 /end CHARACTERISTIC
/begin CHARACTERISTIC DSPL_facEnergyFactorInitMid_C "" VALUE 0x70010f3c Scalar_FLOAT32_IEEE 0 VBU0428Test_CM_single_fac 0.0 1.0 /end CHARACTERISTIC
/begin CHARACTERISTIC DSPL_facEnergyFactorInit_C "" VALUE 0x70010f40 Scalar_FLOAT32_IEEE 0 VBU0428Test_CM_single_fac 0.0 1.0 /end CHARACTERISTIC
/begin CHARACTERISTIC DSPL_facEnergyFactorSelfLearnInit_C "" VALUE 0x70010f44 Scalar_FLOAT32_IEEE 0 VBU0428Test_CM_single_fac 0.0 1.0 /end CHARACTERISTIC
/begin CHARACTERISTIC DSPL_facEnergyFactorTypeInit_C "" VALUE 0x70010f48 Scalar_FLOAT32_IEEE 0 VBU0428Test_CM_single_fac 0.0 1.0 /end CHARACTERISTIC
/begin CHARACTERISTIC DSPL_facEnergyFactorType_C_Md_Default "" VALUE 0x70010f4c Scalar_FLOAT32_IEEE 0 VBU0428Test_CM_single_fac 0.0 1.0 /end CHARACTERISTIC
/begin CHARACTERISTIC DSPL_facEnergyFactorType_C_Md_Type1 "" VALUE 0x70010f50 Scalar_FLOAT32_IEEE 0 VBU0428Test_CM_single_fac 0.0 1.0 /end CHARACTERISTIC
/begin CHARACTERISTIC DSPL_facEnergyFactorType_C_Md_Type2 "" VALUE 0x70010f54 Scalar_FLOAT32_IEEE 0 VBU0428Test_CM_single_fac 0.0 1.0 /end CHARACTERISTIC
/begin CHARACTERISTIC DSPL_facEnergyFactorType_C_Md_Type3 "" VALUE 0x70010f58 Scalar_FLOAT32_IEEE 0 VBU0428Test_CM_single_fac 0.0 1.0 /end CHARACTERISTIC
/begin CHARACTERISTIC DSPL_facEnergyFactorType_C_Md_Type4 "" VALUE 0x70010f5c Scalar_FLOAT32_IEEE 0 VBU0428Test_CM_single_fac 0.0 1.0 /end CHARACTERISTIC
/begin CHARACTERISTIC DSPL_facEnergyFactorUpdateStep_C "" VALUE 0x70010f60 Scalar_FLOAT32_IEEE 0 VBU0428Test_CM_single_fac 0.0 1.0 /end CHARACTERISTIC
/begin CHARACTERISTIC DSPL_facInitRateSOCFactor_C_Md_Default "" VALUE 0x70010f64 Scalar_FLOAT32_IEEE 0 VBU0428Test_CM_single_fac 0.0 1.0 /end CHARACTERISTIC
/begin CHARACTERISTIC DSPL_facInitRateSOCFactor_C_Md_Type1 "" VALUE 0x70010f68 Scalar_FLOAT32_IEEE 0 VBU0428Test_CM_single_fac 0.0 1.0 /end CHARACTERISTIC
/begin CHARACTERISTIC DSPL_facInitRateSOCFactor_C_Md_Type2 "" VALUE 0x70010f6c Scalar_FLOAT32_IEEE 0 VBU0428Test_CM_single_fac 0.0 1.0 /end CHARACTERISTIC
/begin CHARACTERISTIC DSPL_facInitRateSOCFactor_C_Md_Type3 "" VALUE 0x70010f70 Scalar_FLOAT32_IEEE 0 VBU0428Test_CM_single_fac 0.0 1.0 /end CHARACTERISTIC
/begin CHARACTERISTIC DSPL_facInitRateSOCFactor_C_Md_Type4 "" VALUE 0x70010f74 Scalar_FLOAT32_IEEE 0 VBU0428Test_CM_single_fac 0.0 1.0 /end CHARACTERISTIC
/begin CHARACTERISTIC DSPL_kmDrvRngMax_C_Md_Default "" VALUE 0x70010f94 Scalar_FLOAT32_IEEE 0 VBU0428Test_CM_single_km -1.0E+7 1.0E+10 /end CHARACTERISTIC
/begin CHARACTERISTIC DSPL_kmDrvRngMax_C_Md_Type1 "" VALUE 0x70010f98 Scalar_FLOAT32_IEEE 0 VBU0428Test_CM_single_km -1.0E+7 1.0E+10 /end CHARACTERISTIC
/begin CHARACTERISTIC DSPL_kmDrvRngMax_C_Md_Type2 "" VALUE 0x70010f9c Scalar_FLOAT32_IEEE 0 VBU0428Test_CM_single_km -1.0E+7 1.0E+10 /end CHARACTERISTIC
/begin CHARACTERISTIC DSPL_kmDrvRngMax_C_Md_Type3 "" VALUE 0x70010fa0 Scalar_FLOAT32_IEEE 0 VBU0428Test_CM_single_km -1.0E+7 1.0E+10 /end CHARACTERISTIC
/begin CHARACTERISTIC DSPL_kmDrvRngMax_C_Md_Type4 "" VALUE 0x70010fa4 Scalar_FLOAT32_IEEE 0 VBU0428Test_CM_single_km -1.0E+7 1.0E+10 /end CHARACTERISTIC
/begin CHARACTERISTIC DSPL_kmEnergyFactorOdoLow_C "" VALUE 0x70010fac Scalar_FLOAT32_IEEE 0 VBU0428Test_CM_single_km 0.0 1.0E+11 /end CHARACTERISTIC
/begin CHARACTERISTIC DSPL_kmEnergyFactorOdoMid_C "" VALUE 0x70010fb0 Scalar_FLOAT32_IEEE 0 VBU0428Test_CM_single_km 0.0 1.0E+11 /end CHARACTERISTIC
/begin CHARACTERISTIC DSPL_kmEnergyFactorOdoZero_C "" VALUE 0x70010fb4 Scalar_FLOAT32_IEEE 0 VBU0428Test_CM_single_km 0.0 1.0E+11 /end CHARACTERISTIC
/begin CHARACTERISTIC DSPL_kmFullSocRateRng_C_Md_Default "" VALUE 0x70010fb8 Scalar_FLOAT32_IEEE 0 VBU0428Test_CM_single_km 0.0 1.0E+6 /end CHARACTERISTIC
/begin CHARACTERISTIC DSPL_kmFullSocRateRng_C_Md_Type1 "" VALUE 0x70010fbc Scalar_FLOAT32_IEEE 0 VBU0428Test_CM_single_km 0.0 1.0E+6 /end CHARACTERISTIC
/begin CHARACTERISTIC DSPL_kmFullSocRateRng_C_Md_Type2 "" VALUE 0x70010fc0 Scalar_FLOAT32_IEEE 0 VBU0428Test_CM_single_km 0.0 1.0E+6 /end CHARACTERISTIC
/begin CHARACTERISTIC DSPL_kmFullSocRateRng_C_Md_Type3 "" VALUE 0x70010fc4 Scalar_FLOAT32_IEEE 0 VBU0428Test_CM_single_km 0.0 1.0E+6 /end CHARACTERISTIC
/begin CHARACTERISTIC DSPL_kmFullSocRateRng_C_Md_Type4 "" VALUE 0x70010fc8 Scalar_FLOAT32_IEEE 0 VBU0428Test_CM_single_km 0.0 1.0E+6 /end CHARACTERISTIC
/begin CHARACTERISTIC DSPL_pctBMSSOCUpdateStep_C "" VALUE 0x70011004 Scalar_FLOAT32_IEEE 0 VBU0428Test_CM_single_pct 0.0 100.0 /end CHARACTERISTIC
/begin CHARACTERISTIC DSPL_pctEnergySOCLearnMax_C "" VALUE 0x70011008 Scalar_FLOAT32_IEEE 0 VBU0428Test_CM_single_pct 0.0 100.0 /end CHARACTERISTIC
/begin CHARACTERISTIC EDIS_facDecGradSprt_C "" VALUE 0x700110a8 Scalar_FLOAT32_IEEE 0 VBU0428Test_CM_single_cnt -3.4028234663852886E+38 3.4028234663852886E+38 /end CHARACTERISTIC
/begin CHARACTERISTIC EDIS_numCurrentOverDisChDyn_C "" VALUE 0x700110c0 Scalar_FLOAT32_IEEE 0 VBU0428Test_CM_single_cnt -3.4028234663852886E+38 3.4028234663852886E+38 /end CHARACTERISTIC
/begin CHARACTERISTIC EDIS_numDisChDyn_C "" VALUE 0x700110c4 Scalar_FLOAT32_IEEE 0 VBU0428Test_CM_single_cnt -3.4028234663852886E+38 3.4028234663852886E+38 /end CHARACTERISTIC
/begin CHARACTERISTIC EDIS_numDisChOverLim_C "" VALUE 0x700110c8 Scalar_FLOAT32_IEEE 0 VBU0428Test_CM_single_cnt -3.4028234663852886E+38 3.4028234663852886E+38 /end CHARACTERISTIC
/begin CHARACTERISTIC EDIS_numDisChPwrOverCntEEPROMInit_SY "" VALUE 0x700110cc Scalar_FLOAT32_IEEE 0 VBU0428Test_CM_single_cnt -3.4028234663852886E+38 3.4028234663852886E+38 /end CHARACTERISTIC
/begin CHARACTERISTIC EDIS_pctAccPedlDchaLo_C "" VALUE 0x700110d0 Scalar_FLOAT32_IEEE 0 VBU0428Test_CM_single_cnt -3.4028234663852886E+38 3.4028234663852886E+38 /end CHARACTERISTIC
/begin CHARACTERISTIC EDIS_pctAccPedlDchaUp_C "" VALUE 0x700110d4 Scalar_FLOAT32_IEEE 0 VBU0428Test_CM_single_cnt -3.4028234663852886E+38 3.4028234663852886E+38 /end CHARACTERISTIC
/begin CHARACTERISTIC EDIS_pctSocDchaLo_C "" VALUE 0x700110e8 Scalar_FLOAT32_IEEE 0 VBU0428Test_CM_single_cnt -3.4028234663852886E+38 3.4028234663852886E+38 /end CHARACTERISTIC
/begin CHARACTERISTIC EDIS_pctSocDchaUp_C "" VALUE 0x700110ec Scalar_FLOAT32_IEEE 0 VBU0428Test_CM_single_cnt -3.4028234663852886E+38 3.4028234663852886E+38 /end CHARACTERISTIC
/begin CHARACTERISTIC EDIS_pwrBmsDynLTDeltaHi_C "" VALUE 0x70011100 Scalar_FLOAT32_IEEE 0 VBU0428Test_CM_single_cnt -3.4028234663852886E+38 3.4028234663852886E+38 /end CHARACTERISTIC
/begin CHARACTERISTIC EDIS_pwrBmsDynLTDeltaLo_C "" VALUE 0x70011104 Scalar_FLOAT32_IEEE 0 VBU0428Test_CM_single_cnt -3.4028234663852886E+38 3.4028234663852886E+38 /end CHARACTERISTIC
/begin CHARACTERISTIC EDIS_pwrDisChDynMore_C "" VALUE 0x7001112c Scalar_FLOAT32_IEEE 0 VBU0428Test_CM_single_cnt -3.4028234663852886E+38 3.4028234663852886E+38 /end CHARACTERISTIC
/begin CHARACTERISTIC EDIS_pwrDisChOverLim_C "" VALUE 0x70011130 Scalar_FLOAT32_IEEE 0 VBU0428Test_CM_single_kW 0.0 1000.0 /end CHARACTERISTIC
/begin CHARACTERISTIC EDIS_pwrDisChRed40vLim_C "" VALUE 0x70011134 Scalar_FLOAT32_IEEE 0 VBU0428Test_CM_single_cnt -3.4028234663852886E+38 3.4028234663852886E+38 /end CHARACTERISTIC
/begin CHARACTERISTIC EDIS_pwrDisChaFilterHi_C "" VALUE 0x70011138 Scalar_FLOAT32_IEEE 0 VBU0428Test_CM_single_cnt -3.4028234663852886E+38 3.4028234663852886E+38 /end CHARACTERISTIC
/begin CHARACTERISTIC EDIS_pwrDisChaFilterLo_C "" VALUE 0x7001113c Scalar_FLOAT32_IEEE 0 VBU0428Test_CM_single_cnt -3.4028234663852886E+38 3.4028234663852886E+38 /end CHARACTERISTIC
/begin CHARACTERISTIC EDIS_tBmsMaxTempHi_C "" VALUE 0x70011180 Scalar_FLOAT32_IEEE 0 VBU0428Test_CM_single_cnt -3.4028234663852886E+38 3.4028234663852886E+38 /end CHARACTERISTIC
/begin CHARACTERISTIC EDIS_tBmsMaxTempLo_C "" VALUE 0x70011184 Scalar_FLOAT32_IEEE 0 VBU0428Test_CM_single_cnt -3.4028234663852886E+38 3.4028234663852886E+38 /end CHARACTERISTIC
/begin CHARACTERISTIC EDIS_tBmsMinTempHi_C "" VALUE 0x70011188 Scalar_FLOAT32_IEEE 0 VBU0428Test_CM_single_cnt -3.4028234663852886E+38 3.4028234663852886E+38 /end CHARACTERISTIC
/begin CHARACTERISTIC EDIS_tBmsMinTempLo_C "" VALUE 0x7001118c Scalar_FLOAT32_IEEE 0 VBU0428Test_CM_single_cnt -3.4028234663852886E+38 3.4028234663852886E+38 /end CHARACTERISTIC
/begin CHARACTERISTIC EDIS_tiOverDisCha_C "" VALUE 0x7001119c Scalar_FLOAT32_IEEE 0 VBU0428Test_CM_single_cnt -3.4028234663852886E+38 3.4028234663852886E+38 /end CHARACTERISTIC
/begin CHARACTERISTIC EDIS_vVehSpdDchaLo_C "" VALUE 0x700111a8 Scalar_FLOAT32_IEEE 0 VBU0428Test_CM_single_cnt -3.4028234663852886E+38 3.4028234663852886E+38 /end CHARACTERISTIC
/begin CHARACTERISTIC EDIS_vVehSpdDchaUp_C "" VALUE 0x700111ac Scalar_FLOAT32_IEEE 0 VBU0428Test_CM_single_cnt -3.4028234663852886E+38 3.4028234663852886E+38 /end CHARACTERISTIC
/begin CHARACTERISTIC TQDIS_pctShftChngFullAcc_C "" VALUE 0x700117b4 Scalar_FLOAT32_IEEE 0 VBU0428Test_CM_single_cnt -3.4028234663852886E+38 3.4028234663852886E+38 /end CHARACTERISTIC
/begin CHARACTERISTIC TQDIS_tiShftChngDly_C "" VALUE 0x700117c0 Scalar_FLOAT32_IEEE 0 VBU0428Test_CM_single_cnt -3.4028234663852886E+38 3.4028234663852886E+38 /end CHARACTERISTIC
/begin CHARACTERISTIC TQDIS_trqCreepThd_C "" VALUE 0x700117c4 Scalar_FLOAT32_IEEE 0 VBU0428Test_CM_single_cnt -3.4028234663852886E+38 3.4028234663852886E+38 /end CHARACTERISTIC
/begin CHARACTERISTIC TQDIS_trqShftChngLimThres_C "" VALUE 0x700117f4 Scalar_FLOAT32_IEEE 0 VBU0428Test_CM_single_cnt -3.4028234663852886E+38 3.4028234663852886E+38 /end CHARACTERISTIC
/begin CHARACTERISTIC TQDIS_vVehFilterThd_C "" VALUE 0x700117f8 Scalar_FLOAT32_IEEE 0 VBU0428Test_CM_single_cnt -3.4028234663852886E+38 3.4028234663852886E+38 /end CHARACTERISTIC
/begin CHARACTERISTIC TQDMP_facPhaseSclRA_C "" VALUE 0x700117fc Scalar_FLOAT32_IEEE 0 VBU0428Test_CM_single_cnt -3.4028234663852886E+38 3.4028234663852886E+38 /end CHARACTERISTIC
/begin CHARACTERISTIC TQDMP_facPhsCmpDenRA_C "" VALUE 0x70011800 Scalar_FLOAT32_IEEE 0 VBU0428Test_CM_single_cnt -3.4028234663852886E+38 3.4028234663852886E+38 /end CHARACTERISTIC
/begin CHARACTERISTIC TQDMP_facPhsCmpK1RA_C "" VALUE 0x70011804 Scalar_FLOAT32_IEEE 0 VBU0428Test_CM_single_cnt -3.4028234663852886E+38 3.4028234663852886E+38 /end CHARACTERISTIC
/begin CHARACTERISTIC TQDMP_facPhsCmpNumRA_C "" VALUE 0x70011808 Scalar_FLOAT32_IEEE 0 VBU0428Test_CM_single_cnt -3.4028234663852886E+38 3.4028234663852886E+38 /end CHARACTERISTIC
/begin CHARACTERISTIC TQDMP_nSpdHldMax2FA_C "" VALUE 0x70011814 Scalar_FLOAT32_IEEE 0 VBU0428Test_CM_single_cnt -3.4028234663852886E+38 3.4028234663852886E+38 /end CHARACTERISTIC
/begin CHARACTERISTIC TQDMP_nSpdHldMaxFA_C "" VALUE 0x70011818 Scalar_FLOAT32_IEEE 0 VBU0428Test_CM_single_cnt -3.4028234663852886E+38 3.4028234663852886E+38 /end CHARACTERISTIC
/begin CHARACTERISTIC TQDMP_nSpdHldMin2FA_C "" VALUE 0x7001181c Scalar_FLOAT32_IEEE 0 VBU0428Test_CM_single_cnt -3.4028234663852886E+38 3.4028234663852886E+38 /end CHARACTERISTIC
/begin CHARACTERISTIC TQDMP_nSpdHldMinFA_C "" VALUE 0x70011820 Scalar_FLOAT32_IEEE 0 VBU0428Test_CM_single_cnt -3.4028234663852886E+38 3.4028234663852886E+38 /end CHARACTERISTIC
/begin CHARACTERISTIC TQDMP_pctTipInAccPedChgThd_C "" VALUE 0x70011828 Scalar_FLOAT32_IEEE 0 VBU0428Test_CM_single_cnt -3.4028234663852886E+38 3.4028234663852886E+38 /end CHARACTERISTIC
/begin CHARACTERISTIC TQDMP_pctTipInAccPedEnThdHi_C "" VALUE 0x7001182c Scalar_FLOAT32_IEEE 0 VBU0428Test_CM_single_cnt -3.4028234663852886E+38 3.4028234663852886E+38 /end CHARACTERISTIC
/begin CHARACTERISTIC TQDMP_pctTipInAccPedEnThdLo_C "" VALUE 0x70011830 Scalar_FLOAT32_IEEE 0 VBU0428Test_CM_single_cnt -3.4028234663852886E+38 3.4028234663852886E+38 /end CHARACTERISTIC
/begin CHARACTERISTIC TQDMP_pctTipInAccPedTrgThd_C "" VALUE 0x70011834 Scalar_FLOAT32_IEEE 0 VBU0428Test_CM_single_cnt -3.4028234663852886E+38 3.4028234663852886E+38 /end CHARACTERISTIC
/begin CHARACTERISTIC TQDMP_pctTipOutAccPedChgThd_C "" VALUE 0x70011838 Scalar_FLOAT32_IEEE 0 VBU0428Test_CM_single_cnt -3.4028234663852886E+38 3.4028234663852886E+38 /end CHARACTERISTIC
/begin CHARACTERISTIC TQDMP_pctTipOutAccPedEnThdHi_C "" VALUE 0x7001183c Scalar_FLOAT32_IEEE 0 VBU0428Test_CM_single_cnt -3.4028234663852886E+38 3.4028234663852886E+38 /end CHARACTERISTIC
/begin CHARACTERISTIC TQDMP_pctTipOutAccPedEnThdLo_C "" VALUE 0x70011840 Scalar_FLOAT32_IEEE 0 VBU0428Test_CM_single_cnt -3.4028234663852886E+38 3.4028234663852886E+38 /end CHARACTERISTIC
/begin CHARACTERISTIC TQDMP_pctTipOutAccPedTrgThd_C "" VALUE 0x70011844 Scalar_FLOAT32_IEEE 0 VBU0428Test_CM_single_cnt -3.4028234663852886E+38 3.4028234663852886E+38 /end CHARACTERISTIC
/begin CHARACTERISTIC TQDMP_tiTipInAct_C "" VALUE 0x7001184c Scalar_FLOAT32_IEEE 0 VBU0428Test_CM_single_cnt -3.4028234663852886E+38 3.4028234663852886E+38 /end CHARACTERISTIC
/begin CHARACTERISTIC TQDMP_tiTipInDly_C "" VALUE 0x70011850 Scalar_FLOAT32_IEEE 0 VBU0428Test_CM_single_cnt -3.4028234663852886E+38 3.4028234663852886E+38 /end CHARACTERISTIC
/begin CHARACTERISTIC TQDMP_tiTipOutAct_C "" VALUE 0x70011854 Scalar_FLOAT32_IEEE 0 VBU0428Test_CM_single_cnt -3.4028234663852886E+38 3.4028234663852886E+38 /end CHARACTERISTIC
/begin CHARACTERISTIC TQDMP_tiTipOutDly_C "" VALUE 0x70011858 Scalar_FLOAT32_IEEE 0 VBU0428Test_CM_single_cnt -3.4028234663852886E+38 3.4028234663852886E+38 /end CHARACTERISTIC
/begin CHARACTERISTIC TQDMP_tiTrqZeroDly_C "" VALUE 0x7001185c Scalar_FLOAT32_IEEE 0 VBU0428Test_CM_single_cnt -3.4028234663852886E+38 3.4028234663852886E+38 /end CHARACTERISTIC
/begin CHARACTERISTIC TQDMP_trqAxleMaxRA_C "" VALUE 0x70011860 Scalar_FLOAT32_IEEE 0 VBU0428Test_CM_single_cnt -3.4028234663852886E+38 3.4028234663852886E+38 /end CHARACTERISTIC
/begin CHARACTERISTIC TQDMP_trqDeadZoneMaxRA_C "" VALUE 0x70011864 Scalar_FLOAT32_IEEE 0 VBU0428Test_CM_single_cnt -3.4028234663852886E+38 3.4028234663852886E+38 /end CHARACTERISTIC
/begin CHARACTERISTIC TQDMP_trqDeadZoneMinRA_C "" VALUE 0x70011868 Scalar_FLOAT32_IEEE 0 VBU0428Test_CM_single_cnt -3.4028234663852886E+38 3.4028234663852886E+38 /end CHARACTERISTIC
/begin CHARACTERISTIC TQDMP_trqMaxRA_C "" VALUE 0x70011870 Scalar_FLOAT32_IEEE 0 VBU0428Test_CM_single_cnt -3.4028234663852886E+38 3.4028234663852886E+38 /end CHARACTERISTIC
/begin CHARACTERISTIC TQDMP_trqMinRA_C "" VALUE 0x70011874 Scalar_FLOAT32_IEEE 0 VBU0428Test_CM_single_cnt -3.4028234663852886E+38 3.4028234663852886E+38 /end CHARACTERISTIC
/begin CHARACTERISTIC CaSOF_BuffUseFactorCurrtLTCurrtMapDimension_n "" VAL_BLK 0x70011a62 Scalar_ULONG 0 VBU0428Test_CM_uint32_cnt 0.0 4.294967295E+9 NUMBER 2 /end CHARACTERISTIC
/begin CHARACTERISTIC CaSOF_BuffUseFactorSocTempMapDimension_n "" VAL_BLK 0x70011a6a Scalar_ULONG 0 VBU0428Test_CM_uint32_cnt 0.0 4.294967295E+9 NUMBER 2 /end CHARACTERISTIC
/begin CHARACTERISTIC CaSOF_ChargeCurrentLimitBufferTimeSocTempMapDimension_n "" VAL_BLK 0x70011a72 Scalar_ULONG 0 VBU0428Test_CM_uint32_cnt 0.0 4.294967295E+9 NUMBER 2 /end CHARACTERISTIC
/begin CHARACTERISTIC CaSOF_ContinuousDischargeEolSocTempMapDimension_n "" VAL_BLK 0x70011a82 Scalar_ULONG 0 VBU0428Test_CM_uint32_cnt 0.0 4.294967295E+9 NUMBER 2 /end CHARACTERISTIC
/begin CHARACTERISTIC CaSOF_ContinuousDischargeLockedSocTempMapDimension_n "" VAL_BLK 0x70011a8a Scalar_ULONG 0 VBU0428Test_CM_uint32_cnt 0.0 4.294967295E+9 NUMBER 2 /end CHARACTERISTIC
/begin CHARACTERISTIC CaSOF_ContinuousDischargeSocTempMapDimension_n "" VAL_BLK 0x70011a92 Scalar_ULONG 0 VBU0428Test_CM_uint32_cnt 0.0 4.294967295E+9 NUMBER 2 /end CHARACTERISTIC
/begin CHARACTERISTIC CaSOF_DischargeCurrentLimitBufferTimeSocTempMapDimension_n "" VAL_BLK 0x70011a9a Scalar_ULONG 0 VBU0428Test_CM_uint32_cnt 0.0 4.294967295E+9 NUMBER 2 /end CHARACTERISTIC
/begin CHARACTERISTIC CaSOF_DischargeDcirSocTempMapDimension_n "" VAL_BLK 0x70011aa2 Scalar_ULONG 0 VBU0428Test_CM_uint32_cnt 0.0 4.294967295E+9 NUMBER 2 /end CHARACTERISTIC
/begin CHARACTERISTIC CaSOF_DischargeOcvSocTempMapDimension_n "" VAL_BLK 0x70011aaa Scalar_ULONG 0 VBU0428Test_CM_uint32_cnt 0.0 4.294967295E+9 NUMBER 2 /end CHARACTERISTIC
/begin CHARACTERISTIC CaSOF_FastChargeCurrentDropBOLCellVoltageDimension_n "" VAL_BLK 0x70011aba Scalar_ULONG 0 VBU0428Test_CM_uint32_cnt 0.0 4.294967295E+9 NUMBER 2 /end CHARACTERISTIC
/begin CHARACTERISTIC CaSOF_FastChargeCurrentDropEOLCellVoltageDimension_n "" VAL_BLK 0x70011ac2 Scalar_ULONG 0 VBU0428Test_CM_uint32_cnt 0.0 4.294967295E+9 NUMBER 2 /end CHARACTERISTIC
/begin CHARACTERISTIC CaSOF_ShortPulseChargeEolSocTempMapDimension_n "" VAL_BLK 0x70011ada Scalar_ULONG 0 VBU0428Test_CM_uint32_cnt 0.0 4.294967295E+9 NUMBER 2 /end CHARACTERISTIC
/begin CHARACTERISTIC CaSOF_ShortPulseChargeLockedSocTempMapDimension_n "" VAL_BLK 0x70011ae2 Scalar_ULONG 0 VBU0428Test_CM_uint32_cnt 0.0 4.294967295E+9 NUMBER 2 /end CHARACTERISTIC
/begin CHARACTERISTIC CaSOF_ShortPulseChargeSocTempMapDimension_n "" VAL_BLK 0x70011aea Scalar_ULONG 0 VBU0428Test_CM_uint32_cnt 0.0 4.294967295E+9 NUMBER 2 /end CHARACTERISTIC
/begin CHARACTERISTIC CaSOF_ShortPulseDischargeEolSocTempMapDimension_n "" VAL_BLK 0x70011af2 Scalar_ULONG 0 VBU0428Test_CM_uint32_cnt 0.0 4.294967295E+9 NUMBER 2 /end CHARACTERISTIC
/begin CHARACTERISTIC CaSOF_ShortPulseDischargeLockedSocTempMapDimension_n "" VAL_BLK 0x70011afa Scalar_ULONG 0 VBU0428Test_CM_uint32_cnt 0.0 4.294967295E+9 NUMBER 2 /end CHARACTERISTIC
/begin CHARACTERISTIC CaSOF_ShortPulseDischargeSocTempMapDimension_n "" VAL_BLK 0x70011b02 Scalar_ULONG 0 VBU0428Test_CM_uint32_cnt 0.0 4.294967295E+9 NUMBER 2 /end CHARACTERISTIC
/begin CHARACTERISTIC CaSOH_DecreaseCapacityMapDimension_n "" VALUE 0x70010488 Scalar_ULONG 0 VBU0428Test_CM_uint32_cnt 0.0 4.294967295E+9 /end CHARACTERISTIC
/begin CHARACTERISTIC CaSOH_OcvSocMapDimension_n "" VAL_BLK 0x70011b0a Scalar_ULONG 0 VBU0428Test_CM_uint32_cnt 0.0 4.294967295E+9 NUMBER 2 /end CHARACTERISTIC
/begin CHARACTERISTIC CaSOH_UdResisMapDimension_n "" VAL_BLK 0x70011b12 Scalar_ULONG 0 VBU0428Test_CM_uint32_cnt 0.0 4.294967295E+9 NUMBER 2 /end CHARACTERISTIC
/begin CHARACTERISTIC CcSOF_BatteryCycleHomo_n "" VALUE 0x700108a0 Scalar_ULONG 0 VBU0428Test_CM_uint32_cnt 0.0 4.294967295E+9 /end CHARACTERISTIC
/begin CHARACTERISTIC CcSOF_LowVoltageSetTime_s "" VALUE 0x700109a0 Scalar_ULONG 0 VBU0428Test_CM_uint32_cnt 0.0 4.294967295E+9 /end CHARACTERISTIC
/begin CHARACTERISTIC CcSOF_VoltageCorrectCheckInc1_n "" VALUE 0x700109e0 Scalar_ULONG 0 VBU0428Test_CM_uint32_cnt 0.0 4.294967295E+9 /end CHARACTERISTIC
/begin CHARACTERISTIC CcSOF_VoltageCorrectCheckInc2_n "" VALUE 0x700109e4 Scalar_ULONG 0 VBU0428Test_CM_uint32_cnt 0.0 4.294967295E+9 /end CHARACTERISTIC
/begin CHARACTERISTIC CcSOF_VoltageCorrectCheckInc3_n "" VALUE 0x700109e8 Scalar_ULONG 0 VBU0428Test_CM_uint32_cnt 0.0 4.294967295E+9 /end CHARACTERISTIC
/begin CHARACTERISTIC CcSOF_VoltageCorrectCheckInc4_n "" VALUE 0x700109ec Scalar_ULONG 0 VBU0428Test_CM_uint32_cnt 0.0 4.294967295E+9 /end CHARACTERISTIC
/begin CHARACTERISTIC CcSOF_VoltageCorrectEnableInc1_n "" VALUE 0x700109f0 Scalar_ULONG 0 VBU0428Test_CM_uint32_cnt 0.0 4.294967295E+9 /end CHARACTERISTIC
/begin CHARACTERISTIC CcSOF_VoltageCorrectEnableInc2_n "" VALUE 0x700109f4 Scalar_ULONG 0 VBU0428Test_CM_uint32_cnt 0.0 4.294967295E+9 /end CHARACTERISTIC
/begin CHARACTERISTIC CcSOF_VoltageCorrectEnableInc3_n "" VALUE 0x700109f8 Scalar_ULONG 0 VBU0428Test_CM_uint32_cnt 0.0 4.294967295E+9 /end CHARACTERISTIC
/begin CHARACTERISTIC CcSOF_VoltageCorrectEnableInc4_n "" VALUE 0x700109fc Scalar_ULONG 0 VBU0428Test_CM_uint32_cnt 0.0 4.294967295E+9 /end CHARACTERISTIC
/begin CHARACTERISTIC CcSOH_AfterEdgeFallTime_ms "" VALUE 0x70010a1c Scalar_ULONG 0 VBU0428Test_CM_uint32_cnt 0.0 4.294967295E+9 /end CHARACTERISTIC
/begin CHARACTERISTIC CcSOH_BeforeEdgeFallTime_ms "" VALUE 0x70010a20 Scalar_ULONG 0 VBU0428Test_CM_uint32_cnt 0.0 4.294967295E+9 /end CHARACTERISTIC
/begin CHARACTERISTIC CcFCC_BatteryCapacityCycleHomo_n "" VALUE 0x70010094 Scalar_UWORD 0 VBU0428Test_CM_uint16_cnt 0.0 65535.0 /end CHARACTERISTIC
/begin CHARACTERISTIC CcFCC_FullChargeSocDebounceTime_s "" VALUE 0x700100a8 Scalar_UWORD 0 VBU0428Test_CM_uint16_cnt 0.0 65535.0 /end CHARACTERISTIC
/begin CHARACTERISTIC CcSOC_CurrentStableTime_ms "" VALUE 0x700100c2 Scalar_UWORD 0 VBU0428Test_CM_uint16_cnt 0.0 65535.0 /end CHARACTERISTIC
/begin CHARACTERISTIC CcSOF_CellVoltageHigh1_mV "" VALUE 0x700100d8 Scalar_UWORD 0 VBU0428Test_CM_uint16_cnt 0.0 65535.0 /end CHARACTERISTIC
/begin CHARACTERISTIC CcSOF_CellVoltageHigh2_mV "" VALUE 0x700100da Scalar_UWORD 0 VBU0428Test_CM_uint16_cnt 0.0 65535.0 /end CHARACTERISTIC
/begin CHARACTERISTIC CcSOF_CellVoltageHigh3_mV "" VALUE 0x700100dc Scalar_UWORD 0 VBU0428Test_CM_uint16_cnt 0.0 65535.0 /end CHARACTERISTIC
/begin CHARACTERISTIC CcSOF_CellVoltageHigh4_mV "" VALUE 0x700100de Scalar_UWORD 0 VBU0428Test_CM_uint16_cnt 0.0 65535.0 /end CHARACTERISTIC
/begin CHARACTERISTIC CcSOF_CellVoltageLow1_mV "" VALUE 0x700100e0 Scalar_UWORD 0 VBU0428Test_CM_uint16_cnt 0.0 65535.0 /end CHARACTERISTIC
/begin CHARACTERISTIC CcSOF_CellVoltageLow2_mV "" VALUE 0x700100e2 Scalar_UWORD 0 VBU0428Test_CM_uint16_cnt 0.0 65535.0 /end CHARACTERISTIC
/begin CHARACTERISTIC CcSOF_CellVoltageLow3_mV "" VALUE 0x700100e4 Scalar_UWORD 0 VBU0428Test_CM_uint16_cnt 0.0 65535.0 /end CHARACTERISTIC
/begin CHARACTERISTIC CcSOF_CellVoltageLow4_mV "" VALUE 0x700100e6 Scalar_UWORD 0 VBU0428Test_CM_uint16_cnt 0.0 65535.0 /end CHARACTERISTIC
/begin CHARACTERISTIC CcSOF_FccOneThirdCurtSloDelay_ms "" VALUE 0x700100ea Scalar_UWORD 0 VBU0428Test_CM_uint16_cnt 0.0 65535.0 /end CHARACTERISTIC
/begin CHARACTERISTIC CcSOF_LowVoltageAbnormalPowerOnDelay_ms "" VALUE 0x700100f0 Scalar_UWORD 0 VBU0428Test_CM_uint16_cnt 0.0 65535.0 /end CHARACTERISTIC
/begin CHARACTERISTIC CcSOF_LowVoltageSetCurrentDelay_ms "" VALUE 0x700100f4 Scalar_UWORD 0 VBU0428Test_CM_uint16_cnt 0.0 65535.0 /end CHARACTERISTIC
/begin CHARACTERISTIC CcSOF_LowVoltageSetVoltageDelay_ms "" VALUE 0x700100f6 Scalar_UWORD 0 VBU0428Test_CM_uint16_cnt 0.0 65535.0 /end CHARACTERISTIC
/begin CHARACTERISTIC CcSOF_PowerOnOverCurFacSloDelay_ms "" VALUE 0x700100fa Scalar_UWORD 0 VBU0428Test_CM_uint16_cnt 0.0 65535.0 /end CHARACTERISTIC
/begin CHARACTERISTIC CcSOF_PowerOnVolCorCurtSloDelay_ms "" VALUE 0x700100fc Scalar_UWORD 0 VBU0428Test_CM_uint16_cnt 0.0 65535.0 /end CHARACTERISTIC
/begin CHARACTERISTIC CcSOF_PowerOnVolCorFacSloDelay_ms "" VALUE 0x700100fe Scalar_UWORD 0 VBU0428Test_CM_uint16_cnt 0.0 65535.0 /end CHARACTERISTIC
/begin CHARACTERISTIC CcSOF_SocpModeDebounceTime_ms "" VALUE 0x70010100 Scalar_UWORD 0 VBU0428Test_CM_uint16_cnt 0.0 65535.0 /end CHARACTERISTIC
/begin CHARACTERISTIC CcSOF_StopChargeSOCDebounceTime_s "" VALUE 0x70010102 Scalar_UWORD 0 VBU0428Test_CM_uint16_cnt 0.0 65535.0 /end CHARACTERISTIC
/begin CHARACTERISTIC CcSOF_StopChargeVoltDebounceTime_s "" VALUE 0x70010104 Scalar_UWORD 0 VBU0428Test_CM_uint16_cnt 0.0 65535.0 /end CHARACTERISTIC
/begin CHARACTERISTIC CcTHM_CoolantSensorValidDelayTime_s "" VALUE 0x70010116 Scalar_UWORD 0 VBU0428Test_CM_uint16_cnt 0.0 65535.0 /end CHARACTERISTIC
/begin CHARACTERISTIC CbSOF_VoltageCorrectLevelEnable_flg "" VALUE 0x70022070 Scalar_BOOLEAN 0 VBU0428Test_CM_boolean_cnt 0.0 1.0 /end CHARACTERISTIC
/begin CHARACTERISTIC CbSOF_VoltageTableCorrectUsePredictedCellVoltage_flg "" VALUE 0x70022071 Scalar_BOOLEAN 0 VBU0428Test_CM_boolean_cnt 0.0 1.0 /end CHARACTERISTIC
/begin CHARACTERISTIC CcSOF_EnableCalculatedDcir_flg "" VALUE 0x70022198 Scalar_BOOLEAN 0 VBU0428Test_CM_boolean_cnt 0.0 1.0 /end CHARACTERISTIC
/begin CHARACTERISTIC CcSOF_UseSohLimitEnable_flg "" VALUE 0x7002219a Scalar_BOOLEAN 0 VBU0428Test_CM_boolean_cnt 0.0 1.0 /end CHARACTERISTIC
/begin CHARACTERISTIC DSPL_flgEnergyFactorSelfLearnEn_C "" VALUE 0x700222ed Scalar_BOOLEAN 0 VBU0428Test_CM_boolean_flg 0.0 1.0 /end CHARACTERISTIC
/begin CHARACTERISTIC EDIS_flgDisChDynMore_C "" VALUE 0x70022300 Scalar_BOOLEAN 0 VBU0428Test_CM_boolean_cnt 0.0 1.0 /end CHARACTERISTIC
/begin CHARACTERISTIC EDIS_flgDisChDynOverride_C "" VALUE 0x70022301 Scalar_BOOLEAN 0 VBU0428Test_CM_boolean_cnt 0.0 1.0 /end CHARACTERISTIC
/begin CHARACTERISTIC TQDMP_flgROTCEnRA_C "" VALUE 0x70022452 Scalar_BOOLEAN 0 VBU0428Test_CM_boolean_cnt 0.0 1.0 /end CHARACTERISTIC
/begin CHARACTERISTIC TQDMP_flgSpdHldOn_C "" VALUE 0x70022453 Scalar_BOOLEAN 0 VBU0428Test_CM_boolean_cnt 0.0 1.0 /end CHARACTERISTIC
/begin CHARACTERISTIC TQDMP_flgTipInEnaRvs_C "" VALUE 0x70022454 Scalar_BOOLEAN 0 VBU0428Test_CM_boolean_cnt 0.0 1.0 /end CHARACTERISTIC
/begin CHARACTERISTIC TQDMP_flgTipOutEnaRvs_C "" VALUE 0x70022455 Scalar_BOOLEAN 0 VBU0428Test_CM_boolean_cnt 0.0 1.0 /end CHARACTERISTIC
/begin CHARACTERISTIC CcSOF_DcirDelayTimes_n "" VALUE 0x70022195 Scalar_UBYTE 0 VBU0428Test_CM_uint8_cnt 0.0 255.0 /end CHARACTERISTIC
/begin CHARACTERISTIC EDIS_stCurrentGearD_C "" VALUE 0x7002230a Scalar_UBYTE 0 VBU0428Test_CM_uint8_cnt 0.0 15.0 /end CHARACTERISTIC
/begin CHARACTERISTIC SOF_VOLTAGE_CORRECT_LEVEL1 "" VALUE 0x70022419 Scalar_UBYTE 0 VBU0428Test_CM_uint8_cnt 0.0 255.0 /end CHARACTERISTIC
/begin CHARACTERISTIC SOF_VOLTAGE_CORRECT_LEVEL2 "" VALUE 0x7002241a Scalar_UBYTE 0 VBU0428Test_CM_uint8_cnt 0.0 255.0 /end CHARACTERISTIC
/begin CHARACTERISTIC SOF_VOLTAGE_CORRECT_LEVEL3 "" VALUE 0x7002241b Scalar_UBYTE 0 VBU0428Test_CM_uint8_cnt 0.0 255.0 /end CHARACTERISTIC
/begin CHARACTERISTIC SOF_VOLTAGE_CORRECT_LEVEL4 "" VALUE 0x7002241c Scalar_UBYTE 0 VBU0428Test_CM_uint8_cnt 0.0 255.0 /end CHARACTERISTIC
/begin CHARACTERISTIC SOF_VOLTAGE_CORRECT_NONE "" VALUE 0x7002241d Scalar_UBYTE 0 VBU0428Test_CM_uint8_cnt 0.0 255.0 /end CHARACTERISTIC
/begin CHARACTERISTIC SYS_stHMIDrvModeEco_SY "" VALUE 0x70022428 Scalar_UBYTE 0 VBU0428Test_CM_uint8_cnt 0.0 255.0 /end CHARACTERISTIC
/begin CHARACTERISTIC SYS_stHMIDrvModeSport_SY "" VALUE 0x70022429 Scalar_UBYTE 0 VBU0428Test_CM_uint8_cnt 0.0 255.0 /end CHARACTERISTIC
/begin MEASUREMENT Gear_stHWSensor "" ULONG VBU0428Test_CM_uint32 0 0 0.0 15.0 ECU_ADDRESS 0x6003be32 /end MEASUREMENT
/begin MEASUREMENT TQDMP_pctAccPdlVrtlRA "" FLOAT32_IEEE VBU0428Test_CM_single 0 0 -3.4E+38 3.4E+38 ECU_ADDRESS 0x6003bd4e /end MEASUREMENT
/begin MEASUREMENT TQDMP_trqDeltaLPFR "" FLOAT32_IEEE VBU0428Test_CM_single 0 0 -10000.0 10000.0 ECU_ADDRESS 0x6003bd5e /end MEASUREMENT
/begin MEASUREMENT TQDMP_trqDeltaR "" FLOAT32_IEEE VBU0428Test_CM_single 0 0 -10000.0 10000.0 ECU_ADDRESS 0x6003bd62 /end MEASUREMENT
/begin MEASUREMENT TQDMP_trqROTCRA "" FLOAT32_IEEE VBU0428Test_CM_single 0 0 -10000.0 10000.0 ECU_ADDRESS 0x6003bd6a /end MEASUREMENT
/begin MEASUREMENT TQDMP_trqBumpRA "" FLOAT32_IEEE VBU0428Test_CM_single 0 0 -10000.0 10000.0 ECU_ADDRESS 0x6003bd52 /end MEASUREMENT
/begin MEASUREMENT TQO_trqBrkLim "" FLOAT32_IEEE VBU0428Test_CM_single 0 0 -10000.0 10000.0 ECU_ADDRESS 0x6003bd96 /end MEASUREMENT
/begin MEASUREMENT TQO_facShft "" FLOAT32_IEEE VBU0428Test_CM_single 0 0 -3.4E+38 3.4E+38 ECU_ADDRESS 0x6003bd8e /end MEASUREMENT
/begin MEASUREMENT TQDIS_trqCrpBase "" FLOAT32_IEEE VBU0428Test_CM_single 0 0 -10000.0 10000.0 ECU_ADDRESS 0x6003bcf2 /end MEASUREMENT
/begin MEASUREMENT TQDIS_facBrkSlpCrp "" FLOAT32_IEEE VBU0428Test_CM_single 0 0 -3.4E+38 3.4E+38 ECU_ADDRESS 0x6003bcda /end MEASUREMENT
/begin MEASUREMENT TQDIS_trqCrpIncFilter "" FLOAT32_IEEE VBU0428Test_CM_single 0 0 -10000.0 10000.0 ECU_ADDRESS 0x6003bcfa /end MEASUREMENT
/begin MEASUREMENT TQDIS_trqIncBase "" FLOAT32_IEEE VBU0428Test_CM_single 0 0 -3.4E+38 3.4E+38 ECU_ADDRESS 0x90000220 /end MEASUREMENT
/begin MEASUREMENT TQDIS_facIncGain "" FLOAT32_IEEE VBU0428Test_CM_single 0 0 -3.4E+38 3.4E+38 ECU_ADDRESS 0x90000240 /end MEASUREMENT
/begin MEASUREMENT TQDIS_trqBase1RADrvIncLim "" FLOAT32_IEEE VBU0428Test_CM_single 0 0 -3.4E+38 3.4E+38 ECU_ADDRESS 0x90000244 /end MEASUREMENT
/begin MEASUREMENT TQDIS_facAccPedFilter "" FLOAT32_IEEE VBU0428Test_CM_single 0 0 -3.4E+38 3.4E+38 ECU_ADDRESS 0x6003bcce /end MEASUREMENT
/begin MEASUREMENT TQDIS_facUnintdAcc "" FLOAT32_IEEE VBU0428Test_CM_single 0 0 -3.4E+38 3.4E+38 ECU_ADDRESS 0x6003bce2 /end MEASUREMENT
/begin MEASUREMENT TQDIS_trqBase2RADrvIncLim "" FLOAT32_IEEE VBU0428Test_CM_single 0 0 -3.4E+38 3.4E+38 ECU_ADDRESS 0x9000021c /end MEASUREMENT
/begin MEASUREMENT TQDIS_facPwrLo "" FLOAT32_IEEE VBU0428Test_CM_single 0 0 -3.4E+38 3.4E+38 ECU_ADDRESS 0x6003bcde /end MEASUREMENT
/begin MEASUREMENT TQDIS_trqRADrvIncLim "" FLOAT32_IEEE VBU0428Test_CM_single 0 0 -10000.0 10000.0 ECU_ADDRESS 0x6003bd2e /end MEASUREMENT
/begin MEASUREMENT TQDIS_trqCrpDecFilter "" FLOAT32_IEEE VBU0428Test_CM_single 0 0 -10000.0 10000.0 ECU_ADDRESS 0x6003bcf6 /end MEASUREMENT
/begin MEASUREMENT TQDIS_facBrkDec "" FLOAT32_IEEE VBU0428Test_CM_single 0 0 -3.4E+38 3.4E+38 ECU_ADDRESS 0x6003bcd6 /end MEASUREMENT
/begin MEASUREMENT TQDIS_facBase2RADrvDecLim "" FLOAT32_IEEE VBU0428Test_CM_single 0 0 -3.4E+38 3.4E+38 ECU_ADDRESS 0x6003bcd2 /end MEASUREMENT
/begin MEASUREMENT TQDIS_trqRADrvDecLim "" FLOAT32_IEEE VBU0428Test_CM_single 0 0 -10000.0 10000.0 ECU_ADDRESS 0x6003bd2a /end MEASUREMENT
/begin MEASUREMENT TQDIS_trqDmpRAInit "" FLOAT32_IEEE VBU0428Test_CM_single 0 0 -10000.0 10000.0 ECU_ADDRESS 0x6003bd0e /end MEASUREMENT
/begin MEASUREMENT EDIS_pwrDisChLimDynRaw "" FLOAT32_IEEE VBU0428Test_CM_single 0 0 0.0 1000.0 ECU_ADDRESS 0x6003bdee /end MEASUREMENT
/begin MEASUREMENT EDIS_pwrDisChLimSTRaw "" FLOAT32_IEEE VBU0428Test_CM_single 0 0 0.0 1000.0 ECU_ADDRESS 0x6003bdf6 /end MEASUREMENT
/begin MEASUREMENT EDIS_pwrDisChaDynCold "" FLOAT32_IEEE VBU0428Test_CM_single 0 0 0.0 1000.0 ECU_ADDRESS 0x6003bdfe /end MEASUREMENT
/begin MEASUREMENT EDIS_pwrDisChaDynHot "" FLOAT32_IEEE VBU0428Test_CM_single 0 0 -3.4E+38 3.4E+38 ECU_ADDRESS 0x6003bb56 /end MEASUREMENT
/begin MEASUREMENT EDIS_pwrDisChaDynTempCorr "" FLOAT32_IEEE VBU0428Test_CM_single 0 0 0.0 1000.0 ECU_ADDRESS 0x6003be02 /end MEASUREMENT
/begin MEASUREMENT EDIS_pwrDisChLimDynOvrride "" FLOAT32_IEEE VBU0428Test_CM_single 0 0 -3.4E+38 3.4E+38 ECU_ADDRESS 0x6003bb4e /end MEASUREMENT
/begin MEASUREMENT EDIS_pwrDisChLimDynST "" FLOAT32_IEEE VBU0428Test_CM_single 0 0 -3.4E+38 3.4E+38 ECU_ADDRESS 0x6003bb52 /end MEASUREMENT
/begin MEASUREMENT EDIS_facDchDynSp "" FLOAT32_IEEE VBU0428Test_CM_single 0 0 -3.4E+38 3.4E+38 ECU_ADDRESS 0x6003bb3e /end MEASUREMENT
/begin MEASUREMENT EDIS_pwrDisChSp "" FLOAT32_IEEE VBU0428Test_CM_single 0 0 0.0 1000.0 ECU_ADDRESS 0x6003bdfa /end MEASUREMENT
/begin MEASUREMENT EDIS_pwrChLimLTRaw "" FLOAT32_IEEE VBU0428Test_CM_single 0 0 0.0 1000.0 ECU_ADDRESS 0x6003bde6 /end MEASUREMENT
/begin MEASUREMENT EDIS_pwrChLimDynRaw "" FLOAT32_IEEE VBU0428Test_CM_single 0 0 -3.4E+38 3.4E+38 ECU_ADDRESS 0x6003bde2 /end MEASUREMENT
/begin MEASUREMENT EDIS_pwrDisChLimLTRaw "" FLOAT32_IEEE VBU0428Test_CM_single 0 0 0.0 1000.0 ECU_ADDRESS 0x6003bdf2 /end MEASUREMENT
/begin MEASUREMENT SOH_AhCellCapacityMin "" FLOAT32_IEEE VBU0428Test_CM_single 0 0 -3.4E+38 3.4E+38 ECU_ADDRESS 0x900001f4 /end MEASUREMENT
/begin MEASUREMENT SOH_AhCellCapacityMax "" FLOAT32_IEEE VBU0428Test_CM_single 0 0 -3.4E+38 3.4E+38 ECU_ADDRESS 0x900001f0 /end MEASUREMENT
/begin MEASUREMENT SOH_AhCellCapacityAve "" FLOAT32_IEEE VBU0428Test_CM_single 0 0 -3.4E+38 3.4E+38 ECU_ADDRESS 0x900001ec /end MEASUREMENT
/begin MEASUREMENT SOF_pctCurrentSOH "" FLOAT32_IEEE VBU0428Test_CM_single 0 0 -3.4E+38 3.4E+38 ECU_ADDRESS 0x900001e0 /end MEASUREMENT
/begin MEASUREMENT SOF_facContinuousChargeFactor "" FLOAT32_IEEE VBU0428Test_CM_single 0 0 -3.4E+38 3.4E+38 ECU_ADDRESS 0x90000194 /end MEASUREMENT
/begin MEASUREMENT SOF_iAContinuousChargeCurrentBaseRaw "" FLOAT32_IEEE VBU0428Test_CM_single 0 0 -3.4E+38 3.4E+38 ECU_ADDRESS 0x900001a4 /end MEASUREMENT
/begin MEASUREMENT SOF_iAContinuousChargeCurrentLimitMapBaseNormal "" FLOAT32_IEEE VBU0428Test_CM_single 0 0 -3.4E+38 3.4E+38 ECU_ADDRESS 0x6003bbde /end MEASUREMENT
/begin MEASUREMENT SOF_iAShortPulseChargeCurrentLimitMapBaseNormal "" FLOAT32_IEEE VBU0428Test_CM_single 0 0 -3.4E+38 3.4E+38 ECU_ADDRESS 0x6003bc1e /end MEASUREMENT
/begin MEASUREMENT SOF_iAShortPulseDischargeCurrentLimitBase "" FLOAT32_IEEE VBU0428Test_CM_single 0 0 -3.4E+38 3.4E+38 ECU_ADDRESS 0x6003bc2a /end MEASUREMENT
/begin MEASUREMENT SOF_iAShortPulseDischargeCurrentLimitFastChrgChk "" FLOAT32_IEEE VBU0428Test_CM_single 0 0 -3.4E+38 3.4E+38 ECU_ADDRESS 0x6003bc2e /end MEASUREMENT
/begin MEASUREMENT SOF_iAContinuousDischargeCurrentLimitFastChrgChk "" FLOAT32_IEEE VBU0428Test_CM_single 0 0 -3.4E+38 3.4E+38 ECU_ADDRESS 0x6003bbea /end MEASUREMENT
/begin MEASUREMENT SOF_iAShortPulseChargeCurrentLimitFastChrgChk "" FLOAT32_IEEE VBU0428Test_CM_single 0 0 -3.4E+38 3.4E+38 ECU_ADDRESS 0x6003bc1a /end MEASUREMENT
/begin MEASUREMENT SOF_iAContinuousChargeCurrentLimitFastChrgChkRaw "" FLOAT32_IEEE VBU0428Test_CM_single 0 0 -3.4E+38 3.4E+38 ECU_ADDRESS 0x6003bbda /end MEASUREMENT
/begin MEASUREMENT SOF_iAContinuousChargeCurrentLimitFastChrgChk "" FLOAT32_IEEE VBU0428Test_CM_single 0 0 -3.4E+38 3.4E+38 ECU_ADDRESS 0x6003bbd6 /end MEASUREMENT
/begin MEASUREMENT SOF_mohmCellDischargeDcirCalc "" FLOAT32_IEEE VBU0428Test_CM_single 0 0 -3.4E+38 3.4E+38 ECU_ADDRESS 0x6003bc5e /end MEASUREMENT
/begin MEASUREMENT SOF_iAShortPulseChargeCurrentLimitVltgTarget "" FLOAT32_IEEE VBU0428Test_CM_single 0 0 -3.4E+38 3.4E+38 ECU_ADDRESS 0x6003bc26 /end MEASUREMENT
/begin MEASUREMENT SOF_iAContinuousChargeCurrentLimitVltgTarget "" FLOAT32_IEEE VBU0428Test_CM_single 0 0 -3.4E+38 3.4E+38 ECU_ADDRESS 0x6003bbe6 /end MEASUREMENT
/begin MEASUREMENT SOF_iADynamicChargeCurrentLimitVltgTarget "" FLOAT32_IEEE VBU0428Test_CM_single 0 0 -3.4E+38 3.4E+38 ECU_ADDRESS 0x6003bbfe /end MEASUREMENT
/begin MEASUREMENT SOF_iAShortPulseDischargeCurrentLimitVltgTarget "" FLOAT32_IEEE VBU0428Test_CM_single 0 0 -3.4E+38 3.4E+38 ECU_ADDRESS 0x6003bc36 /end MEASUREMENT
/begin MEASUREMENT SOF_iAContinuousDischargeCurrentLimitVltgTarget "" FLOAT32_IEEE VBU0428Test_CM_single 0 0 -3.4E+38 3.4E+38 ECU_ADDRESS 0x6003bbf2 /end MEASUREMENT
/begin MEASUREMENT SOF_iADynamicDischargeCurrentLimitVltgBefoTarget "" FLOAT32_IEEE VBU0428Test_CM_single 0 0 -3.4E+38 3.4E+38 ECU_ADDRESS 0x6003bc0a /end MEASUREMENT
/begin MEASUREMENT SOF_iADynamicDischargeCurrentLimitVltgDcirTarget "" FLOAT32_IEEE VBU0428Test_CM_single 0 0 -3.4E+38 3.4E+38 ECU_ADDRESS 0x6003bc0e /end MEASUREMENT
/begin MEASUREMENT SOF_iADynamicDischargeCurrentLimitVltgTarget "" FLOAT32_IEEE VBU0428Test_CM_single 0 0 -3.4E+38 3.4E+38 ECU_ADDRESS 0x6003bc12 /end MEASUREMENT
/begin MEASUREMENT SOF_AsChargeCurrentLimitBufferFull "" FLOAT32_IEEE VBU0428Test_CM_single 0 0 -3.4E+38 3.4E+38 ECU_ADDRESS 0x6003bbc2 /end MEASUREMENT
/begin MEASUREMENT SOF_AsChargeCurrentLimitBufferUse "" FLOAT32_IEEE VBU0428Test_CM_single 0 0 -3.4E+38 3.4E+38 ECU_ADDRESS 0x6003bbc6 /end MEASUREMENT
/begin MEASUREMENT SOF_iADynamicChargeCurrentLimitFastChrgChk "" FLOAT32_IEEE VBU0428Test_CM_single 0 0 -3.4E+38 3.4E+38 ECU_ADDRESS 0x6003bbf6 /end MEASUREMENT
/begin MEASUREMENT SOF_iACalDynamicChgCurLimitFCCChk "" FLOAT32_IEEE VBU0428Test_CM_single 0 0 -3.4E+38 3.4E+38 ECU_ADDRESS 0x90000198 /end MEASUREMENT
/begin MEASUREMENT SOF_AsDischargeCurrentLimitBufferFull "" FLOAT32_IEEE VBU0428Test_CM_single 0 0 -3.4E+38 3.4E+38 ECU_ADDRESS 0x6003bbca /end MEASUREMENT
/begin MEASUREMENT SOF_AsDischargeCurrentLimitBufferUse "" FLOAT32_IEEE VBU0428Test_CM_single 0 0 -3.4E+38 3.4E+38 ECU_ADDRESS 0x6003bbce /end MEASUREMENT
/begin MEASUREMENT SOF_iADynamicDischargeCurrentLimitFastChrgChk "" FLOAT32_IEEE VBU0428Test_CM_single 0 0 -3.4E+38 3.4E+38 ECU_ADDRESS 0x6003bc02 /end MEASUREMENT
/begin MEASUREMENT CTD_jAccumulatedAvaliableHeat "" FLOAT32_IEEE VBU0428Test_CM_single 0 0 -3.4E+38 3.4E+38 ECU_ADDRESS 0x6003bf2a /end MEASUREMENT
/begin MEASUREMENT SOF_mvFastChargeCurrentDropCellVoltage "" UWORD VBU0428Test_CM_uint16 0 0 0 65535 ECU_ADDRESS 0x90000caa /end MEASUREMENT
/begin MEASUREMENT SOF_nbrDischargeVoltageCorrectLevel "" UBYTE VBU0428Test_CM_uint8 0 0 0 255 ECU_ADDRESS 0x90001cb2 /end MEASUREMENT
/begin MEASUREMENT SOF_nbrChargeVoltageCorrectLevel "" UBYTE VBU0428Test_CM_uint8 0 0 0 255 ECU_ADDRESS 0x90001cb1 /end MEASUREMENT
/begin MEASUREMENT Gear_flgRGearReqRawDigitalAction "" UBYTE VBU0428Test_CM_boolean 0 0 0.0 1.0 ECU_ADDRESS 0x90001d1e /end MEASUREMENT
/begin MEASUREMENT Gear_flgDGearReqRawDigitalAction "" UBYTE VBU0428Test_CM_boolean 0 0 0.0 1.0 ECU_ADDRESS 0x90001d17 /end MEASUREMENT
/begin MEASUREMENT Gear_flgNGearReqRawDigitalAction "" UBYTE VBU0428Test_CM_boolean 0 0 0 1 ECU_ADDRESS 0x90001f78 /end MEASUREMENT
/begin MEASUREMENT Gear_flgGearWarningST "" UBYTE VBU0428Test_CM_boolean 0 0 0.0 1.0 ECU_ADDRESS 0x90001d6a /end MEASUREMENT
/begin MEASUREMENT Gear_flgGearWarningLT "" UBYTE VBU0428Test_CM_boolean 0 0 0.0 1.0 ECU_ADDRESS 0x90001d69 /end MEASUREMENT
/begin MEASUREMENT Gear_flgDftGearPlausibilityDigital "" UBYTE VBU0428Test_CM_boolean 0 0 0.0 1.0 ECU_ADDRESS 0x90001d64 /end MEASUREMENT
/begin MEASUREMENT Gear_flgNGearReq "" UBYTE VBU0428Test_CM_boolean 0 0 0 1 ECU_ADDRESS 0x90001f76 /end MEASUREMENT
/begin MEASUREMENT TQDMP_flgTipInEnaRA "" UBYTE VBU0428Test_CM_boolean 0 0 0.0 1.0 ECU_ADDRESS 0x90001d58 /end MEASUREMENT
/begin MEASUREMENT TQDMP_flgTipOutEnaRA "" UBYTE VBU0428Test_CM_boolean 0 0 0.0 1.0 ECU_ADDRESS 0x90001d59 /end MEASUREMENT
/begin MEASUREMENT TQDMP_flgSpdHldR "" UBYTE VBU0428Test_CM_boolean 0 0 0.0 1.0 ECU_ADDRESS 0x90001d57 /end MEASUREMENT
/begin MEASUREMENT TQDMP_flgROTCActRA "" UBYTE VBU0428Test_CM_boolean 0 0 0.0 1.0 ECU_ADDRESS 0x90001d56 /end MEASUREMENT
/begin MEASUREMENT TQDIS_flgCrp "" UBYTE VBU0428Test_CM_boolean 0 0 0.0 1.0 ECU_ADDRESS 0x90001d55 /end MEASUREMENT
/begin MEASUREMENT EDIS_flgVehSpdLow "" UBYTE VBU0428Test_CM_boolean 0 0 0.0 1.0 ECU_ADDRESS 0x90001d01 /end MEASUREMENT
/begin MEASUREMENT EDIS_flgPowDisChToSTLim "" UBYTE VBU0428Test_CM_boolean 0 0 0.0 1.0 ECU_ADDRESS 0x90001d00 /end MEASUREMENT
/begin MEASUREMENT DCH_flgAPlusWkup "" UBYTE VBU0428Test_CM_boolean 0 0 0.0 1.0 ECU_ADDRESS 0x90001cc2 /end MEASUREMENT
/begin MEASUREMENT DCH_flgBmsChAvl "" UBYTE VBU0428Test_CM_boolean 0 0 0.0 1.0 ECU_ADDRESS 0x90001cce /end MEASUREMENT
/begin MEASUREMENT DCH_flgDCChRlyCloseSt "" UBYTE VBU0428Test_CM_boolean 0 0 0.0 1.0 ECU_ADDRESS 0x90001cd6 /end MEASUREMENT
/begin MEASUREMENT SOF_flgFastChrgOneThirdRateCurrentLimit "" UBYTE VBU0428Test_CM_boolean 0 0 0.0 1.0 ECU_ADDRESS 0x90001d4a /end MEASUREMENT
/begin MEASUREMENT SOF_flgCellDischargeDcirCalcValid "" UBYTE VBU0428Test_CM_boolean 0 0 0 1 ECU_ADDRESS 0x90001d48 /end MEASUREMENT
/begin MEASUREMENT SOF_flgLowVoltageState "" UBYTE VBU0428Test_CM_boolean 0 0 0 1 ECU_ADDRESS 0x90001d4b /end MEASUREMENT
/begin MEASUREMENT LbSOC_FastChargeCurrentStable_flg "" UBYTE VBU0428Test_CM_boolean 0 0 0 1 ECU_ADDRESS 0x90001f7e /end MEASUREMENT
/begin MEASUREMENT VoltThld_flg "" UBYTE VBU0428Test_CM_boolean 0 0 0 1 ECU_ADDRESS 0x90001f93 /end MEASUREMENT
/begin MEASUREMENT VoltThld1_flg "" UBYTE VBU0428Test_CM_boolean 0 0 0 1 ECU_ADDRESS 0x90001f92 /end MEASUREMENT
/begin MEASUREMENT FCC_flgFullChargeSOCCriteria "" UBYTE VBU0428Test_CM_boolean 0 0 0.0 1.0 ECU_ADDRESS 0x90001d10 /end MEASUREMENT
/begin MEASUREMENT EcSOF_LowVoltageStartTime_s "" ULONG VBU0428Test_CM_uint32 0 0 0 4294967295 ECU_ADDRESS 0x6003bb6a /end MEASUREMENT
/begin MEASUREMENT EcSOF_LowVoltageState_flg "" UBYTE VBU0428Test_CM_boolean 0 0 0 1 ECU_ADDRESS 0x90001d02 /end MEASUREMENT
/begin COMPU_METHOD VBU0428Test_CM_single_C "Q = V" RAT_FUNC "%8.6" "C" COEFFS 0 1 0 0 0 1 /end COMPU_METHOD
/begin COMPU_METHOD VBU0428Test_CM_single_cnt "Q = V" RAT_FUNC "%8.6" "cnt" COEFFS 0 1 0 0 0 1 /end COMPU_METHOD
/begin COMPU_METHOD VBU0428Test_CM_uint16_cnt "Q = V" RAT_FUNC "%5.0" "cnt" COEFFS 0 1 0 0 0 1 /end COMPU_METHOD
/begin COMPU_METHOD VBU0428Test_CM_single_Nm "Q = V" RAT_FUNC "%8.6" "Nm" COEFFS 0 1 0 0 0 1 /end COMPU_METHOD
/begin COMPU_METHOD VBU0428Test_CM_single_kph "Q = V" RAT_FUNC "%8.6" "kph" COEFFS 0 1 0 0 0 1 /end COMPU_METHOD
/begin COMPU_METHOD VBU0428Test_CM_single_pct "Q = V" RAT_FUNC "%8.6" "pct" COEFFS 0 1 0 0 0 1 /end COMPU_METHOD
/begin COMPU_METHOD VBU0428Test_CM_single_t "Q = V" RAT_FUNC "%8.6" "t" COEFFS 0 1 0 0 0 1 /end COMPU_METHOD
/begin COMPU_METHOD VBU0428Test_CM_single_A "Q = V" RAT_FUNC "%8.6" "A" COEFFS 0 1 0 0 0 1 /end COMPU_METHOD
/begin COMPU_METHOD VBU0428Test_CM_single_fac "Q = V" RAT_FUNC "%8.6" "fac" COEFFS 0 1 0 0 0 1 /end COMPU_METHOD
/begin COMPU_METHOD VBU0428Test_CM_uint8 "Q = V" RAT_FUNC "%3.0" "" COEFFS 0 1 0 0 0 1 /end COMPU_METHOD
/begin COMPU_METHOD VBU0428Test_CM_single_km "Q = V" RAT_FUNC "%8.6" "km" COEFFS 0 1 0 0 0 1 /end COMPU_METHOD
/begin COMPU_METHOD VBU0428Test_CM_single_i "Q = V" RAT_FUNC "%8.6" "i" COEFFS 0 1 0 0 0 1 /end COMPU_METHOD
/begin COMPU_METHOD VBU0428Test_CM_uint16 "Q = V" RAT_FUNC "%5.0" "" COEFFS 0 1 0 0 0 1 /end COMPU_METHOD
/begin COMPU_METHOD VBU0428Test_CM_single_kw "Q = V" RAT_FUNC "%8.6" "kw" COEFFS 0 1 0 0 0 1 /end COMPU_METHOD
/begin COMPU_METHOD VBU0428Test_CM_single "Q = V" RAT_FUNC "%8.6" "" COEFFS 0 1 0 0 0 1 /end COMPU_METHOD
/begin COMPU_METHOD VBU0428Test_CM_single_kW "Q = V" RAT_FUNC "%8.6" "kW" COEFFS 0 1 0 0 0 1 /end COMPU_METHOD
/begin COMPU_METHOD VBU0428Test_CM_uint32_cnt "Q = V" RAT_FUNC "%10.0" "cnt" COEFFS 0 1 0 0 0 1 /end COMPU_METHOD
/begin COMPU_METHOD VBU0428Test_CM_uint32 "Q = V" RAT_FUNC "%10.0" "" COEFFS 0 1 0 0 0 1 /end COMPU_METHOD
/begin COMPU_METHOD VBU0428Test_CM_boolean_flg "Q = V" RAT_FUNC "%1.0" "flg" COEFFS 0 1 0 0 0 1 /end COMPU_METHOD
/begin COMPU_METHOD VBU0428Test_CM_boolean_cnt "Q = V" RAT_FUNC "%1.0" "cnt" COEFFS 0 1 0 0 0 1 /end COMPU_METHOD
/begin COMPU_METHOD VBU0428Test_CM_boolean "Q = V" RAT_FUNC "%1.0" "" COEFFS 0 1 0 0 0 1 /end COMPU_METHOD
/begin COMPU_METHOD VBU0428Test_CM_uint8_cnt "Q = V" RAT_FUNC "%3.0" "cnt" COEFFS 0 1 0 0 0 1 /end COMPU_METHOD
/begin GROUP S841_FullCharge_criteria4 "VBU0428Test/VBUSystem/BMS/FCC /FCC/Subsystem/Fastcharge_Conditions_Check/Condition_Categorize/Full_Charge_Determination/FullCharge_criteria4"
 /begin REF_CHARACTERISTIC CcFCC_BatteryCapacityCycleHomo_n CcFCC_FullChargeSocDebounceTime_s CcFCC_FullChargeSocDelta_pct CcFCC_HomoFullChargeSoc_pct /end REF_CHARACTERISTIC
 /begin REF_MEASUREMENT FCC_flgFullChargeSOCCriteria /end REF_MEASUREMENT
/end GROUP
/begin GROUP S1053_Calculate_WindowAverage_BatteryCurrent "VBU0428Test/VBUSystem/BMS/SOC/Subsystem5/Subsystem/Determine_FastChargeCorrection_Soc/FastCharge_DynamicCorrection/FastCharge_DynamicCorrection_Enable/Calculate_WindowAverage_BatteryCurrent" /begin REF_CHARACTERISTIC CcSOC_CurrentWinAvePeriodTime_ms /end REF_CHARACTERISTIC /end GROUP
/begin GROUP S1053_Determine_CurrentStable_Condition "VBU0428Test/VBUSystem/BMS/SOC/Subsystem5/Subsystem/Determine_FastChargeCorrection_Soc/FastCharge_DynamicCorrection/FastCharge_DynamicCorrection_Enable/Determine_CurrentStable_Condition" /begin SUB_GROUP S1055_Delay_RisingEdge /end SUB_GROUP
 /begin REF_CHARACTERISTIC CcSOC_CurrentStableThresholdRate_pct CcSOC_CurrentStableTime_ms /end REF_CHARACTERISTIC
/end GROUP
/begin GROUP S1053_VoltThldEdge "VBU0428Test/VBUSystem/BMS/SOC/Subsystem5/Subsystem/Determine_FastChargeCorrection_Soc/FastCharge_DynamicCorrection/FastCharge_DynamicCorrection_Enable/VoltThldEdge" /begin REF_MEASUREMENT VoltThld_flg /end REF_MEASUREMENT /end GROUP
/begin GROUP S1053_VoltThldEdge1 "VBU0428Test/VBUSystem/BMS/SOC/Subsystem5/Subsystem/Determine_FastChargeCorrection_Soc/FastCharge_DynamicCorrection/FastCharge_DynamicCorrection_Enable/VoltThldEdge1" /begin REF_MEASUREMENT VoltThld1_flg /end REF_MEASUREMENT /end GROUP
/begin GROUP S1187_Power_Limit_Level1_ChargePowerLimit "VBU0428Test/VBUSystem/BMS/SOF/Subsystem6/Subsystem/Calculate_PowerLimit/Determine_Capacity_Cycle_PowerLimit/Power_Limit_Cycle_Level1/Power_Limit_Level1_ChargePowerLimit"
 /begin REF_CHARACTERISTIC CcSOF_CyclePowerLimitCharge_Kw CcSOF_CyclePowerLimitLevel1SOCMax_pct CcSOF_CyclePowerLimitMax_Kw /end REF_CHARACTERISTIC
/end GROUP
/begin GROUP S1187_Power_Limit_Level1_DischargePowerLimit "VBU0428Test/VBUSystem/BMS/SOF/Subsystem6/Subsystem/Calculate_PowerLimit/Determine_Capacity_Cycle_PowerLimit/Power_Limit_Cycle_Level1/Power_Limit_Level1_DischargePowerLimit"
 /begin REF_CHARACTERISTIC CcSOF_CyclePowerLimitLevel1Discharge_Kw CcSOF_CyclePowerLimitLevel1SOCMin_pct CcSOF_CyclePowerLimitMax_Kw /end REF_CHARACTERISTIC
/end GROUP
/begin GROUP S1188_Power_Limit_Cycle_Level2_ChargePowerLimit "VBU0428Test/VBUSystem/BMS/SOF/Subsystem6/Subsystem/Calculate_PowerLimit/Determine_Capacity_Cycle_PowerLimit/Power_Limit_Cycle_Level2/Power_Limit_Cycle_Level2_ChargePowerLimit"
 /begin REF_CHARACTERISTIC CcSOF_CyclePowerLimitCharge_Kw CcSOF_CyclePowerLimitLevel2SOCMax_pct CcSOF_CyclePowerLimitMax_Kw /end REF_CHARACTERISTIC
/end GROUP
/begin GROUP S1188_Power_Limit_Cycle_Level2_DischargePowerLimit "VBU0428Test/VBUSystem/BMS/SOF/Subsystem6/Subsystem/Calculate_PowerLimit/Determine_Capacity_Cycle_PowerLimit/Power_Limit_Cycle_Level2/Power_Limit_Cycle_Level2_DischargePowerLimit"
 /begin REF_CHARACTERISTIC CcSOF_CyclePowerLimitLevel2Discharge_Kw CcSOF_CyclePowerLimitLevel2SOCMin_pct CcSOF_CyclePowerLimitMax_Kw /end REF_CHARACTERISTIC
/end GROUP
/begin GROUP S1189_Power_Limit_Cycle_Level3_ChargePowerLimit "VBU0428Test/VBUSystem/BMS/SOF/Subsystem6/Subsystem/Calculate_PowerLimit/Determine_Capacity_Cycle_PowerLimit/Power_Limit_Cycle_Level3/Power_Limit_Cycle_Level3_ChargePowerLimit"
 /begin REF_CHARACTERISTIC CcSOF_CyclePowerLimitCharge_Kw CcSOF_CyclePowerLimitLevel3SOCMax_pct CcSOF_CyclePowerLimitMax_Kw /end REF_CHARACTERISTIC
/end GROUP
/begin GROUP S1189_Power_Limit_Cycle_Level3_DischargePowerLimit "VBU0428Test/VBUSystem/BMS/SOF/Subsystem6/Subsystem/Calculate_PowerLimit/Determine_Capacity_Cycle_PowerLimit/Power_Limit_Cycle_Level3/Power_Limit_Cycle_Level3_DischargePowerLimit"
 /begin REF_CHARACTERISTIC CcSOF_CyclePowerLimitLevel2SOCMin_pct CcSOF_CyclePowerLimitLevel3Discharge1_Kw CcSOF_CyclePowerLimitLevel3Discharge2_Kw CcSOF_CyclePowerLimitLevel3SOCMin_pct CcSOF_CyclePowerLimitMax_Kw /end REF_CHARACTERISTIC
/end GROUP
/begin GROUP S1197_Determine_SOCP_Condition "VBU0428Test/VBUSystem/BMS/SOF/Subsystem6/Subsystem/Calculate_PowerLimit/Determine_SOCP_PowerLimit/Determine_ContinuousDischargePowerLimitTarget/Determine_SOCP_Condition"
 /begin REF_CHARACTERISTIC CcSOF_SocpDischargeSocDebounce_pct CcSOF_SocpModeDebounceTime_ms /end REF_CHARACTERISTIC
/end GROUP
/begin GROUP S1198_Determine_SOCP_Condition "VBU0428Test/VBUSystem/BMS/SOF/Subsystem6/Subsystem/Calculate_PowerLimit/Determine_SOCP_PowerLimit/Determine_DischargePowerLimitTarget/Determine_SOCP_Condition"
 /begin REF_CHARACTERISTIC CcSOF_SocpDischargeSocDebounce_pct CcSOF_SocpModeDebounceTime_ms /end REF_CHARACTERISTIC
/end GROUP
/begin GROUP S1212_Calculate_ContinuousChargeCurrent "VBU0428Test/VBUSystem/BMS/SOF/Subsystem6/Subsystem/Determine_Currentlimit_Target/Calculate_CurrentLimit_Target/Calculate_CurrentLimit_Base/Calculate_ContinuousChargeCurrent"
 /begin SUB_GROUP S1217_Calculate_Locked_SOC S1217_Calculate_Locked_SOC1 S1217_Calculate_Locked_SOC2 S1217_Calculate_SOH_Current_Limit /end SUB_GROUP
 /begin REF_CHARACTERISTIC CaSOF_ContinuousChargeEolMap_v CaSOF_ContinuousChargeFactorMap_v CaSOF_ContinuousChargeHomoMap_v CaSOF_ContinuousChargeLockedHomoMap_v CaSOF_ContinuousChargeLockedMap_v CaSOF_ContinuousChargeMap_v CcSOF_BaseCurrentLimitFactor_pct CcSOF_BatteryCycleHomo_n CcSOF_UseSohLimitEnable_flg /end REF_CHARACTERISTIC
 /begin REF_MEASUREMENT SOF_facContinuousChargeFactor SOF_iAContinuousChargeCurrentBaseRaw SOF_iAContinuousChargeCurrentLimitMapBaseNormal /end REF_MEASUREMENT
/end GROUP
/begin GROUP S1212_Calculate_ContinuousDischargeCurrent "VBU0428Test/VBUSystem/BMS/SOF/Subsystem6/Subsystem/Determine_Currentlimit_Target/Calculate_CurrentLimit_Target/Calculate_CurrentLimit_Base/Calculate_ContinuousDischargeCurrent"
 /begin SUB_GROUP S1218_Calculate_Locked_SOC S1218_Calculate_Locked_SOC1 S1218_Calculate_SOH_Current_Limit /end SUB_GROUP
 /begin REF_CHARACTERISTIC CaSOF_ContinuousDischargeEolSocTempMapDimension_n CaSOF_ContinuousDischargeEolSocTempMapZ_A CaSOF_ContinuousDischargeLockedSocTempMapDimension_n CaSOF_ContinuousDischargeLockedSocTempMapZ_A CaSOF_ContinuousDischargeSocTempMapDimension_n CaSOF_ContinuousDischargeSocTempMapZ_A CcSOF_BaseCurrentLimitFactor_pct CcSOF_UseSohLimitEnable_flg /end REF_CHARACTERISTIC
/end GROUP
/begin GROUP S1212_Calculate_ShortPulseChargeCurrent "VBU0428Test/VBUSystem/BMS/SOF/Subsystem6/Subsystem/Determine_Currentlimit_Target/Calculate_CurrentLimit_Target/Calculate_CurrentLimit_Base/Calculate_ShortPulseChargeCurrent"
 /begin SUB_GROUP S1219_Calculate_Locked_SOC S1219_Calculate_Locked_SOC1 S1219_Calculate_SOH_Current_Limit /end SUB_GROUP
 /begin REF_CHARACTERISTIC CaSOF_ShortPulseChargeEolSocTempMapDimension_n CaSOF_ShortPulseChargeEolSocTempMapZ_A CaSOF_ShortPulseChargeLockedSocTempMapDimension_n CaSOF_ShortPulseChargeLockedSocTempMapX_C CaSOF_ShortPulseChargeLockedSocTempMapY_pct CaSOF_ShortPulseChargeSocTempMapDimension_n CaSOF_ShortPulseChargeSocTempMapX_C CaSOF_ShortPulseChargeSocTempMapY_pct CcSOF_BaseCurrentLimitFactor_pct CcSOF_UseSohLimitEnable_flg /end REF_CHARACTERISTIC
 /begin REF_MEASUREMENT SOF_iAShortPulseChargeCurrentLimitMapBaseNormal /end REF_MEASUREMENT
/end GROUP
/begin GROUP S1212_Calculate_ShortPulseDischargeCurrent "VBU0428Test/VBUSystem/BMS/SOF/Subsystem6/Subsystem/Determine_Currentlimit_Target/Calculate_CurrentLimit_Target/Calculate_CurrentLimit_Base/Calculate_ShortPulseDischargeCurrent"
 /begin SUB_GROUP S1220_Calculate_Locked_SOC S1220_Calculate_Locked_SOC1 S1220_Calculate_SOH_Current_Limit /end SUB_GROUP
 /begin REF_CHARACTERISTIC CaSOF_ShortPulseDischargeEolSocTempMapDimension_n CaSOF_ShortPulseDischargeEolSocTempMapZ_A CaSOF_ShortPulseDischargeLockedSocTempMapDimension_n CaSOF_ShortPulseDischargeLockedSocTempMapZ_A CaSOF_ShortPulseDischargeSocTempMapDimension_n CaSOF_ShortPulseDischargeSocTempMapZ_A CcSOF_BaseCurrentLimitFactor_pct CcSOF_UseSohLimitEnable_flg /end REF_CHARACTERISTIC
 /begin REF_MEASUREMENT SOF_iAShortPulseDischargeCurrentLimitBase /end REF_MEASUREMENT
/end GROUP
/begin GROUP S1212_Determine_LowVoltageLimitChargeCurrent "VBU0428Test/VBUSystem/BMS/SOF/Subsystem6/Subsystem/Determine_Currentlimit_Target/Calculate_CurrentLimit_Target/Calculate_CurrentLimit_Base/Determine_LowVoltageLimitChargeCurrent" /begin SUB_GROUP S1223_RS_FlipFlop_EEPROM /end SUB_GROUP
 /begin REF_CHARACTERISTIC CcSOF_LowVoltageAbnormalPowerOnDelay_ms CcSOF_LowVoltageResetSOC_pct CcSOF_LowVoltageSetCurrentDelay_ms CcSOF_LowVoltageSetCurrent_A CcSOF_LowVoltageSetSOC_pct CcSOF_LowVoltageSetTime_s CcSOF_LowVoltageSetVolt2Delta_mV CcSOF_LowVoltageSetVolt2_mV CcSOF_LowVoltageSetVolt_mV CcSOF_LowVoltageSetVoltageDelay_ms /end REF_CHARACTERISTIC
 /begin REF_MEASUREMENT EcSOF_LowVoltageStartTime_s SOF_flgLowVoltageState /end REF_MEASUREMENT
/end GROUP
/begin GROUP S1213_Calculate_Dynamic_ChargeCurrentLimit "VBU0428Test/VBUSystem/BMS/SOF/Subsystem6/Subsystem/Determine_Currentlimit_Target/Calculate_CurrentLimit_Target/Calculate_Dynamic_CurrentLimit/Calculate_Dynamic_ChargeCurrentLimit"
 /begin SUB_GROUP S1262_Calculate_ChargeCurrentLimit_Buff S1262_Calculate_Dynamic_ChargeCurrentLimit /end SUB_GROUP
/end GROUP
/begin GROUP S1213_Calculate_Dynamic_DischargeCurrentLimit "VBU0428Test/VBUSystem/BMS/SOF/Subsystem6/Subsystem/Determine_Currentlimit_Target/Calculate_CurrentLimit_Target/Calculate_Dynamic_CurrentLimit/Calculate_Dynamic_DischargeCurrentLimit"
 /begin SUB_GROUP S1263_Calculate_DischargeCurrentLimit_Buff S1263_Calculate_Dynamic_DischargeCurrentLimit /end SUB_GROUP
/end GROUP
/begin GROUP S1214_FastChrgOneThirdRateCurrentLimitCheck "VBU0428Test/VBUSystem/BMS/SOF/Subsystem6/Subsystem/Determine_Currentlimit_Target/Calculate_CurrentLimit_Target/CurrentLimit_FastCharge_Check/FastChrgOneThirdRateCurrentLimitCheck" /begin SUB_GROUP S1283_FCC_CHARGE_MODE1 S1283_Rate_Limiter_Reset /end SUB_GROUP
 /begin REF_CHARACTERISTIC CaSOF_ContinuousChargeSocTempMapZ_A CaSOF_FastChargeCurrentDropBOLCellVoltageDimension_n CaSOF_FastChargeCurrentDropBOLCellVoltageMapZ_mV CaSOF_FastChargeCurrentDropEOLCellVoltageDimension_n CaSOF_FastChargeCurrentDropEOLCellVoltageMapZ_mV CcSOF_FastChargeCellVoltageSOCLimit_pct CcSOF_FastChargeSOCLimit_pct CcSOF_FccOneThirdCurtSloDelay_ms CcSOF_FccOneThirdRateCurtSlope_A /end REF_CHARACTERISTIC
 /begin REF_MEASUREMENT SOF_flgFastChrgOneThirdRateCurrentLimit SOF_mvFastChargeCurrentDropCellVoltage /end REF_MEASUREMENT
/end GROUP
/begin GROUP S1214_SegmentChargeCheck "VBU0428Test/VBUSystem/BMS/SOF/Subsystem6/Subsystem/Determine_Currentlimit_Target/Calculate_CurrentLimit_Target/CurrentLimit_FastCharge_Check/SegmentChargeCheck" /begin SUB_GROUP S1284_FCC_CHARGE_MODE1 S1284_FastCharge /end SUB_GROUP
 /begin REF_MEASUREMENT SOF_iAContinuousChargeCurrentLimitFastChrgChkRaw SOF_iAContinuousDischargeCurrentLimitFastChrgChk SOF_iAShortPulseChargeCurrentLimitFastChrgChk SOF_iAShortPulseDischargeCurrentLimitFastChrgChk /end REF_MEASUREMENT
/end GROUP
/begin GROUP S1215_CAT4 "VBU0428Test/VBUSystem/BMS/SOF/Subsystem6/Subsystem/Determine_Currentlimit_Target/Calculate_CurrentLimit_Target/CurrentLimit_Fault_Correct/CAT4"
 /begin REF_CHARACTERISTIC CcSOF_ContinuousChargeCurrentLimp_A CcSOF_ContinuousDischargeCurrentLimp_A CcSOF_DynamicChargeCurrentLimp_A CcSOF_DynamicDischargeCurrentLimp_A CcSOF_ShortPulseChargeCurrentLimp_A CcSOF_ShortPulseDischargeCurrentLimp_A /end REF_CHARACTERISTIC
/end GROUP
/begin GROUP S1215_Determine_StopCharge_Condition "VBU0428Test/VBUSystem/BMS/SOF/Subsystem6/Subsystem/Determine_Currentlimit_Target/Calculate_CurrentLimit_Target/CurrentLimit_Fault_Correct/Determine_StopCharge_Condition"
 /begin REF_CHARACTERISTIC CcSOF_StopChargeBattVolt_V CcSOF_StopChargeDeltaBattVolt_V CcSOF_StopChargeDeltaSOC_pct CcSOF_StopChargeSOCDebounceTime_s CcSOF_StopChargeSOC_pct CcSOF_StopChargeVoltDebounceTime_s /end REF_CHARACTERISTIC
/end GROUP
/begin GROUP S1216_Correct_CurrentLimit "VBU0428Test/VBUSystem/BMS/SOF/Subsystem6/Subsystem/Determine_Currentlimit_Target/Calculate_CurrentLimit_Target/CurrentLimit_Voltage_Correct/Correct_CurrentLimit"
 /begin SUB_GROUP S1319_Calculate_CurrentLimit S1319_Determine_VoltageCorrect_level /end SUB_GROUP
/end GROUP
/begin GROUP S1409_Caculate_WeightingLifeTimeCharge "VBU0428Test/VBUSystem/BMS/SOH/Subsystem4/Subsystem1/Calculate_Capacity/Calculate_CellCapacity/Caculate_CellCapacity_LifeTimeQ/Caculate_WeightingLifeTimeCharge" /begin REF_CHARACTERISTIC CcSOH_FastChargeWeighting_pct /end REF_CHARACTERISTIC /end GROUP
/begin GROUP S1410_LimittedByNVMvalue "VBU0428Test/VBUSystem/BMS/SOH/Subsystem4/Subsystem1/Calculate_Capacity/Calculate_CellCapacity/CellCapacity_Limit/LimittedByNVMvalue"
 /begin REF_CHARACTERISTIC CaSOH_DecreaseCapacityMapDimension_n CaSOH_DecreaseCapacityMapY_pct /end REF_CHARACTERISTIC
/end GROUP
/begin GROUP S1411_MMASVC1 "VBU0428Test/VBUSystem/BMS/SOH/Subsystem4/Subsystem1/Calculate_Capacity/Calculate_CellCapacity/Determine_CellCapacity/MMASVC1" /begin SUB_GROUP S1425_Update_Max_Min /end SUB_GROUP /end GROUP
/begin GROUP S1443_Determine_AhIntegral_Q "VBU0428Test/VBUSystem/BMS/SOH/Subsystem4/Subsystem1/Calculate_Capacity/Calculate_CellCapacity_SlowCharge/Determine_AhIntegral_DeltaQ/Determine_AhIntegral_Q" /begin SUB_GROUP S1449_Determine_Cell_Balanced_Capacity /end SUB_GROUP
 /begin REF_CHARACTERISTIC CcSOH_MaxBalancedCapacity_As CcSOH_MaxCurrentIntegral_As CcSOH_MinBalancedCapacity_As CcSOH_MinCurrentIntegral_As /end REF_CHARACTERISTIC
/end GROUP
/begin GROUP S1443_Determine_Module_Current "VBU0428Test/VBUSystem/BMS/SOH/Subsystem4/Subsystem1/Calculate_Capacity/Calculate_CellCapacity_SlowCharge/Determine_AhIntegral_DeltaQ/Determine_Module_Current" /begin SUB_GROUP S1450_CONTACTOR_STATUS_OPENED1 /end SUB_GROUP /end GROUP
/begin GROUP S1445_Determine_Module_Current "VBU0428Test/VBUSystem/BMS/SOH/Subsystem4/Subsystem1/Calculate_Capacity/Calculate_CellCapacity_SlowCharge/Determine_Soc/Determine_Module_Current" /begin SUB_GROUP S1454_CONTACTOR_STATUS_OPENED1 /end SUB_GROUP /end GROUP
/begin GROUP S1445_Lookup_Table_Cal_Soc "VBU0428Test/VBUSystem/BMS/SOH/Subsystem4/Subsystem1/Calculate_Capacity/Calculate_CellCapacity_SlowCharge/Determine_Soc/Lookup_Table_Cal_Soc" /begin SUB_GROUP S1455_Cal_Resistance S1455_Cal_Soc /end SUB_GROUP /end GROUP
/begin GROUP S1482_DuringStep_AfterStep_Check "VBU0428Test/VBUSystem/BMS/SOH/Subsystem4/Subsystem1/Calculate_Resistance/BasicCellResistance_Calculation_Check/BeforStep_DuringStep_AfterStep_Check/DuringStep_AfterStep_Check" /begin REF_CHARACTERISTIC CcSOH_AfterEdgeFallTime_ms CcSOH_BeforeEdgeFallTime_ms /end REF_CHARACTERISTIC /end GROUP
/begin GROUP S1498_Determine_FCCPulseCurrent_Condition "VBU0428Test/VBUSystem/BMS/SOH/Subsystem4/Subsystem1/Calculate_Resistance/Determine_Condition_Calculate_Pulse_Average_CurrentVoltage/Determine_Condition/Determine_FCCPulseCurrent_Condition" /begin REF_CHARACTERISTIC CcSOH_PulseCurrentThreshold_pct /end REF_CHARACTERISTIC /end GROUP
/begin GROUP S1498_Determine_OBCPulseCurrent_Condition "VBU0428Test/VBUSystem/BMS/SOH/Subsystem4/Subsystem1/Calculate_Resistance/Determine_Condition_Calculate_Pulse_Average_CurrentVoltage/Determine_Condition/Determine_OBCPulseCurrent_Condition" /begin REF_CHARACTERISTIC CcSOH_PulseCurrentThreshold_pct /end REF_CHARACTERISTIC /end GROUP
/begin GROUP S1540_Determinate_InletTempValidationDelay "VBU0428Test/VBUSystem/BMS/THM/Subsystem/Subsystem/Calculate_PipeTemperature/Determine_CoolantSensorTemp_Validation/Determine_InletTemp_Validation/Determinate_InletTempValidationDelay" /begin REF_CHARACTERISTIC CcTHM_CoolantSensorValidDelayTime_s /end REF_CHARACTERISTIC /end GROUP
/begin GROUP S1541_Determinate_OutletTempValidationDelay "VBU0428Test/VBUSystem/BMS/THM/Subsystem/Subsystem/Calculate_PipeTemperature/Determine_CoolantSensorTemp_Validation/Determine_OutletTemp_Validation/Determinate_OutletTempValidationDelay" /begin REF_CHARACTERISTIC CcTHM_CoolantSensorValidDelayTime_s /end REF_CHARACTERISTIC /end GROUP
/begin GROUP S3233_Turn_Off_Delay_Time "VBU0428Test/VBUSystem/VCU /DCH/DCH_Overall/DCH_DCChargeCtrlOverall/DCH_DCChargeCtrlStateflow/DCH_InputSignalPreProcess/DCH_BMSChAvlDebounce/Turn_Off_Delay_Time" /begin REF_MEASUREMENT DCH_flgBmsChAvl /end REF_MEASUREMENT /end GROUP
/begin GROUP S3234_Turn_Off_Delay_Time2 "VBU0428Test/VBUSystem/VCU /DCH/DCH_Overall/DCH_DCChargeCtrlOverall/DCH_DCChargeCtrlStateflow/DCH_InputSignalPreProcess/DCH_DCRelayCloseDiagnose/Turn_Off_Delay_Time2" /begin REF_MEASUREMENT DCH_flgDCChRlyCloseSt /end REF_MEASUREMENT /end GROUP
/begin GROUP S3235_Turn_Off_Delay_Time2 "VBU0428Test/VBUSystem/VCU /DCH/DCH_Overall/DCH_DCChargeCtrlOverall/DCH_DCChargeCtrlStateflow/DCH_InputSignalPreProcess/DCH_VehStateAnalyze/Turn_Off_Delay_Time2" /begin REF_MEASUREMENT DCH_flgAPlusWkup /end REF_MEASUREMENT /end GROUP
/begin GROUP S3343_DSPL_EnergyFactorInit "VBU0428Test/VBUSystem/VCU /DSPL /DSPL/DriveRange/DSPL_Consumption/DSPL_EnergySelfLearn/DSPL_EnergyFactorCal/DSPL_EnergyFactorInit" /begin SUB_GROUP S3350_SwitchParameter /end SUB_GROUP
 /begin REF_CHARACTERISTIC DSPL_facEnergyFactorInitHigh_C DSPL_facEnergyFactorInitLow_C DSPL_facEnergyFactorInitMid_C DSPL_facEnergyFactorInit_C DSPL_facEnergyFactorTypeInit_C DSPL_kmEnergyFactorOdoLow_C DSPL_kmEnergyFactorOdoMid_C DSPL_kmEnergyFactorOdoZero_C /end REF_CHARACTERISTIC
/end GROUP
/begin GROUP S3343_DSPL_EnergyFactorUpdate "VBU0428Test/VBUSystem/VCU /DSPL /DSPL/DriveRange/DSPL_Consumption/DSPL_EnergySelfLearn/DSPL_EnergyFactorCal/DSPL_EnergyFactorUpdate"
 /begin REF_CHARACTERISTIC DSPL_facEnergyFactorSOCUpdate_CUR_v DSPL_facEnergyFactorSelfLearnInit_C DSPL_facEnergyFactorUpdateStep_C DSPL_flgEnergyFactorSelfLearnEn_C DSPL_pctBMSSOCUpdateStep_C DSPL_pctEnergySOCLearnMax_C /end REF_CHARACTERISTIC
/end GROUP
/begin GROUP S3418_SwitchParameter "VBU0428Test/VBUSystem/VCU /DSPL /DSPL/DriveRange/RemainingRange/FullRangeAndSocDeclineFactor/FullRangeCalculation/SwitchParameter"
 /begin REF_CHARACTERISTIC DSPL_kmFullSocRateRng_C_Md_Default DSPL_kmFullSocRateRng_C_Md_Type1 DSPL_kmFullSocRateRng_C_Md_Type2 DSPL_kmFullSocRateRng_C_Md_Type3 DSPL_kmFullSocRateRng_C_Md_Type4 /end REF_CHARACTERISTIC
/end GROUP
/begin GROUP S3420_SwitchParameter "VBU0428Test/VBUSystem/VCU /DSPL /DSPL/DriveRange/RemainingRange/FullRangeAndSocDeclineFactor/SOCDeclineFactorCalculation/SwitchParameter"
 /begin REF_CHARACTERISTIC DSPL_facInitRateSOCFactor_C_Md_Default DSPL_facInitRateSOCFactor_C_Md_Type1 DSPL_facInitRateSOCFactor_C_Md_Type2 DSPL_facInitRateSOCFactor_C_Md_Type3 DSPL_facInitRateSOCFactor_C_Md_Type4 /end REF_CHARACTERISTIC
/end GROUP
/begin GROUP S3420_SwitchParameter1 "VBU0428Test/VBUSystem/VCU /DSPL /DSPL/DriveRange/RemainingRange/FullRangeAndSocDeclineFactor/SOCDeclineFactorCalculation/SwitchParameter1"
 /begin REF_CHARACTERISTIC DSPL_facDecRateVldLo_C_Md_Default DSPL_facDecRateVldLo_C_Md_Type1 DSPL_facDecRateVldLo_C_Md_Type2 DSPL_facDecRateVldLo_C_Md_Type3 DSPL_facDecRateVldLo_C_Md_Type4 /end REF_CHARACTERISTIC
/end GROUP
/begin GROUP S3420_SwitchParameter2 "VBU0428Test/VBUSystem/VCU /DSPL /DSPL/DriveRange/RemainingRange/FullRangeAndSocDeclineFactor/SOCDeclineFactorCalculation/SwitchParameter2"
 /begin REF_CHARACTERISTIC DSPL_facDecRateVldHi_C_Md_Default DSPL_facDecRateVldHi_C_Md_Type1 DSPL_facDecRateVldHi_C_Md_Type2 DSPL_facDecRateVldHi_C_Md_Type3 DSPL_facDecRateVldHi_C_Md_Type4 /end REF_CHARACTERISTIC
/end GROUP
/begin GROUP S3433_SwitchParameter "VBU0428Test/VBUSystem/VCU /DSPL /DSPL/DriveRange/RemainingRange/SelectDisplayRange/storeRange/SwitchParameter"
 /begin REF_CHARACTERISTIC DSPL_kmDrvRngMax_C_Md_Default DSPL_kmDrvRngMax_C_Md_Type1 DSPL_kmDrvRngMax_C_Md_Type2 DSPL_kmDrvRngMax_C_Md_Type3 DSPL_kmDrvRngMax_C_Md_Type4 /end REF_CHARACTERISTIC
/end GROUP
/begin GROUP S3505_GradientLimiter "VBU0428Test/VBUSystem/VCU /EDIS/EDIS_Ctrl/battery_power_calculate/charge_power_calculate/ChPowSetPoint/fid_action/GradientLimiter" /begin REF_MEASUREMENT EDIS_pwrChLimDynRaw /end REF_MEASUREMENT /end GROUP
/begin GROUP S3505_GradientLimiter1 "VBU0428Test/VBUSystem/VCU /EDIS/EDIS_Ctrl/battery_power_calculate/charge_power_calculate/ChPowSetPoint/fid_action/GradientLimiter1" /begin REF_MEASUREMENT EDIS_pwrChLimLTRaw /end REF_MEASUREMENT /end GROUP
/begin GROUP S3520_GradientLimiter "VBU0428Test/VBUSystem/VCU /EDIS/EDIS_Ctrl/battery_power_calculate/discharge_power_calculate/DchPowSetpiont/fid_action/GradientLimiter" /begin REF_MEASUREMENT EDIS_pwrDisChLimDynRaw /end REF_MEASUREMENT /end GROUP
/begin GROUP S3520_GradientLimiter1 "VBU0428Test/VBUSystem/VCU /EDIS/EDIS_Ctrl/battery_power_calculate/discharge_power_calculate/DchPowSetpiont/fid_action/GradientLimiter1" /begin REF_MEASUREMENT EDIS_pwrDisChLimLTRaw /end REF_MEASUREMENT /end GROUP
/begin GROUP S3520_GradientLimiter2 "VBU0428Test/VBUSystem/VCU /EDIS/EDIS_Ctrl/battery_power_calculate/discharge_power_calculate/DchPowSetpiont/fid_action/GradientLimiter2" /begin REF_MEASUREMENT EDIS_pwrDisChLimSTRaw /end REF_MEASUREMENT /end GROUP
/begin GROUP S3521_batt_stpower_overrite "VBU0428Test/VBUSystem/VCU /EDIS/EDIS_Ctrl/battery_power_calculate/discharge_power_calculate/DchPowSetpiont/setpoint/batt_stpower_overrite" /begin SUB_GROUP S3531_GradientLimiter S3531_Hysteresis_LHC_RLC1 /end SUB_GROUP
 /begin REF_CHARACTERISTIC EDIS_facDecGradSprt_C EDIS_flgDisChDynMore_C EDIS_flgDisChDynOverride_C EDIS_numCurrentOverDisChDyn_C EDIS_numDisChDyn_C EDIS_pctAccPedlDchaLo_C EDIS_pctAccPedlDchaUp_C EDIS_pctSocDchaLo_C EDIS_pctSocDchaUp_C EDIS_pwrBmsDynLTDeltaHi_C EDIS_pwrBmsDynLTDeltaLo_C EDIS_pwrDecGradSprt_MAP_v EDIS_pwrDisChDynMore_C EDIS_pwrDisChaFilterHi_C EDIS_pwrDisChaFilterLo_C EDIS_stCurrentGearD_C EDIS_tBmsMaxTempHi_C EDIS_tBmsMaxTempLo_C EDIS_tBmsMinTempHi_C EDIS_tBmsMinTempLo_C EDIS_tiOverDisCha_C EDIS_vVehSpdDchaLo_C EDIS_vVehSpdDchaUp_C SYS_stHMIDrvModeSport_SY /end REF_CHARACTERISTIC
 /begin REF_MEASUREMENT EDIS_flgPowDisChToSTLim EDIS_pwrDisChLimDynOvrride /end REF_MEASUREMENT
/end GROUP
/begin GROUP S3521_discharge_setpoint "VBU0428Test/VBUSystem/VCU /EDIS/EDIS_Ctrl/battery_power_calculate/discharge_power_calculate/DchPowSetpiont/setpoint/discharge_setpoint"
 /begin REF_CHARACTERISTIC EDIS_facBMSSOCDisCh_CUR_v EDIS_facDisChPwrDeltaBaseDiff_CUR_v EDIS_facMaxBMSDisCh_CUR_v EDIS_facMinBMSDisCh_CUR_v EDIS_numDisChOverLim_C EDIS_numDisChPwrOverCntEEPROMInit_SY EDIS_pwrDisChOverLim_C EDIS_pwrDisChRed40vLim_C EDIS_pwrSpBaseDchDyn_CUR_v /end REF_CHARACTERISTIC
 /begin REF_MEASUREMENT EDIS_facDchDynSp EDIS_pwrDisChSp /end REF_MEASUREMENT
/end GROUP
/begin GROUP S3522_BattDisChaCold "VBU0428Test/VBUSystem/VCU /EDIS/EDIS_Ctrl/battery_power_calculate/discharge_power_calculate/DchPowSetpiont/temperature_correction/BattDisChaCold" /begin REF_MEASUREMENT EDIS_pwrDisChaDynCold /end REF_MEASUREMENT /end GROUP
/begin GROUP S3522_BattDisChaHot "VBU0428Test/VBUSystem/VCU /EDIS/EDIS_Ctrl/battery_power_calculate/discharge_power_calculate/DchPowSetpiont/temperature_correction/BattDisChaHot" /begin REF_MEASUREMENT EDIS_pwrDisChaDynHot /end REF_MEASUREMENT /end GROUP
/begin GROUP S3522_MinSel "VBU0428Test/VBUSystem/VCU /EDIS/EDIS_Ctrl/battery_power_calculate/discharge_power_calculate/DchPowSetpiont/temperature_correction/MinSel" /begin REF_MEASUREMENT EDIS_pwrDisChaDynTempCorr /end REF_MEASUREMENT /end GROUP
/begin GROUP S3883_ConditionRAArb "VBU0428Test/VBUSystem/VCU /TQO/TQOAll/Subsystem/TQDMP/RAROTC/ROTCConidtion/ConditionRAArb" /begin REF_CHARACTERISTIC TQDMP_flgROTCEnRA_C TQDMP_tiTrqZeroDly_C /end REF_CHARACTERISTIC /begin REF_MEASUREMENT TQDMP_flgROTCActRA /end REF_MEASUREMENT /end GROUP
/begin GROUP S3883_SpeedHoldEnableRA "VBU0428Test/VBUSystem/VCU /TQO/TQOAll/Subsystem/TQDMP/RAROTC/ROTCConidtion/SpeedHoldEnableRA"
 /begin REF_CHARACTERISTIC TQDMP_flgSpdHldOn_C TQDMP_nSpdHldMax2FA_C TQDMP_nSpdHldMaxFA_C TQDMP_nSpdHldMin2FA_C TQDMP_nSpdHldMinFA_C /end REF_CHARACTERISTIC
 /begin REF_MEASUREMENT TQDMP_flgSpdHldR /end REF_MEASUREMENT
/end GROUP
/begin GROUP S3883_TipInRA "VBU0428Test/VBUSystem/VCU /TQO/TQOAll/Subsystem/TQDMP/RAROTC/ROTCConidtion/TipInRA"
 /begin REF_CHARACTERISTIC TQDMP_pctTipInAccPedChgThd_C TQDMP_pctTipInAccPedTrgThd_C TQDMP_tiTipInDly_C /end REF_CHARACTERISTIC
/end GROUP
/begin GROUP S3883_TipOutRA "VBU0428Test/VBUSystem/VCU /TQO/TQOAll/Subsystem/TQDMP/RAROTC/ROTCConidtion/TipOutRA"
 /begin REF_CHARACTERISTIC TQDMP_pctTipOutAccPedChgThd_C TQDMP_pctTipOutAccPedTrgThd_C TQDMP_tiTipOutDly_C /end REF_CHARACTERISTIC
/end GROUP
/begin GROUP S3883_TipinEnaRA "VBU0428Test/VBUSystem/VCU /TQO/TQOAll/Subsystem/TQDMP/RAROTC/ROTCConidtion/TipinEnaRA" /begin SUB_GROUP S3895_SR_Flip_Flop /end SUB_GROUP
 /begin REF_CHARACTERISTIC TQDMP_flgTipInEnaRvs_C TQDMP_pctTipInAccPedEnThdHi_C TQDMP_pctTipInAccPedEnThdLo_C TQDMP_tiTipInAct_C /end REF_CHARACTERISTIC
/end GROUP
/begin GROUP S3883_TipoutEnaRA "VBU0428Test/VBUSystem/VCU /TQO/TQOAll/Subsystem/TQDMP/RAROTC/ROTCConidtion/TipoutEnaRA" /begin SUB_GROUP S3896_SR_Flip_Flop /end SUB_GROUP
 /begin REF_CHARACTERISTIC TQDMP_flgTipOutEnaRvs_C TQDMP_pctTipOutAccPedEnThdHi_C TQDMP_pctTipOutAccPedEnThdLo_C TQDMP_tiTipOutAct_C /end REF_CHARACTERISTIC
/end GROUP
/begin GROUP S3883_VrtlRA "VBU0428Test/VBUSystem/VCU /TQO/TQOAll/Subsystem/TQDMP/RAROTC/ROTCConidtion/VrtlRA" /begin REF_CHARACTERISTIC TQDMP_trqAxleMaxRA_C /end REF_CHARACTERISTIC /begin REF_MEASUREMENT TQDMP_pctAccPdlVrtlRA /end REF_MEASUREMENT /end GROUP
/begin GROUP S3884_CompensationPhase "VBU0428Test/VBUSystem/VCU /TQO/TQOAll/Subsystem/TQDMP/RAROTC/TorqueCal/CompensationPhase"
 /begin REF_CHARACTERISTIC TQDMP_facPhsCmpDenRA_C TQDMP_facPhsCmpK1RA_C TQDMP_facPhsCmpNumRA_C /end REF_CHARACTERISTIC
 /begin REF_MEASUREMENT TQDMP_trqDeltaLPFR TQDMP_trqDeltaR /end REF_MEASUREMENT
/end GROUP
/begin GROUP S3884_DeltaTrqArb "VBU0428Test/VBUSystem/VCU /TQO/TQOAll/Subsystem/TQDMP/RAROTC/TorqueCal/DeltaTrqArb" /begin REF_MEASUREMENT TQDMP_trqBumpRA /end REF_MEASUREMENT /end GROUP
/begin GROUP S3884_TorqueLim "VBU0428Test/VBUSystem/VCU /TQO/TQOAll/Subsystem/TQDMP/RAROTC/TorqueCal/TorqueLim"
 /begin REF_CHARACTERISTIC TQDMP_facDeltaRPMFAC1_CUR_v TQDMP_facPhaseSclRA_C TQDMP_trqDeadZoneMaxRA_C TQDMP_trqDeadZoneMinRA_C TQDMP_trqMaxRA_C TQDMP_trqMinRA_C /end REF_CHARACTERISTIC
 /begin REF_MEASUREMENT TQDMP_trqROTCRA /end REF_MEASUREMENT
/end GROUP
/begin GROUP S3973_BandStopInit "VBU0428Test/VBUSystem/VCU /TQO/TQOAll/TQDIS/TQDIS/Dmp/DmpFilter/BandStopInit" /begin REF_MEASUREMENT TQDIS_trqDmpRAInit /end REF_MEASUREMENT /end GROUP
/begin GROUP S3986_AccPdlIdl "VBU0428Test/VBUSystem/VCU /TQO/TQOAll/TQDIS/TQDIS/TrqFilter/DrvLim/AccPdlIdl"
 /begin REF_CHARACTERISTIC TQDIS_facShftChngLim_CUR_v TQDIS_pctShftChngFullAcc_C TQDIS_pctShftChngLimThres_CUR_v TQDIS_tiShftChngDly_C TQDIS_trqShftChngLimThres_C /end REF_CHARACTERISTIC
 /begin REF_MEASUREMENT TQDIS_facUnintdAcc /end REF_MEASUREMENT
/end GROUP
/begin GROUP S3986_Creep "VBU0428Test/VBUSystem/VCU /TQO/TQOAll/TQDIS/TQDIS/TrqFilter/DrvLim/Creep"
 /begin REF_CHARACTERISTIC TQDIS_facAccPedFilter_CUR_v TQDIS_facBrkDec_MAP_v TQDIS_facBrkSlpCrp_MAP_v TQDIS_facDrvLo_CUR_y TQDIS_facRgnLo_CUR_y TQDIS_facShftDR_CUR_v TQDIS_trqCreepThd_C TQDIS_trqCrpBase_MAP_v TQDIS_vVehFilterThd_C /end REF_CHARACTERISTIC
 /begin REF_MEASUREMENT TQDIS_facAccPedFilter TQDIS_facBrkDec TQDIS_facBrkSlpCrp TQDIS_facPwrLo TQDIS_flgCrp TQDIS_trqCrpBase TQDIS_trqCrpDecFilter TQDIS_trqCrpIncFilter /end REF_MEASUREMENT
/end GROUP
/begin GROUP S3986_RADrvDec "VBU0428Test/VBUSystem/VCU /TQO/TQOAll/TQDIS/TQDIS/TrqFilter/DrvLim/RADrvDec"
 /begin REF_CHARACTERISTIC SYS_stHMIDrvModeEco_SY TQDIS_trqDecGradECORA_MAP_v TQDIS_trqDecGradRA_MAP_v /end REF_CHARACTERISTIC
 /begin REF_MEASUREMENT TQDIS_facBase2RADrvDecLim TQDIS_trqRADrvDecLim /end REF_MEASUREMENT
/end GROUP
/begin GROUP S3986_RADrvInc "VBU0428Test/VBUSystem/VCU /TQO/TQOAll/TQDIS/TQDIS/TrqFilter/DrvLim/RADrvInc"
 /begin REF_CHARACTERISTIC SYS_stHMIDrvModeEco_SY TQDIS_facAPDTrqECORA_MAP_v TQDIS_facAPDTrqNrmRA_MAP_v TQDIS_facAccPdlECORA_MAP_v TQDIS_facAccPdlNrmRA_MAP_v TQDIS_trqIncGradECORA_MAP_v TQDIS_trqIncGradRA_MAP_v /end REF_CHARACTERISTIC
 /begin REF_MEASUREMENT TQDIS_facIncGain TQDIS_trqBase1RADrvIncLim TQDIS_trqBase2RADrvIncLim TQDIS_trqIncBase TQDIS_trqRADrvIncLim /end REF_MEASUREMENT
/end GROUP
/begin GROUP S4008_GradientLimiter "VBU0428Test/VBUSystem/VCU /TQO/TQOAll/TQO/TQO/MotorTorque/Subsystem/GradientLimiter" /begin REF_MEASUREMENT TQO_facShft /end REF_MEASUREMENT /end GROUP
/begin GROUP S4011_DecGradienLimiter "VBU0428Test/VBUSystem/VCU /TQO/TQOAll/TQO/TQO/Trq/TrqProtect/DecGradienLimiter" /begin REF_MEASUREMENT TQO_trqBrkLim /end REF_MEASUREMENT /end GROUP
/begin GROUP S4114_SetBit2 "VBU0428Test/VBUSystem/VCU /VehINP/VehINP_Logic/GearShift/Gear1/Digital_Gear_D_R/Gear_Bit/SetBit2" /begin REF_MEASUREMENT Gear_stHWSensor /end REF_MEASUREMENT /end GROUP
/begin GROUP S4115_Turn_On_Delay_Time "VBU0428Test/VBUSystem/VCU /VehINP/VehINP_Logic/GearShift/Gear1/Digital_Gear_D_R/Gear_DR_Req/Turn_On_Delay_Time" /begin REF_MEASUREMENT Gear_flgDGearReqRawDigitalAction /end REF_MEASUREMENT /end GROUP
/begin GROUP S4115_Turn_On_Delay_Time1 "VBU0428Test/VBUSystem/VCU /VehINP/VehINP_Logic/GearShift/Gear1/Digital_Gear_D_R/Gear_DR_Req/Turn_On_Delay_Time1" /begin REF_MEASUREMENT Gear_flgRGearReqRawDigitalAction /end REF_MEASUREMENT /end GROUP
/begin GROUP S4115_Turn_On_Delay_Time2 "VBU0428Test/VBUSystem/VCU /VehINP/VehINP_Logic/GearShift/Gear1/Digital_Gear_D_R/Gear_DR_Req/Turn_On_Delay_Time2" /begin REF_MEASUREMENT Gear_flgNGearReqRawDigitalAction /end REF_MEASUREMENT /end GROUP
/begin GROUP S4116_Turn_On_Delay_Time "VBU0428Test/VBUSystem/VCU /VehINP/VehINP_Logic/GearShift/Gear1/Digital_Gear_D_R/Gear_DR_Warning/Turn_On_Delay_Time" /begin REF_MEASUREMENT Gear_flgGearWarningST /end REF_MEASUREMENT /end GROUP
/begin GROUP S4116_Turn_On_Delay_Time1 "VBU0428Test/VBUSystem/VCU /VehINP/VehINP_Logic/GearShift/Gear1/Digital_Gear_D_R/Gear_DR_Warning/Turn_On_Delay_Time1" /begin REF_MEASUREMENT Gear_flgGearWarningLT /end REF_MEASUREMENT /end GROUP
/begin GROUP S4118_SR_Flip_Flop1 "VBU0428Test/VBUSystem/VCU /VehINP/VehINP_Logic/GearShift/Gear1/Digital_Gear_D_R/Gear_Warning/SR_Flip_Flop1" /begin REF_MEASUREMENT Gear_flgDftGearPlausibilityDigital /end REF_MEASUREMENT /end GROUP
/begin GROUP S4162_SR_Flip_Flop2 "VBU0428Test/VBUSystem/VCU /VehINP/VehINP_Logic/GearShift/Gear1/Gear_Status/Gear_GearReq/SR_Flip_Flop2" /begin REF_MEASUREMENT Gear_flgNGearReq /end REF_MEASUREMENT /end GROUP
/begin GROUP S59_Enabled_Subsystem "VBU0428Test/VBUSystem/BMS/BCV/BCV/Subsystem/Calculate_BatteryCurrent/Correct_BatteryCurrent/Calculate_BatteryCurrent_ZeroDrift/Calculate_ExtremeData/Enabled_Subsystem" /begin SUB_GROUP S64_Calculate_Current_Sum /end SUB_GROUP /end GROUP
/begin GROUP S460_Determine_Accumulated_RemainingHeat "VBU0428Test/VBUSystem/BMS/CTD/Subsystem/Subsystem4/PrechrgProcessMonitoring/Precharge_Thermal_Management/Determine_Precharge_JouleHeat/Determine_Accumulated_RemainingHeat/Determine_Accumulated_RemainingHeat" /begin REF_CHARACTERISTIC CcCTD_MaxAccumulatedHeadLoad_J /end REF_CHARACTERISTIC /begin REF_MEASUREMENT CTD_jAccumulatedAvaliableHeat /end REF_MEASUREMENT /end GROUP
/begin GROUP S1055_Delay_RisingEdge "VBU0428Test/VBUSystem/BMS/SOC/Subsystem5/Subsystem/Determine_FastChargeCorrection_Soc/FastCharge_DynamicCorrection/FastCharge_DynamicCorrection_Enable/Determine_CurrentStable_Condition/Delay_RisingEdge" /begin REF_MEASUREMENT LbSOC_FastChargeCurrentStable_flg /end REF_MEASUREMENT /end GROUP
/begin GROUP S1217_Calculate_SOH_Current_Limit "VBU0428Test/VBUSystem/BMS/SOF/Subsystem6/Subsystem/Determine_Currentlimit_Target/Calculate_CurrentLimit_Target/Calculate_CurrentLimit_Base/Calculate_ContinuousChargeCurrent/Calculate_SOH_Current_Limit" /begin REF_CHARACTERISTIC CcSOF_BolSoh_pct CcSOF_EolSoh_pct /end REF_CHARACTERISTIC /begin REF_MEASUREMENT SOF_pctCurrentSOH /end REF_MEASUREMENT /end GROUP
/begin GROUP S1218_Calculate_SOH_Current_Limit "VBU0428Test/VBUSystem/BMS/SOF/Subsystem6/Subsystem/Determine_Currentlimit_Target/Calculate_CurrentLimit_Target/Calculate_CurrentLimit_Base/Calculate_ContinuousDischargeCurrent/Calculate_SOH_Current_Limit" /begin REF_CHARACTERISTIC CcSOF_BolSoh_pct CcSOF_EolSoh_pct /end REF_CHARACTERISTIC /end GROUP
/begin GROUP S1219_Calculate_SOH_Current_Limit "VBU0428Test/VBUSystem/BMS/SOF/Subsystem6/Subsystem/Determine_Currentlimit_Target/Calculate_CurrentLimit_Target/Calculate_CurrentLimit_Base/Calculate_ShortPulseChargeCurrent/Calculate_SOH_Current_Limit" /begin REF_CHARACTERISTIC CcSOF_BolSoh_pct CcSOF_EolSoh_pct /end REF_CHARACTERISTIC /end GROUP
/begin GROUP S1220_Calculate_SOH_Current_Limit "VBU0428Test/VBUSystem/BMS/SOF/Subsystem6/Subsystem/Determine_Currentlimit_Target/Calculate_CurrentLimit_Target/Calculate_CurrentLimit_Base/Calculate_ShortPulseDischargeCurrent/Calculate_SOH_Current_Limit" /begin REF_CHARACTERISTIC CcSOF_BolSoh_pct CcSOF_EolSoh_pct /end REF_CHARACTERISTIC /end GROUP
/begin GROUP S1223_RS_FlipFlop_EEPROM "VBU0428Test/VBUSystem/BMS/SOF/Subsystem6/Subsystem/Determine_Currentlimit_Target/Calculate_CurrentLimit_Target/Calculate_CurrentLimit_Base/Determine_LowVoltageLimitChargeCurrent/RS_FlipFlop_EEPROM" /begin REF_MEASUREMENT EcSOF_LowVoltageState_flg /end REF_MEASUREMENT /end GROUP
/begin GROUP S1262_Calculate_ChargeCurrentLimit_Buff "VBU0428Test/VBUSystem/BMS/SOF/Subsystem6/Subsystem/Determine_Currentlimit_Target/Calculate_CurrentLimit_Target/Calculate_Dynamic_CurrentLimit/Calculate_Dynamic_ChargeCurrentLimit/Calculate_ChargeCurrentLimit_Buff"
 /begin SUB_GROUP S1264_Calculate_ChargeCurrentLimitBuffer_Full S1264_Calculate_ChargeCurrentLimitBuffer_Use /end SUB_GROUP
/end GROUP
/begin GROUP S1262_Calculate_Dynamic_ChargeCurrentLimit "VBU0428Test/VBUSystem/BMS/SOF/Subsystem6/Subsystem/Determine_Currentlimit_Target/Calculate_CurrentLimit_Target/Calculate_Dynamic_CurrentLimit/Calculate_Dynamic_ChargeCurrentLimit/Calculate_Dynamic_ChargeCurrentLimit" /begin SUB_GROUP S1265_Buffer_Used /end SUB_GROUP /begin REF_MEASUREMENT SOF_iACalDynamicChgCurLimitFCCChk /end REF_MEASUREMENT /end GROUP
/begin GROUP S1263_Calculate_DischargeCurrentLimit_Buff "VBU0428Test/VBUSystem/BMS/SOF/Subsystem6/Subsystem/Determine_Currentlimit_Target/Calculate_CurrentLimit_Target/Calculate_Dynamic_CurrentLimit/Calculate_Dynamic_DischargeCurrentLimit/Calculate_DischargeCurrentLimit_Buff"
 /begin SUB_GROUP S1272_Calculate_DischargeCurrentLimitBuffer_Full S1272_Calculate_DischargeCurrentLimitBuffer_Use /end SUB_GROUP
/end GROUP
/begin GROUP S1263_Calculate_Dynamic_DischargeCurrentLimit "VBU0428Test/VBUSystem/BMS/SOF/Subsystem6/Subsystem/Determine_Currentlimit_Target/Calculate_CurrentLimit_Target/Calculate_Dynamic_CurrentLimit/Calculate_Dynamic_DischargeCurrentLimit/Calculate_Dynamic_DischargeCurrentLimit" /begin SUB_GROUP S1273_Rate_Limiter /end SUB_GROUP
 /begin REF_CHARACTERISTIC CcSOF_DischargeOverCurrentLimitFactor_n CcSOF_DischargeOverCurrentThresholdDec_As CcSOF_DischargeOverCurrentThresholdInc_As CcSOF_PowerOnOverCurFacSloDelay_ms /end REF_CHARACTERISTIC
 /begin REF_MEASUREMENT SOF_iADynamicDischargeCurrentLimitFastChrgChk /end REF_MEASUREMENT
/end GROUP
/begin GROUP S1283_Rate_Limiter_Reset "VBU0428Test/VBUSystem/BMS/SOF/Subsystem6/Subsystem/Determine_Currentlimit_Target/Calculate_CurrentLimit_Target/CurrentLimit_FastCharge_Check/FastChrgOneThirdRateCurrentLimitCheck/Rate_Limiter_Reset" /begin REF_MEASUREMENT SOF_iAContinuousChargeCurrentLimitFastChrgChk /end REF_MEASUREMENT /end GROUP
/begin GROUP S1284_FastCharge "VBU0428Test/VBUSystem/BMS/SOF/Subsystem6/Subsystem/Determine_Currentlimit_Target/Calculate_CurrentLimit_Target/CurrentLimit_FastCharge_Check/SegmentChargeCheck/FastCharge" /begin SUB_GROUP S1292_FastCharge_Calculation /end SUB_GROUP /end GROUP
/begin GROUP S1319_Calculate_CurrentLimit "VBU0428Test/VBUSystem/BMS/SOF/Subsystem6/Subsystem/Determine_Currentlimit_Target/Calculate_CurrentLimit_Target/CurrentLimit_Voltage_Correct/Correct_CurrentLimit/Calculate_CurrentLimit"
 /begin SUB_GROUP S1321_BatteryVoltageAveCalculate S1321_Calculate_Cell_Discharge_DCIR S1321_Rate_Limiter1 S1321_Rate_Limiter_Reset /end SUB_GROUP
 /begin REF_CHARACTERISTIC CaSOF_DischargeDcirSocTempMapDimension_n CaSOF_DischargeDcirSocTempMapZ_mOhm CaSOF_DischargeOcvSocTempMapDimension_n CaSOF_DischargeOcvSocTempMapZ_V CaSOF_LowTempDischargeVoltageCorrectFactorMapY_n CaSOF_VoltageCorrectCellVoltMinMapY_V CaSOF_VoltageCorrectFactorChargeMapY_n CaSOF_VoltageCorrectFactorDischargeMapY_n CaSOF_VoltageCorrectFactorRegenMapY_n CbSOF_VoltageCorrectLevelEnable_flg CbSOF_VoltageTableCorrectUsePredictedCellVoltage_flg CcSOF_ChargeVoltageCorrectSlope_n CcSOF_DischargeVolCorCurrentSlopeDec_A CcSOF_DischargeVolCorCurrentSlopeInc_A CcSOF_DischargeVoltageCorrectSlope_n CcSOF_EnableCalculatedDcir_flg CcSOF_PowerOnVolCorCurtSloDelay_ms CcSOF_PowerOnVolCorFacSloDelay_ms CcSOF_UseCalculatedDcirTemp_C CcSOF_VoltageCorrectFactor0_n CcSOF_VoltageCorrectFactor1_n CcSOF_VoltageCorrectFactor2_n CcSOF_VoltageCorrectFactor3_n CcSOF_VoltageCorrectFactor4_n /end REF_CHARACTERISTIC
 /begin REF_MEASUREMENT SOF_iAContinuousChargeCurrentLimitVltgTarget SOF_iAContinuousDischargeCurrentLimitVltgTarget SOF_iADynamicChargeCurrentLimitVltgTarget SOF_iADynamicDischargeCurrentLimitVltgBefoTarget SOF_iADynamicDischargeCurrentLimitVltgTarget SOF_iAShortPulseChargeCurrentLimitVltgTarget SOF_iAShortPulseDischargeCurrentLimitVltgTarget /end REF_MEASUREMENT
/end GROUP
/begin GROUP S1319_Determine_VoltageCorrect_level "VBU0428Test/VBUSystem/BMS/SOF/Subsystem6/Subsystem/Determine_Currentlimit_Target/Calculate_CurrentLimit_Target/CurrentLimit_Voltage_Correct/Correct_CurrentLimit/Determine_VoltageCorrect_level"
 /begin SUB_GROUP S1322_Set_ChargeVoltageCorrect_level1 S1322_Set_ChargeVoltageCorrect_level2 S1322_Set_ChargeVoltageCorrect_level3 S1322_Set_ChargeVoltageCorrect_level4 S1322_Set_DischargeVoltageCorrect_level1 S1322_Set_DischargeVoltageCorrect_level2 S1322_Set_DischargeVoltageCorrect_level3 S1322_Set_DischargeVoltageCorrect_level4 /end SUB_GROUP
 /begin REF_MEASUREMENT SOF_nbrChargeVoltageCorrectLevel SOF_nbrDischargeVoltageCorrectLevel /end REF_MEASUREMENT
/end GROUP
/begin GROUP S1425_Update_Max_Min "VBU0428Test/VBUSystem/BMS/SOH/Subsystem4/Subsystem1/Calculate_Capacity/Calculate_CellCapacity/Determine_CellCapacity/MMASVC1/Update_Max_Min"
 /begin REF_MEASUREMENT SOH_AhCellCapacityAve SOH_AhCellCapacityMax SOH_AhCellCapacityMin /end REF_MEASUREMENT
/end GROUP
/begin GROUP S1455_Cal_Resistance "VBU0428Test/VBUSystem/BMS/SOH/Subsystem4/Subsystem1/Calculate_Capacity/Calculate_CellCapacity_SlowCharge/Determine_Soc/Lookup_Table_Cal_Soc/Cal_Resistance"
 /begin REF_CHARACTERISTIC CaSOH_UdResisMapDimension_n CaSOH_UdResisMapZ_mohm CcSOH_ChargeResisLowerLimit_mohm /end REF_CHARACTERISTIC
/end GROUP
/begin GROUP S1455_Cal_Soc "VBU0428Test/VBUSystem/BMS/SOH/Subsystem4/Subsystem1/Calculate_Capacity/Calculate_CellCapacity_SlowCharge/Determine_Soc/Lookup_Table_Cal_Soc/Cal_Soc" /begin REF_CHARACTERISTIC CaSOH_OcvSocMapDimension_n CaSOH_OcvSocMapZ_pct /end REF_CHARACTERISTIC /end GROUP
/begin GROUP S3350_SwitchParameter "VBU0428Test/VBUSystem/VCU /DSPL /DSPL/DriveRange/DSPL_Consumption/DSPL_EnergySelfLearn/DSPL_EnergyFactorCal/DSPL_EnergyFactorInit/SwitchParameter"
 /begin REF_CHARACTERISTIC DSPL_facEnergyFactorType_C_Md_Default DSPL_facEnergyFactorType_C_Md_Type1 DSPL_facEnergyFactorType_C_Md_Type2 DSPL_facEnergyFactorType_C_Md_Type3 DSPL_facEnergyFactorType_C_Md_Type4 /end REF_CHARACTERISTIC
/end GROUP
/begin GROUP S3531_GradientLimiter "VBU0428Test/VBUSystem/VCU /EDIS/EDIS_Ctrl/battery_power_calculate/discharge_power_calculate/DchPowSetpiont/setpoint/batt_stpower_overrite/GradientLimiter" /begin REF_MEASUREMENT EDIS_pwrDisChLimDynST /end REF_MEASUREMENT /end GROUP
/begin GROUP S3531_Hysteresis_LHC_RLC1 "VBU0428Test/VBUSystem/VCU /EDIS/EDIS_Ctrl/battery_power_calculate/discharge_power_calculate/DchPowSetpiont/setpoint/batt_stpower_overrite/Hysteresis_LHC_RLC1" /begin REF_MEASUREMENT EDIS_flgVehSpdLow /end REF_MEASUREMENT /end GROUP
/begin GROUP S3895_SR_Flip_Flop "VBU0428Test/VBUSystem/VCU /TQO/TQOAll/Subsystem/TQDMP/RAROTC/ROTCConidtion/TipinEnaRA/SR_Flip_Flop" /begin REF_MEASUREMENT TQDMP_flgTipInEnaRA /end REF_MEASUREMENT /end GROUP
/begin GROUP S3896_SR_Flip_Flop "VBU0428Test/VBUSystem/VCU /TQO/TQOAll/Subsystem/TQDMP/RAROTC/ROTCConidtion/TipoutEnaRA/SR_Flip_Flop" /begin REF_MEASUREMENT TQDMP_flgTipOutEnaRA /end REF_MEASUREMENT /end GROUP
/begin GROUP S1264_Calculate_ChargeCurrentLimitBuffer_Full "VBU0428Test/VBUSystem/BMS/SOF/Subsystem6/Subsystem/Determine_Currentlimit_Target/Calculate_CurrentLimit_Target/Calculate_Dynamic_CurrentLimit/Calculate_Dynamic_ChargeCurrentLimit/Calculate_ChargeCurrentLimit_Buff/Calculate_ChargeCurrentLimitBuffer_Full"
 /begin REF_CHARACTERISTIC CaSOF_ChargeCurrentLimitBufferTimeSocTempMapDimension_n CaSOF_ChargeCurrentLimitBufferTimeSocTempMapZ_s /end REF_CHARACTERISTIC
 /begin REF_MEASUREMENT SOF_AsChargeCurrentLimitBufferFull /end REF_MEASUREMENT
/end GROUP
/begin GROUP S1264_Calculate_ChargeCurrentLimitBuffer_Use "VBU0428Test/VBUSystem/BMS/SOF/Subsystem6/Subsystem/Determine_Currentlimit_Target/Calculate_CurrentLimit_Target/Calculate_Dynamic_CurrentLimit/Calculate_Dynamic_ChargeCurrentLimit/Calculate_ChargeCurrentLimit_Buff/Calculate_ChargeCurrentLimitBuffer_Use" /begin REF_CHARACTERISTIC CcSOF_ChargeCurrentLimitViolateBuffer_A /end REF_CHARACTERISTIC /begin REF_MEASUREMENT SOF_AsChargeCurrentLimitBufferUse /end REF_MEASUREMENT /end GROUP
/begin GROUP S1265_Buffer_Used "VBU0428Test/VBUSystem/BMS/SOF/Subsystem6/Subsystem/Determine_Currentlimit_Target/Calculate_CurrentLimit_Target/Calculate_Dynamic_CurrentLimit/Calculate_Dynamic_ChargeCurrentLimit/Calculate_Dynamic_ChargeCurrentLimit/Buffer_Used" /begin REF_MEASUREMENT SOF_iADynamicChargeCurrentLimitFastChrgChk /end REF_MEASUREMENT /end GROUP
/begin GROUP S1272_Calculate_DischargeCurrentLimitBuffer_Full "VBU0428Test/VBUSystem/BMS/SOF/Subsystem6/Subsystem/Determine_Currentlimit_Target/Calculate_CurrentLimit_Target/Calculate_Dynamic_CurrentLimit/Calculate_Dynamic_DischargeCurrentLimit/Calculate_DischargeCurrentLimit_Buff/Calculate_DischargeCurrentLimitBuffer_Full"
 /begin REF_CHARACTERISTIC CaSOF_DischargeCurrentLimitBufferTimeSocTempMapDimension_n CaSOF_DischargeCurrentLimitBufferTimeSocTempMapZ_s /end REF_CHARACTERISTIC
 /begin REF_MEASUREMENT SOF_AsDischargeCurrentLimitBufferFull /end REF_MEASUREMENT
/end GROUP
/begin GROUP S1272_Calculate_DischargeCurrentLimitBuffer_Use "VBU0428Test/VBUSystem/BMS/SOF/Subsystem6/Subsystem/Determine_Currentlimit_Target/Calculate_CurrentLimit_Target/Calculate_Dynamic_CurrentLimit/Calculate_Dynamic_DischargeCurrentLimit/Calculate_DischargeCurrentLimit_Buff/Calculate_DischargeCurrentLimitBuffer_Use"
 /begin REF_CHARACTERISTIC CaSOF_BuffUseFactorCurrtLTCurrtMapDimension_n CaSOF_BuffUseFactorCurrtLTCurrtMapZ_n CaSOF_BuffUseFactorSocTempMapDimension_n CaSOF_BuffUseFactorSocTempMapZ_n /end REF_CHARACTERISTIC
 /begin REF_MEASUREMENT SOF_AsDischargeCurrentLimitBufferUse /end REF_MEASUREMENT
/end GROUP
/begin GROUP S1273_Rate_Limiter "VBU0428Test/VBUSystem/BMS/SOF/Subsystem6/Subsystem/Determine_Currentlimit_Target/Calculate_CurrentLimit_Target/Calculate_Dynamic_CurrentLimit/Calculate_Dynamic_DischargeCurrentLimit/Calculate_Dynamic_DischargeCurrentLimit/Rate_Limiter"
 /begin REF_CHARACTERISTIC CcSOF_DischaOverCurFactorSlopeDec_n CcSOF_DischaOverCurFactorSlopeInc_n /end REF_CHARACTERISTIC
/end GROUP
/begin GROUP S1292_FastCharge_Calculation "VBU0428Test/VBUSystem/BMS/SOF/Subsystem6/Subsystem/Determine_Currentlimit_Target/Calculate_CurrentLimit_Target/CurrentLimit_FastCharge_Check/SegmentChargeCheck/FastCharge/FastCharge_Calculation" /begin SUB_GROUP S1294_Determine_FastCharge_Conditions /end SUB_GROUP
 /begin REF_CHARACTERISTIC CcSOF_FastChargeCurrentStep1_A CcSOF_FastChargeCurrentStep2_A CcSOF_FastChargeSocStep1_pct /end REF_CHARACTERISTIC
/end GROUP
/begin GROUP S1321_Calculate_Cell_Discharge_DCIR "VBU0428Test/VBUSystem/BMS/SOF/Subsystem6/Subsystem/Determine_Currentlimit_Target/Calculate_CurrentLimit_Target/CurrentLimit_Voltage_Correct/Correct_CurrentLimit/Calculate_CurrentLimit/Calculate_Cell_Discharge_DCIR" /begin SUB_GROUP S1324_Calculate_DCIR_Validation S1324_Calculate_Enable /end SUB_GROUP /end GROUP
/begin GROUP S1321_Rate_Limiter1 "VBU0428Test/VBUSystem/BMS/SOF/Subsystem6/Subsystem/Determine_Currentlimit_Target/Calculate_CurrentLimit_Target/CurrentLimit_Voltage_Correct/Correct_CurrentLimit/Calculate_CurrentLimit/Rate_Limiter1"
 /begin REF_CHARACTERISTIC CcSOF_DischargeVoltageCorrectSlopeDec_n CcSOF_DischargeVoltageCorrectSlopeInc_n /end REF_CHARACTERISTIC
/end GROUP
/begin GROUP S1321_Rate_Limiter_Reset "VBU0428Test/VBUSystem/BMS/SOF/Subsystem6/Subsystem/Determine_Currentlimit_Target/Calculate_CurrentLimit_Target/CurrentLimit_Voltage_Correct/Correct_CurrentLimit/Calculate_CurrentLimit/Rate_Limiter_Reset" /begin REF_MEASUREMENT SOF_iADynamicDischargeCurrentLimitVltgDcirTarget /end REF_MEASUREMENT /end GROUP
/begin GROUP S1322_Set_ChargeVoltageCorrect_level1 "VBU0428Test/VBUSystem/BMS/SOF/Subsystem6/Subsystem/Determine_Currentlimit_Target/Calculate_CurrentLimit_Target/CurrentLimit_Voltage_Correct/Correct_CurrentLimit/Determine_VoltageCorrect_level/Set_ChargeVoltageCorrect_level1"
 /begin REF_CHARACTERISTIC CcSOF_CellVoltageHigh1_mV CcSOF_VoltageCorrectCheckInc1_n CcSOF_VoltageCorrectEnableInc1_n SOF_VOLTAGE_CORRECT_LEVEL1 SOF_VOLTAGE_CORRECT_NONE /end REF_CHARACTERISTIC
/end GROUP
/begin GROUP S1322_Set_ChargeVoltageCorrect_level2 "VBU0428Test/VBUSystem/BMS/SOF/Subsystem6/Subsystem/Determine_Currentlimit_Target/Calculate_CurrentLimit_Target/CurrentLimit_Voltage_Correct/Correct_CurrentLimit/Determine_VoltageCorrect_level/Set_ChargeVoltageCorrect_level2"
 /begin REF_CHARACTERISTIC CcSOF_CellVoltageHigh2_mV CcSOF_VoltageCorrectCheckInc2_n CcSOF_VoltageCorrectEnableInc2_n SOF_VOLTAGE_CORRECT_LEVEL2 SOF_VOLTAGE_CORRECT_NONE /end REF_CHARACTERISTIC
/end GROUP
/begin GROUP S1322_Set_ChargeVoltageCorrect_level3 "VBU0428Test/VBUSystem/BMS/SOF/Subsystem6/Subsystem/Determine_Currentlimit_Target/Calculate_CurrentLimit_Target/CurrentLimit_Voltage_Correct/Correct_CurrentLimit/Determine_VoltageCorrect_level/Set_ChargeVoltageCorrect_level3"
 /begin REF_CHARACTERISTIC CcSOF_CellVoltageHigh3_mV CcSOF_VoltageCorrectCheckInc3_n CcSOF_VoltageCorrectEnableInc3_n SOF_VOLTAGE_CORRECT_LEVEL3 SOF_VOLTAGE_CORRECT_NONE /end REF_CHARACTERISTIC
/end GROUP
/begin GROUP S1322_Set_ChargeVoltageCorrect_level4 "VBU0428Test/VBUSystem/BMS/SOF/Subsystem6/Subsystem/Determine_Currentlimit_Target/Calculate_CurrentLimit_Target/CurrentLimit_Voltage_Correct/Correct_CurrentLimit/Determine_VoltageCorrect_level/Set_ChargeVoltageCorrect_level4"
 /begin REF_CHARACTERISTIC CcSOF_BatteryCurrentLow_A CcSOF_CellVoltageHigh4_mV CcSOF_VoltageCorrectCheckInc4_n CcSOF_VoltageCorrectEnableInc4_n SOF_VOLTAGE_CORRECT_LEVEL4 SOF_VOLTAGE_CORRECT_NONE /end REF_CHARACTERISTIC
/end GROUP
/begin GROUP S1322_Set_DischargeVoltageCorrect_level1 "VBU0428Test/VBUSystem/BMS/SOF/Subsystem6/Subsystem/Determine_Currentlimit_Target/Calculate_CurrentLimit_Target/CurrentLimit_Voltage_Correct/Correct_CurrentLimit/Determine_VoltageCorrect_level/Set_DischargeVoltageCorrect_level1"
 /begin REF_CHARACTERISTIC CcSOF_CellVoltageLow1_mV CcSOF_VoltageCorrectCheckInc1_n CcSOF_VoltageCorrectEnableInc1_n SOF_VOLTAGE_CORRECT_LEVEL1 SOF_VOLTAGE_CORRECT_NONE /end REF_CHARACTERISTIC
/end GROUP
/begin GROUP S1322_Set_DischargeVoltageCorrect_level2 "VBU0428Test/VBUSystem/BMS/SOF/Subsystem6/Subsystem/Determine_Currentlimit_Target/Calculate_CurrentLimit_Target/CurrentLimit_Voltage_Correct/Correct_CurrentLimit/Determine_VoltageCorrect_level/Set_DischargeVoltageCorrect_level2"
 /begin REF_CHARACTERISTIC CcSOF_CellVoltageLow2_mV CcSOF_VoltageCorrectCheckInc2_n CcSOF_VoltageCorrectEnableInc2_n SOF_VOLTAGE_CORRECT_LEVEL2 SOF_VOLTAGE_CORRECT_NONE /end REF_CHARACTERISTIC
/end GROUP
/begin GROUP S1322_Set_DischargeVoltageCorrect_level3 "VBU0428Test/VBUSystem/BMS/SOF/Subsystem6/Subsystem/Determine_Currentlimit_Target/Calculate_CurrentLimit_Target/CurrentLimit_Voltage_Correct/Correct_CurrentLimit/Determine_VoltageCorrect_level/Set_DischargeVoltageCorrect_level3"
 /begin REF_CHARACTERISTIC CcSOF_CellVoltageLow3_mV CcSOF_VoltageCorrectCheckInc3_n CcSOF_VoltageCorrectEnableInc3_n SOF_VOLTAGE_CORRECT_LEVEL3 SOF_VOLTAGE_CORRECT_NONE /end REF_CHARACTERISTIC
/end GROUP
/begin GROUP S1322_Set_DischargeVoltageCorrect_level4 "VBU0428Test/VBUSystem/BMS/SOF/Subsystem6/Subsystem/Determine_Currentlimit_Target/Calculate_CurrentLimit_Target/CurrentLimit_Voltage_Correct/Correct_CurrentLimit/Determine_VoltageCorrect_level/Set_DischargeVoltageCorrect_level4"
 /begin REF_CHARACTERISTIC CcSOF_BatteryCurrentLow_A CcSOF_CellVoltageLow4_mV CcSOF_VoltageCorrectCheckInc4_n CcSOF_VoltageCorrectEnableInc4_n SOF_VOLTAGE_CORRECT_LEVEL4 SOF_VOLTAGE_CORRECT_NONE /end REF_CHARACTERISTIC
/end GROUP
/begin GROUP S1294_Determine_FastCharge_Conditions "VBU0428Test/VBUSystem/BMS/SOF/Subsystem6/Subsystem/Determine_Currentlimit_Target/Calculate_CurrentLimit_Target/CurrentLimit_FastCharge_Check/SegmentChargeCheck/FastCharge/FastCharge_Calculation/Determine_FastCharge_Conditions" /begin SUB_GROUP S1295_Condition1 S1295_Condition2 S1295_Condition3 /end SUB_GROUP /end GROUP
/begin GROUP S1324_Calculate_DCIR_Validation "VBU0428Test/VBUSystem/BMS/SOF/Subsystem6/Subsystem/Determine_Currentlimit_Target/Calculate_CurrentLimit_Target/CurrentLimit_Voltage_Correct/Correct_CurrentLimit/Calculate_CurrentLimit/Calculate_Cell_Discharge_DCIR/Calculate_DCIR_Validation"
 /begin REF_CHARACTERISTIC CcSOF_CellDischargeDcirMax_mOhm CcSOF_CellDischargeDcirMin_mOhm CcSOF_OriginalDcirDispersion_pct /end REF_CHARACTERISTIC
 /begin REF_MEASUREMENT SOF_flgCellDischargeDcirCalcValid SOF_mohmCellDischargeDcirCalc /end REF_MEASUREMENT
/end GROUP
/begin GROUP S1324_Calculate_Enable "VBU0428Test/VBUSystem/BMS/SOF/Subsystem6/Subsystem/Determine_Currentlimit_Target/Calculate_CurrentLimit_Target/CurrentLimit_Voltage_Correct/Correct_CurrentLimit/Calculate_CurrentLimit/Calculate_Cell_Discharge_DCIR/Calculate_Enable" /begin REF_CHARACTERISTIC CcSOF_DcirDelayTimes_n CcSOF_DcirDeltaCurrentMin_A /end REF_CHARACTERISTIC /end GROUP
/begin GROUP S1295_Condition1 "VBU0428Test/VBUSystem/BMS/SOF/Subsystem6/Subsystem/Determine_Currentlimit_Target/Calculate_CurrentLimit_Target/CurrentLimit_FastCharge_Check/SegmentChargeCheck/FastCharge/FastCharge_Calculation/Determine_FastCharge_Conditions/Condition1"
 /begin REF_CHARACTERISTIC CcSOF_FastChargeDisableTempUpperLimit_C CcSOF_FastChargeEnableSocLowerLimit_pct CcSOF_FastChargeEnableSocUpperLimit_pct CcSOF_FastChargeEnableTempLowerLimit_C /end REF_CHARACTERISTIC
/end GROUP
/begin GROUP S1295_Condition2 "VBU0428Test/VBUSystem/BMS/SOF/Subsystem6/Subsystem/Determine_Currentlimit_Target/Calculate_CurrentLimit_Target/CurrentLimit_FastCharge_Check/SegmentChargeCheck/FastCharge/FastCharge_Calculation/Determine_FastCharge_Conditions/Condition2"
 /begin REF_CHARACTERISTIC CcSOF_FastChargeEnableSocLowerLimit_pct CcSOF_FastChargeEnableSocUpperLimit_pct CcSOF_FastChargeEnableTempLowerLimit_C CcSOF_FastChargeRecoverTempUpperLimit_C /end REF_CHARACTERISTIC
/end GROUP
/begin GROUP S1295_Condition3 "VBU0428Test/VBUSystem/BMS/SOF/Subsystem6/Subsystem/Determine_Currentlimit_Target/Calculate_CurrentLimit_Target/CurrentLimit_FastCharge_Check/SegmentChargeCheck/FastCharge/FastCharge_Calculation/Determine_FastCharge_Conditions/Condition3"
 /begin REF_CHARACTERISTIC CcSOF_FastChargeDisableTempLowerLimit_C CcSOF_FastChargeDisableTempUpperLimit_C CcSOF_FastChargeEnableSocLowerLimit_pct CcSOF_FastChargeEnableSocUpperLimit_pct /end REF_CHARACTERISTIC
/end GROUP
/end MODULE
/end PROJECT
